ASAP2_VERSION 1 60
/begin PROJECT FC33 ""
/begin HEADER "" VERSION "1.0" /end HEADER
/begin MODULE FC33 ""
/begin MOD_COMMON "" BYTE_ORDER MSB_FIRST ALIGNMENT_LONG 2 ALIGNMENT_WORD 1 /end MOD_COMMON
/begin MEASUREMENT aux_ethst_ect_mmv "filtered ect used by electrical thermostat" SWORD u_deg_C 0 0 -256 255.9921875 ECU_ADDRESS 0x4000DA4E /end MEASUREMENT
/begin MEASUREMENT aux_ethst_ect_sp "electrical thermostat ect setpoint" SWORD u_deg_C 0 0 -256 255.9921875 ECU_ADDRESS 0x4000DA4E /end MEASUREMENT
/begin MEASUREMENT aux_ethst_sp_a "electrical thermostat ect setpoint a" SWORD u_deg_C 0 0 -256 255.9921875 ECU_ADDRESS 0x4000DA4E /end MEASUREMENT
/begin MEASUREMENT aux_ethst_sp_b "electrical thermostat ect setpoint b" SWORD u_deg_C 0 0 -256 255.9921875 ECU_ADDRESS 0x4000DA4E /end MEASUREMENT
/begin MEASUREMENT aux_ethst_sp_c "electrical thermostat ect setpoint c" SWORD u_deg_C 0 0 -256 255.9921875 ECU_ADDRESS 0x4000DA4E /end MEASUREMENT
/begin MEASUREMENT aux_ethst_sp_typ "electrical thermostat ect setpoint type" UBYTE u_ethst_sp_typ 0 0 0.0 3.0 ECU_ADDRESS 0x4000DA4E FORMAT "%1.0" /end MEASUREMENT
/begin MEASUREMENT aux_ethst_ctrl_en "electrical thermostat control enable" UBYTE b_true 0 0 0.0 1.0 ECU_ADDRESS 0x4000DA4E FORMAT "%1.0" /end MEASUREMENT
/begin MEASUREMENT aux_ethst_flw_pct_mmv "stroke flow percent" UWORD u_pct_8 0 0 0.0 799.98779296875 ECU_ADDRESS 0x4000DA4E FORMAT "%4.3" /end MEASUREMENT
/begin MEASUREMENT aux_ethst_dty_bs "electrical thermostat control duty base" SWORD u_pct_s 0 0 -200 199.993896484375 ECU_ADDRESS 0x4000DA4E /end MEASUREMENT
/begin MEASUREMENT aux_ethst_p_dty "electrical thermostat control duty prop" SWORD u_pct_s 0 0 -200 199.993896484375 ECU_ADDRESS 0x4000DA4E /end MEASUREMENT
/begin MEASUREMENT aux_ethst_int_dty_dlt "electrical thermostat control duty int delta" SWORD u_pct_s 0 0 -200 199.993896484375 ECU_ADDRESS 0x4000DA4E /end MEASUREMENT
/begin MEASUREMENT aux_ethst_int_dty "electrical thermostat control duty int" SWORD u_pct_s 0 0 -200 199.993896484375 ECU_ADDRESS 0x4000DA4E /end MEASUREMENT
/begin MEASUREMENT aux_ethst_dty_raw "electrical thermostat control duty raw" SWORD u_pct_s 0 0 -200 199.993896484375 ECU_ADDRESS 0x4000DA4E /end MEASUREMENT
/begin MEASUREMENT aux_ethst_dty_fnl "electrical thermostat control duty final" SWORD u_pct_s 0 0 -200 199.993896484375 ECU_ADDRESS 0x4000DA4E /end MEASUREMENT
/begin MEASUREMENT vvt_vlv_ovlp_ang "ect bias of base ignition angle" SWORD u_iga 0 0 -256.0 255.9921875 ECU_ADDRESS 0x4000DA4E FORMAT "%4.2" /end MEASUREMENT
/begin MEASUREMENT vvt_b1_intk_sp "bank1 intake vvt setpoint" SWORD u_iga 0 0 -256.0 255.9921875 ECU_ADDRESS 0x4000DA4E FORMAT "%4.2" /end MEASUREMENT
/begin MEASUREMENT vvt_b1_exh_sp "bank1 exhaust vvt setpoint" SWORD u_iga 0 0 -256.0 255.9921875 ECU_ADDRESS 0x4000DA4E FORMAT "%4.2" /end MEASUREMENT
/begin MEASUREMENT vvt_b1_intk_act "bank1 intake vvt actual position" SWORD u_iga 0 0 -256.0 255.9921875 ECU_ADDRESS 0x4000DA4E FORMAT "%4.2" /end MEASUREMENT
/begin MEASUREMENT vvt_b1_exh_act "bank1 exhaust vvt actual position" SWORD u_iga 0 0 -256.0 255.9921875 ECU_ADDRESS 0x4000DA4E FORMAT "%4.2" /end MEASUREMENT
/begin MEASUREMENT vvt_intk_abs_sp_lmtd "intake setpoint limited abs value" SWORD u_iga_abs 0 0 0.000000 1023.984375 ECU_ADDRESS 0x4000DA4E FORMAT "%4.2" /end MEASUREMENT
/begin MEASUREMENT vvt_intk_sp_dlt "intake setpoint change delta" SWORD u_cam_ang_hi 0 0 0.000000 63.9990234375 ECU_ADDRESS 0x4000DA4E /end MEASUREMENT
/begin MEASUREMENT vvt_intk_b1_pos_err "intake position error" SWORD u_iga 0 0 -256.0 255.9921875 ECU_ADDRESS 0x4000DA4E FORMAT "%4.2" /end MEASUREMENT
/begin MEASUREMENT vvt_exh_b1_pos_err "intake position error" SWORD u_iga 0 0 -256.0 255.9921875 ECU_ADDRESS 0x4000DA4E FORMAT "%4.2" /end MEASUREMENT
/begin MEASUREMENT vvt_actv_cnds_met "bank1 intake vvt setpoint" UBYTE b_true 0 0 0.00 1.00 BIT_MASK 0x1 ECU_ADDRESS 0x4000DA4E FORMAT "%4.2" /end MEASUREMENT
/begin MEASUREMENT vvt_intk_err_rt "intake position error ratio" SWORD u_fac_n32_p32 0 0 -32.0 31.9990234375 ECU_ADDRESS 0x4000DA4E /end MEASUREMENT
/begin MEASUREMENT vvt_exh_err_rt "exhaust position error ratio" SWORD u_fac_n32_p32 0 0 -32.0 31.9990234375 ECU_ADDRESS 0x4000DA4E /end MEASUREMENT
/begin MEASUREMENT osht_ht_en_met "o2 heater enable met" UBYTE b_true 0 0 0.00 1.00 ECU_ADDRESS 0x400050DA FORMAT "%1.0" /end MEASUREMENT
/begin MEASUREMENT osht_uo2_ht_st "up o2 heater state" UBYTE u_o2_ht_st 0 0 0.00 6.00 ECU_ADDRESS 0x400050DA FORMAT "%1.0" /end MEASUREMENT
/begin MEASUREMENT osht_do2_ht_st "up o2 heater state" UBYTE u_o2_ht_st 0 0 0.00 6.00 ECU_ADDRESS 0x400050DA FORMAT "%1.0" SYMBOL_LINK "osht_do2_ht_st" 1 /end MEASUREMENT
/begin MEASUREMENT osht_mdl_exh_t "model exhaust temp" UWORD u_deg_K 0 0 0.00 2047.96875 ECU_ADDRESS 0x400050DA FORMAT "%5.1" /end MEASUREMENT
/begin MEASUREMENT osht_mdl_exh_t_mmv "model exhaust temp filted" UWORD u_deg_K 0 0 0.00 2047.96875 ECU_ADDRESS 0x400050DA FORMAT "%5.1" /end MEASUREMENT
/begin MEASUREMENT osht_cool_exh_t_mmv "model exhaust temp filted when hyb engine stop" UWORD u_deg_K 0 0 0.00 2047.96875 ECU_ADDRESS 0x400050DA FORMAT "%5.1" /end MEASUREMENT
/begin MEASUREMENT osht_mdl_exh_vld_tmr "model exh temp valid timer" UWORD u_16x_tmr 0 0 0.00 8191.875 ECU_ADDRESS 0x400050DA SYMBOL_LINK "osht_ctrl_tmr" 0 /end MEASUREMENT
/begin MEASUREMENT osht_eng_stp_tmr "engine stop timer" UWORD u_16x_tmr 0 0 0.00 8191.875 ECU_ADDRESS 0x400050DA SYMBOL_LINK "osht_ctrl_tmr" 2 /end MEASUREMENT
/begin MEASUREMENT osht_eng_stop_actv "engine stop active" UBYTE b_true 0 0 0.00 1.00 ECU_ADDRESS 0x400050DA FORMAT "%1.0" /end MEASUREMENT
/begin MEASUREMENT osht_eng_stop_actv_lst "engine stop active" UBYTE b_true 0 0 0.00 1.00 ECU_ADDRESS 0x400050DA FORMAT "%1.0" /end MEASUREMENT
/begin MEASUREMENT osht_hyb_restart "hyb restart active" UBYTE b_true 0 0 0.00 1.00 ECU_ADDRESS 0x400050DA FORMAT "%1.0" /end MEASUREMENT
/begin MEASUREMENT osht_uo2_dew_reach "up o2 dew point reached" UBYTE u_dew_st 0 0 0.00 2.00 ECU_ADDRESS 0x400050DA FORMAT "%1.0" SYMBOL_LINK "osht_dew_reach" 0 /end MEASUREMENT
/begin MEASUREMENT osht_do2_dew_reach "down o2 dew point reached" UBYTE u_dew_st 0 0 0.00 2.00 ECU_ADDRESS 0x400050DA FORMAT "%1.0" SYMBOL_LINK "osht_dew_reach" 1 /end MEASUREMENT
/begin MEASUREMENT osht_uo2_dew_reach_nv "up o2 dew point reached last trip" UBYTE u_dew_st 0 0 0.00 2.00 ECU_ADDRESS 0x400050DA FORMAT "%1.0" SYMBOL_LINK "osht_dew_reach_nv" 0 /end MEASUREMENT
/begin MEASUREMENT osht_do2_dew_reach_nv "down o2 dew point reached last trip" UBYTE u_dew_st 0 0 0.00 2.00 ECU_ADDRESS 0x400050DA FORMAT "%1.0" SYMBOL_LINK "osht_dew_reach_nv" 1 /end MEASUREMENT
/begin MEASUREMENT osht_fuel_int "fuel int" ULONG u_gram_l_65536 0 0 0.00 65535.9999847412109375 ECU_ADDRESS 0x400050DA FORMAT "%6.1" /end MEASUREMENT
/begin MEASUREMENT osht_fuel_int_thr "fuel int thr" ULONG u_gram_l_65536 0 0 0.00 65535.9999847412109375 ECU_ADDRESS 0x400050DA FORMAT "%6.1" /end MEASUREMENT
/begin MEASUREMENT osht_fuel_int_met "fuel int condition met" UBYTE b_true 0 0 0.00 1.00 ECU_ADDRESS 0x400050DA FORMAT "%1.0" /end MEASUREMENT
/begin MEASUREMENT osht_uo2_dly_bias "uo2 heater delay bias" UWORD u_500m_tmr 0 0 0.00 32767.5 ECU_ADDRESS 0x400050DA FORMAT "%5.1" SYMBOL_LINK "osht_dly_bias" 0 /end MEASUREMENT
/begin MEASUREMENT osht_do2_dly_bias "do2 heater delay bias" UWORD u_500m_tmr 0 0 0.00 32767.5 ECU_ADDRESS 0x400050DA FORMAT "%5.1" SYMBOL_LINK "osht_dly_bias" 2 /end MEASUREMENT
/begin MEASUREMENT osht_uo2_ht_dly "uo2 heater delay" UWORD u_500m_tmr 0 0 0.00 32767.5 ECU_ADDRESS 0x400050DA FORMAT "%5.1" SYMBOL_LINK "osht_ht_dly" 0 /end MEASUREMENT
/begin MEASUREMENT osht_do2_ht_dly "uo2 heater delay" UWORD u_500m_tmr 0 0 0.00 32767.5 ECU_ADDRESS 0x400050DA FORMAT "%5.1" SYMBOL_LINK "osht_ht_dly" 2 /end MEASUREMENT
/begin MEASUREMENT osht_uo2_dly_tmr "uo2 heater delay" UWORD u_16x_tmr 0 0 0.00 8191.875 ECU_ADDRESS 0x400050DA SYMBOL_LINK "osht_ht_dly" 0 /end MEASUREMENT
/begin MEASUREMENT osht_do2_dly_tmr "do2 heater delay" UWORD u_16x_tmr 0 0 0.00 8191.875 ECU_ADDRESS 0x400050DA SYMBOL_LINK "osht_ht_dly" 2 /end MEASUREMENT
/begin MEASUREMENT osht_uo2_ht_dly_fn "uo2 heater delay finish" UBYTE b_true 0 0 0.00 1.00 ECU_ADDRESS 0x400050DA FORMAT "%1.0" SYMBOL_LINK "osht_ht_dly_fn" 0 /end MEASUREMENT
/begin MEASUREMENT osht_do2_ht_dly_fn "do2 heater delay finish" UBYTE b_true 0 0 0.00 1.00 ECU_ADDRESS 0x400050DA FORMAT "%1.0" SYMBOL_LINK "osht_ht_dly_fn" 1 /end MEASUREMENT
/begin MEASUREMENT osht_eng_warm_fn "engine warm up finish" UBYTE b_true 0 0 0.00 1.00 ECU_ADDRESS 0x400050DA FORMAT "%1.0" /end MEASUREMENT
/begin MEASUREMENT osht_ht_ss "all heater at steady state" UBYTE b_true 0 0 0.00 1.00 ECU_ADDRESS 0x400050DA FORMAT "%1.0" /end MEASUREMENT
/begin MEASUREMENT osht_mdl_exh_vld "modle exh temp valid" UBYTE b_true 0 0 0.00 1.00 ECU_ADDRESS 0x400050DA FORMAT "%1.0" /end MEASUREMENT
/begin MEASUREMENT osht_uo2_rmp_tmr "uo2 heater ramp timer" UWORD u_16x_tmr 0 0 0.00 8191.875 ECU_ADDRESS 0x400050DA SYMBOL_LINK "osht_rmp_tmr" 0 /end MEASUREMENT
/begin MEASUREMENT osht_do2_rmp_tmr "uo2 heater ramp timer" UWORD u_16x_tmr 0 0 0.00 8191.875 ECU_ADDRESS 0x400050DA SYMBOL_LINK "osht_rmp_tmr" 2 /end MEASUREMENT
/begin MEASUREMENT osht_uo2_dty_base "uo2 heater duty base" UWORD u_pct 0 0 0.00 199.996948242187 ECU_ADDRESS 0x400050DA FORMAT "%4.1" SYMBOL_LINK "osht_dty_base" 0 /end MEASUREMENT
/begin MEASUREMENT osht_do2_dty_base "do2 heater duty base" UWORD u_pct 0 0 0.00 199.996948242187 ECU_ADDRESS 0x400050DA FORMAT "%4.1" SYMBOL_LINK "osht_dty_base" 2 /end MEASUREMENT
/begin MEASUREMENT osht_uo2_ht_vlt "uo2 heater voltage" UWORD u_volt_32 0 0 0.00 31.99951171875 ECU_ADDRESS 0x400050DA FORMAT "%4.2" SYMBOL_LINK "osht_ht_vlt" 0 /end MEASUREMENT
/begin MEASUREMENT osht_do2_ht_vlt "do2 heater voltage" UWORD u_volt_32 0 0 0.00 31.99951171875 ECU_ADDRESS 0x400050DA FORMAT "%4.2" SYMBOL_LINK "osht_ht_vlt" 2 /end MEASUREMENT
/begin MEASUREMENT osht_ovr_temp "heater over temp" UBYTE b_true 0 0 0.00 1.00 ECU_ADDRESS 0x400050DA FORMAT "%1.0" /end MEASUREMENT
/begin MEASUREMENT osht_uo2_fco_actv "up o2 fuel cut active" UBYTE b_true 0 0 0.00 1.00 ECU_ADDRESS 0x400050DA FORMAT "%1.0" SYMBOL_LINK "osht_fco_actv" 0 /end MEASUREMENT
/begin MEASUREMENT osht_do2_fco_actv "down o2 fuel cut active" UBYTE b_true 0 0 0.00 1.00 ECU_ADDRESS 0x400050DA FORMAT "%1.0" SYMBOL_LINK "osht_fco_actv" 1 /end MEASUREMENT
/begin MEASUREMENT osht_uo2_dty_fn "uo2 heater duty final" UWORD u_pct 0 0 0.00 199.996948242187 ECU_ADDRESS 0x400050DA FORMAT "%4.1" SYMBOL_LINK "osht_dty_fn" 0 /end MEASUREMENT
/begin MEASUREMENT osht_do2_dty_fn "do2 heater duty final" UWORD u_pct 0 0 0.00 199.996948242187 ECU_ADDRESS 0x400050DA FORMAT "%4.1" SYMBOL_LINK "osht_dty_fn" 2 /end MEASUREMENT
/begin MEASUREMENT offt_off_dur_nv "power off duration" UWORD u_min 0 0 0.0 65535 ECU_ADDRESS 0x4000440A FORMAT "%5.2" /end MEASUREMENT
/begin MEASUREMENT offt_flt_actv "Power off fault active." UBYTE b_true 0 0 0.00 1.00 BIT_MASK 0x1 ECU_ADDRESS 0x4000440A FORMAT "%1.0" /end MEASUREMENT
/begin MEASUREMENT ensc_eng_idl "engine idle conditions met" UBYTE b_true 0 0 0.00 1.00 BIT_MASK 0x1 ECU_ADDRESS 0x4000440A FORMAT "%1.0" /end MEASUREMENT
/begin MEASUREMENT ensc_idl_sp "Idle engine speed setpoint" UWORD u_espd 0 0 0 8191.875 ECU_ADDRESS 0x400052D4 FORMAT "%6.2" /end MEASUREMENT
/begin MEASUREMENT ensc_idl_bas "base idle engine speed setpoint" UWORD u_espd 0 0 0 8191.875 ECU_ADDRESS 0x400052D4 FORMAT "%6.2" /end MEASUREMENT
/begin MEASUREMENT ensc_idl_cat_ht_bias "catalyst heating bias of engine speed setpoint" UWORD u_espd 0 0 0 8191.875 ECU_ADDRESS 0x400052D4 FORMAT "%6.2" /end MEASUREMENT
/begin MEASUREMENT ensc_idl_st_bias "engine start bias of engine speed setpoint" UWORD u_espd 0 0 0 8191.875 ECU_ADDRESS 0x400052D4 FORMAT "%6.2" /end MEASUREMENT
/begin MEASUREMENT ensc_idl_dev_bias "high engine speed deviation bias of engine speed setpoint" UWORD u_espd 0 0 0 8191.875 ECU_ADDRESS 0x400052D4 FORMAT "%6.2" /end MEASUREMENT
/begin MEASUREMENT ensc_idl_ac_bias "AC bias of engine speed setpoint" UWORD u_espd 0 0 0 8191.875 ECU_ADDRESS 0x400052D4 FORMAT "%6.2" /end MEASUREMENT
/begin MEASUREMENT ensc_idl_eld_bias "Eload bias of engine speed setpoint" UWORD u_espd 0 0 0 8191.875 ECU_ADDRESS 0x400052D4 FORMAT "%6.2" /end MEASUREMENT
/begin MEASUREMENT ensc_idl_iat_bias "Eload bias of engine speed setpoint" UWORD u_espd 0 0 0 8191.875 ECU_ADDRESS 0x400052D4 FORMAT "%6.2" /end MEASUREMENT
/begin MEASUREMENT ensc_idl_bat_bias_en "enable status of espd sp low battery bias" UBYTE b_true 0 0 0.00 1.00 BIT_MASK 0x1 ECU_ADDRESS 0x4000440A FORMAT "%1.0" /end MEASUREMENT
/begin MEASUREMENT ensc_idl_ps "PS idle engine speed setpoint" UWORD u_espd 0 0 0 8191.875 ECU_ADDRESS 0x400052D4 FORMAT "%6.2" /end MEASUREMENT
/begin MEASUREMENT ensc_idl_evam "Evaporative monitor idle engine speed setpoint" UWORD u_espd 0 0 0 8191.875 ECU_ADDRESS 0x400052D4 FORMAT "%6.2" /end MEASUREMENT
/begin MEASUREMENT ensc_idl_can "can idle engine speed setpoint" UWORD u_espd 0 0 0 8191.875 ECU_ADDRESS 0x400052D4 FORMAT "%6.2" /end MEASUREMENT
/begin MEASUREMENT ensc_idl_cat_ht_min "catalyst heating idle engine speed setpoint min" UWORD u_espd 0 0 0 8191.875 ECU_ADDRESS 0x400052D4 FORMAT "%6.2" /end MEASUREMENT
/begin MEASUREMENT ensc_veh_in_gear "drivetrain engaged status true: MT/AMT or AT in gear" UBYTE b_true 0 0 0.00 1.00 BIT_MASK 0x1 ECU_ADDRESS 0x4000440A FORMAT "%1.0" /end MEASUREMENT
/begin MEASUREMENT ensc_idl_brk_off_min "break off idle engine speed setpoint min" UWORD u_espd 0 0 0 8191.875 ECU_ADDRESS 0x400052D4 FORMAT "%6.2" /end MEASUREMENT
/begin MEASUREMENT ensc_espd_dev "engine speed deviation between ensc_idl_sp and sys_eng_spd" SWORD u_espd_n4096_p4096 0 0 -4096 4095.875 ECU_ADDRESS 0x400052D4 /end MEASUREMENT
/begin MEASUREMENT ensc_espd_dev_avg "engine speed deviation between ensc_idl_sp and sys_espd_avg" SWORD u_espd_n4096_p4096 0 0 -4096 4095.875 ECU_ADDRESS 0x400052D4 /end MEASUREMENT
/begin MEASUREMENT ensc_espd_dev_filt "filtered engine speed deviation" UWORD u_espd 0 0 0 8191.875 ECU_ADDRESS 0x400052D4 FORMAT "%6.2" /end MEASUREMENT
/begin MEASUREMENT ensc_idl_st "idle control state" UBYTE u_idl_st 0 0 0 5 ECU_ADDRESS 0x400052D4 FORMAT "%1.0" /end MEASUREMENT
/begin MEASUREMENT ensc_espd_delt "engine speed delta over 50ms" SWORD u_espd_n256_p256 0 0 -256 255.9921875 ECU_ADDRESS 0x400052D4 /end MEASUREMENT
/begin MEASUREMENT ensc_idl_sp_filt "filtered value of Idle engine speed setpoint" UWORD u_espd 0 0 0 8191.875 ECU_ADDRESS 0x400052D4 FORMAT "%6.2" /end MEASUREMENT
/begin MEASUREMENT ensc_espd_filt_dev "engine speed deviation between ensc_idl_sp_filt and sys_eng_spd" SWORD u_espd_n4096_p4096 0 0 -4096 4095.875 ECU_ADDRESS 0x400052D4 /end MEASUREMENT
/begin MEASUREMENT ensc_mt_in_gr "MT transmission in gear flag" UBYTE b_true 0 0 0.00 1.00 BIT_MASK 0x1 ECU_ADDRESS 0x400050DA FORMAT "%1.0" /end MEASUREMENT
/begin MEASUREMENT ensc_trans_eng_dly "delay time before transmission gear shift engaged" UWORD u_2x_tmr 0 0 0.0 1023.984375 ECU_ADDRESS 0x4000DA4E /end MEASUREMENT
/begin MEASUREMENT ensc_gr_shft_actv "true means gear shift active" UBYTE b_true 0 0 0.00 1.00 BIT_MASK 0x1 ECU_ADDRESS 0x4000440A FORMAT "%1.0" /end MEASUREMENT
/begin MEASUREMENT ensc_ac_stat_chg "flag indicate that AC on condition met status has changed" UBYTE b_true 0 0 0.00 1.00 BIT_MASK 0x1 ECU_ADDRESS 0x40003F41 FORMAT "%1.0" /end MEASUREMENT
/begin MEASUREMENT ensc_ac_conds_met_prev "AC on condition met status previous loop" UBYTE b_true 0 0 0.00 1.00 BIT_MASK 0x1 ECU_ADDRESS 0x40003F41 FORMAT "%1.0" /end MEASUREMENT
/begin MEASUREMENT ensc_eld1_conds_met "Eload1 conditions met" UBYTE b_true 0 0 0.00 1.00 BIT_MASK 0x1 ECU_ADDRESS 0x40003F41 FORMAT "%1.0" /end MEASUREMENT
/begin MEASUREMENT ensc_eld2_conds_met "Eload2 conditions met" UBYTE b_true 0 0 0.00 1.00 BIT_MASK 0x1 ECU_ADDRESS 0x40003F41 FORMAT "%1.0" /end MEASUREMENT
/begin MEASUREMENT ensc_shft_dly_stat "auto transmission gear shift engaged delay status" UBYTE b_true 0 0 0.00 1.00 BIT_MASK 0x1 ECU_ADDRESS 0x40003F41 FORMAT "%1.0" /end MEASUREMENT
/begin MEASUREMENT ensc_idl_ps_typ "type of PS sensor used in idle control" UBYTE u_idle_ps_typ 0 0 0 2 ECU_ADDRESS 0x400017C8 FORMAT "%1.0" /end MEASUREMENT
/begin MEASUREMENT ensc_eld1_stat_chg "flag indicate that Eload1 on condition met status has changed" UBYTE b_true 0 0 0.00 1.00 BIT_MASK 0x1 ECU_ADDRESS 0x40003F41 FORMAT "%1.0" /end MEASUREMENT
/begin MEASUREMENT ensc_eld2_stat_chg "flag indicate that Eload2 on condition met status has changed" UBYTE b_true 0 0 0.00 1.00 BIT_MASK 0x1 ECU_ADDRESS 0x40003F41 FORMAT "%1.0" /end MEASUREMENT
/begin MEASUREMENT ensc_gr_lever_old "gear lever position status last loop" UBYTE u_at_gr_typ_1 0 0 0 9 ECU_ADDRESS 0x4000409D FORMAT "%1.0" /end MEASUREMENT
/begin MEASUREMENT ensc_at_gr_eng_stat "AT gear engaged status" UBYTE b_true 0 0 0.00 1.00 BIT_MASK 0x1 ECU_ADDRESS 0x40003F41 FORMAT "%1.0" /end MEASUREMENT
/begin MEASUREMENT ensc_gr_shft_fn "AT gear shift prograss finish" UBYTE b_true 0 0 0.00 1.00 BIT_MASK 0x1 ECU_ADDRESS 0x40003F41 FORMAT "%1.0" /end MEASUREMENT
/begin MEASUREMENT ensc_dr_shft_dly_stat "AT D2R R2D gear shift engaged delay status" UBYTE b_true 0 0 0.00 1.00 BIT_MASK 0x1 ECU_ADDRESS 0x40003F41 FORMAT "%1.0" /end MEASUREMENT
/begin MEASUREMENT ensc_dr_shft_fn "AT D2R R2D gear shift prograss finish" UBYTE b_true 0 0 0.00 1.00 BIT_MASK 0x1 ECU_ADDRESS 0x40003F41 FORMAT "%1.0" /end MEASUREMENT
/begin MEASUREMENT ensc_at_gr_eng_stat_old "AT gear engaged status last loop" UBYTE b_true 0 0 0.00 1.00 BIT_MASK 0x1 ECU_ADDRESS 0x40003F41 FORMAT "%1.0" /end MEASUREMENT
/begin MEASUREMENT ensc_at_gr_eng_stat_trans "true means transition of AT gear engaged status happen" UBYTE b_true 0 0 0.00 1.00 BIT_MASK 0x1 ECU_ADDRESS 0x40003F41 FORMAT "%1.0" /end MEASUREMENT
/begin MEASUREMENT ensc_idl_load_trans_stat "true means transition of idle engine load happen" UBYTE b_true 0 0 0.00 1.00 BIT_MASK 0x1 ECU_ADDRESS 0x40003F41 FORMAT "%1.0" /end MEASUREMENT
/begin MEASUREMENT ensc_idl_load_trans_dur "puc off duration" UWORD u_2x_tmr 0 0 0 1023.984375 ECU_ADDRESS 0x4000CF72 /end MEASUREMENT
/begin MEASUREMENT ensc_idl_lrn_cell_chg "change status of idle int term adp cell number" UBYTE b_true 0 0 0.00 1.00 BIT_MASK 0x1 ECU_ADDRESS 0x40003F41 FORMAT "%1.0" /end MEASUREMENT
/begin MEASUREMENT ensc_idl_adp_cell "idle int term adp cell number" UBYTE u_idl_lrn_cell 0 0 0.00 6.00 ECU_ADDRESS 0x40003C59 FORMAT "%3.0" /end MEASUREMENT
/begin MEASUREMENT ensc_nm_pid_conds_met "true means normal idle PID conditions met" UBYTE b_true 0 0 0.00 1.00 BIT_MASK 0x1 ECU_ADDRESS 0x40003F41 FORMAT "%1.0" /end MEASUREMENT
/begin MEASUREMENT ensc_nm_pd_conds_met "true means normal idle PD conditions met" UBYTE b_true 0 0 0.00 1.00 BIT_MASK 0x1 ECU_ADDRESS 0x40003F41 FORMAT "%1.0" /end MEASUREMENT
/begin MEASUREMENT ensc_nm_pid_en "true means normal idle PID enable conditions met" UBYTE b_true 0 0 0.00 1.00 BIT_MASK 0x1 ECU_ADDRESS 0x40003F41 FORMAT "%1.0" /end MEASUREMENT
/begin MEASUREMENT ensc_nm_pd_en "true means normal idle PD enable conditions met" UBYTE b_true 0 0 0.00 1.00 BIT_MASK 0x1 ECU_ADDRESS 0x40003F41 FORMAT "%1.0" /end MEASUREMENT
/begin MEASUREMENT ensc_idl_sp_no_puc_flwr_bias "idle engine speed setpoint not including PUC and follower bias" UWORD u_espd 0 0 0 8191.875 ECU_ADDRESS 0x4000410E FORMAT "%6.2" /end MEASUREMENT
/begin MEASUREMENT ensc_or_pd_conds_met "true means overrun idle PD conditions met" UBYTE b_true 0 0 0.00 1.00 BIT_MASK 0x1 ECU_ADDRESS 0x40003F41 FORMAT "%1.0" /end MEASUREMENT
/begin MEASUREMENT ensc_or_pid_conds_met "true means overrun idle PID conditions met" UBYTE b_true 0 0 0.00 1.00 BIT_MASK 0x1 ECU_ADDRESS 0x40003F41 FORMAT "%1.0" /end MEASUREMENT
/begin MEASUREMENT ensc_or_pd_en "true means overrun idle PD enable conditions met" UBYTE b_true 0 0 0.00 1.00 BIT_MASK 0x1 ECU_ADDRESS 0x40003F41 FORMAT "%1.0" /end MEASUREMENT
/begin MEASUREMENT ensc_or_pid_en "true means overrun idle PID enable conditions met" UBYTE b_true 0 0 0.00 1.00 BIT_MASK 0x1 ECU_ADDRESS 0x40003F41 FORMAT "%1.0" /end MEASUREMENT
/begin MEASUREMENT ensc_iga_cl_conds_met "true means idle iga CL conditions met" UBYTE b_true 0 0 0.00 1.00 BIT_MASK 0x1 ECU_ADDRESS 0x40003F41 FORMAT "%1.0" /end MEASUREMENT
/begin MEASUREMENT ensc_idl_pid_st_dly "delay time after engine run to enable PID idle control" UWORD u_2x_tmr 0 0 0.0 1023.984375 ECU_ADDRESS 0x40004DD4 /end MEASUREMENT
/begin MEASUREMENT ensc_idl_st_hyb "true means hybrid start active" UBYTE b_true 0 0 0.00 1.00 BIT_MASK 0x1 ECU_ADDRESS 0x4000540C FORMAT "%1.0" /end MEASUREMENT
/begin MEASUREMENT ensc_idl_st_bias_dcy_stat "true means idle sp start bias is decaying" UBYTE b_true 0 0 0.00 1.00 BIT_MASK 0x1 ECU_ADDRESS 0x4000540C FORMAT "%1.0" /end MEASUREMENT
/begin MEASUREMENT ensc_idl_st_bias_dcy_fn "true means decay of idle sp start bias finished" UBYTE b_true 0 0 0.00 1.00 BIT_MASK 0x1 ECU_ADDRESS 0x4000540C FORMAT "%1.0" /end MEASUREMENT
/begin MEASUREMENT ensc_idl_st_bias_exit_stat "true means idle sp start bias is exiting" UBYTE b_true 0 0 0.00 1.00 BIT_MASK 0x1 ECU_ADDRESS 0x4000540C FORMAT "%1.0" /end MEASUREMENT
/begin MEASUREMENT ensc_idl_dev_bias_espd_dev "engine speed deviation to calculate high engine speed deviation bias" UWORD u_espd 0 0 0 8191.875 ECU_ADDRESS 0x40004148 FORMAT "%6.2" /end MEASUREMENT
/begin MEASUREMENT ensc_idl_brk_off_dcy_stat "true means brake off min idle sp is decaying" UBYTE b_true 0 0 0.00 1.00 BIT_MASK 0x1 ECU_ADDRESS 0x4000540C FORMAT "%1.0" /end MEASUREMENT
/begin MEASUREMENT ensc_idl_ps_dcy_stat "true means PS idle sp is decaying" UBYTE b_true 0 0 0.00 1.00 BIT_MASK 0x1 ECU_ADDRESS 0x4000540C FORMAT "%1.0" /end MEASUREMENT
/begin MEASUREMENT ensc_idl_ps_en "true means PS idle sp enable" UBYTE b_true 0 0 0.00 1.00 BIT_MASK 0x1 ECU_ADDRESS 0x4000540C FORMAT "%1.0" /end MEASUREMENT
/begin MEASUREMENT ensc_idl_ps_conds_met "true means PS idle sp conditions met" UBYTE b_true 0 0 0.00 1.00 BIT_MASK 0x1 ECU_ADDRESS 0x4000540C FORMAT "%1.0" /end MEASUREMENT
/begin MEASUREMENT ensc_idl_evam_actv "true means idle sp increase due to EVAM" UBYTE b_true 0 0 0.00 1.00 BIT_MASK 0x1 ECU_ADDRESS 0x4000540C FORMAT "%1.0" /end MEASUREMENT
/begin MEASUREMENT thro_keyon_mov_en "key on throttle move enable" UBYTE b_true 0 0 0.0 1.0 BIT_MASK 0x1 ECU_ADDRESS 0x400050DA FORMAT "%1.0" /end MEASUREMENT
/begin MEASUREMENT thro_keyon_mov_tmr "key on throttle move timer" UWORD u_2x_tmr 0 0 0.00 1023.984375 ECU_ADDRESS 0x400050DA SYMBOL_LINK "sys_tps_tmr" 10 /end MEASUREMENT
/begin MEASUREMENT thro_keyon_mov_sp "key on throttle move setpoint" UWORD u_pct_r 0 0 0.00 127.998046875 ECU_ADDRESS 0x400050DA /end MEASUREMENT
/begin MEASUREMENT thro_ctrl_volt_fn "throttle control voltage final" SWORD u_volt_512n_512p 0 0 -512.00 511.984375 ECU_ADDRESS 0x400050DA /end MEASUREMENT
/begin MEASUREMENT thro_ctrl_st "throttle control state" UBYTE u_thro_ctrl_st 0 0 0 3 ECU_ADDRESS 0x400050DA FORMAT "%1.0" /end MEASUREMENT
/begin MEASUREMENT thro_tps_st "tps state" UBYTE u_thro_tps_st 0 0 0 7 ECU_ADDRESS 0x400050DA FORMAT "%1.0" /end MEASUREMENT
/begin MEASUREMENT thro_tps_st_r "tps state" UBYTE u_thro_tps_st_r 0 0 0 7 ECU_ADDRESS 0x400050DA FORMAT "%1.0" /end MEASUREMENT
/begin MEASUREMENT thro_actr_st "actor state" UBYTE u_thro_actr_st 0 0 0 3 ECU_ADDRESS 0x400050DA FORMAT "%1.0" /end MEASUREMENT
/begin MEASUREMENT thro_actr_st_r "actor state" UBYTE u_thro_actr_st_r 0 0 0 3 ECU_ADDRESS 0x400050DA FORMAT "%1.0" /end MEASUREMENT
/begin MEASUREMENT thro_stop_sp_typ "throttle stop setpoint type" UBYTE u_thro_sp_typ 0 0 0 2 ECU_ADDRESS 0x400050DA FORMAT "%1.0" /end MEASUREMENT
/begin MEASUREMENT thro_mot_stuck "throttle motor stuck" UBYTE b_true 0 0 0.0 1.0 BIT_MASK 0x1 ECU_ADDRESS 0x400050DA FORMAT "%1.0" /end MEASUREMENT
/begin MEASUREMENT thro_lrn_mov_actv "throttle zero learn move active" UBYTE b_true 0 0 0.0 1.0 BIT_MASK 0x1 ECU_ADDRESS 0x400050DA FORMAT "%1.0" /end MEASUREMENT
/begin MEASUREMENT thro_pos_sp "throttle position setpoint" UWORD u_pct_r 0 0 0.00 127.998046875 ECU_ADDRESS 0x400050DA /end MEASUREMENT
/begin MEASUREMENT thro_pos_err "throttle position error" SWORD u_pct_r_s 0 0 -128.00 127.99609375 ECU_ADDRESS 0x400050DA /end MEASUREMENT
/begin MEASUREMENT thro_pos_err_d "throttle position error derivative" SWORD u_cnts 0 0 -32768 32767 ECU_ADDRESS 0x400050DA FORMAT "%5.0" /end MEASUREMENT
/begin MEASUREMENT thro_sp_dlt "throttle position setpoint delta" SWORD u_pct_r_s 0 0 -128.00 127.99609375 ECU_ADDRESS 0x400050DA /end MEASUREMENT
/begin MEASUREMENT thro_stop_tmr "throttle stop timer" UWORD u_2x_tmr 0 0 0.00 1023.984375 ECU_ADDRESS 0x400050DA SYMBOL_LINK "thro_2x_tmr" 2 /end MEASUREMENT
/begin MEASUREMENT thro_stuck_ctrl_tmr "throttle base timer" UWORD u_base_tmr 0 0 0.00 255.99609375 ECU_ADDRESS 0x400050DA FORMAT "%5.2" SYMBOL_LINK "thro_base_tmr" 2 /end MEASUREMENT
/begin MEASUREMENT thro_fric_ctrl_tmr "throttle base timer" UWORD u_base_tmr 0 0 0.00 255.99609375 ECU_ADDRESS 0x400050DA FORMAT "%5.2" SYMBOL_LINK "thro_base_tmr" 0 /end MEASUREMENT
/begin MEASUREMENT thro_pedal_st "throttle control state" UBYTE u_thro_pedal_st 0 0 0 3 ECU_ADDRESS 0x400050DA FORMAT "%1.0" /end MEASUREMENT
/begin MEASUREMENT thro_pedal_st_r "throttle control state" UBYTE u_thro_pedal_st_r 0 0 0 3 ECU_ADDRESS 0x400050DA FORMAT "%1.0" /end MEASUREMENT
/begin MEASUREMENT thro_drv_cmd_st "driver command state" UBYTE u_thro_drv_st 0 0 0 3 ECU_ADDRESS 0x400050DA FORMAT "%1.0" /end MEASUREMENT
/begin MEASUREMENT thro_drv_cmd_st_r "driver command state" UBYTE u_thro_drv_st_r 0 0 0 3 ECU_ADDRESS 0x400050DA FORMAT "%1.0" /end MEASUREMENT
/begin MEASUREMENT thro_air_st "airflow sensor state" UBYTE u_thro_air_st 0 0 0 3 ECU_ADDRESS 0x400050DA FORMAT "%1.0" /end MEASUREMENT
/begin MEASUREMENT thro_air_st_r "airflow sensor state" UBYTE u_thro_air_st_r 0 0 0 3 ECU_ADDRESS 0x400050DA FORMAT "%1.0" /end MEASUREMENT
/begin MEASUREMENT thro_throt_st "throttle state" UBYTE u_thro_pedal_st 0 0 0 3 ECU_ADDRESS 0x400050DA FORMAT "%1.0" /end MEASUREMENT
/begin MEASUREMENT thro_throt_st_r "throttle state" UBYTE u_thro_pedal_st_r 0 0 0 3 ECU_ADDRESS 0x400050DA FORMAT "%1.0" /end MEASUREMENT
/begin MEASUREMENT thro_pps_cor_st "pps corr state" UBYTE u_thro_pps_cor_st 0 0 0 1 ECU_ADDRESS 0x400050DA FORMAT "%1.0" /end MEASUREMENT
/begin MEASUREMENT thro_pps_cor_st_r "pps corr state" UBYTE u_thro_pps_cor_st_r 0 0 0 1 ECU_ADDRESS 0x400050DA FORMAT "%1.0" /end MEASUREMENT
/begin MEASUREMENT thro_pps_range_st "pps range state" UBYTE u_thro_pps_range_st 0 0 0 1 ECU_ADDRESS 0x400050DA FORMAT "%1.0" /end MEASUREMENT
/begin MEASUREMENT thro_pps_range_st_r "pps range state" UBYTE u_thro_pps_range_st_r 0 0 0 1 ECU_ADDRESS 0x400050DA FORMAT "%1.0" /end MEASUREMENT
/begin MEASUREMENT thro_force_tps_cor_fl "force tps correlation report fail" UBYTE b_true 0 0 0.00 1.00 ECU_ADDRESS 0x40004EA0 FORMAT "%1.0" /end MEASUREMENT
/begin CHARACTERISTIC ENSC_V_IDL_DFLT "default engine speed setpoint" VALUE 0x374C0 __UWORD_S 0 u_espd 0.0 8191.875 FORMAT "%6.2" /end CHARACTERISTIC
/begin CHARACTERISTIC ENSC_M_IDL_DR "engine speed setpoint when MT/AMT transmission present or AT is in gear D" MAP 0x2091C __UWORD_S 0 u_espd 0.0 8191.875 FORMAT "%6.2" SYMBOL_LINK "ENSC_M_IDL_DR" 4
 /begin AXIS_DESCR FIX_AXIS sys_amp u_kPa_0_256 7 45 105 /begin FIX_AXIS_PAR_LIST 11520 14080 16640 19200 21760 24320 26880 /end FIX_AXIS_PAR_LIST /end AXIS_DESCR
 /begin AXIS_DESCR FIX_AXIS sys_ect u_deg_C 17 -40 120
  /begin FIX_AXIS_PAR_LIST -5120 -3840 -2560 -1280 0 1280 2560 3840 5120 6400 7680 8960 10240 11520 12800 14080 15360 /end FIX_AXIS_PAR_LIST
 /end AXIS_DESCR
/end CHARACTERISTIC
/begin CHARACTERISTIC ENSC_M_IDL_PN "engine speed setpoint when AT present and in gear P/N" MAP 0x2091C __UWORD_S 0 u_espd 0.0 8191.875 FORMAT "%6.2" SYMBOL_LINK "ENSC_M_IDL_PN" 4
 /begin AXIS_DESCR FIX_AXIS sys_amp u_kPa_0_256 7 45 105 /begin FIX_AXIS_PAR_LIST 11520 14080 16640 19200 21760 24320 26880 /end FIX_AXIS_PAR_LIST /end AXIS_DESCR
 /begin AXIS_DESCR FIX_AXIS sys_ect u_deg_C 17 -40 120
  /begin FIX_AXIS_PAR_LIST -5120 -3840 -2560 -1280 0 1280 2560 3840 5120 6400 7680 8960 10240 11520 12800 14080 15360 /end FIX_AXIS_PAR_LIST
 /end AXIS_DESCR
/end CHARACTERISTIC
/begin CHARACTERISTIC ENSC_M_IDL_R "engine speed setpoint when AT present and in gear R" MAP 0x2091C __UWORD_S 0 u_espd 0.0 8191.875 FORMAT "%6.2" SYMBOL_LINK "ENSC_M_IDL_R" 4
 /begin AXIS_DESCR FIX_AXIS sys_amp u_kPa_0_256 7 45 105 /begin FIX_AXIS_PAR_LIST 11520 14080 16640 19200 21760 24320 26880 /end FIX_AXIS_PAR_LIST /end AXIS_DESCR
 /begin AXIS_DESCR FIX_AXIS sys_ect u_deg_C 17 -40 120
  /begin FIX_AXIS_PAR_LIST -5120 -3840 -2560 -1280 0 1280 2560 3840 5120 6400 7680 8960 10240 11520 12800 14080 15360 /end FIX_AXIS_PAR_LIST
 /end AXIS_DESCR
/end CHARACTERISTIC
/begin CHARACTERISTIC ENSC_V_IDL_RAMP_EN "true means enable idle engine speed setpoint ramp control" VALUE 0x20054 __UBYTE_S 0 b_enable 0 1 FORMAT "%5.2" /end CHARACTERISTIC
/begin CHARACTERISTIC ENSC_C_IDL_INC_STP "increase step of idle engine speed setpoint when ramp control enable" CURVE 0x22512 __UWORD_S 0 u_espd_128 0.0 127.998046875 FORMAT "%6.3" SYMBOL_LINK "ENSC_C_IDL_INC_STP" 2
 /begin AXIS_DESCR FIX_AXIS sys_ect u_deg_C 17 -40 120
  /begin FIX_AXIS_PAR_LIST -5120 -3840 -2560 -1280 0 1280 2560 3840 5120 6400 7680 8960 10240 11520 12800 14080 15360 /end FIX_AXIS_PAR_LIST
 /end AXIS_DESCR
/end CHARACTERISTIC
/begin CHARACTERISTIC ENSC_C_IDL_DEC_STP "decrease step of idle engine speed setpoint when ramp control enable" CURVE 0x22512 __UWORD_S 0 u_espd_128 0.0 127.998046875 FORMAT "%6.3" SYMBOL_LINK "ENSC_C_IDL_DEC_STP" 2
 /begin AXIS_DESCR FIX_AXIS sys_ect u_deg_C 17 -40 120
  /begin FIX_AXIS_PAR_LIST -5120 -3840 -2560 -1280 0 1280 2560 3840 5120 6400 7680 8960 10240 11520 12800 14080 15360 /end FIX_AXIS_PAR_LIST
 /end AXIS_DESCR
/end CHARACTERISTIC
/begin CHARACTERISTIC ENSC_M_IDL_VSPD_BIAS_R "bias of engine speed vehicle speed term when AT present and in gear R" MAP 0x2091C __SWORD_S 0 u_espd_n4096_p4096 -1000.00 200.00 SYMBOL_LINK "ENSC_M_IDL_VSPD_BIAS_R" 4
 /begin AXIS_DESCR COM_AXIS sys_veh_spd u_vspd 8 0 511.9921875 AXIS_PTS_REF ENSC_X_VSPD_A /end AXIS_DESCR
 /begin AXIS_DESCR FIX_AXIS sys_ect u_deg_C 17 -40 120
  /begin FIX_AXIS_PAR_LIST -5120 -3840 -2560 -1280 0 1280 2560 3840 5120 6400 7680 8960 10240 11520 12800 14080 15360 /end FIX_AXIS_PAR_LIST
 /end AXIS_DESCR
/end CHARACTERISTIC
/begin CHARACTERISTIC ENSC_M_IDL_VSPD_BIAS_D "bias of engine speed setpoint when MT/AMT transmission present or AT is in gear D" MAP 0x2091C __SWORD_S 0 u_espd_n4096_p4096 -1000.00 200.00 SYMBOL_LINK "ENSC_M_IDL_VSPD_BIAS_D" 4
 /begin AXIS_DESCR COM_AXIS sys_veh_spd u_vspd 8 0 511.9921875 AXIS_PTS_REF ENSC_X_VSPD_A /end AXIS_DESCR
 /begin AXIS_DESCR FIX_AXIS sys_ect u_deg_C 17 -40 120
  /begin FIX_AXIS_PAR_LIST -5120 -3840 -2560 -1280 0 1280 2560 3840 5120 6400 7680 8960 10240 11520 12800 14080 15360 /end FIX_AXIS_PAR_LIST
 /end AXIS_DESCR
/end CHARACTERISTIC
/begin AXIS_PTS ENSC_X_VSPD_A "vspd breakpoint" 0x284C8 sys_veh_spd SSV__UWORD_S 0 u_vspd 8 0 511.9921875 DEPOSIT ABSOLUTE SYMBOL_LINK "ENSC_X_VSPD_A" 2 /end AXIS_PTS
/begin CHARACTERISTIC ENSC_C_IDL_BIAS_ST_HYB "engine start bias of engine speed setpoint when Hybrid start" CURVE 0x22512 __UWORD_S 0 u_espd 0.0 8191.875 FORMAT "%6.2" SYMBOL_LINK "ENSC_C_IDL_BIAS_ST_HYB" 2
 /begin AXIS_DESCR FIX_AXIS sys_ect u_deg_C 17 -40 120
  /begin FIX_AXIS_PAR_LIST -5120 -3840 -2560 -1280 0 1280 2560 3840 5120 6400 7680 8960 10240 11520 12800 14080 15360 /end FIX_AXIS_PAR_LIST
 /end AXIS_DESCR
/end CHARACTERISTIC
/begin CHARACTERISTIC ENSC_C_IDL_BIAS_ST_PN "engine start bias of engine speed setpoint when sys_eng_state is not RUN or MT or AT not in gear" CURVE 0x22512 __UWORD_S 0 u_espd 0.0 8191.875 FORMAT "%6.2" SYMBOL_LINK "ENSC_C_IDL_BIAS_ST_PN" 2
 /begin AXIS_DESCR FIX_AXIS sys_ect u_deg_C 17 -40 120
  /begin FIX_AXIS_PAR_LIST -5120 -3840 -2560 -1280 0 1280 2560 3840 5120 6400 7680 8960 10240 11520 12800 14080 15360 /end FIX_AXIS_PAR_LIST
 /end AXIS_DESCR
/end CHARACTERISTIC
/begin CHARACTERISTIC ENSC_C_IDL_BIAS_ST_R "engine start bias of engine speed setpoint when sys_eng_state is RUN and AT in gear R" CURVE 0x22512 __UWORD_S 0 u_espd 0.0 8191.875 FORMAT "%6.2" SYMBOL_LINK "ENSC_C_IDL_BIAS_ST_R" 2
 /begin AXIS_DESCR FIX_AXIS sys_ect u_deg_C 17 -40 120
  /begin FIX_AXIS_PAR_LIST -5120 -3840 -2560 -1280 0 1280 2560 3840 5120 6400 7680 8960 10240 11520 12800 14080 15360 /end FIX_AXIS_PAR_LIST
 /end AXIS_DESCR
/end CHARACTERISTIC
/begin CHARACTERISTIC ENSC_C_IDL_BIAS_ST_D "engine start bias of engine speed setpoint when sys_eng_state is RUN and AT in gear D" CURVE 0x22512 __UWORD_S 0 u_espd 0.0 8191.875 FORMAT "%6.2" SYMBOL_LINK "ENSC_C_IDL_BIAS_ST_D" 2
 /begin AXIS_DESCR FIX_AXIS sys_ect u_deg_C 17 -40 120
  /begin FIX_AXIS_PAR_LIST -5120 -3840 -2560 -1280 0 1280 2560 3840 5120 6400 7680 8960 10240 11520 12800 14080 15360 /end FIX_AXIS_PAR_LIST
 /end AXIS_DESCR
/end CHARACTERISTIC
/begin CHARACTERISTIC ENSC_V_IDL_CAT_HT_BIAS_EN "True means use engine start bias of engine speed setpoint for catalyst heating" VALUE 0x6804D __UBYTE_S 0 b_true 0 1 FORMAT "%5.2" /end CHARACTERISTIC
/begin CHARACTERISTIC ENSC_V_IDL_ST_BIAS_EXIT_FAC "factor used to decay start bias of engine speed setpoint when normal decay exit condition met" VALUE 0x0002038C __UWORD_S 0 u_fac_1 0 0.999984741210937 /end CHARACTERISTIC
/begin CHARACTERISTIC ENSC_C_IDL_ST_BIAS_HLD_DUR "start bias of engine speed setpoint hold duration" CURVE 0x000200B0 __UWORD_S 0 u_8x_tmr 0 4095.9375 FORMAT "%6.3" SYMBOL_LINK "ENSC_C_IDL_ST_BIAS_HLD_DUR" 2
 /begin AXIS_DESCR FIX_AXIS sys_ect u_deg_C 17 -40 120
  /begin FIX_AXIS_PAR_LIST -5120 -3840 -2560 -1280 0 1280 2560 3840 5120 6400 7680 8960 10240 11520 12800 14080 15360 /end FIX_AXIS_PAR_LIST
 /end AXIS_DESCR
/end CHARACTERISTIC
/begin CHARACTERISTIC ENSC_C_IDL_ST_BIAS_DCY_DLY "start bias of engine speed setpoint decay delay" CURVE 0x000200B0 __UWORD_S 0 u_8x_tmr 0 4095.9375 FORMAT "%6.3" SYMBOL_LINK "ENSC_C_IDL_ST_BIAS_DCY_DLY" 2
 /begin AXIS_DESCR FIX_AXIS sys_ect u_deg_C 17 -40 120
  /begin FIX_AXIS_PAR_LIST -5120 -3840 -2560 -1280 0 1280 2560 3840 5120 6400 7680 8960 10240 11520 12800 14080 15360 /end FIX_AXIS_PAR_LIST
 /end AXIS_DESCR
/end CHARACTERISTIC
/begin CHARACTERISTIC ENSC_V_IDL_ST_BIAS_DCY_FAC "start bias of engine speed setpoint decay factor" VALUE 0x0002038C __UWORD_S 0 u_fac_1 0 0.999984741210937 /end CHARACTERISTIC
/begin CHARACTERISTIC ENSC_M_IDL_VSPD_BIAS "vehicle speed bias of engine speed setpoint" MAP 0x2091C __UWORD_S 0 u_espd 0 8191.875 FORMAT "%6.2" SYMBOL_LINK "ENSC_M_IDL_VSPD_BIAS" 4
 /begin AXIS_DESCR COM_AXIS sys_veh_spd u_vspd 5 0.000000 511.992188 AXIS_PTS_REF ENSC_X_VSPD_B /end AXIS_DESCR
 /begin AXIS_DESCR COM_AXIS sys_ect u_deg_C 5 -256.000000 255.9921875 AXIS_PTS_REF ENSC_X_ECT_A /end AXIS_DESCR
/end CHARACTERISTIC
/begin AXIS_PTS ENSC_X_VSPD_B "axis of vehicle speed" 0x0002006C sys_veh_spd SSV__UWORD_S 0 u_vspd 5 0.000000 511.992188 DEPOSIT ABSOLUTE SYMBOL_LINK "ENSC_X_VSPD_B" 2 /end AXIS_PTS
/begin AXIS_PTS ENSC_X_ECT_A "ect breakpoint" 0x0002006C sys_ect SSV__SWORD_S 0 u_deg_C 5 -256.000000 255.9921875 FORMAT "%4.1" DEPOSIT ABSOLUTE SYMBOL_LINK "ENSC_X_ECT_A" 2 /end AXIS_PTS
/begin CHARACTERISTIC ENSC_V_IDL_DEV_BIAS_DB "engine speed deviation deadband to disable high DIF bias of engine speed setpoint" VALUE 0x374C0 __UWORD_S 0 u_espd 0.0 8191.875 FORMAT "%6.2" /end CHARACTERISTIC
/begin CHARACTERISTIC ENSC_V_IDL_DEV_BIAS_FAC "factor of engine speed deviation to calculate high DIF bias of engine speed setpoint " VALUE 0x0002038C __UWORD_S 0 u_fac_1 0 0.999984741210937 /end CHARACTERISTIC
/begin CHARACTERISTIC ENSC_V_IDL_DEV_BIAS_MAX "Max available high DIF bias of engine speed setpoint" VALUE 0x374C0 __UWORD_S 0 u_espd 0.0 8191.875 FORMAT "%6.2" /end CHARACTERISTIC
/begin CHARACTERISTIC ENSC_C_IDL_DEV_BIAS_DCY_FAC_PN "decay factor of high DIF bias when in PN" CURVE 0x000200B0 __UWORD_S 0 u_fac_1 0 0.999984741210937 FORMAT "%5.4" SYMBOL_LINK "ENSC_C_IDL_DEV_BIAS_DCY_FAC_PN" 2
 /begin AXIS_DESCR FIX_AXIS sys_ect u_deg_C 4 -40 120 /begin FIX_AXIS_PAR_LIST -2048 2560 7168 11776 /end FIX_AXIS_PAR_LIST /end AXIS_DESCR
/end CHARACTERISTIC
/begin CHARACTERISTIC ENSC_C_IDL_DEV_BIAS_DCY_FAC_DR "decay factor of high DIF bias when not in PN" CURVE 0x000200B0 __UWORD_S 0 u_fac_1 0 0.999984741210937 FORMAT "%5.4" SYMBOL_LINK "ENSC_C_IDL_DEV_BIAS_DCY_FAC_DR" 2
 /begin AXIS_DESCR FIX_AXIS sys_ect u_deg_C 4 -40 120 /begin FIX_AXIS_PAR_LIST -2048 2560 7168 11776 /end FIX_AXIS_PAR_LIST /end AXIS_DESCR
/end CHARACTERISTIC
/begin CHARACTERISTIC ENSC_V_IDL_AC_BIAS_HLD_DUR "AC bias of espd sp hold duration when AC OFF" VALUE 0x0002038C __UWORD_S 0 u_8x_tmr 0.0 4095.9375 FORMAT "%5.3" /end CHARACTERISTIC
/begin CHARACTERISTIC ENSC_C_IDL_AC_BIAS_R "AC bias of espd sp when in gear R" CURVE 0x22512 __UWORD_S 0 u_espd 0.0 8191.875 FORMAT "%6.2" SYMBOL_LINK "ENSC_C_IDL_AC_BIAS_R" 2
 /begin AXIS_DESCR FIX_AXIS sys_ect u_deg_C 17 -40 120
  /begin FIX_AXIS_PAR_LIST -5120 -3840 -2560 -1280 0 1280 2560 3840 5120 6400 7680 8960 10240 11520 12800 14080 15360 /end FIX_AXIS_PAR_LIST
 /end AXIS_DESCR
/end CHARACTERISTIC
/begin CHARACTERISTIC ENSC_C_IDL_AC_BIAS_PN "AC bias of espd sp when in gear PN" CURVE 0x22512 __UWORD_S 0 u_espd 0.0 8191.875 FORMAT "%6.2" SYMBOL_LINK "ENSC_C_IDL_AC_BIAS_PN" 2
 /begin AXIS_DESCR FIX_AXIS sys_ect u_deg_C 17 -40 120
  /begin FIX_AXIS_PAR_LIST -5120 -3840 -2560 -1280 0 1280 2560 3840 5120 6400 7680 8960 10240 11520 12800 14080 15360 /end FIX_AXIS_PAR_LIST
 /end AXIS_DESCR
/end CHARACTERISTIC
/begin CHARACTERISTIC ENSC_M_IDL_AC_BIAS_D "bias of engine speed setpoint when MT/AMT transmission present or AT is in gear D" MAP 0x2091C __UWORD_S 0 u_espd 0.0 8191.875 FORMAT "%6.2" SYMBOL_LINK "ENSC_M_IDL_AC_BIAS_D" 4
 /begin AXIS_DESCR COM_AXIS sys_veh_spd u_vspd 8 0 511.9921875 AXIS_PTS_REF ENSC_X_VSPD_A /end AXIS_DESCR
 /begin AXIS_DESCR FIX_AXIS sys_ect u_deg_C 17 -40 120
  /begin FIX_AXIS_PAR_LIST -5120 -3840 -2560 -1280 0 1280 2560 3840 5120 6400 7680 8960 10240 11520 12800 14080 15360 /end FIX_AXIS_PAR_LIST
 /end AXIS_DESCR
/end CHARACTERISTIC
/begin CHARACTERISTIC ENSC_V_IDL_AC_BIAS_INC_STP "increase step of engine speed setpoint AC bias" VALUE 0x0002038C __UWORD_S 0 u_espd 0.0 8191.875 FORMAT "%6.2" /end CHARACTERISTIC
/begin CHARACTERISTIC ENSC_V_IDL_AC_BIAS_DEC_STP "decrease step of engine speed setpoint AC bias" VALUE 0x0002038C __UWORD_S 0 u_espd 0.0 8191.875 FORMAT "%6.2" /end CHARACTERISTIC
/begin CHARACTERISTIC ENSC_V_IDL_PUC_BIAS "PUC bias of espd sp" VALUE 0x0002038C __UWORD_S 0 u_espd 0.0 8191.875 FORMAT "%6.2" /end CHARACTERISTIC
/begin CHARACTERISTIC ENSC_V_IDL_PUC_BIAS_DCY_DLY "decay delay of espd sp PUC bias" VALUE 0x0002038C __UWORD_S 0 u_2x_tmr 0 1023.984375 /end CHARACTERISTIC
/begin CHARACTERISTIC ENSC_V_IDL_PUC_BIAS_DCY_FAC "decay factor of espd sp PUC bias" VALUE 0x0002038C __UWORD_S 0 u_fac_1 0 0.999984741210937 /end CHARACTERISTIC
/begin CHARACTERISTIC ENSC_V_IDL_ELD_CTRL_EN "True means enable Eload bias of espd sp" VALUE 0x0002038C __UBYTE_S 0 b_true 0 1 FORMAT "%1.0" /end CHARACTERISTIC
/begin CHARACTERISTIC ENSC_V_IDL_ELD1_BIAS "Eload1 bias of espd sp" VALUE 0x0002038C __UWORD_S 0 u_espd 0.0 8191.875 FORMAT "%6.2" /end CHARACTERISTIC
/begin CHARACTERISTIC ENSC_V_IDL_ELD2_BIAS "Eload2 bias of espd sp" VALUE 0x0002038C __UWORD_S 0 u_espd 0.0 8191.875 FORMAT "%6.2" /end CHARACTERISTIC
/begin CHARACTERISTIC ENSC_C_IDL_FLWR_BIAS "throttle follower bias of espd sp" CURVE 0x22512 __UWORD_S 0 u_espd 0.0 8191.875 FORMAT "%6.2" SYMBOL_LINK "ENSC_C_IDL_FLWR_BIAS" 2
 /begin AXIS_DESCR FIX_AXIS sys_ect u_deg_C 17 -40 120
  /begin FIX_AXIS_PAR_LIST -5120 -3840 -2560 -1280 0 1280 2560 3840 5120 6400 7680 8960 10240 11520 12800 14080 15360 /end FIX_AXIS_PAR_LIST
 /end AXIS_DESCR
/end CHARACTERISTIC
/begin CHARACTERISTIC ENSC_C_IDL_FLWR_BIAS_PN "throttle follower bias of espd sp when in gear PN" CURVE 0x22512 __UWORD_S 0 u_espd 0.0 8191.875 FORMAT "%6.2" SYMBOL_LINK "ENSC_C_IDL_FLWR_BIAS_PN" 2
 /begin AXIS_DESCR FIX_AXIS sys_ect u_deg_C 17 -40 120
  /begin FIX_AXIS_PAR_LIST -5120 -3840 -2560 -1280 0 1280 2560 3840 5120 6400 7680 8960 10240 11520 12800 14080 15360 /end FIX_AXIS_PAR_LIST
 /end AXIS_DESCR
/end CHARACTERISTIC
/begin CHARACTERISTIC ENSC_V_IDL_FLWR_RMP_VSPD_THR "vehicle speed threshold above witch ramp of throttle follower bias will be enable" VALUE 0x0002038C __UWORD_S 0 u_vspd 0 511.992188 FORMAT "%4.1" /end CHARACTERISTIC
/begin CHARACTERISTIC ENSC_V_IDL_FLWR_BIAS_RMP_STP "ramp step of throttle follower bias" VALUE 0x0002038C __UWORD_S 0 u_espd 0.0 8191.875 FORMAT "%6.2" /end CHARACTERISTIC
/begin CHARACTERISTIC ENSC_V_IDL_FLWR_BIAS_DCY_THR "deviation threshold between espd and espd sp to begin decay of throttle follower bias" VALUE 0x0002038C __UWORD_S 0 u_espd 0.0 8191.875 FORMAT "%6.2" /end CHARACTERISTIC
/begin CHARACTERISTIC ENSC_V_IDL_FLWR_BIAS_HLD_DUR "throttle follower bias of espd sp hold duration" VALUE 0x0002038C __UWORD_S 0 u_2x_tmr 0 1023.984375 /end CHARACTERISTIC
/begin CHARACTERISTIC ENSC_V_IDL_FLWR_BIAS_DCY_DLY "throttle follower bias of espd sp decay delay" VALUE 0x0002038C __UWORD_S 0 u_2x_tmr 0 1023.984375 /end CHARACTERISTIC
/begin CHARACTERISTIC ENSC_V_IDL_FLWR_BIAS_DCY_FAC "throttle follower bias of espd sp decay factor" VALUE 0x0002038C __UWORD_S 0 u_fac_1 0 0.999984741210937 /end CHARACTERISTIC
/begin CHARACTERISTIC ENSC_V_IDL_FLWR_BIAS_DCY_FAC_PN "throttle follower bias of espd sp decay factor when in gear PN" VALUE 0x0002038C __UWORD_S 0 u_fac_1 0 0.999984741210937 /end CHARACTERISTIC
/begin CHARACTERISTIC ENSC_V_IDL_IAT_BIAS_ECT_THR "ect min threshold to enable iat bias of espd sp" VALUE 0x0002038C __SWORD_S 0 u_deg_C -256 255.9921875 FORMAT "%4.2" /end CHARACTERISTIC
/begin CHARACTERISTIC ENSC_V_IDL_IAT_BIAS_IAT_THR "iat max threshold to enable iat bias of espd sp" VALUE 0x0002038C __SWORD_S 0 u_deg_C -256 255.9921875 FORMAT "%4.2" /end CHARACTERISTIC
/begin CHARACTERISTIC ENSC_C_IDL_IAT_BIAS "iat bias of espd sp" CURVE 0x22512 __UWORD_S 0 u_espd 0.0 8191.875 FORMAT "%6.2" SYMBOL_LINK "ENSC_C_IDL_IAT_BIAS" 2
 /begin AXIS_DESCR FIX_AXIS sys_iat u_deg_C 9 -40 56 /begin FIX_AXIS_PAR_LIST -5120 -3584 -2048 -512 1024 2560 4096 5632 7168 /end FIX_AXIS_PAR_LIST /end AXIS_DESCR
/end CHARACTERISTIC
/begin CHARACTERISTIC ENSC_V_IDL_BAT_EN_BAT_VLT "battery voltage low threshold to enable bat bias of espd sp" VALUE 0x0002038C __UWORD_S 0 u_volt_32 0 31.99951171875 FORMAT "%4.2" /end CHARACTERISTIC
/begin CHARACTERISTIC ENSC_V_IDL_BAT_DIS_BAT_VLT "battery voltage high threshold to disable bat bias of espd sp" VALUE 0x0002038C __UWORD_S 0 u_volt_32 0 31.99951171875 FORMAT "%4.2" /end CHARACTERISTIC
/begin CHARACTERISTIC ENSC_V_IDL_BAT_EN_DLY "time of battery voltage below ENSC_V_ESPD_BAT_BIAS_LO_THR needed to apply BAT bias" VALUE 0x0002038C __UWORD_S 0 u_1s_tmr 0 65535 /end CHARACTERISTIC
/begin CHARACTERISTIC ENSC_V_IDL_BAT_DIS_DLY "time of battery voltage above ENSC_V_ESPD_BAT_BIAS_HI_THR needed to cancel BAT bias " VALUE 0x0002038C __UWORD_S 0 u_1s_tmr 0 65535 /end CHARACTERISTIC
/begin CHARACTERISTIC ENSC_V_IDL_BAT_RMP_STP "ramp step of BAT bias" VALUE 0x0002038C __UWORD_S 0 u_espd 0.0 8191.875 FORMAT "%6.2" /end CHARACTERISTIC
/begin CHARACTERISTIC ENSC_V_IDL_BAT_BIAS "Low battery voltage bias of espd sp" VALUE 0x0002038C __UWORD_S 0 u_espd 0.0 8191.875 FORMAT "%6.2" /end CHARACTERISTIC
/begin CHARACTERISTIC ENSC_V_IDL_PS_DFLT "default PS espd sp when PS sensor fault active" VALUE 0x0002038C __UWORD_S 0 u_espd 0.0 8191.875 FORMAT "%6.2" /end CHARACTERISTIC
/begin CHARACTERISTIC ENSC_V_IDL_PS_D "PS espd sp when MT/AMT present or AT in gear" VALUE 0x0002038C __UWORD_S 0 u_espd 0.0 8191.875 FORMAT "%6.2" /end CHARACTERISTIC
/begin CHARACTERISTIC ENSC_V_IDL_PS_PN "PS espd sp when AT in PN" VALUE 0x0002038C __UWORD_S 0 u_espd 0.0 8191.875 FORMAT "%6.2" /end CHARACTERISTIC
/begin CHARACTERISTIC ENSC_V_PS_ACTV_PRES_THR "PS pressure thresh to determine PS active" VALUE 0x0002038C __UWORD_S 0 u_kPa_0_32768 0 32767.5 FORMAT "%5.1" /end CHARACTERISTIC
/begin CHARACTERISTIC ENSC_V_IDL_PS_INC_STP "increase step of PS espd sp" VALUE 0x0002038C __UWORD_S 0 u_espd_per_sec 0 524280 /end CHARACTERISTIC
/begin CHARACTERISTIC ENSC_V_IDL_PS_DEC_STP "decrease step of PS espd sp" VALUE 0x0002038C __UWORD_S 0 u_espd_per_sec 0 524280 /end CHARACTERISTIC
/begin CHARACTERISTIC ENSC_V_IDL_PS_DEC_DLY "decrease delay of PS espd sp" VALUE 0x0002038C __UWORD_S 0 u_2x_tmr 0 1023.984375 /end CHARACTERISTIC
/begin CHARACTERISTIC ENSC_V_IDL_EVAM_AC "EVAM espd sp when AC ON, MT/AMT present or AT in gear" VALUE 0x0002038C __UWORD_S 0 u_espd 0.0 8191.875 FORMAT "%6.2" /end CHARACTERISTIC
/begin CHARACTERISTIC ENSC_V_IDL_EVAM "EVAM espd sp when AC OFF, MT/AMT present or AT in gear" VALUE 0x0002038C __UWORD_S 0 u_espd 0.0 8191.875 FORMAT "%6.2" /end CHARACTERISTIC
/begin CHARACTERISTIC ENSC_V_IDL_EVAM_AC_PN "EVAD espd sp when AC ON,AT in PN" VALUE 0x0002038C __UWORD_S 0 u_espd 0.0 8191.875 FORMAT "%6.2" /end CHARACTERISTIC
/begin CHARACTERISTIC ENSC_V_IDL_EVAM_PN "EVAD espd sp when AC OFF,AT in PN" VALUE 0x0002038C __UWORD_S 0 u_espd 0.0 8191.875 FORMAT "%6.2" /end CHARACTERISTIC
/begin CHARACTERISTIC ENSC_V_IDL_EVAM_DCY_STP "decay step of EVAD espd sp" VALUE 0x0002038C __UWORD_S 0 u_espd 0.0 8191.875 FORMAT "%6.2" /end CHARACTERISTIC
/begin CHARACTERISTIC ENSC_V_IDL_EVAM_DCY_DLY "decay delay of EVAD espd sp" VALUE 0x0002038C __UWORD_S 0 u_2x_tmr 0 1023.984375 /end CHARACTERISTIC
/begin CHARACTERISTIC ENSC_V_IDL_AMT_CREEP_MIN "min espd sp when AMT present and creeping" VALUE 0x0002038C __UWORD_S 0 u_espd 0.0 8191.875 FORMAT "%6.2" /end CHARACTERISTIC
/begin CHARACTERISTIC ENSC_V_IDL_CAT_HT_PN "catalyst heating espd sp when AT in PN or not AT" VALUE 0x0002038C __UWORD_S 0 u_espd 0.0 8191.875 FORMAT "%6.2" /end CHARACTERISTIC
/begin CHARACTERISTIC ENSC_V_IDL_CAT_HT_DR "catalyst heating espd sp when AT in gear" VALUE 0x0002038C __UWORD_S 0 u_espd 0.0 8191.875 FORMAT "%6.2" /end CHARACTERISTIC
/begin CHARACTERISTIC ENSC_V_IDL_ETC_LMT "ESPD sp when ETC mode is not normal and ensc_dt is true" VALUE 0x0002038C __UWORD_S 0 u_espd 0.0 8191.875 FORMAT "%6.2" /end CHARACTERISTIC
/begin CHARACTERISTIC ENSC_V_IDL_ETC_LMT_PN "ESPD sp when ETC mode is not normal and not in gear" VALUE 0x0002038C __UWORD_S 0 u_espd 0.0 8191.875 FORMAT "%6.2" /end CHARACTERISTIC
/begin CHARACTERISTIC ENSC_C_IDL_MAX "MAX allowed idle engine speed setpoint" CURVE 0x22512 __UWORD_S 0 u_espd 0.0 8191.875 FORMAT "%6.2" SYMBOL_LINK "ENSC_C_IDL_MAX" 2
 /begin AXIS_DESCR FIX_AXIS sys_ect u_deg_C 17 -40 120
  /begin FIX_AXIS_PAR_LIST -5120 -3840 -2560 -1280 0 1280 2560 3840 5120 6400 7680 8960 10240 11520 12800 14080 15360 /end FIX_AXIS_PAR_LIST
 /end AXIS_DESCR
/end CHARACTERISTIC
/begin CHARACTERISTIC ENSC_V_IDL_BKOF_VSPD_HI "vehicle speed threshold above which drive off espd sp will be disabled" VALUE 0x0002038C __UWORD_S 0 u_vspd 0 511.992188 FORMAT "%4.1" /end CHARACTERISTIC
/begin CHARACTERISTIC ENSC_V_IDL_BKOF_VSPD_LO "vehicle speed threshold below which drive off espd sp will be enabled" VALUE 0x0002038C __UWORD_S 0 u_vspd 0 511.992188 FORMAT "%4.1" /end CHARACTERISTIC
/begin CHARACTERISTIC ENSC_V_IDL_BKOF_D1 "drive off espd sp when in gear 1st" VALUE 0x0002038C __UWORD_S 0 u_espd 0.0 8191.875 FORMAT "%6.2" /end CHARACTERISTIC
/begin CHARACTERISTIC ENSC_V_IDL_BKOF_D2 "drive off espd sp when in gear 2nd" VALUE 0x0002038C __UWORD_S 0 u_espd 0.0 8191.875 FORMAT "%6.2" /end CHARACTERISTIC
/begin CHARACTERISTIC ENSC_V_IDL_BKOF_R "drive off espd sp when in gear R" VALUE 0x0002038C __UWORD_S 0 u_espd 0.0 8191.875 FORMAT "%6.2" /end CHARACTERISTIC
/begin CHARACTERISTIC ENSC_C_IDL_BKOF_LNCH "drive off espd sp when launch mode active" CURVE 0x22512 __UWORD_S 0 u_espd 0.0 8191.875 FORMAT "%6.2"
 /begin AXIS_DESCR FIX_AXIS NO_INPUT_QUANTITY x_AC_status 2 0 1 /begin FIX_AXIS_PAR_LIST 0 1 /end FIX_AXIS_PAR_LIST /end AXIS_DESCR
/end CHARACTERISTIC
/begin CHARACTERISTIC ENSC_C_IDL_BKOF_VSPD_FAC "vehicle speed factor to calculate the min espd sp in drive off mode" CURVE 0x22512 __UWORD_S 0 u_fac_1 0 0.999984741210937 SYMBOL_LINK "ENSC_C_IDL_BKOF_VSPD_FAC" 2
 /begin AXIS_DESCR COM_AXIS sys_veh_spd u_vspd 8 0.000000 511.992188 AXIS_PTS_REF ENSC_X_VSPD_D /end AXIS_DESCR
/end CHARACTERISTIC
/begin AXIS_PTS ENSC_X_VSPD_D "axis of vehicle speed" 0x27BB8 sys_veh_spd SSV__UWORD_S 0 u_vspd 8 0.000000 511.992188 DEPOSIT ABSOLUTE SYMBOL_LINK "ENSC_X_VSPD_D" 2 /end AXIS_PTS
/begin CHARACTERISTIC ENSC_V_IDL_BKOF_LNCH_CFG "configuration of drive off launch logic£¬true means limit the min espd sp to ENSC_V_IDL_BKOF_LNCH_MIN" VALUE 0x0002038C __UBYTE_S 0 b_true 0 1 FORMAT "%5.2" /end CHARACTERISTIC
/begin CHARACTERISTIC ENSC_V_IDL_BKOF_LNCH_MIN "when ENSC_V_IDL_BKOF_LNCH_CFG=true£¬limit the min espd sp to this CAL" VALUE 0x0002038C __UWORD_S 0 u_espd 0.0 8191.875 FORMAT "%6.2" /end CHARACTERISTIC
/begin CHARACTERISTIC ENSC_V_IDL_BKOF_DEC_STP "decrease step of drive off espd sp, when ENSC_V_IDL_BKOF_LNCH_CFG=true" VALUE 0x0002038C __UWORD_S 0 u_espd 0.0 8191.875 FORMAT "%6.2" /end CHARACTERISTIC
/begin CHARACTERISTIC ENSC_V_IDL_BKOF_DCY_FAC "decay factor of drive off espd sp, when ENSC_V_IDL_BKOF_LNCH_CFG=false" VALUE 0x0002038C __UWORD_S 0 u_fac_1 0 0.999984741210937 /end CHARACTERISTIC
/begin CHARACTERISTIC ENSC_V_ESPD_DEV_FIL "filter coefficient of ensc_espd_dev  when ensc_idl_st is normal PID or overrun PID" VALUE 0x0002038C __UWORD_S 0 u_filter 0 0.9999847412109375 FORMAT "%10.9" /end CHARACTERISTIC
/begin CHARACTERISTIC ENSC_V_IDL_SP_FIL_INC "filter coefficient of ensc_idl_sp  when ensc_idl_sp is increasing" VALUE 0x0002038C __UWORD_S 0 u_filter 0 0.9999847412109375 FORMAT "%10.9" /end CHARACTERISTIC
/begin CHARACTERISTIC ENSC_V_IDL_SP_FIL_DEC "filter coefficient of ensc_idl_sp  when ensc_idl_sp is decreasing" VALUE 0x0002038C __UWORD_S 0 u_filter 0 0.9999847412109375 FORMAT "%10.9" /end CHARACTERISTIC
/begin CHARACTERISTIC ENSC_V_ESPD_DEV_FILT_DFLT "default value of ensc_espd_dev_filt when ensc_idl_st is not normal PID or overrun PID" VALUE 0x0002038C __UWORD_S 0 u_espd 0.0 8191.875 FORMAT "%6.2" /end CHARACTERISTIC
/begin CHARACTERISTIC ENSC_V_OR_IDL_VSPD_THR "vehicle speed threshold above which overrun idle control will be enable " VALUE 0x0002038C __UWORD_S 0 u_vspd 0 511.992188 FORMAT "%4.1" /end CHARACTERISTIC
/begin CHARACTERISTIC ENSC_V_NM_PID_MT_CFG "True means when ensc_mt_in_gr==true normal idle control can be active regardless of vehicle speed condition" VALUE 0x0002038C __UBYTE_S 0 b_true 0 1 FORMAT "%5.2" /end CHARACTERISTIC
/begin CHARACTERISTIC ENSC_C_NM_PID_ACOFF_MAP "MAP Threshold when AC OFF, below which normal PID MAP condition met" CURVE 0x000200B0 __UWORD_S 0 u_kPa_0_256 0 255.99609375 SYMBOL_LINK "ENSC_C_NM_PID_ACOFF_MAP" 2
 /begin AXIS_DESCR FIX_AXIS sys_ect u_deg_C 17 -40 152
  /begin FIX_AXIS_PAR_LIST -5120 -3584 -2048 -512 1024 2560 4096 5632 7168 8704 10240 11776 13312 14848 16384 17920 19456 /end FIX_AXIS_PAR_LIST
 /end AXIS_DESCR
/end CHARACTERISTIC
/begin CHARACTERISTIC ENSC_C_NM_PID_ACON_MAP "MAP Threshold when AC ON, below which normal PID MAP condition met" CURVE 0x000200B0 __UWORD_S 0 u_kPa_0_256 0 255.99609375 SYMBOL_LINK "ENSC_C_NM_PID_ACON_MAP" 2
 /begin AXIS_DESCR FIX_AXIS sys_ect u_deg_C 17 -40 152
  /begin FIX_AXIS_PAR_LIST -5120 -3584 -2048 -512 1024 2560 4096 5632 7168 8704 10240 11776 13312 14848 16384 17920 19456 /end FIX_AXIS_PAR_LIST
 /end AXIS_DESCR
/end CHARACTERISTIC
/begin AXIS_PTS ENSC_X_TMP "" 0x0002006C NO_INPUT_QUANTITY SSV__SWORD_S 0 u_deg_C 17 -256.000000 255.9921875 FORMAT "%4.1" DEPOSIT ABSOLUTE SYMBOL_LINK "ENSC_X_TMP" 2 /end AXIS_PTS
/begin CHARACTERISTIC ENSC_C_NIDL_SP_MIN "min engine speed setpoint when in neutral idle control mode" CURVE 0x362C2 __UWORD_S 0 u_espd 0.0 8191.875 FORMAT "%6.2" SYMBOL_LINK "ENSC_C_NIDL_SP_MIN" 2
 /begin AXIS_DESCR FIX_AXIS sys_ect u_deg_C 17 -40 120
  /begin FIX_AXIS_PAR_LIST -5120 -3840 -2560 -1280 0 1280 2560 3840 5120 6400 7680 8960 10240 11520 12800 14080 15360 /end FIX_AXIS_PAR_LIST
 /end AXIS_DESCR
/end CHARACTERISTIC
/begin CHARACTERISTIC ENSC_V_ELD1_CFG "configuration of Eload1 input" VALUE 0x204D8 __UBYTE_S 0 u_eload_cfg 0 4 FORMAT "%1.0" /end CHARACTERISTIC
/begin CHARACTERISTIC ENSC_V_ELD2_CFG "configuration of Eload2 input" VALUE 0x204D8 __UBYTE_S 0 u_eload_cfg 0 4 FORMAT "%1.0" /end CHARACTERISTIC
/begin CHARACTERISTIC ENSC_V_AT_GR_ENG_DLY_VSPD_MAX "vehicle speed threshold above which AT gear shift engaged delay will be finished" VALUE 0x291A2 __UWORD_S 0 u_vspd 0.0 511.9921875 /end CHARACTERISTIC
/begin CHARACTERISTIC ENSC_C_AT_GR_ENG_DLY_MAP_THR_IN "delta MAP threshold above which  AT gear shift engaged delay will be finished when trs_at_in_gr==1" CURVE 0x37828 __UWORD_S 0 u_kPa_0_256 0 255.99609375 SYMBOL_LINK "ENSC_C_AT_GR_ENG_DLY_MAP_THR_IN" 2
 /begin AXIS_DESCR COM_AXIS NO_INPUT_QUANTITY u_deg_C 17 -256 255.9921875 AXIS_PTS_REF ENSC_X_TMP /end AXIS_DESCR
/end CHARACTERISTIC
/begin CHARACTERISTIC ENSC_C_AT_GR_ENG_DLY_MAP_THR_OUT "delta MAP threshold above which  AT gear shift engaged delay will be finished when trs_at_in_gr==0" CURVE 0x37828 __UWORD_S 0 u_kPa_0_256 0 255.99609375 SYMBOL_LINK "ENSC_C_AT_GR_ENG_DLY_MAP_THR_OUT" 2
 /begin AXIS_DESCR COM_AXIS NO_INPUT_QUANTITY u_deg_C 17 -256 255.9921875 AXIS_PTS_REF ENSC_X_TMP /end AXIS_DESCR
/end CHARACTERISTIC
/begin CHARACTERISTIC ENSC_V_AT_GR_ENG_DLY_TISS_TMP_THR "temperature threshold below which will enable TISS condition of AT gear shift engaged delay" VALUE 0x65E7A __SWORD_S 0 u_deg_C -256 255.9921875 /end CHARACTERISTIC
/begin CHARACTERISTIC ENSC_V_AT_GR_ENG_DLY_TISS_IN_THR "gradient of TISS threshold below which AT gear shift engaged delay will be finished" VALUE 0x202FC __SWORD_S 0 u_spd_grad -512 511.984375 /end CHARACTERISTIC
/begin CHARACTERISTIC ENSC_V_AT_GR_ENG_DLY_TISS_OUT_THR "gradient of TISS threshold above which AT gear shift engaged delay will be finished" VALUE 0x202FC __SWORD_S 0 u_spd_grad -512 511.984375 /end CHARACTERISTIC
/begin CHARACTERISTIC ENSC_V_MT_IN_GR_CONDS_EN "True will enable normal conditions to determine ensc_mt_in_gr, false will make ensc_mt_in_gr==1 " VALUE 0x37118 __UBYTE_S 0 b_true 0 1 FORMAT "%5.2" /end CHARACTERISTIC
/begin CHARACTERISTIC ENSC_V_MT_IN_GR_CLTCH_CFG "True means use clutch top sensor to determine ensc_mt_in_gr, false means use bottom sensor" VALUE 0x37118 __UBYTE_S 0 b_true 0 1 FORMAT "%5.2" /end CHARACTERISTIC
/begin CHARACTERISTIC ENSC_V_IDL_LOAD_TRANS_ACOFF "hold duration of ensc_idl_load_trans_stat when idle load transition due to AC OFF" VALUE 0x365CA __UWORD_S 0 u_2x_tmr 0 1023.984375 /end CHARACTERISTIC
/begin CHARACTERISTIC ENSC_V_IDL_LOAD_TRANS_ACON "hold duration of ensc_idl_load_trans_stat when idle load transition due to AC ON" VALUE 0x365CA __UWORD_S 0 u_2x_tmr 0 1023.984375 /end CHARACTERISTIC
/begin CHARACTERISTIC ENSC_V_IDL_LOAD_TRANS_FANOFF "hold duration of ensc_idl_load_trans_stat when idle load transition due to FAN OFF" VALUE 0x365CA __UWORD_S 0 u_2x_tmr 0 1023.984375 /end CHARACTERISTIC
/begin CHARACTERISTIC ENSC_V_IDL_LOAD_TRANS_FANON "hold duration of ensc_idl_load_trans_stat when idle load transition due to FAN ON" VALUE 0x365CA __UWORD_S 0 u_2x_tmr 0 1023.984375 /end CHARACTERISTIC
/begin CHARACTERISTIC ENSC_V_IDL_LOAD_TRANS_ELDOFF "hold duration of ensc_idl_load_trans_stat when idle load transition due to Eload OFF" VALUE 0x365CA __UWORD_S 0 u_2x_tmr 0 1023.984375 /end CHARACTERISTIC
/begin CHARACTERISTIC ENSC_V_IDL_LOAD_TRANS_ELDON "hold duration of ensc_idl_load_trans_stat when idle load transition due to Eload ON" VALUE 0x365CA __UWORD_S 0 u_2x_tmr 0 1023.984375 /end CHARACTERISTIC
/begin CHARACTERISTIC ENSC_V_IDL_LOAD_TRANS_ATINGR "hold duration of ensc_idl_load_trans_stat when idle load transition due to AT in gear" VALUE 0x365CA __UWORD_S 0 u_2x_tmr 0 1023.984375 /end CHARACTERISTIC
/begin CHARACTERISTIC ENSC_V_IDL_LOAD_TRANS_ATOUTGR "hold duration of ensc_idl_load_trans_stat when idle load transition due to AT out of gear" VALUE 0x365CA __UWORD_S 0 u_2x_tmr 0 1023.984375 /end CHARACTERISTIC
/begin CHARACTERISTIC ENSC_V_IDL_LOAD_TRANS_NIDL "hold duration of ensc_idl_load_trans_stat when idle load transition due to Neutral idle" VALUE 0x365CA __UWORD_S 0 u_2x_tmr 0 1023.984375 FORMAT "%5.3" /end CHARACTERISTIC
/begin CHARACTERISTIC ENSC_V_NM_IDL_MT_CFG "TRUE means enable normal idle control when ensc_mt_in_gr==0" VALUE 0x37118 __UBYTE_S 0 b_true 0 1 FORMAT "%5.2" /end CHARACTERISTIC
/begin CHARACTERISTIC ENSC_V_VSS_FAULT_IDL_I_CFG "true will use the default calibration as idle flow I slow adp term when VSS fault active" VALUE 0x37118 __UBYTE_S 0 b_true 0 1 FORMAT "%5.2" /end CHARACTERISTIC
/begin CHARACTERISTIC ENSC_V_IDL_I_DEV_SUM_CFG "true means idle I deviation sum logic will be enabled in all idle state" VALUE 0x37118 __UBYTE_S 0 b_true 0 1 FORMAT "%5.2" /end CHARACTERISTIC
/begin CHARACTERISTIC ENSC_V_NM_IDL_DLY "delay time to enable normal idle control" VALUE 0x36B8E __UWORD_S 0 u_2x_tmr 0 1023.984375 /end CHARACTERISTIC
/begin CHARACTERISTIC ENSC_V_OR_PD_ACOFF_MAP_MIN "min MAP Threshold when AC OFF of overrun PD idle mode" VALUE 0x202E8 __UWORD_S 0 u_kPa_0_256 0 255.99609375 /end CHARACTERISTIC
/begin CHARACTERISTIC ENSC_V_OR_PD_ACOFF_MAP_MAX "max MAP Threshold when AC OFF of overrun PD idle mode" VALUE 0x202E8 __UWORD_S 0 u_kPa_0_256 0 255.99609375 /end CHARACTERISTIC
/begin CHARACTERISTIC ENSC_V_OR_PD_ACON_MAP_MIN "min MAP Threshold when AC ON of overrun PD idle mode" VALUE 0x202E8 __UWORD_S 0 u_kPa_0_256 0 255.99609375 /end CHARACTERISTIC
/begin CHARACTERISTIC ENSC_V_OR_PD_ACON_MAP_MAX "max MAP Threshold when AC ON of overrun PD idle mode" VALUE 0x202E8 __UWORD_S 0 u_kPa_0_256 0 255.99609375 /end CHARACTERISTIC
/begin CHARACTERISTIC ENSC_V_OR_PD_MAP_HYS "MAP hysteresis to calculate MAP threshold of overrun PD mode" VALUE 0x202E8 __UWORD_S 0 u_kPa_0_256 0 255.99609375 /end CHARACTERISTIC
/begin CHARACTERISTIC ENSC_V_OR_PID_ACOFF_MAP_MIN "min MAP Threshold when AC OFF of overrun PID idle mode" VALUE 0x202E8 __UWORD_S 0 u_kPa_0_256 0 255.99609375 /end CHARACTERISTIC
/begin CHARACTERISTIC ENSC_V_OR_PID_ACOFF_MAP_MAX "max MAP Threshold when AC OFF of overrun PID idle mode" VALUE 0x202E8 __UWORD_S 0 u_kPa_0_256 0 255.99609375 /end CHARACTERISTIC
/begin CHARACTERISTIC ENSC_V_OR_PID_ACON_MAP_MIN "min MAP Threshold when AC ON of overrun PID idle mode" VALUE 0x202E8 __UWORD_S 0 u_kPa_0_256 0 255.99609375 /end CHARACTERISTIC
/begin CHARACTERISTIC ENSC_V_OR_PID_ACON_MAP_MAX "max MAP Threshold when AC ON of overrun PID idle mode" VALUE 0x202E8 __UWORD_S 0 u_kPa_0_256 0 255.99609375 /end CHARACTERISTIC
/begin CHARACTERISTIC ENSC_V_OR_PID_MAP_HYS "MAP hysteresis to calculate MAP threshold of overrun PID mode" VALUE 0x202E8 __UWORD_S 0 u_kPa_0_256 0 255.99609375 /end CHARACTERISTIC
/begin CHARACTERISTIC ENSC_V_OR_IDL_MAP_MET_TM_MIN "min time of sys_map_amp in range of MAP threshold to meet the overrun MAP condition" VALUE 0x3D18A __UWORD_S 0 u_2x_tmr 0 1023.984375 /end CHARACTERISTIC
/begin CHARACTERISTIC ENSC_V_OR_IDL_DLY "delay time to enable overrun idle control" VALUE 0x3D18A __UWORD_S 0 u_2x_tmr 0 1023.984375 /end CHARACTERISTIC
/begin CHARACTERISTIC ENSC_V_LNCH_PD_EN "true means enable launch PD idle control mode" VALUE 0x229A4 __UBYTE_S 0 b_true 0 1 FORMAT "%5.2" /end CHARACTERISTIC
/begin CHARACTERISTIC ENSC_V_IGA_CL_VSPD_MAX "max vehicle speed threshold to determinate ensc_iga_cl_conds_met" VALUE 0x2DDCA __UWORD_S 0 u_vspd 0 511.9921875 FORMAT "%4.1" /end CHARACTERISTIC
/begin CHARACTERISTIC ENSC_C_IDL_PID_ST_DLY "delay time after engine run to enable PID idle control" CURVE 0x360EC __UWORD_S 0 u_2x_tmr 0 1023.984375 SYMBOL_LINK "ENSC_C_IDL_PID_ST_DLY" 2
 /begin AXIS_DESCR FIX_AXIS sys_keyon_ect u_deg_C 17 -40 152
  /begin FIX_AXIS_PAR_LIST -5120 -3584 -2048 -512 1024 2560 4096 5632 7168 8704 10240 11776 13312 14848 16384 17920 19456 /end FIX_AXIS_PAR_LIST
 /end AXIS_DESCR
/end CHARACTERISTIC
/begin CHARACTERISTIC ENSC_C_IDL_PD_ST_DLY "delay time after engine run to enable PD idle control" CURVE 0x360EC __UWORD_S 0 u_2x_tmr 0 1023.984375 SYMBOL_LINK "ENSC_C_IDL_PD_ST_DLY" 2
 /begin AXIS_DESCR FIX_AXIS sys_keyon_ect u_deg_C 17 -40 152
  /begin FIX_AXIS_PAR_LIST -5120 -3584 -2048 -512 1024 2560 4096 5632 7168 8704 10240 11776 13312 14848 16384 17920 19456 /end FIX_AXIS_PAR_LIST
 /end AXIS_DESCR
/end CHARACTERISTIC
/begin CHARACTERISTIC ENSC_V_IDL_LOAD_TRANS_PS_P_DEV_THR "PS pressure deviation threshold above which set ensc_idl_load_trans_stat to true" VALUE 0x0002038C __UWORD_S 0 u_kPa_0_32768 0 32767.5 /end CHARACTERISTIC
/begin CHARACTERISTIC ENSC_C_IDL_LOAD_TRANS_PS "hold duration of ensc_idl_load_trans_stat when idle load transition due to PS active" CURVE 0x22512 __UWORD_S 0 u_2x_tmr 0 1023.984375 SYMBOL_LINK "ENSC_C_IDL_LOAD_TRANS_PS" 2
 /begin AXIS_DESCR FIX_AXIS sys_ect u_deg_C 17 -40 120
  /begin FIX_AXIS_PAR_LIST -5120 -3840 -2560 -1280 0 1280 2560 3840 5120 6400 7680 8960 10240 11520 12800 14080 15360 /end FIX_AXIS_PAR_LIST
 /end AXIS_DESCR
/end CHARACTERISTIC
/begin CHARACTERISTIC ENSC_V_IDL_ALT_BIAS_DFLT "default PWM alternator bias of espd sp when related fault active" VALUE 0x374C0 __UWORD_S 0 u_espd 0.0 8191.875 FORMAT "%6.2" /end CHARACTERISTIC
/begin CHARACTERISTIC ENSC_V_IDL_ALT_BIAS_ECT_MIN "ect min threshold to enable PWM alternator bias of espd sp" VALUE 0x0002038C __SWORD_S 0 u_deg_C -256 255.9921875 FORMAT "%4.2" /end CHARACTERISTIC
/begin CHARACTERISTIC ENSC_V_IDL_ALT_BIAS_PWM_THR "alternator duty threshold above which alternator bias of espd sp can be increased" VALUE 0x0002038C __UWORD_S 0 u_pct_1 0.0 99.9984741210937 FORMAT "%4.2" /end CHARACTERISTIC
/begin CHARACTERISTIC ENSC_V_IDL_ALT_BIAS_INC_DLY "increase delay of PWM alternator bias of espd sp" VALUE 0x0002038C __UWORD_S 0 u_2x_tmr 0 1023.984375 /end CHARACTERISTIC
/begin CHARACTERISTIC ENSC_V_IDL_ALT_BIAS_DEC_DLY "decrease delay of PWM alternator bias of espd sp" VALUE 0x0002038C __UWORD_S 0 u_2x_tmr 0 1023.984375 /end CHARACTERISTIC
/begin CHARACTERISTIC ENSC_C_IDL_ALT_BIAS_INC_STP "increase step of PWM alternator bias of espd sp" CURVE 0x22512 __UWORD_S 0 u_espd 0.0 8191.875 FORMAT "%6.2" SYMBOL_LINK "ENSC_C_IDL_ALT_BIAS_INC_STP" 2
 /begin AXIS_DESCR COM_AXIS sys_alt_pwm u_pct_1 9 0.000000 99.9984741210937 AXIS_PTS_REF ENSC_X_ALT_PWM /end AXIS_DESCR
/end CHARACTERISTIC
/begin CHARACTERISTIC ENSC_C_IDL_ALT_BIAS_DEC_STP "decrease step of PWM alternator bias of espd sp" CURVE 0x22512 __UWORD_S 0 u_espd 0.0 8191.875 FORMAT "%6.2" SYMBOL_LINK "ENSC_C_IDL_ALT_BIAS_DEC_STP" 2
 /begin AXIS_DESCR COM_AXIS sys_alt_pwm u_pct_1 9 0.000000 99.9984741210937 AXIS_PTS_REF ENSC_X_ALT_PWM /end AXIS_DESCR
/end CHARACTERISTIC
/begin AXIS_PTS ENSC_X_ALT_PWM "" 0x0002006C sys_alt_pwm SSV__UWORD_S 0 u_pct_1 9 0.000000 99.9984741210937 DEPOSIT ABSOLUTE SYMBOL_LINK "ENSC_X_ALT_PWM" 2 /end AXIS_PTS
/begin CHARACTERISTIC ENSC_V_IDL_ALT_BIAS_MAX_R_AC "max limit of PWM alternator espd sp bias when gear R and AC on" VALUE 0x374C0 __UWORD_S 0 u_espd 0.0 8191.875 FORMAT "%6.2" /end CHARACTERISTIC
/begin CHARACTERISTIC ENSC_V_IDL_ALT_BIAS_MAX_R "max limit of PWM alternator espd sp bias when gear R and AC off" VALUE 0x374C0 __UWORD_S 0 u_espd 0.0 8191.875 FORMAT "%6.2" /end CHARACTERISTIC
/begin CHARACTERISTIC ENSC_V_IDL_ALT_BIAS_MAX_D_AC "max limit of PWM alternator espd sp bias when gear D and AC on" VALUE 0x374C0 __UWORD_S 0 u_espd 0.0 8191.875 FORMAT "%6.2" /end CHARACTERISTIC
/begin CHARACTERISTIC ENSC_V_IDL_ALT_BIAS_MAX_D "max limit of PWM alternator espd sp bias when gear D and AC off" VALUE 0x374C0 __UWORD_S 0 u_espd 0.0 8191.875 FORMAT "%6.2" /end CHARACTERISTIC
/begin CHARACTERISTIC ENSC_V_IDL_ALT_BIAS_MAX_PN_AC "max limit of PWM alternator espd sp bias when gear PN and AC on" VALUE 0x374C0 __UWORD_S 0 u_espd 0.0 8191.875 FORMAT "%6.2" /end CHARACTERISTIC
/begin CHARACTERISTIC ENSC_V_IDL_ALT_BIAS_MAX_PN "max limit of PWM alternator espd sp bias when gear PN and AC off" VALUE 0x374C0 __UWORD_S 0 u_espd 0.0 8191.875 FORMAT "%6.2" /end CHARACTERISTIC
/begin CHARACTERISTIC THRO_C_SP_NORM_MAX "throttle setpoint max at normal condition" CURVE 0x000200B0 __UWORD_S 0 u_pct_r 0 127.998046875 SYMBOL_LINK "THRO_C_SP_NORM_MAX" 2
 /begin AXIS_DESCR FIX_AXIS sys_pps_scaled u_pct 17 0 100
  /begin FIX_AXIS_PAR_LIST 0 2048 4096 6144 8192 10240 12288 14336 16384 18432 20480 22528 24576 26624 28672 30720 32768 /end FIX_AXIS_PAR_LIST
 /end AXIS_DESCR
/end CHARACTERISTIC
/begin CHARACTERISTIC THRO_C_SP_NORM_MAX_R "throttle setpoint max at normal condition" CURVE 0x000200B0 __SWORD_S 0 u_pct_r_s -128 127.99609375 SYMBOL_LINK "THRO_C_SP_NORM_MAX_R" 2
 /begin AXIS_DESCR FIX_AXIS sys_pps_scaled u_pct 17 0 100
  /begin FIX_AXIS_PAR_LIST 0 2048 4096 6144 8192 10240 12288 14336 16384 18432 20480 22528 24576 26624 28672 30720 32768 /end FIX_AXIS_PAR_LIST
 /end AXIS_DESCR
/end CHARACTERISTIC
/begin CHARACTERISTIC THRO_V_TST_EN "etc test enable" VALUE 0x0002038C __UBYTE_S 0 b_enable 0 1 FORMAT "%4.2" /end CHARACTERISTIC
/begin CHARACTERISTIC THRO_V_TST_MODE "etc test enable" VALUE 0x0002038C __UBYTE_S 0 u_etc_tst_mod 0 3 FORMAT "%4.0" /end CHARACTERISTIC
/begin CHARACTERISTIC THRO_V_TST_EN_ESPD "etc test enable" VALUE 0x0002038C __UWORD_S 0 u_espd 0 8191.875000 FORMAT "%5.1" /end CHARACTERISTIC
/begin CHARACTERISTIC THRO_V_KEYON_MOV_DUR "key on move duration" VALUE 0x0002038C __UWORD_S 0 u_2x_tmr 0 1023.984375 /end CHARACTERISTIC
/begin CHARACTERISTIC THRO_C_KEYON_MOV_SP "TPS power on position setpoint" CURVE 0x000200B0 __SWORD_S 0 u_pct_r_s -128 127.99609375 SYMBOL_LINK "THRO_C_KEYON_MOV_SP" 2
 /begin AXIS_DESCR COM_AXIS thro_keyon_mov_tmr u_2x_tmr 13 0 1023.984375 AXIS_PTS_REF THRO_X_KEYON_DUR /end AXIS_DESCR
/end CHARACTERISTIC
/begin AXIS_PTS THRO_X_KEYON_DUR "power on time" 0x0002006C thro_keyon_mov_tmr SSV__UWORD_S 0 u_2x_tmr 13 0 1023.984375 DEPOSIT ABSOLUTE SYMBOL_LINK "THRO_X_KEYON_DUR" 2 /end AXIS_PTS
/begin CHARACTERISTIC THRO_V_SP_DEC_MISC_FIL "throttle setpoint decrease filter for misc condition" VALUE 0x0002038C __UWORD_S 0 u_filter 0 0.9999847412109375 FORMAT "%4.3" /end CHARACTERISTIC
/begin CHARACTERISTIC THRO_V_SP_DEC_CRUZ_FIL "throttle setpoint decrease filter for cruise condition" VALUE 0x0002038C __UWORD_S 0 u_filter 0 0.9999847412109375 FORMAT "%4.3" /end CHARACTERISTIC
/begin CHARACTERISTIC THRO_V_SP_DEC_LMT_FIL "throttle setpoint decrease filter for limit perf condition" VALUE 0x0002038C __UWORD_S 0 u_filter 0 0.9999847412109375 FORMAT "%4.3" /end CHARACTERISTIC
/begin CHARACTERISTIC THRO_V_SP_INC_MISC_FIL "throttle setpoint increase filter for misc condition" VALUE 0x0002038C __UWORD_S 0 u_filter 0 0.9999847412109375 FORMAT "%4.3" /end CHARACTERISTIC
/begin CHARACTERISTIC THRO_V_SP_INC_CRUZ_FIL "throttle setpoint increase filter for cruise condition" VALUE 0x0002038C __UWORD_S 0 u_filter 0 0.9999847412109375 FORMAT "%4.3" /end CHARACTERISTIC
/begin CHARACTERISTIC THRO_V_SP_INC_LMT_FIL "throttle setpoint increase filter for limit perf condition" VALUE 0x0002038C __UWORD_S 0 u_filter 0 0.9999847412109375 FORMAT "%4.3" /end CHARACTERISTIC
/begin CHARACTERISTIC THRO_C_SP_NORM_FIL "throttle setpoint filter for normal condition" CURVE 0x000200B0 __UWORD_S 0 u_filter 0 0.9999847412109375 FORMAT "%4.3" SYMBOL_LINK "THRO_C_SP_NORM_FIL" 2
 /begin AXIS_DESCR FIX_AXIS thro_sp_dlt u_pct_r_s 17 -128 127.99609375
  /begin FIX_AXIS_PAR_LIST -6400 -5600 -4800 -4000 -3200 -2400 -1600 -800 0 800 1600 2400 3200 4000 4800 5600 6400 /end FIX_AXIS_PAR_LIST
 /end AXIS_DESCR
/end CHARACTERISTIC
/begin CHARACTERISTIC THRO_C_SP_LMT_MAX "throttle setpoint max at limit perf condition" CURVE 0x000200B0 __UWORD_S 0 u_pct_r 0 127.998046875 SYMBOL_LINK "THRO_C_SP_LMT_MAX" 2
 /begin AXIS_DESCR FIX_AXIS sys_pps_scaled u_pct 17 0 100
  /begin FIX_AXIS_PAR_LIST 0 2048 4096 6144 8192 10240 12288 14336 16384 18432 20480 22528 24576 26624 28672 30720 32768 /end FIX_AXIS_PAR_LIST
 /end AXIS_DESCR
/end CHARACTERISTIC
/begin CHARACTERISTIC THRO_C_SP_LMT_MAX_R "throttle setpoint max at limit perf condition" CURVE 0x000200B0 __SWORD_S 0 u_pct_r_s -128 127.99609375 SYMBOL_LINK "THRO_C_SP_LMT_MAX_R" 2
 /begin AXIS_DESCR FIX_AXIS sys_pps_scaled u_pct 17 0 100
  /begin FIX_AXIS_PAR_LIST 0 2048 4096 6144 8192 10240 12288 14336 16384 18432 20480 22528 24576 26624 28672 30720 32768 /end FIX_AXIS_PAR_LIST
 /end AXIS_DESCR
/end CHARACTERISTIC
/begin CHARACTERISTIC THRO_V_SP_TST "test mode throttle setpoint" VALUE 0x0002038C __UWORD_S 0 u_pct_r 0 127.998046875 /end CHARACTERISTIC
/begin CHARACTERISTIC THRO_V_SP_TST_R "test mode throttle setpoint" VALUE 0x0002038C __SWORD_S 0 u_pct_r_s -128 127.99609375 /end CHARACTERISTIC
/begin CHARACTERISTIC THRO_C_SP_STOP_SHRT "TPS power on position setpoint" CURVE 0x000200B0 __UWORD_S 0 u_pct_r 0 127.998046875 SYMBOL_LINK "THRO_C_SP_STOP_SHRT" 2
 /begin AXIS_DESCR COM_AXIS thro_stop_tmr u_2x_tmr 32 0 1023.984375 AXIS_PTS_REF THRO_X_STOP_TMR_A /end AXIS_DESCR
/end CHARACTERISTIC
/begin AXIS_PTS THRO_X_STOP_TMR_A "stop time" 0x0002006C thro_stop_tmr SSV__UWORD_S 0 u_2x_tmr 32 0 1023.984375 DEPOSIT ABSOLUTE SYMBOL_LINK "THRO_X_STOP_TMR_A" 2 /end AXIS_PTS
/begin CHARACTERISTIC THRO_M_DRV_CMD_MODE "throttle driver command mode config" MAP 0x36504 __UBYTE_S 0 u_thro_drv_mode 0 2 FORMAT "%1.0"
 /begin AXIS_DESCR FIX_AXIS thro_drv_cmd_st u_thro_drv_st 4 0 3 /begin FIX_AXIS_PAR_LIST 0 1 2 3 /end FIX_AXIS_PAR_LIST /end AXIS_DESCR
 /begin AXIS_DESCR FIX_AXIS thro_pedal_st u_thro_pedal_st 4 0 3 /begin FIX_AXIS_PAR_LIST 0 1 2 3 /end FIX_AXIS_PAR_LIST /end AXIS_DESCR
/end CHARACTERISTIC
/begin CHARACTERISTIC THRO_M_DRV_CMD_MODE_R "throttle driver command mode config" MAP 0x36504 __UBYTE_S 0 u_thro_drv_mode_r 0 2 FORMAT "%1.0"
 /begin AXIS_DESCR FIX_AXIS thro_drv_cmd_st_r u_thro_drv_st_r 4 0 3 /begin FIX_AXIS_PAR_LIST 0 1 2 3 /end FIX_AXIS_PAR_LIST /end AXIS_DESCR
 /begin AXIS_DESCR FIX_AXIS thro_pedal_st_r u_thro_pedal_st_r 4 0 3 /begin FIX_AXIS_PAR_LIST 0 1 2 3 /end FIX_AXIS_PAR_LIST /end AXIS_DESCR
/end CHARACTERISTIC
/begin CHARACTERISTIC THRO_C_SP_HYB_CRK_MAX "throttle setpoint max at hybrid engine crank" CURVE 0x000200B0 __UWORD_S 0 u_pct_r 0 127.998046875 SYMBOL_LINK "THRO_C_SP_HYB_CRK_MAX" 2
 /begin AXIS_DESCR FIX_AXIS sys_ect u_pct 17 -40 120
  /begin FIX_AXIS_PAR_LIST -5120 -3840 -2560 -1280 0 1280 2560 3840 5120 6400 7680 8960 10240 11520 12800 14080 15360 /end FIX_AXIS_PAR_LIST
 /end AXIS_DESCR
/end CHARACTERISTIC
/begin CHARACTERISTIC THRO_M_THRO_ST_CFG "throttle state config" MAP 0x36504 __UBYTE_S 0 u_thro_pedal_st 0 3 FORMAT "%1.0"
 /begin AXIS_DESCR FIX_AXIS thro_actr_st u_thro_actr_st 4 0 3 /begin FIX_AXIS_PAR_LIST 0 1 2 3 /end FIX_AXIS_PAR_LIST /end AXIS_DESCR
 /begin AXIS_DESCR FIX_AXIS thro_tps_st u_thro_tps_st 8 0 7 /begin FIX_AXIS_PAR_LIST 0 1 2 3 4 5 6 7 /end FIX_AXIS_PAR_LIST /end AXIS_DESCR
/end CHARACTERISTIC
/begin CHARACTERISTIC THRO_M_THRO_ST_CFG_R "throttle state config" MAP 0x36504 __UBYTE_S 0 u_thro_pedal_st_r 0 3 FORMAT "%1.0"
 /begin AXIS_DESCR FIX_AXIS thro_actr_st_r u_thro_actr_st_r 4 0 3 /begin FIX_AXIS_PAR_LIST 0 1 2 3 /end FIX_AXIS_PAR_LIST /end AXIS_DESCR
 /begin AXIS_DESCR FIX_AXIS thro_tps_st_r u_thro_tps_st_r 8 0 7 /begin FIX_AXIS_PAR_LIST 0 1 2 3 4 5 6 7 /end FIX_AXIS_PAR_LIST /end AXIS_DESCR
/end CHARACTERISTIC
/begin CHARACTERISTIC THRO_M_POW_CTRL_CFG "throttle power control config" MAP 0x36504 __UBYTE_S 0 u_thro_pow_st 0 2 FORMAT "%1.0"
 /begin AXIS_DESCR FIX_AXIS thro_air_st u_thro_air_st 4 0 3 /begin FIX_AXIS_PAR_LIST 0 1 2 3 /end FIX_AXIS_PAR_LIST /end AXIS_DESCR
 /begin AXIS_DESCR FIX_AXIS thro_throt_st u_thro_pedal_st 4 0 3 /begin FIX_AXIS_PAR_LIST 0 1 2 3 /end FIX_AXIS_PAR_LIST /end AXIS_DESCR
/end CHARACTERISTIC
/begin CHARACTERISTIC THRO_M_POW_CTRL_CFG_R "throttle power control config" MAP 0x36504 __UBYTE_S 0 u_thro_pow_st_r 0 2 FORMAT "%1.0"
 /begin AXIS_DESCR FIX_AXIS thro_air_st_r u_thro_air_st_r 4 0 3 /begin FIX_AXIS_PAR_LIST 0 1 2 3 /end FIX_AXIS_PAR_LIST /end AXIS_DESCR
 /begin AXIS_DESCR FIX_AXIS thro_throt_st_r u_thro_pedal_st 4 0 3 /begin FIX_AXIS_PAR_LIST 0 1 2 3 /end FIX_AXIS_PAR_LIST /end AXIS_DESCR
/end CHARACTERISTIC
/begin CHARACTERISTIC THRO_M_PEDAL_ST_CFG "throttle state config" MAP 0x36504 __UBYTE_S 0 u_thro_pedal_st 0 3 FORMAT "%1.0"
 /begin AXIS_DESCR FIX_AXIS thro_pps_cor_st u_thro_pps_cor_st 2 0 1 /begin FIX_AXIS_PAR_LIST 0 1 /end FIX_AXIS_PAR_LIST /end AXIS_DESCR
 /begin AXIS_DESCR FIX_AXIS thro_pps_range_st u_thro_pps_range_st 4 0 3 /begin FIX_AXIS_PAR_LIST 0 1 2 3 /end FIX_AXIS_PAR_LIST /end AXIS_DESCR
/end CHARACTERISTIC
/begin CHARACTERISTIC THRO_M_PEDAL_ST_CFG_R "throttle state config" MAP 0x36504 __UBYTE_S 0 u_thro_pedal_st_r 0 3 FORMAT "%1.0"
 /begin AXIS_DESCR FIX_AXIS thro_pps_cor_st_r u_thro_pps_cor_st_r 2 0 1 /begin FIX_AXIS_PAR_LIST 0 1 /end FIX_AXIS_PAR_LIST /end AXIS_DESCR
 /begin AXIS_DESCR FIX_AXIS thro_pps_range_st_r u_thro_pps_range_st 4 0 3 /begin FIX_AXIS_PAR_LIST 0 1 2 3 /end FIX_AXIS_PAR_LIST /end AXIS_DESCR
/end CHARACTERISTIC
/begin CHARACTERISTIC THRO_C_FAIL_ST_CFG "throttle setpoint max at hybrid engine crank" CURVE 0x000200B0 __UBYTE_S 0 u_thro_fail_st 0 5 FORMAT "%5.2"
 /begin AXIS_DESCR FIX_AXIS NO_INPUT_QUANTITY u_thro_fail_idx 31 0 30
  /begin FIX_AXIS_PAR_LIST 0 1 2 3 4 5 6 7 8 9 10 11 12 13 14 15 16 17 18 19 20 21 22 23 24 25 26 27 28 29 30 /end FIX_AXIS_PAR_LIST
 /end AXIS_DESCR
/end CHARACTERISTIC
/begin CHARACTERISTIC THRO_C_FAIL_ST_CFG_R "throttle setpoint max at hybrid engine crank" CURVE 0x000200B0 __UBYTE_S 0 u_thro_fail_st_r 0 5 FORMAT "%5.2"
 /begin AXIS_DESCR FIX_AXIS NO_INPUT_QUANTITY u_thro_fail_idx_r 31 0 30
  /begin FIX_AXIS_PAR_LIST 0 1 2 3 4 5 6 7 8 9 10 11 12 13 14 15 16 17 18 19 20 21 22 23 24 25 26 27 28 29 30 /end FIX_AXIS_PAR_LIST
 /end AXIS_DESCR
/end CHARACTERISTIC
/begin CHARACTERISTIC THRO_V_TST_DTY "throttle control test duty cycle" VALUE 0x0002038C __UWORD_S 0 u_pct_r 0 127.998046875 /end CHARACTERISTIC
/begin CHARACTERISTIC THRO_V_TST_DIR "throttle control test direction" VALUE 0x0002038C __UBYTE_S 0 u_mot_dir 0 1 FORMAT "%1.0" /end CHARACTERISTIC
/begin CHARACTERISTIC THRO_V_CLS_DTY_MAX "throttle control close duty cycle max" VALUE 0x0002038C __SWORD_S 0 u_pct_r_lo_s -256 255.9921875 /end CHARACTERISTIC
/begin CHARACTERISTIC THRO_V_OPN_DTY_MAX "throttle control open duty cycle max" VALUE 0x0002038C __SWORD_S 0 u_pct_r_lo_s -256 255.9921875 /end CHARACTERISTIC
/begin CHARACTERISTIC THRO_V_PWM_FREQ "throttle control frequency" VALUE 0x0002038C __UWORD_S 0 u_freq 0 16383.75 /end CHARACTERISTIC
/begin CHARACTERISTIC THRO_V_MOT_D_DB "throttle control d term deadband" VALUE 0x0002038C __UWORD_S 0 u_pct_r_lo_s 0 511.9921875 /end CHARACTERISTIC
/begin CHARACTERISTIC THRO_V_MOT_FRIC_CLS_TRM "throttle control anti friction close term" VALUE 0x0002038C __SWORD_S 0 u_volt_512n_512p -512 511.9921875 /end CHARACTERISTIC
/begin CHARACTERISTIC THRO_V_MOT_FRIC_OPN_TRM "throttle control anti friction open term" VALUE 0x0002038C __SWORD_S 0 u_volt_512n_512p -512 511.9921875 /end CHARACTERISTIC
/begin CHARACTERISTIC THRO_V_MOT_INT_MIN "throttle control int term min" VALUE 0x0002038C __SWORD_S 0 u_volt_512n_512p -512 511.9921875 /end CHARACTERISTIC
/begin CHARACTERISTIC THRO_V_MOT_INT_MAX "throttle control int term max" VALUE 0x0002038C __SWORD_S 0 u_volt_512n_512p -512 511.9921875 /end CHARACTERISTIC
/begin CHARACTERISTIC THRO_C_MOT_VLT_TO_DTY_FAC "throttle motor control voltage to PWM duty factor" CURVE 0x000200B0 __UWORD_S 0 u_fac_32 0 31.99951171875 FORMAT "%5.3" SYMBOL_LINK "THRO_C_MOT_VLT_TO_DTY_FAC" 2
 /begin AXIS_DESCR FIX_AXIS hw_bat_vlt_filt u_volt_32 17 0 31.99951171875
  /begin FIX_AXIS_PAR_LIST 0 3276 6553 9830 13107 16384 19660 22937 26214 29491 32768 36044 39321 42598 45875 49152 52428 /end FIX_AXIS_PAR_LIST
 /end AXIS_DESCR
/end CHARACTERISTIC
/begin CHARACTERISTIC THRO_C_MOT_D_TRM "throttle motor control voltage d term" CURVE 0x000200B0 __SWORD_S 0 u_volt_512n_512p -512 511.9921875 SYMBOL_LINK "THRO_C_MOT_D_TRM" 2
 /begin AXIS_DESCR FIX_AXIS thro_pos_err_d u_cnts 33 -32768 32767
  /begin FIX_AXIS_PAR_LIST -14500 -12500 -10500 -8500 -6500 -4500 -2500 -2250 -2000 -1750 -1500 -1250 -1000 -750 -500 -250 0 250 500 750 1000 1250 1500 1750 2000 2250 2500 4500 6500 8500 10500 12500 14500 /end FIX_AXIS_PAR_LIST
 /end AXIS_DESCR
/end CHARACTERISTIC
/begin CHARACTERISTIC THRO_C_MOT_I_TRM "throttle motor control voltage i term" CURVE 0x000200B0 __SWORD_S 0 u_volt_32n_32p -32 31.9990234375 FORMAT "%5.3" SYMBOL_LINK "THRO_C_MOT_I_TRM" 2
 /begin AXIS_DESCR FIX_AXIS thro_pos_err u_pct_r_s 33 -128 127.99609375
  /begin FIX_AXIS_PAR_LIST -3200 -3000 -2800 -2600 -2400 -2200 -2000 -1800 -1600 -1400 -1200 -1000 -800 -600 -400 -200 0 200 400 600 800 1000 1200 1400 1600 1800 2000 2200 2400 2600 2800 3000 3200 /end FIX_AXIS_PAR_LIST
 /end AXIS_DESCR
/end CHARACTERISTIC
/begin CHARACTERISTIC THRO_C_MOT_P_TRM "throttle motor control voltage p term" CURVE 0x000200B0 __SWORD_S 0 u_volt_32n_32p -32 31.9990234375 FORMAT "%5.3" SYMBOL_LINK "THRO_C_MOT_P_TRM" 2
 /begin AXIS_DESCR FIX_AXIS thro_pos_err u_pct_r_s 29 -128 127.99609375
  /begin FIX_AXIS_PAR_LIST -25600 -20480 -15360 -10240 -5120 -4608 -4096 -3584 -3072 -2560 -2048 -1536 -1024 -512 0 512 1024 1536 2048 2560 3072 3584 4096 4608 5120 10240 15360 20480 25600 /end FIX_AXIS_PAR_LIST
 /end AXIS_DESCR
/end CHARACTERISTIC
/begin CHARACTERISTIC THRO_C_MOT_SPRING_TRM "throttle motor control voltage spring term" CURVE 0x000200B0 __SWORD_S 0 u_volt_512n_512p -512 511.9921875 SYMBOL_LINK "THRO_C_MOT_SPRING_TRM" 2
 /begin AXIS_DESCR COM_AXIS NO_INPUT_QUANTITY u_pct_r_s 9 -128 127.99609375 AXIS_PTS_REF THRO_X_TPS_DELTA_A /end AXIS_DESCR
/end CHARACTERISTIC
/begin AXIS_PTS THRO_X_TPS_DELTA_A "delta between desired tps and unpowered tps" 0x0002006C NO_INPUT_QUANTITY SSV__SWORD_S 0 u_pct_r_s 9 -128 127.99609375 DEPOSIT ABSOLUTE /end AXIS_PTS
/begin CHARACTERISTIC THRO_C_OPN_LONG_DTY_MAX "throttle motor control open long duty max" CURVE 0x000200B0 __SWORD_S 0 u_pct_r_lo_s -256 255.9921875 SYMBOL_LINK "THRO_C_OPN_LONG_DTY_MAX" 2
 /begin AXIS_DESCR FIX_AXIS hw_bat_vlt_filt u_volt_32 17 0 31.99951171875
  /begin FIX_AXIS_PAR_LIST 0 3276 6553 9830 13107 16384 19660 22937 26214 29491 32768 36044 39321 42598 45875 49152 52428 /end FIX_AXIS_PAR_LIST
 /end AXIS_DESCR
/end CHARACTERISTIC
/begin CHARACTERISTIC THRO_C_CLS_LONG_DTY_MAX "throttle motor control close long duty max" CURVE 0x000200B0 __SWORD_S 0 u_pct_r_lo_s -256 255.9921875 SYMBOL_LINK "THRO_C_CLS_LONG_DTY_MAX" 2
 /begin AXIS_DESCR FIX_AXIS hw_bat_vlt_filt u_volt_32 17 0 31.99951171875
  /begin FIX_AXIS_PAR_LIST 0 3276 6553 9830 13107 16384 19660 22937 26214 29491 32768 36044 39321 42598 45875 49152 52428 /end FIX_AXIS_PAR_LIST
 /end AXIS_DESCR
/end CHARACTERISTIC
/begin CHARACTERISTIC THRO_V_STUCK_D_MAX "throttle stuck derivative max" VALUE 0x0002038C __UWORD_S 0 u_pct_r_lo_s 0 511.9921875 /end CHARACTERISTIC
/begin CHARACTERISTIC THRO_V_STUCK_ERR_INT_MIN "throttle stuck position error int min" VALUE 0x0002038C __SWORD_S 0 u_pct_r_s -128 127.99609375 /end CHARACTERISTIC
/begin CHARACTERISTIC THRO_V_STUCK_RUN_ERR_MIN "engine run throttle stuck position error min" VALUE 0x0002038C __UWORD_S 0 u_pct_r_lo_s 0 511.9921875 /end CHARACTERISTIC
/begin CHARACTERISTIC THRO_C_MOT_STUCK_TRM "throttle motor control voltage stuck term" CURVE 0x000200B0 __SWORD_S 0 u_volt_512n_512p -512 511.9921875
 /begin AXIS_DESCR FIX_AXIS thro_stuck_ctrl_tmr u_base_tmr 32 0 0.15
  /begin FIX_AXIS_PAR_LIST 0 1 2 3 4 5 6 7 8 9 10 11 12 13 14 15 16 17 18 19 20 21 22 23 24 25 26 27 28 29 30 31 /end FIX_AXIS_PAR_LIST
 /end AXIS_DESCR
/end CHARACTERISTIC
/begin CHARACTERISTIC THRO_C_MOT_STOP_STUCK_TRM "throttle motor control voltage stuck term" CURVE 0x000200B0 __SWORD_S 0 u_volt_512n_512p -512 511.9921875
 /begin AXIS_DESCR FIX_AXIS thro_stuck_ctrl_tmr u_base_tmr 32 0 0.15
  /begin FIX_AXIS_PAR_LIST 0 1 2 3 4 5 6 7 8 9 10 11 12 13 14 15 16 17 18 19 20 21 22 23 24 25 26 27 28 29 30 31 /end FIX_AXIS_PAR_LIST
 /end AXIS_DESCR
/end CHARACTERISTIC
/begin CHARACTERISTIC THRO_V_STUCK_CTRL_DUR "throttle stuck control duration" VALUE 0x0002038C __UWORD_S 0 u_base_tmr 0 255.99609375 FORMAT "%5.2" /end CHARACTERISTIC
/begin CHARACTERISTIC THRO_V_STUCK_CTRL_OFF_MIN "throttle stuck control off duration min" VALUE 0x0002038C __UWORD_S 0 u_base_tmr 0 255.99609375 FORMAT "%5.2" /end CHARACTERISTIC
/begin CHARACTERISTIC THRO_V_MOT_IDL_I_DB "throttle control idle i term deadband" VALUE 0x0002038C __UWORD_S 0 u_pct_r_lo_s 0 511.9921875 /end CHARACTERISTIC
/begin CHARACTERISTIC THRO_C_MOT_I_DB "throttle motor control i term deadband" CURVE 0x000200B0 __UWORD_S 0 u_pct_r_lo_s 0 511.9921875 SYMBOL_LINK "THRO_C_MOT_I_DB" 2
 /begin AXIS_DESCR FIX_AXIS thro_pos_sp u_pct_r 5 0 100 /begin FIX_AXIS_PAR_LIST 0 12800 25600 38400 51200 /end FIX_AXIS_PAR_LIST /end AXIS_DESCR
/end CHARACTERISTIC
/begin AXIS_PTS OSHT_X_KEYON_ECT "keyon ECT breakpoint" 0x0002006C sys_keyon_ect SSV__SWORD_S 0 u_deg_C 17 -256 255.9921875 FORMAT "%4.1" DEPOSIT ABSOLUTE SYMBOL_LINK "OSHT_X_KEYON_ECT" 2 /end AXIS_PTS
/begin CHARACTERISTIC OSHT_C_SS_VLT_INIT_SP "initial steady state voltage setpoint" CURVE 0x000200B0 __UWORD_S 0 u_volt_32 0 31.99951171875 FORMAT "%4.2"
 /begin AXIS_DESCR FIX_AXIS NO_INPUT_QUANTITY u_o2_loc 2 0 1 /begin FIX_AXIS_PAR_LIST 0 1 /end FIX_AXIS_PAR_LIST /end AXIS_DESCR
/end CHARACTERISTIC
/begin CHARACTERISTIC OSHT_C_HYB_IDL_VLT_INIT_SP "hybrid initial idle voltage setpoint" CURVE 0x000200B0 __UWORD_S 0 u_volt_32 0 31.99951171875 FORMAT "%4.2"
 /begin AXIS_DESCR FIX_AXIS NO_INPUT_QUANTITY u_o2_loc 2 0 1 /begin FIX_AXIS_PAR_LIST 0 1 /end FIX_AXIS_PAR_LIST /end AXIS_DESCR
/end CHARACTERISTIC
/begin CHARACTERISTIC OSHT_C_HYB_FCO_VLT_INIT_SP "hybrid initial fuel cut off voltage setpoint" CURVE 0x000200B0 __UWORD_S 0 u_volt_32 0 31.99951171875 FORMAT "%4.2"
 /begin AXIS_DESCR FIX_AXIS NO_INPUT_QUANTITY u_o2_loc 2 0 1 /begin FIX_AXIS_PAR_LIST 0 1 /end FIX_AXIS_PAR_LIST /end AXIS_DESCR
/end CHARACTERISTIC
/begin CHARACTERISTIC OSHT_C_DTY_MAX_SP "heater max state duty cycle setpoint" CURVE 0x000200B0 __UWORD_S 0 u_pct 0 199.996948 FORMAT "%4.1"
 /begin AXIS_DESCR FIX_AXIS NO_INPUT_QUANTITY u_o2_loc 2 0 1 /begin FIX_AXIS_PAR_LIST 0 1 /end FIX_AXIS_PAR_LIST /end AXIS_DESCR
/end CHARACTERISTIC
/begin CHARACTERISTIC OSHT_V_HI_SPD_DTY "high engine speed heater duty" VALUE 0x0002038C __UWORD_S 0 u_pct 0 199.996948 FORMAT "%4.1" /end CHARACTERISTIC
/begin CHARACTERISTIC OSHT_C_DO2_MAX_DUR "down o2 heater duty max duration" CURVE 0x000200B0 __UWORD_S 0 u_16x_tmr 0 8191.875 SYMBOL_LINK "OSHT_C_DO2_MAX_DUR" 2
 /begin AXIS_DESCR COM_AXIS sys_keyon_ect u_deg_C 17 -256 255.9921875 AXIS_PTS_REF OSHT_X_KEYON_ECT /end AXIS_DESCR
/end CHARACTERISTIC
/begin CHARACTERISTIC OSHT_C_UO2_MAX_DUR "up o2 heater duty max duration" CURVE 0x000200B0 __UWORD_S 0 u_16x_tmr 0 8191.875 SYMBOL_LINK "OSHT_C_UO2_MAX_DUR" 2
 /begin AXIS_DESCR COM_AXIS sys_keyon_ect u_deg_C 17 -256 255.9921875 AXIS_PTS_REF OSHT_X_KEYON_ECT /end AXIS_DESCR
/end CHARACTERISTIC
/begin CHARACTERISTIC OSHT_V_RMP_DWN_DUR "heater duty ramp down duration" VALUE 0x0002038C __UWORD_S 0 u_16x_tmr 0 8191.875 /end CHARACTERISTIC
/begin CHARACTERISTIC OSHT_C_RMP_UP_DUR "heater max state duty cycle setpoint" CURVE 0x000200B0 __UWORD_S 0 u_16x_tmr 0 8191.875
 /begin AXIS_DESCR FIX_AXIS NO_INPUT_QUANTITY u_o2_loc 2 0 1 /begin FIX_AXIS_PAR_LIST 0 1 /end FIX_AXIS_PAR_LIST /end AXIS_DESCR
/end CHARACTERISTIC
/begin CHARACTERISTIC OSHT_C_FCO_ON_DLY "fuel cut off duty enable delay" CURVE 0x000200B0 __UWORD_S 0 u_16x_tmr 0 8191.875
 /begin AXIS_DESCR FIX_AXIS NO_INPUT_QUANTITY u_o2_loc 2 0 1 /begin FIX_AXIS_PAR_LIST 0 1 /end FIX_AXIS_PAR_LIST /end AXIS_DESCR
/end CHARACTERISTIC
/begin CHARACTERISTIC OSHT_C_FCO_OFF_DLY "fuel cut off duty disable delay" CURVE 0x000200B0 __UWORD_S 0 u_16x_tmr 0 8191.875
 /begin AXIS_DESCR FIX_AXIS NO_INPUT_QUANTITY u_o2_loc 2 0 1 /begin FIX_AXIS_PAR_LIST 0 1 /end FIX_AXIS_PAR_LIST /end AXIS_DESCR
/end CHARACTERISTIC
/begin CHARACTERISTIC OSHT_V_ESPD_HI_THR "engine speed high thr" VALUE 0x0002038C __UWORD_S 0 u_espd 0 8191.875000 FORMAT "%5.1" /end CHARACTERISTIC
/begin CHARACTERISTIC OSHT_C_UO2_DLY_BIAS "up o2 heater active delay bias when dewpoint not reached last key" CURVE 0x000200B0 __UWORD_S 0 u_16x_tmr 0 8191.875 SYMBOL_LINK "OSHT_C_UO2_DLY_BIAS" 2
 /begin AXIS_DESCR COM_AXIS sys_keyon_ect u_deg_C 17 -256 255.9921875 AXIS_PTS_REF OSHT_X_KEYON_ECT /end AXIS_DESCR
/end CHARACTERISTIC
/begin CHARACTERISTIC OSHT_C_DO2_DLY_BIAS "down o2 heater active delay bias when dewpoint not reached last key" CURVE 0x000200B0 __UWORD_S 0 u_16x_tmr 0 8191.875 SYMBOL_LINK "OSHT_C_DO2_DLY_BIAS" 2
 /begin AXIS_DESCR COM_AXIS sys_keyon_ect u_deg_C 17 -256 255.9921875 AXIS_PTS_REF OSHT_X_KEYON_ECT /end AXIS_DESCR
/end CHARACTERISTIC
/begin CHARACTERISTIC OSHT_C_UO2_DLY "up o2 heater active delay" CURVE 0x000200B0 __UWORD_S 0 u_16x_tmr 0 8191.875 SYMBOL_LINK "OSHT_C_UO2_DLY" 2
 /begin AXIS_DESCR COM_AXIS sys_keyon_ect u_deg_C 17 -256 255.9921875 AXIS_PTS_REF OSHT_X_KEYON_ECT /end AXIS_DESCR
/end CHARACTERISTIC
/begin CHARACTERISTIC OSHT_C_DO2_DLY "down o2 heater active delay" CURVE 0x000200B0 __UWORD_S 0 u_16x_tmr 0 8191.875 SYMBOL_LINK "OSHT_C_DO2_DLY" 2
 /begin AXIS_DESCR COM_AXIS sys_keyon_ect u_deg_C 17 -256 255.9921875 AXIS_PTS_REF OSHT_X_KEYON_ECT /end AXIS_DESCR
/end CHARACTERISTIC
/begin CHARACTERISTIC OSHT_C_EXH_T_VLD_DLY "exhaust model temp ready delay" CURVE 0x000200B0 __UWORD_S 0 u_16x_tmr 0 8191.875 SYMBOL_LINK "OSHT_C_EXH_T_VLD_DLY" 2
 /begin AXIS_DESCR COM_AXIS sys_keyon_ect u_deg_C 17 -256 255.9921875 AXIS_PTS_REF OSHT_X_KEYON_ECT /end AXIS_DESCR
/end CHARACTERISTIC
/begin CHARACTERISTIC OSHT_M_DO2_SS_VLT_SP "down heater steady state volt setpoint" MAP 0x36504 __UWORD_S 0 u_volt_32 0 31.99951171875 FORMAT "%4.2" SYMBOL_LINK "OSHT_M_DO2_SS_VLT_SP" 4
 /begin AXIS_DESCR COM_AXIS osht_mdl_exh_t u_deg_K 17 0.0 2047.96875 AXIS_PTS_REF OSHT_X_EXH_T_B /end AXIS_DESCR
 /begin AXIS_DESCR FIX_AXIS sys_eng_spd u_espd 17 0 6400
  /begin FIX_AXIS_PAR_LIST 0 3200 6400 9600 12800 16000 19200 22400 25600 28800 32000 35200 38400 41600 44800 48000 51200 /end FIX_AXIS_PAR_LIST
 /end AXIS_DESCR
/end CHARACTERISTIC
/begin CHARACTERISTIC OSHT_M_UO2_SS_VLT_SP "up heater steady state volt setpoint" MAP 0x36504 __UWORD_S 0 u_volt_32 0 31.99951171875 FORMAT "%4.2" SYMBOL_LINK "OSHT_M_UO2_SS_VLT_SP" 4
 /begin AXIS_DESCR COM_AXIS osht_mdl_exh_t u_deg_K 17 0.0 2047.96875 AXIS_PTS_REF OSHT_X_EXH_T_A /end AXIS_DESCR
 /begin AXIS_DESCR FIX_AXIS sys_eng_spd u_espd 17 0 6400
  /begin FIX_AXIS_PAR_LIST 0 3200 6400 9600 12800 16000 19200 22400 25600 28800 32000 35200 38400 41600 44800 48000 51200 /end FIX_AXIS_PAR_LIST
 /end AXIS_DESCR
/end CHARACTERISTIC
/begin AXIS_PTS OSHT_X_EXH_T_A "exhaust temp breakpoint" 0x0002006C osht_mdl_exh_t SSV__UWORD_S 0 u_deg_K 17 0.0 2047.96875 FORMAT "%5.1" DEPOSIT ABSOLUTE SYMBOL_LINK "OSHT_X_EXH_T_A" 2 /end AXIS_PTS
/begin AXIS_PTS OSHT_X_EXH_T_B "exhaust temp breakpoint" 0x0002006C osht_mdl_exh_t SSV__UWORD_S 0 u_deg_K 17 0.0 2047.96875 FORMAT "%5.1" DEPOSIT ABSOLUTE SYMBOL_LINK "OSHT_X_EXH_T_B" 2 /end AXIS_PTS
/begin CHARACTERISTIC OSHT_M_DO2_FCO_VLT_SP "down heater fuel cut off volt setpoint" MAP 0x36504 __UWORD_S 0 u_volt_32 0 31.99951171875 FORMAT "%4.2" SYMBOL_LINK "OSHT_M_DO2_FCO_VLT_SP" 4
 /begin AXIS_DESCR COM_AXIS osht_mdl_exh_t_mmv u_deg_K 13 0.0 2047.96875 AXIS_PTS_REF OSHT_X_EXH_T_C /end AXIS_DESCR
 /begin AXIS_DESCR COM_AXIS afm_air_flw u_g_per_sec 10 0 511.9921875 AXIS_PTS_REF OSHT_X_AIR_FLW_A /end AXIS_DESCR
/end CHARACTERISTIC
/begin CHARACTERISTIC OSHT_M_UO2_FCO_VLT_SP "up heater fuel cut off volt setpoint" MAP 0x36504 __UWORD_S 0 u_volt_32 0 31.99951171875 FORMAT "%4.2" SYMBOL_LINK "OSHT_M_UO2_FCO_VLT_SP" 4
 /begin AXIS_DESCR COM_AXIS osht_mdl_exh_t_mmv u_deg_K 13 0.0 2047.96875 AXIS_PTS_REF OSHT_X_EXH_T_C /end AXIS_DESCR
 /begin AXIS_DESCR COM_AXIS afm_air_flw u_g_per_sec 10 0 511.9921875 AXIS_PTS_REF OSHT_X_AIR_FLW_A /end AXIS_DESCR
/end CHARACTERISTIC
/begin AXIS_PTS OSHT_X_AIR_FLW_A "airflow breakpoint" 0x0002006C afm_air_flw SSV__UWORD_S 0 u_g_per_sec 10 0 511.9921875 DEPOSIT ABSOLUTE SYMBOL_LINK "OSHT_X_AIR_FLW_A" 2 /end AXIS_PTS
/begin AXIS_PTS OSHT_X_EXH_T_C "exhaust temp breakpoint" 0x0002006C osht_mdl_exh_t SSV__UWORD_S 0 u_deg_K 13 0.0 2047.96875 FORMAT "%5.1" DEPOSIT ABSOLUTE SYMBOL_LINK "OSHT_X_EXH_T_C" 2 /end AXIS_PTS
/begin CHARACTERISTIC OSHT_C_FL_ON_DLY "ECT fail heater on delay" CURVE 0x000200B0 __UWORD_S 0 u_1s_tmr 0 65535
 /begin AXIS_DESCR FIX_AXIS NO_INPUT_QUANTITY u_o2_loc 2 0 1 /begin FIX_AXIS_PAR_LIST 0 1 /end FIX_AXIS_PAR_LIST /end AXIS_DESCR
/end CHARACTERISTIC
/begin CHARACTERISTIC OSHT_M_DTY_FIL "steady state volt setpoint filter" MAP 0x36504 __UWORD_S 0 u_filter 0 0.9999847412109375 FORMAT "%4.3"
 /begin AXIS_DESCR FIX_AXIS NO_INPUT_QUANTITY u_o2_loc 2 0 1 /begin FIX_AXIS_PAR_LIST 0 1 /end FIX_AXIS_PAR_LIST /end AXIS_DESCR
 /begin AXIS_DESCR FIX_AXIS NO_INPUT_QUANTITY u_osht_dir 2 0 1 /begin FIX_AXIS_PAR_LIST 0 1 /end FIX_AXIS_PAR_LIST /end AXIS_DESCR
/end CHARACTERISTIC
/begin CHARACTERISTIC OSHT_C_EXH_T_FIL "exhaust temp filter" CURVE 0x000200B0 __UWORD_S 0 u_filter 0 0.9999847412109375 FORMAT "%4.3"
 /begin AXIS_DESCR FIX_AXIS NO_INPUT_QUANTITY u_osht_dir 2 0 1 /begin FIX_AXIS_PAR_LIST 0 1 /end FIX_AXIS_PAR_LIST /end AXIS_DESCR
/end CHARACTERISTIC
/begin CHARACTERISTIC OSHT_C_EXH_T_HYB_FIL "hybrid active exhaust temp filter" CURVE 0x000200B0 __UWORD_S 0 u_filter 0 0.9999847412109375 FORMAT "%4.3"
 /begin AXIS_DESCR FIX_AXIS NO_INPUT_QUANTITY u_osht_dir 2 0 1 /begin FIX_AXIS_PAR_LIST 0 1 /end FIX_AXIS_PAR_LIST /end AXIS_DESCR
/end CHARACTERISTIC
/begin CHARACTERISTIC OSHT_C_DO2_DEW_VLT_SP "down o2 heater dewpoint duty setpoint" CURVE 0x000200B0 __UWORD_S 0 u_volt_32 0 31.99951171875 FORMAT "%4.2" SYMBOL_LINK "OSHT_C_DO2_DEW_VLT_SP" 2
 /begin AXIS_DESCR COM_AXIS sys_keyon_ect u_deg_C 17 -256 255.9921875 AXIS_PTS_REF OSHT_X_KEYON_ECT /end AXIS_DESCR
/end CHARACTERISTIC
/begin CHARACTERISTIC OSHT_C_UO2_DEW_VLT_SP "up o2 heater dewpoint duty setpoint" CURVE 0x000200B0 __UWORD_S 0 u_volt_32 0 31.99951171875 FORMAT "%4.2" SYMBOL_LINK "OSHT_C_UO2_DEW_VLT_SP" 2
 /begin AXIS_DESCR COM_AXIS sys_keyon_ect u_deg_C 17 -256 255.9921875 AXIS_PTS_REF OSHT_X_KEYON_ECT /end AXIS_DESCR
/end CHARACTERISTIC
/begin CHARACTERISTIC OSHT_V_BIAS_EN_SOAK_MAX "heater on delay bias enable soak time max" VALUE 0x0002038C __UWORD_S 0 u_min 0 65535 /end CHARACTERISTIC
/begin CHARACTERISTIC OSHT_C_FUEL_ACCUM_THR "accumulated fuel threshold" CURVE 0x000200B0 __ULONG_S 0 u_gram_l_65536 0 65535.9999847412109375 FORMAT "%6.1" SYMBOL_LINK "OSHT_C_FUEL_ACCUM_THR" 2
 /begin AXIS_DESCR COM_AXIS sys_keyon_ect u_deg_C 4 -256 255.9921875 AXIS_PTS_REF OSHT_X_KEYON_ECT_A /end AXIS_DESCR
/end CHARACTERISTIC
/begin AXIS_PTS OSHT_X_KEYON_ECT_A "temp delta breakpoint" 0x0002006C sys_keyon_ect SSV__SWORD_S 0 u_deg_C 4 -256 255.9921875 DEPOSIT ABSOLUTE SYMBOL_LINK "OSHT_X_KEYON_ECT_A" 2 /end AXIS_PTS
/begin CHARACTERISTIC OSHT_V_FUEL_TO_T_FAC "fuel consumption to temp factor" VALUE 0x0002038C __UBYTE_S 0 u_fac_16_b 0 15.9375 /end CHARACTERISTIC
/begin CHARACTERISTIC OSHT_C_STP_T_DEC "idle stop temp decrease" CURVE 0x000200B0 __SWORD_S 0 u_deg_C -256 255.9921875 SYMBOL_LINK "OSHT_C_STP_T_DEC" 2
 /begin AXIS_DESCR FIX_AXIS osht_eng_stp_tmr u_16x_tmr 8 0 8191.875 /begin FIX_AXIS_PAR_LIST 40 80 160 320 640 1280 2560 5120 /end FIX_AXIS_PAR_LIST /end AXIS_DESCR
/end CHARACTERISTIC
/begin CHARACTERISTIC OSHT_V_EN_VOLT_MAX "heater on enable voltage max" VALUE 0x0002038C __UWORD_S 0 u_volt_32 0 31.99951171875 FORMAT "%4.2" /end CHARACTERISTIC
/begin CHARACTERISTIC OSHT_V_HOT_STRT_ECT "hot restart ECT thr" VALUE 0x0002038C __SWORD_S 0 u_deg_C -256 255.9921875 /end CHARACTERISTIC
/begin CHARACTERISTIC OSHT_V_HOT_STRT_DLT "hot restart delta" VALUE 0x0002038C __SWORD_S 0 u_deg_C -256 255.9921875 /end CHARACTERISTIC
/begin CHARACTERISTIC OSHT_V_HOT_STRT_SOAK "hot restart soak time max" VALUE 0x0002038C __UWORD_S 0 u_min 0 65535 /end CHARACTERISTIC
/begin CHARACTERISTIC OSHT_V_HYB_FCO_DUR_MAX "heater on duration max when hybrid fuel cut active" VALUE 0x0002038C __UWORD_S 0 u_500m_tmr 0 32767.5 FORMAT "%6.1" /end CHARACTERISTIC
/begin CHARACTERISTIC OSHT_V_HYB_STOP_DUR_MAX "heater on duration max when hybrid stop active" VALUE 0x0002038C __UWORD_S 0 u_1x_tmr 0 511.9921875 FORMAT "%5.2" /end CHARACTERISTIC
/begin CHARACTERISTIC OSHT_V_HYB_EXH_CLD_THR "hybrid exhaust temp cold thr" VALUE 0x0002038C __UWORD_S 0 u_deg_K 0 2047.96875 FORMAT "%5.1" /end CHARACTERISTIC
/begin CHARACTERISTIC OSHT_V_WARM_UP_HYB_DIS "hybrid stop warm up disable" VALUE 0x0002038C __UWORD_S 0 u_deg_K 0 2047.96875 FORMAT "%5.1" /end CHARACTERISTIC
/begin CHARACTERISTIC AUX_V_BPUMP_EN_VSPD "brake pump enable vehicle speed min when brake boost sensor fail" VALUE 0x0002038C __UWORD_S 0 u_vspd 0 511.9921875 /end CHARACTERISTIC
/begin CHARACTERISTIC AUX_V_BPUMP_EN_RUN "brake pump enable engine runtime min" VALUE 0x0002038C __UWORD_S 0 u_1s_tmr 0 65535 /end CHARACTERISTIC
/begin CHARACTERISTIC AUX_V_BPUMP_EN_DLY "brake pump enable delay after all conditions met" VALUE 0x0002038C __UWORD_S 0 u_16x_tmr 0.0 8191.875 /end CHARACTERISTIC
/begin CHARACTERISTIC AUX_V_BPUMP_OFF_MIN "brake pump off min to enable pump" VALUE 0x0002038C __UWORD_S 0 u_16x_tmr 0.0 8191.875 /end CHARACTERISTIC
/begin CHARACTERISTIC AUX_V_BPUMP_ON_MAX "brake pump on duration max" VALUE 0x0002038C __UWORD_S 0 u_16x_tmr 0.0 8191.875 /end CHARACTERISTIC
/begin CHARACTERISTIC AUX_C_BPUMP_ON_P "brake pump on press" CURVE 0x000200B0 __UWORD_S 0 u_kPa_0_256 0 255.99609375 SYMBOL_LINK "AUX_C_BPUMP_ON_P" 2
 /begin AXIS_DESCR FIX_AXIS sys_amp u_kPa_0_256 6 55 105 /begin FIX_AXIS_PAR_LIST 14080 16640 19200 21760 24320 26880 /end FIX_AXIS_PAR_LIST /end AXIS_DESCR
/end CHARACTERISTIC
/begin CHARACTERISTIC AUX_C_BPUMP_OFF_P "brake pump off press" CURVE 0x000200B0 __UWORD_S 0 u_kPa_0_256 0 255.99609375 SYMBOL_LINK "AUX_C_BPUMP_OFF_P" 2
 /begin AXIS_DESCR FIX_AXIS sys_amp u_kPa_0_256 6 55 105 /begin FIX_AXIS_PAR_LIST 14080 16640 19200 21760 24320 26880 /end FIX_AXIS_PAR_LIST /end AXIS_DESCR
/end CHARACTERISTIC
/begin CHARACTERISTIC AUX_V_BPUMP_INST "brake pump install" VALUE 0x0002038C __UBYTE_S 0 b_true 0.0 1 FORMAT "%1.0" /end CHARACTERISTIC
/begin CHARACTERISTIC AUX_V_BPUMP_HYB_EN "brake pump enable when hybrid stop on" VALUE 0x0002038C __UBYTE_S 0 b_true 0.0 1 FORMAT "%1.0" /end CHARACTERISTIC
/begin CHARACTERISTIC AUX_V_SRLY_CRK_ON_DLY "starter relay on delay after crank key active" VALUE 0x0002038C __UWORD_S 0 u_2x_tmr 0.0 1023.984375 /end CHARACTERISTIC
/begin CHARACTERISTIC AUX_V_SRLY_KEY_ON_DLY "key on delay" VALUE 0x0002038C __UWORD_S 0 u_2x_tmr 0.0 1023.984375 /end CHARACTERISTIC
/begin CHARACTERISTIC AUX_V_SRLY_ON_MIN "starter on duration min" VALUE 0x0002038C __UWORD_S 0 u_2x_tmr 0.0 1023.984375 /end CHARACTERISTIC
/begin CHARACTERISTIC AUX_V_SRLY_NCRK_ON_MAX "starter on duration max when engine not crank" VALUE 0x0002038C __UWORD_S 0 u_2x_tmr 0.0 1023.984375 /end CHARACTERISTIC
/begin CHARACTERISTIC AUX_C_SRLY_ON_DUR "starter on duration after crank switch off" CURVE 0x000200B0 __UWORD_S 0 u_2x_tmr 0.0 1023.984375 SYMBOL_LINK "AUX_C_SRLY_ON_DUR" 2
 /begin AXIS_DESCR FIX_AXIS sys_ect u_deg_C 17 -40 152
  /begin FIX_AXIS_PAR_LIST -5120 -3584 -2048 -512 1024 2560 4096 5632 7168 8704 10240 11776 13312 14848 16384 17920 19456 /end FIX_AXIS_PAR_LIST
 /end AXIS_DESCR
/end CHARACTERISTIC
/begin CHARACTERISTIC AUX_C_SRLY_FN_DLY "starter crank finish delay after engine run segment conds met" CURVE 0x000200B0 __UWORD_S 0 u_2x_tmr 0.0 1023.984375 SYMBOL_LINK "AUX_C_SRLY_FN_DLY" 2
 /begin AXIS_DESCR FIX_AXIS sys_ect u_deg_C 17 -40 152
  /begin FIX_AXIS_PAR_LIST -5120 -3584 -2048 -512 1024 2560 4096 5632 7168 8704 10240 11776 13312 14848 16384 17920 19456 /end FIX_AXIS_PAR_LIST
 /end AXIS_DESCR
/end CHARACTERISTIC
/begin CHARACTERISTIC AUX_C_SRLY_HYB_FN_DLY "hybrid starter crank finish delay after engine run segment conds met" CURVE 0x000200B0 __UWORD_S 0 u_2x_tmr 0.0 1023.984375 SYMBOL_LINK "AUX_C_SRLY_HYB_FN_DLY" 2
 /begin AXIS_DESCR FIX_AXIS sys_ect u_deg_C 17 -40 152
  /begin FIX_AXIS_PAR_LIST -5120 -3584 -2048 -512 1024 2560 4096 5632 7168 8704 10240 11776 13312 14848 16384 17920 19456 /end FIX_AXIS_PAR_LIST
 /end AXIS_DESCR
/end CHARACTERISTIC
/begin CHARACTERISTIC AUX_V_SRLY_CFG "starter relay control config" VALUE 0x0002038C __UBYTE_S 0 u_srly_cfg 0.0 4 FORMAT "%1.0" /end CHARACTERISTIC
/begin CHARACTERISTIC AUX_V_SRLY_CRK_CFG "crank switch config" VALUE 0x0002038C __UBYTE_S 0 u_crk_sw_cfg 1 2 FORMAT "%1.0" /end CHARACTERISTIC
/begin CHARACTERISTIC AUX_V_SRLY_DIS_CFG "starter on disable config" VALUE 0x0002038C __UBYTE_S 0 u_crk_dis_cfg 1 2 FORMAT "%1.0" /end CHARACTERISTIC
/begin CHARACTERISTIC AUX_V_SRLY_WRM_FN_SEG "warm crank finish segment counts" VALUE 0x0002038C __UBYTE_S 0 u_cnts 0 255 /end CHARACTERISTIC
/begin CHARACTERISTIC AUX_V_SRLY_HOT_FN_SEG "hot crank finish segment counts" VALUE 0x0002038C __UBYTE_S 0 u_cnts 0 255 /end CHARACTERISTIC
/begin CHARACTERISTIC AUX_V_SRLY_CLD_FN_SEG "cold crank finish segment counts" VALUE 0x0002038C __UBYTE_S 0 u_cnts 0 255 /end CHARACTERISTIC
/begin CHARACTERISTIC AUX_V_SRLY_HYB_FN_SEG "hybrid crank finish segment counts" VALUE 0x0002038C __UBYTE_S 0 u_cnts 0 255 /end CHARACTERISTIC
/begin CHARACTERISTIC AUX_V_SRLY_OVRHT_ACTV_CNTS "starter over heat active counts" VALUE 0x0002038C __UWORD_S 0 u_cnts 0 65535 FORMAT "%5.0" /end CHARACTERISTIC
/begin CHARACTERISTIC AUX_V_SRLY_OVRHT_EXT_CNTS "starter over heat exit counts" VALUE 0x0002038C __UWORD_S 0 u_cnts 0 65535 FORMAT "%5.0" /end CHARACTERISTIC
/begin CHARACTERISTIC AUX_V_SRLY_OVRHT_DEC_CNTS "starter over heat decrease counts" VALUE 0x0002038C __UWORD_S 0 u_cnts 0 65535 FORMAT "%5.0" /end CHARACTERISTIC
/begin CHARACTERISTIC AUX_V_SRLY_OVRHT_INC_CNTS "starter over heat increase counts" VALUE 0x0002038C __UWORD_S 0 u_cnts 0 65535 FORMAT "%5.0" SYMBOL_LINK "AUX_V_SRLY_OVRHT_DEC_CNTS" 0 /end CHARACTERISTIC
/begin CHARACTERISTIC AUX_V_SRLY_OVRHT_STCK_INC_CNTS "starter over heat increase counts when motor stuck" VALUE 0x0002038C __UWORD_S 0 u_cnts 0 65535 FORMAT "%5.0" /end CHARACTERISTIC
/begin CHARACTERISTIC AUX_V_SRLY_CRK_TM_FIL "average crank time filter" VALUE 0x2886C __UWORD_S 0 u_filter 0 0.9999847412109375 FORMAT "%10.9" /end CHARACTERISTIC
/begin CHARACTERISTIC AUX_V_SRLY_LRN_VLT "starter control unuse learned voltage thr" VALUE 0x0002038C __UWORD_S 0 u_volt_32 0 31.99951171875 FORMAT "%4.2" /end CHARACTERISTIC
/begin CHARACTERISTIC AUX_V_SRLY_STCK_VLT "starter stuck voltage thr" VALUE 0x0002038C __UWORD_S 0 u_volt_32 0 31.99951171875 FORMAT "%4.2" /end CHARACTERISTIC
/begin CHARACTERISTIC AUX_V_SRLY_PRECRK_EN "crank enable before IMMO authentication is passed" VALUE 0x0002038C __UBYTE_S 0 b_true 0 1 FORMAT "%3.0" /end CHARACTERISTIC
/begin CHARACTERISTIC AUX_V_SRLY_FCO_RUN_MAX "starter control fuel cut off enble engine runtime max when starter relay fail" VALUE 0x0002038C __UWORD_S 0 u_1s_tmr 0 65535 /end CHARACTERISTIC
/begin CHARACTERISTIC AUX_V_SRLY_FCO_RST_DLY "starter control fuel cut off rest power down delay" VALUE 0x0002038C __UWORD_S 0 u_1x_tmr 0.0 511.9921875 FORMAT "%5.2" /end CHARACTERISTIC
/begin CHARACTERISTIC AUX_V_SRLY_FCO_FL_DLY "starter control fuel cut off diag fail delay" VALUE 0x0002038C __UWORD_S 0 u_2x_tmr 0.0 1023.984375 /end CHARACTERISTIC
/begin CHARACTERISTIC AUX_C_SRLY_FN_ESPD "starter crank finish engine speed thr" CURVE 0x000200B0 __UWORD_S 0 u_espd 0.0 8191.875000 FORMAT "%5.1" SYMBOL_LINK "AUX_C_SRLY_FN_ESPD" 2
 /begin AXIS_DESCR COM_AXIS sys_ect u_deg_C 5 -256 255.9921875 AXIS_PTS_REF AUX_X_ECT_A /end AXIS_DESCR
/end CHARACTERISTIC
/begin AXIS_PTS AUX_X_ECT_A "temp delta breakpoint" 0x0002006C sys_ect SSV__SWORD_S 0 u_deg_C 5 -256 255.9921875 DEPOSIT ABSOLUTE SYMBOL_LINK "AUX_X_ECT_A" 2 /end AXIS_PTS
/begin CHARACTERISTIC AUX_V_SRLY_CRK_REQ_CAN "crank request from can" VALUE 0x0002038C __UBYTE_S 0 b_true 0 1 FORMAT "%3.0" /end CHARACTERISTIC
/begin CHARACTERISTIC AUX_V_SRLY_DOUBLE_INST "double starter relay install" VALUE 0x0002038C __UBYTE_S 0 b_true 0 1 FORMAT "%3.0" /end CHARACTERISTIC
/begin CHARACTERISTIC AUX_C_SRLY_CRK_DUR_MAX "starter crank duration max" CURVE 0x000200B0 __UWORD_S 0 u_2x_tmr 0.0 1023.984375 SYMBOL_LINK "AUX_C_SRLY_CRK_DUR_MAX" 2
 /begin AXIS_DESCR COM_AXIS sys_keyon_ect u_deg_C 5 -256 255.9921875 AXIS_PTS_REF AUX_X_ECT_B /end AXIS_DESCR
/end CHARACTERISTIC
/begin AXIS_PTS AUX_X_ECT_B "temp delta breakpoint" 0x0002006C sys_keyon_ect SSV__SWORD_S 0 u_deg_C 5 -256 255.9921875 DEPOSIT ABSOLUTE SYMBOL_LINK "AUX_X_ECT_B" 2 /end AXIS_PTS
/begin CHARACTERISTIC AUX_V_SRLY_DRVTRAIN_INST "drive train relay install" VALUE 0x0002038C __UBYTE_S 0 b_true 0 1 FORMAT "%3.0" /end CHARACTERISTIC
/begin CHARACTERISTIC AUX_V_OLMP_OFF_ESPD_HI "oil press low lamp turn off immediately when oil press high and engine speed high" VALUE 0x0002038C __UWORD_S 0 u_espd 0 8191.875000 FORMAT "%5.1" /end CHARACTERISTIC
/begin CHARACTERISTIC AUX_V_OLMP_OFF_ESPD_LO "oil press low lamp turn off after delay when oil press high and engine speed low" VALUE 0x0002038C __UWORD_S 0 u_espd 0 8191.875000 FORMAT "%5.1" /end CHARACTERISTIC
/begin CHARACTERISTIC AUX_V_OLMP_ENG_OFF_ON "oil lamp on when engine off" VALUE 0x0002038C __UBYTE_S 0 b_true 0 1 FORMAT "%3.0" /end CHARACTERISTIC
/begin CHARACTERISTIC AUX_C_OLMP_INIT_DLY "oil lamp on initial delay" CURVE 0x000200B0 __UWORD_S 0 u_4x_tmr 0.0 2047.96875 FORMAT "%4.3" SYMBOL_LINK "AUX_C_OLMP_INIT_DLY" 2
 /begin AXIS_DESCR FIX_AXIS sys_ect u_deg_C 9 -40 152 /begin FIX_AXIS_PAR_LIST -5120 -2048 1024 4096 7168 10240 13312 16384 19456 /end FIX_AXIS_PAR_LIST /end AXIS_DESCR
/end CHARACTERISTIC
/begin CHARACTERISTIC AUX_V_OLMP_INIT_DLY_ESPD "oil press low lamp turn on initial delay active engine speed min" VALUE 0x0002038C __UWORD_S 0 u_espd 0 8191.875000 FORMAT "%5.1" /end CHARACTERISTIC
/begin CHARACTERISTIC AUX_V_OLMP_INIT_DLY_ESPD_HYS "oil press low lamp turn on initial delay active engine speed hys" VALUE 0x0002038C __UWORD_S 0 u_espd 0 8191.875000 FORMAT "%5.1" /end CHARACTERISTIC
/begin CHARACTERISTIC AUX_V_OLMP_DLY_ESPD_THR "oil press low lamp turn on delay engine speed thr" VALUE 0x0002038C __UWORD_S 0 u_espd 0 8191.875000 FORMAT "%5.1" /end CHARACTERISTIC
/begin CHARACTERISTIC AUX_V_OLMP_ESPD_LO_DLY "oil press low lamp turn on low engine speed delay" VALUE 0x0002038C __UWORD_S 0 u_4x_tmr 0.0 2047.96875 FORMAT "%5.1" /end CHARACTERISTIC
/begin CHARACTERISTIC AUX_V_OLMP_ESPD_HI_DLY "oil press low lamp turn on high engine speed delay" VALUE 0x0002038C __UWORD_S 0 u_4x_tmr 0.0 2047.96875 FORMAT "%5.1" /end CHARACTERISTIC
/begin CHARACTERISTIC AUX_V_OLMP_OFF_DLY "oil press low lamp turn off low engine speed delay" VALUE 0x0002038C __UWORD_S 0 u_4x_tmr 0.0 2047.96875 FORMAT "%5.1" /end CHARACTERISTIC
/begin CHARACTERISTIC AUX_V_FPUMP_PRM_ON_DUR "fuel pump prime on duration" VALUE 0x0002038C __UWORD_S 0 u_1x_tmr 0.0 511.9921875 FORMAT "%5.2" /end CHARACTERISTIC
/begin CHARACTERISTIC AUX_V_FPUMP_STOP_ON_DUR "fuel pump engine stop on duration" VALUE 0x0002038C __UWORD_S 0 u_1x_tmr 0.0 511.9921875 FORMAT "%5.2" /end CHARACTERISTIC
/begin CHARACTERISTIC AUX_V_FLV_LOW_LO_THR "fuel level low thr low" VALUE 0x0002038C __UWORD_S 0 u_pct_1 0.0 99.9984741210937 FORMAT "%4.2" /end CHARACTERISTIC
/begin CHARACTERISTIC AUX_V_FLV_LOW_HI_THR "fuel level low thr high" VALUE 0x0002038C __UWORD_S 0 u_pct_1 0.0 99.9984741210937 FORMAT "%4.2" /end CHARACTERISTIC
/begin CHARACTERISTIC AUX_V_FLV_LO_LAMP_ON_DLY "fuel level low lamp on delay" VALUE 0x0002038C __UWORD_S 0 u_500m_tmr 0.0 32767.5 FORMAT "%6.1" /end CHARACTERISTIC
/begin CHARACTERISTIC AUX_V_FLV_LO_LAMP_OFF_DLY "fuel level low lamp off delay" VALUE 0x0002038C __UWORD_S 0 u_500m_tmr 0.0 32767.5 FORMAT "%6.1" /end CHARACTERISTIC
/begin CHARACTERISTIC AUX_V_ETHST_LD_FIL "electrical thermostat control load filter" VALUE 0x0002038C __UWORD_S 0 u_filter 0.0 0.9999847412109375 FORMAT "%5.4" /end CHARACTERISTIC
/begin CHARACTERISTIC AUX_V_ETHST_ECT_FIL "electrical thermostat control engine coolant temp filter" VALUE 0x0002038C __UWORD_S 0 u_filter 0.0 0.9999847412109375 FORMAT "%5.4" /end CHARACTERISTIC
/begin CHARACTERISTIC AUX_V_ETHST_EN_VSPD "electrical thermostat control enable vehicle speed" VALUE 0x0002038C __UWORD_S 0 u_vspd 0.0 511.9921875 /end CHARACTERISTIC
/begin CHARACTERISTIC AUX_V_ETHST_EN_LD "electrical thermostat control enable load" VALUE 0x0002038C __UWORD_S 0 u_pct_8 0.0 799.987793 /end CHARACTERISTIC
/begin CHARACTERISTIC AUX_C_ETHST_PWM_VLT_FAC "electrical thermostat pwm duty voltage factor" CURVE 0x000200B0 __UWORD_S 0 u_fac_2 0.0 1.999969482421875 FORMAT "%4.3" SYMBOL_LINK "AUX_C_ETHST_PWM_VLT_FAC" 2
 /begin AXIS_DESCR COM_AXIS hw_bat_vlt u_volt_32 6 0 31.99951171875 AXIS_PTS_REF AUX_X_BAT_VLT_A /end AXIS_DESCR
/end CHARACTERISTIC
/begin AXIS_PTS AUX_X_BAT_VLT_A "battery voltage breakpoint" 0x0002006C hw_bat_vlt SSV__UWORD_S 0 u_volt_32 6 0 31.99951171875 FORMAT "%4.2" DEPOSIT ABSOLUTE SYMBOL_LINK "AUX_X_BAT_VLT_A" 2 /end AXIS_PTS
/begin CHARACTERISTIC AUX_V_ETHST_AMB_T_LO "electrical thermostat ect setpoint ambient temp low thr" VALUE 0x0002038C __SWORD_S 0 u_deg_C -256 255.9921875 /end CHARACTERISTIC
/begin CHARACTERISTIC AUX_V_ETHST_AMB_T_MID "electrical thermostat ect setpoint ambient temp mid thr" VALUE 0x0002038C __SWORD_S 0 u_deg_C -256 255.9921875 /end CHARACTERISTIC
/begin CHARACTERISTIC AUX_V_ETHST_AMB_T_HI "electrical thermostat ect setpoint ambient temp high thr" VALUE 0x0002038C __SWORD_S 0 u_deg_C -256 255.9921875 /end CHARACTERISTIC
/begin CHARACTERISTIC AUX_V_ETHST_DFLT_SP_A "electrical thermostat ect setpoint default" VALUE 0x0002038C __SWORD_S 0 u_deg_C -256 255.9921875 /end CHARACTERISTIC
/begin CHARACTERISTIC AUX_V_ETHST_DFLT_SP_B "electrical thermostat ect setpoint default" VALUE 0x0002038C __SWORD_S 0 u_deg_C -256 255.9921875 /end CHARACTERISTIC
/begin CHARACTERISTIC AUX_V_ETHST_DFLT_SP_C "electrical thermostat ect setpoint default" VALUE 0x0002038C __SWORD_S 0 u_deg_C -256 255.9921875 /end CHARACTERISTIC
/begin CHARACTERISTIC AUX_M_ETHST_SP_A "electrical thermostat ect setpoint A" MAP 0x36504 __SWORD_S 0 u_deg_C -256 255.9921875 SYMBOL_LINK "AUX_M_ETHST_SP_A" 4
 /begin AXIS_DESCR COM_AXIS afm_stk_flw_pct u_pct_8 6 0.0 799.987793 AXIS_PTS_REF AUX_X_LD_A /end AXIS_DESCR
 /begin AXIS_DESCR COM_AXIS sys_eng_spd u_espd 7 0 8191.875000 AXIS_PTS_REF AUX_X_ESPD_A /end AXIS_DESCR
/end CHARACTERISTIC
/begin AXIS_PTS AUX_X_LD_A "airflow load breakpoint" 0x0002006C afm_stk_flw_pct SSV__UWORD_S 0 u_pct_8 6 0.0 799.987793 DEPOSIT ABSOLUTE SYMBOL_LINK "AUX_X_LD_A" 2 /end AXIS_PTS
/begin AXIS_PTS AUX_X_ESPD_A "engine speed breakpoint" 0x0002006C sys_eng_spd SSV__UWORD_S 0 u_espd 7 0 8191.875000 FORMAT "%5.1" DEPOSIT ABSOLUTE SYMBOL_LINK "AUX_X_ESPD_A" 2 /end AXIS_PTS
/begin CHARACTERISTIC AUX_M_ETHST_SP_B "electrical thermostat ect setpoint B" MAP 0x36504 __SWORD_S 0 u_deg_C -256 255.9921875 SYMBOL_LINK "AUX_M_ETHST_SP_B" 4
 /begin AXIS_DESCR COM_AXIS sys_veh_spd u_vspd 6 0.0 511.9921875 AXIS_PTS_REF AUX_X_VSPD_A /end AXIS_DESCR
 /begin AXIS_DESCR COM_AXIS sys_iat u_deg_C 7 -256 255.9921875 AXIS_PTS_REF AUX_X_IAT_A /end AXIS_DESCR
/end CHARACTERISTIC
/begin AXIS_PTS AUX_X_VSPD_A "vehicle speed breakpoint" 0x0002006C sys_veh_spd SSV__UWORD_S 0 u_vspd 6 0.0 511.9921875 DEPOSIT ABSOLUTE SYMBOL_LINK "AUX_X_VSPD_A" 2 /end AXIS_PTS
/begin AXIS_PTS AUX_X_IAT_A "IAT breakpoint" 0x0002006C sys_iat SSV__SWORD_S 0 u_deg_C 7 -256 255.9921875 DEPOSIT ABSOLUTE SYMBOL_LINK "AUX_X_IAT_A" 2 /end AXIS_PTS
/begin CHARACTERISTIC AUX_M_ETHST_SP_C "electrical thermostat ect setpoint C" MAP 0x36504 __SWORD_S 0 u_deg_C -256 255.9921875 SYMBOL_LINK "AUX_M_ETHST_SP_C" 4
 /begin AXIS_DESCR COM_AXIS afm_stk_flw_pct u_pct_8 6 0.0 799.987793 AXIS_PTS_REF AUX_X_LD_B /end AXIS_DESCR
 /begin AXIS_DESCR COM_AXIS sys_veh_spd u_vspd 6 0.0 511.9921875 AXIS_PTS_REF AUX_X_VSPD_B /end AXIS_DESCR
/end CHARACTERISTIC
/begin AXIS_PTS AUX_X_LD_B "airflow load breakpoint" 0x0002006C afm_stk_flw_pct SSV__UWORD_S 0 u_pct_8 6 0.0 799.987793 DEPOSIT ABSOLUTE SYMBOL_LINK "AUX_X_LD_B" 2 /end AXIS_PTS
/begin AXIS_PTS AUX_X_VSPD_B "vehicle speed breakpoint" 0x0002006C sys_veh_spd SSV__UWORD_S 0 u_vspd 6 0.0 511.9921875 DEPOSIT ABSOLUTE SYMBOL_LINK "AUX_X_VSPD_B" 2 /end AXIS_PTS
/begin CHARACTERISTIC AUX_C_ETHST_PWM_DTY_MIN "electrical thermostat pwm duty min" CURVE 0x000200B0 __SWORD_S 0 u_pct_s -200 199.993896484375 SYMBOL_LINK "AUX_C_ETHST_PWM_DTY_MIN" 2
 /begin AXIS_DESCR COM_AXIS aux_ethst_ect_mmv u_deg_C 8 -256 255.9921875 AXIS_PTS_REF AUX_X_ECT_C /end AXIS_DESCR
/end CHARACTERISTIC
/begin AXIS_PTS AUX_X_ECT_C "ect breakpoint" 0x0002006C aux_ethst_ect_mmv SSV__SWORD_S 0 u_deg_C 8 -256 255.9921875 DEPOSIT ABSOLUTE SYMBOL_LINK "AUX_X_ECT_C" 2 /end AXIS_PTS
/begin CHARACTERISTIC AUX_C_ETHST_PWM_DTY_MAX "electrical thermostat pwm duty max" CURVE 0x000200B0 __SWORD_S 0 u_pct_s -200 199.993896484375 SYMBOL_LINK "AUX_C_ETHST_PWM_DTY_MAX" 2
 /begin AXIS_DESCR COM_AXIS aux_ethst_ect_mmv u_deg_C 8 -256 255.9921875 AXIS_PTS_REF AUX_X_ECT_D /end AXIS_DESCR
/end CHARACTERISTIC
/begin AXIS_PTS AUX_X_ECT_D "ect breakpoint" 0x0002006C aux_ethst_ect_mmv SSV__SWORD_S 0 u_deg_C 8 -256 255.9921875 DEPOSIT ABSOLUTE SYMBOL_LINK "AUX_X_ECT_D" 2 /end AXIS_PTS
/begin CHARACTERISTIC AUX_V_ETHST_PWM_DTY_DFLT "electrical thermostat pwm duty default" VALUE 0x0002038C __SWORD_S 0 u_pct_s -200 199.993896484375 /end CHARACTERISTIC
/begin CHARACTERISTIC AUX_V_ETHST_BYPASS_ABM_T "electrical thermostat setpoint bypass ambient temp thr" VALUE 0x0002038C __UBYTE_S 0 b_true 0 1 FORMAT "%3.0" /end CHARACTERISTIC
/begin CHARACTERISTIC AUX_M_ETHST_PWM_DTY_BASE "electrical thermostat pwm duty base" MAP 0x36504 __SWORD_S 0 u_pct_s -200 199.993896484375 SYMBOL_LINK "AUX_M_ETHST_PWM_DTY_BASE" 4
 /begin AXIS_DESCR COM_AXIS afm_stk_flw_pct u_pct_8 6 0.0 799.987793 AXIS_PTS_REF AUX_X_LD_C /end AXIS_DESCR
 /begin AXIS_DESCR COM_AXIS aux_ethst_ect_sp u_deg_C 6 -256 255.9921875 AXIS_PTS_REF AUX_X_ECT_SP_A /end AXIS_DESCR
/end CHARACTERISTIC
/begin AXIS_PTS AUX_X_ECT_SP_A "ect setpoint breakpoint" 0x0002006C aux_ethst_ect_sp SSV__SWORD_S 0 u_deg_C 6 -256 255.9921875 DEPOSIT ABSOLUTE SYMBOL_LINK "AUX_X_ECT_SP_A" 2 /end AXIS_PTS
/begin AXIS_PTS AUX_X_LD_C "airflow load breakpoint" 0x0002006C afm_stk_flw_pct SSV__UWORD_S 0 u_pct_8 6 0.0 799.987793 DEPOSIT ABSOLUTE SYMBOL_LINK "AUX_X_LD_C" 2 /end AXIS_PTS
/begin CHARACTERISTIC AUX_V_ETHST_INT_DB "electrical thermostat int deadband" VALUE 0x0002038C __SWORD_S 0 u_deg_C -256 255.9921875 /end CHARACTERISTIC
/begin CHARACTERISTIC AUX_C_ETHST_P "electrical thermostat control prop" CURVE 0x000200B0 __SWORD_S 0 u_pct_s -200 199.993896484375 SYMBOL_LINK "AUX_C_ETHST_P" 2
 /begin AXIS_DESCR COM_AXIS NO_INPUT_QUANTITY u_deg_C 13 -256 255.9921875 AXIS_PTS_REF AUX_X_ECT_ERR_A /end AXIS_DESCR
/end CHARACTERISTIC
/begin AXIS_PTS AUX_X_ECT_ERR_A "ect error breakpoint" 0x0002006C NO_INPUT_QUANTITY SSV__SWORD_S 0 u_deg_C 13 -256 255.9921875 DEPOSIT ABSOLUTE SYMBOL_LINK "AUX_X_ECT_ERR_A" 2 /end AXIS_PTS
/begin CHARACTERISTIC AUX_C_ETHST_I_DLT "electrical thermostat control int delta" CURVE 0x000200B0 __SWORD_S 0 u_pct_s -200 199.993896484375 SYMBOL_LINK "AUX_C_ETHST_I_DLT" 2
 /begin AXIS_DESCR COM_AXIS NO_INPUT_QUANTITY u_deg_C 13 -256 255.9921875 AXIS_PTS_REF AUX_X_ECT_ERR_B /end AXIS_DESCR
/end CHARACTERISTIC
/begin AXIS_PTS AUX_X_ECT_ERR_B "ect error breakpoint" 0x0002006C NO_INPUT_QUANTITY SSV__SWORD_S 0 u_deg_C 13 -256 255.9921875 DEPOSIT ABSOLUTE SYMBOL_LINK "AUX_X_ECT_ERR_B" 2 /end AXIS_PTS
/begin CHARACTERISTIC AUX_C_ETHST_FULL_OPN_DTY "electrical thermostat control full open duty" CURVE 0x000200B0 __SWORD_S 0 u_pct_s -200 199.993896484375 SYMBOL_LINK "AUX_C_ETHST_FULL_OPN_DTY" 2
 /begin AXIS_DESCR COM_AXIS aux_ethst_ect_mmv u_deg_C 8 -256 255.9921875 AXIS_PTS_REF AUX_X_ECT_E /end AXIS_DESCR
/end CHARACTERISTIC
/begin AXIS_PTS AUX_X_ECT_E "ect breakpoint" 0x0002006C NO_INPUT_QUANTITY SSV__SWORD_S 0 u_deg_C 8 -256 255.9921875 DEPOSIT ABSOLUTE SYMBOL_LINK "AUX_X_ECT_E" 2 /end AXIS_PTS
/begin CHARACTERISTIC AUX_C_ETHST_FULL_OPN_DUR "electrical thermostat control full open duration" CURVE 0x000200B0 __UWORD_S 0 u_16x_tmr 0 8191.875 SYMBOL_LINK "AUX_C_ETHST_FULL_OPN_DUR" 2
 /begin AXIS_DESCR COM_AXIS aux_ethst_ect_mmv u_deg_C 8 -256 255.9921875 AXIS_PTS_REF AUX_X_ECT_F /end AXIS_DESCR
/end CHARACTERISTIC
/begin AXIS_PTS AUX_X_ECT_F "ect breakpoint" 0x0002006C NO_INPUT_QUANTITY SSV__SWORD_S 0 u_deg_C 8 -256 255.9921875 DEPOSIT ABSOLUTE SYMBOL_LINK "AUX_X_ECT_F" 2 /end AXIS_PTS
/begin CHARACTERISTIC AUX_V_ETHST_I_MAX "electrical thermostat int max" VALUE 0x0002038C __SWORD_S 0 u_pct_s -200 199.993896484375 /end CHARACTERISTIC
/begin CHARACTERISTIC AUX_V_ETHST_I_MIN "electrical thermostat int min" VALUE 0x0002038C __SWORD_S 0 u_pct_s -200 199.993896484375 /end CHARACTERISTIC
/begin CHARACTERISTIC VVT_M_INTK_SP "intake vvt setpoint" MAP 0x00020320 __SBYTE_S 0 u_iga_64n_64p_b -64 63.5 SYMBOL_LINK "VVT_M_INTK_SP" 3
 /begin AXIS_DESCR COM_AXIS sys_eng_spd u_espd 15 0.000000 8191.875000 AXIS_PTS_REF VVT_X_ESPD_A /end AXIS_DESCR
 /begin AXIS_DESCR FIX_AXIS tq_estd_imep_ref u_kPa_0_4096 17 0 1600
  /begin FIX_AXIS_PAR_LIST 0 1600 3200 4800 6400 8000 9600 11200 12800 14400 16000 17600 19200 20800 22400 24000 25600 /end FIX_AXIS_PAR_LIST
 /end AXIS_DESCR
/end CHARACTERISTIC
/begin CHARACTERISTIC VVT_M_EXH_SP "exhaust vvt setpoint" MAP 0x00020320 __SBYTE_S 0 u_iga_64n_64p_b -64 63.5 SYMBOL_LINK "VVT_M_EXH_SP" 3
 /begin AXIS_DESCR COM_AXIS sys_eng_spd u_espd 15 0.000000 8191.875000 AXIS_PTS_REF VVT_X_ESPD_A /end AXIS_DESCR
 /begin AXIS_DESCR FIX_AXIS tq_estd_imep_ref u_kPa_0_4096 17 0 1600
  /begin FIX_AXIS_PAR_LIST 0 1600 3200 4800 6400 8000 9600 11200 12800 14400 16000 17600 19200 20800 22400 24000 25600 /end FIX_AXIS_PAR_LIST
 /end AXIS_DESCR
/end CHARACTERISTIC
/begin CHARACTERISTIC VVT_C_EXH_DEC_SP "decelaration VVT setpoint" CURVE 0x000200B0 __SBYTE_S 0 u_iga_64n_64p_b -64 63.5 SYMBOL_LINK "VVT_C_EXH_DEC_SP" 2
 /begin AXIS_DESCR COM_AXIS sys_eng_spd u_espd 15 0.000000 8191.875000 AXIS_PTS_REF VVT_X_ESPD_A /end AXIS_DESCR
/end CHARACTERISTIC
/begin AXIS_PTS VVT_X_ESPD_A "espd breakpoint" 0x0002006C sys_eng_spd SSV__UWORD_S 0 u_espd 15 0.000000 8191.875000 FORMAT "%5.1" DEPOSIT ABSOLUTE SYMBOL_LINK "VVT_X_ESPD_A" 2 /end AXIS_PTS
/begin CHARACTERISTIC VVT_C_EN_DLY_SS "VVT enable delay when start stop active" CURVE 0x000200B0 __UWORD_S 0 u_1s_tmr 0 65535 SYMBOL_LINK "VVT_C_EN_DLY_SS" 2
 /begin AXIS_DESCR COM_AXIS sys_keyon_ect u_deg_C 10 -256 255.9921875 AXIS_PTS_REF VVT_X_ECT_A /end AXIS_DESCR
/end CHARACTERISTIC
/begin CHARACTERISTIC VVT_C_EN_DLY_CAT_HT "VVT enable delay when catalyst heat ignition active" CURVE 0x000200B0 __UWORD_S 0 u_1s_tmr 0 65535 SYMBOL_LINK "VVT_C_EN_DLY_CAT_HT" 2
 /begin AXIS_DESCR COM_AXIS sys_keyon_ect u_deg_C 10 -256 255.9921875 AXIS_PTS_REF VVT_X_ECT_A /end AXIS_DESCR
/end CHARACTERISTIC
/begin AXIS_PTS VVT_X_ECT_A "espd breakpoint" 0x0002006C sys_keyon_ect SSV__SWORD_S 0 u_deg_C 10 -256 255.9921875 FORMAT "%4.1" DEPOSIT ABSOLUTE SYMBOL_LINK "VVT_X_ECT_A" 2 /end AXIS_PTS
/begin CHARACTERISTIC VVT_V_FCUT_CLN_EN_ESPD "fuel cut off vvt valve clean,engine speed thr" VALUE 0x0002038C __UWORD_S 0 u_espd 0 8191.875000 FORMAT "%5.1" /end CHARACTERISTIC
/begin CHARACTERISTIC VVT_M_INTK_LNCH_POS_BIAS "intake vvt duty cycle positive lunch bias" MAP 0x00020320 __SBYTE_S 0 u_pct_b_s -200 198.4375 FORMAT "%3.1" SYMBOL_LINK "VVT_M_INTK_LNCH_POS_BIAS" 3
 /begin AXIS_DESCR COM_AXIS vvt_intk_abs_sp_lmtd u_iga_abs 5 0.000000 1023.984375 AXIS_PTS_REF VVT_X_ABS_POS_A /end AXIS_DESCR
 /begin AXIS_DESCR COM_AXIS sys_oil_t u_deg_C 5 -256.000000 255.9921875 AXIS_PTS_REF VVT_X_OIL_T_A /end AXIS_DESCR
/end CHARACTERISTIC
/begin CHARACTERISTIC VVT_M_INTK_LNCH_NEG_BIAS "intake vvt duty cycle lunch negtive bias" MAP 0x00020320 __SBYTE_S 0 u_pct_b_s -200 198.4375 FORMAT "%3.1" SYMBOL_LINK "VVT_M_INTK_LNCH_NEG_BIAS" 3
 /begin AXIS_DESCR COM_AXIS vvt_intk_abs_sp_lmtd u_iga_abs 5 0.000000 1023.984375 AXIS_PTS_REF VVT_X_ABS_POS_A /end AXIS_DESCR
 /begin AXIS_DESCR COM_AXIS sys_oil_t u_deg_C 5 -256.000000 255.9921875 AXIS_PTS_REF VVT_X_OIL_T_A /end AXIS_DESCR
/end CHARACTERISTIC
/begin CHARACTERISTIC VVT_M_INTK_LNCH_DUR "intake vvt duty cycle lunch bias duration" MAP 0x00020320 __UBYTE_S 0 u_2x_tmr 0 1023.984375 SYMBOL_LINK "VVT_M_INTK_LNCH_DUR" 3
 /begin AXIS_DESCR COM_AXIS vvt_intk_abs_sp_lmtd u_iga_abs 5 0.000000 1023.984375 AXIS_PTS_REF VVT_X_ABS_POS_A /end AXIS_DESCR
 /begin AXIS_DESCR COM_AXIS sys_oil_t u_deg_C 5 -256.000000 255.9921875 AXIS_PTS_REF VVT_X_OIL_T_A /end AXIS_DESCR
/end CHARACTERISTIC
/begin CHARACTERISTIC VVT_M_EXH_LNCH_POS_BIAS "exhaust vvt duty cycle lunch positive bias" MAP 0x00020320 __SBYTE_S 0 u_pct_b_s -200 198.4375 FORMAT "%3.1" SYMBOL_LINK "VVT_M_EXH_LNCH_POS_BIAS" 3
 /begin AXIS_DESCR COM_AXIS vvt_intk_abs_sp_lmtd u_iga_abs 5 0.000000 1023.984375 AXIS_PTS_REF VVT_X_ABS_POS_A /end AXIS_DESCR
 /begin AXIS_DESCR COM_AXIS sys_oil_t u_deg_C 5 -256.000000 255.9921875 AXIS_PTS_REF VVT_X_OIL_T_A /end AXIS_DESCR
/end CHARACTERISTIC
/begin CHARACTERISTIC VVT_M_EXH_LNCH_NEG_BIAS "exhaust vvt duty cycle lunch negtive bias" MAP 0x00020320 __SBYTE_S 0 u_pct_b_s -200 198.4375 FORMAT "%3.1" SYMBOL_LINK "VVT_M_EXH_LNCH_NEG_BIAS" 3
 /begin AXIS_DESCR COM_AXIS vvt_intk_abs_sp_lmtd u_iga_abs 5 0.000000 1023.984375 AXIS_PTS_REF VVT_X_ABS_POS_A /end AXIS_DESCR
 /begin AXIS_DESCR COM_AXIS sys_oil_t u_deg_C 5 -256.000000 255.9921875 AXIS_PTS_REF VVT_X_OIL_T_A /end AXIS_DESCR
/end CHARACTERISTIC
/begin CHARACTERISTIC VVT_M_EXH_LNCH_DUR "exhaust vvt duty cycle lunch bias duration" MAP 0x00020320 __UBYTE_S 0 u_cnts 0 255 SYMBOL_LINK "VVT_M_EXH_LNCH_DUR" 3
 /begin AXIS_DESCR COM_AXIS vvt_intk_abs_sp_lmtd u_iga_abs 5 0.000000 1023.984375 AXIS_PTS_REF VVT_X_ABS_POS_A /end AXIS_DESCR
 /begin AXIS_DESCR COM_AXIS sys_oil_t u_deg_C 5 -256.000000 255.9921875 AXIS_PTS_REF VVT_X_OIL_T_A /end AXIS_DESCR
/end CHARACTERISTIC
/begin AXIS_PTS VVT_X_ABS_POS_A "vvt breakpoint" 0x0002006C NO_INPUT_QUANTITY SSV__UWORD_S 0 u_iga_abs 5 0.000000 1023.984375 DEPOSIT ABSOLUTE SYMBOL_LINK "VVT_X_ABS_POS_A" 2 /end AXIS_PTS
/begin AXIS_PTS VVT_X_OIL_T_A "oil temp breakpoint" 0x0002006C sys_oil_t SSV__SWORD_S 0 u_deg_C 5 -256.000000 255.9921875 DEPOSIT ABSOLUTE SYMBOL_LINK "VVT_X_OIL_T_A" 2 /end AXIS_PTS
/begin AXIS_PTS VVT_X_OIL_P_A "oil press breakpoint" 0x0002006C sys_oil_p SSV__UWORD_S 0 u_kPa_0_1024 5 0.000000 1023.984375 FORMAT "%5.1" DEPOSIT ABSOLUTE SYMBOL_LINK "VVT_X_OIL_P_A" 2 /end AXIS_PTS
/begin CHARACTERISTIC VVT_V_LNCH_EXT_FIL "launch exit filter" VALUE 0x2886C __UWORD_S 0 u_filter 0 0.9999847412109375 FORMAT "%10.9" /end CHARACTERISTIC
/begin CHARACTERISTIC VVT_V_LNCH_EN_ESPD_MAX "lunch enable engine speed max" VALUE 0x0002038C __UWORD_S 0 u_espd 0 8191.875000 FORMAT "%5.1" /end CHARACTERISTIC
/begin CHARACTERISTIC VVT_V_LNCH_EN_OIL_T_MIN "lunch enable oil temp min" VALUE 0x0002038C __SWORD_S 0 u_deg_C -256.000000 255.9921875 /end CHARACTERISTIC
/begin CHARACTERISTIC VVT_V_LNCH_EN_POS_DLT_MIN "lunch enable actual vvt position delta from min position" VALUE 0x0002038C __UWORD_S 0 u_cam_ang_hi 0 63.9990234375 FORMAT "%3.1" /end CHARACTERISTIC
/begin CHARACTERISTIC VVT_V_INTK_D_POS_DB "positive deadband of intake vvt d" VALUE 0x0002038C __SWORD_S 0 u_iga -256.000000 255.9921875 FORMAT "%4.2" /end CHARACTERISTIC
/begin CHARACTERISTIC VVT_V_INTK_D_NEG_DB "negtive deadband of intake vvt d" VALUE 0x0002038C __SWORD_S 0 u_iga -256.000000 255.9921875 FORMAT "%4.2" /end CHARACTERISTIC
/begin CHARACTERISTIC VVT_V_EXH_D_POS_DB "positive deadband of exhaust vvt d" VALUE 0x0002038C __SWORD_S 0 u_iga -256.000000 255.9921875 FORMAT "%4.2" /end CHARACTERISTIC
/begin CHARACTERISTIC VVT_V_EXH_D_NEG_DB "negtive deadband of exhaust vvt d" VALUE 0x0002038C __SWORD_S 0 u_iga -256.000000 255.9921875 FORMAT "%4.2" /end CHARACTERISTIC
/begin CHARACTERISTIC VVT_V_INTK_I_DIS_FAC "intake vvt i control disable factor,multiply on vvt velocity cal" VALUE 0x0002038C __SWORD_S 0 u_fac_512 -256.000000 255.9921875 FORMAT "%4.2" /end CHARACTERISTIC
/begin CHARACTERISTIC VVT_V_EXH_I_DIS_FAC "intake vvt i control disable factor,multiply on vvt velocity cal" VALUE 0x0002038C __SWORD_S 0 u_fac_512 -256.000000 255.9921875 FORMAT "%4.2" /end CHARACTERISTIC
/begin CHARACTERISTIC VVT_V_INTK_I_EN_VLV_SPD_MAX "intake vvt i control disable cam speed" VALUE 0x0002038C __SWORD_S 0 u_cam_spd -4096.000000 4095.875 /end CHARACTERISTIC
/begin CHARACTERISTIC VVT_V_EXH_I_EN_VLV_SPD_MAX "exhaust vvt i control disable cam speed" VALUE 0x0002038C __SWORD_S 0 u_cam_spd -4096.000000 4095.875 /end CHARACTERISTIC
/begin CHARACTERISTIC VVT_M_INTK_I_TRANS_EN_DLY "vvt i control enable delay when vvt setpoint change" MAP 0x00020320 __UBYTE_S 0 u_2x_tmr 0 1023.984375 SYMBOL_LINK "VVT_M_INTK_I_TRANS_EN_DLY" 3
 /begin AXIS_DESCR FIX_AXIS sys_oil_t u_deg_C 3 -15 130 /begin FIX_AXIS_PAR_LIST -1920 6400 16640 /end FIX_AXIS_PAR_LIST /end AXIS_DESCR
 /begin AXIS_DESCR FIX_AXIS vvt_intk_sp_dlt u_cam_ang_hi 9 5 55 /begin FIX_AXIS_PAR_LIST 5120 11520 17920 24320 30720 37120 43520 49920 56320 /end FIX_AXIS_PAR_LIST /end AXIS_DESCR
/end CHARACTERISTIC
/begin CHARACTERISTIC VVT_M_EXH_I_TRANS_EN_DLY "vvt i control enable delay when vvt setpoint change" MAP 0x00020320 __UBYTE_S 0 u_2x_tmr 0 1023.984375 SYMBOL_LINK "VVT_M_EXH_I_TRANS_EN_DLY" 3
 /begin AXIS_DESCR FIX_AXIS sys_oil_t u_deg_C 3 -15 130 /begin FIX_AXIS_PAR_LIST -1920 6400 16640 /end FIX_AXIS_PAR_LIST /end AXIS_DESCR
 /begin AXIS_DESCR FIX_AXIS vvt_intk_sp_dlt u_cam_ang_hi 9 5 55 /begin FIX_AXIS_PAR_LIST 5120 11520 17920 24320 30720 37120 43520 49920 56320 /end FIX_AXIS_PAR_LIST /end AXIS_DESCR
/end CHARACTERISTIC
/begin CHARACTERISTIC VVT_V_INTK_I_TRANS_CHG_THR "intake i control transient delay setpoint change step thr" VALUE 0x0002038C __UWORD_S 0 u_cam_ang_hi 0 63.9990234375 /end CHARACTERISTIC
/begin CHARACTERISTIC VVT_V_EXH_I_TRANS_CHG_THR "exhaust i control transient delay setpoint change step thr" VALUE 0x0002038C __UWORD_S 0 u_cam_ang_hi 0 63.9990234375 /end CHARACTERISTIC
/begin CHARACTERISTIC VVT_V_INTK_I_TRANS_DLT_THR "intake i control transient delay,setpoint delta thr" VALUE 0x0002038C __UWORD_S 0 u_cam_ang_hi 0 63.9990234375 /end CHARACTERISTIC
/begin CHARACTERISTIC VVT_V_EXH_I_TRANS_DLT_THR "exhaust i control transient delay,setpoint delta thr" VALUE 0x0002038C __UWORD_S 0 u_cam_ang_hi 0 63.9990234375 /end CHARACTERISTIC
/begin CHARACTERISTIC VVT_V_EXH_POS_MIN "exhaust vvt position min" VALUE 0x0002038C __SWORD_S 0 u_iga -256.000000 255.9921875 FORMAT "%4.2" /end CHARACTERISTIC
/begin CHARACTERISTIC VVT_V_EXH_POS_MAX "exhaust vvt position min" VALUE 0x0002038C __SWORD_S 0 u_iga -256.000000 255.9921875 FORMAT "%4.2" /end CHARACTERISTIC
/begin CHARACTERISTIC VVT_C_EXH_REF_TOOTH "VVT exhaust position reference tooth" CURVE 0x000200B0 __UBYTE_S 0 u_cnts 0 255 FORMAT "%5.0"
 /begin AXIS_DESCR FIX_AXIS NO_INPUT_QUANTITY x_cnts 6 1 6 /begin FIX_AXIS_PAR_LIST 1 2 3 4 5 6 /end FIX_AXIS_PAR_LIST /end AXIS_DESCR
/end CHARACTERISTIC
/begin CHARACTERISTIC VVT_V_INTK_POS_MIN "intake vvt position min" VALUE 0x0002038C __SWORD_S 0 u_iga -256.000000 255.9921875 FORMAT "%4.2" /end CHARACTERISTIC
/begin CHARACTERISTIC VVT_V_INTK_POS_MAX "intake vvt position min" VALUE 0x0002038C __SWORD_S 0 u_iga -256.000000 255.9921875 FORMAT "%4.2" /end CHARACTERISTIC
/begin CHARACTERISTIC VVT_C_INTK_REF_TOOTH "VVT intake position reference tooth" CURVE 0x000200B0 __UBYTE_S 0 u_cnts 0 255 FORMAT "%5.0"
 /begin AXIS_DESCR FIX_AXIS NO_INPUT_QUANTITY x_cnts 6 1 6 /begin FIX_AXIS_PAR_LIST 1 2 3 4 5 6 /end FIX_AXIS_PAR_LIST /end AXIS_DESCR
/end CHARACTERISTIC
/begin CHARACTERISTIC VVT_C_EN_DLY_RUN_TM "VVT enable runtime delay " CURVE 0x000200B0 __UWORD_S 0 u_2x_tmr 0 1023.984375 SYMBOL_LINK "VVT_C_EN_DLY_RUN_TM" 2
 /begin AXIS_DESCR FIX_AXIS sys_oil_t u_deg_C 9 -40 152 /begin FIX_AXIS_PAR_LIST -5120 -2048 1024 4096 7168 10240 13312 16384 19456 /end FIX_AXIS_PAR_LIST /end AXIS_DESCR
/end CHARACTERISTIC
/begin CHARACTERISTIC VVT_C_EN_OIL_T_MAX "VVT enable oil temp thr" CURVE 0x000200B0 __SBYTE_S 0 u_deg_C_b -256.000000 254.0 SYMBOL_LINK "VVT_C_EN_OIL_T_MAX" 2
 /begin AXIS_DESCR FIX_AXIS sys_eng_spd u_espd 9 800 4000 /begin FIX_AXIS_PAR_LIST 6400 9600 12800 16000 19200 22400 25600 28800 32000 /end FIX_AXIS_PAR_LIST /end AXIS_DESCR
/end CHARACTERISTIC
/begin CHARACTERISTIC VVT_C_EN_OIL_T_MIN "VVT enable oil temp thr" CURVE 0x000200B0 __SBYTE_S 0 u_deg_C_b -256.000000 254.0 SYMBOL_LINK "VVT_C_EN_OIL_T_MIN" 2
 /begin AXIS_DESCR FIX_AXIS sys_eng_spd u_espd 9 800 4000 /begin FIX_AXIS_PAR_LIST 6400 9600 12800 16000 19200 22400 25600 28800 32000 /end FIX_AXIS_PAR_LIST /end AXIS_DESCR
/end CHARACTERISTIC
/begin CHARACTERISTIC VVT_C_EN_ESPD_MIN "VVT enable engine speed min" CURVE 0x000200B0 __UBYTE_S 0 u_espd_b 0 2040 FORMAT "%4.0" SYMBOL_LINK "VVT_C_EN_ESPD_MIN" 2
 /begin AXIS_DESCR FIX_AXIS sys_oil_t u_deg_C 9 -40 152 /begin FIX_AXIS_PAR_LIST -5120 -2048 1024 4096 7168 10240 13312 16384 19456 /end FIX_AXIS_PAR_LIST /end AXIS_DESCR
/end CHARACTERISTIC
/begin CHARACTERISTIC VVT_C_IDL_EN_ESPD_MIN "VVT idle enable engine speed min" CURVE 0x000200B0 __UBYTE_S 0 u_espd_b 0 2040 FORMAT "%4.0" SYMBOL_LINK "VVT_C_IDL_EN_ESPD_MIN" 2
 /begin AXIS_DESCR FIX_AXIS sys_oil_t u_deg_C 9 -40 152 /begin FIX_AXIS_PAR_LIST -5120 -2048 1024 4096 7168 10240 13312 16384 19456 /end FIX_AXIS_PAR_LIST /end AXIS_DESCR
/end CHARACTERISTIC
/begin CHARACTERISTIC VVT_V_INTK_OP_ATDC_BASE "intake vvt base open angle after TDC" VALUE 0x0002038C __UWORD_S 0 u_iga_abs 0 1023.984375 FORMAT "%5.1" /end CHARACTERISTIC
/begin CHARACTERISTIC VVT_V_EXH_CL_ATDC_BASE "exhaust vvt base close angle after TDC" VALUE 0x0002038C __UWORD_S 0 u_iga_abs 0 1023.984375 FORMAT "%5.1" /end CHARACTERISTIC
/begin CHARACTERISTIC VVT_V_INTK_SP_V_MIN "vvt position setpoint change negtive max,when vehicle speed low" VALUE 0x0002038C __SWORD_S 0 u_cam_vec -1024.000000 1023.96875 /end CHARACTERISTIC
/begin CHARACTERISTIC VVT_V_INTK_SP_V_MAX "vvt position setpoint change positive max,when vehicle speed low" VALUE 0x0002038C __SWORD_S 0 u_cam_vec -1024.000000 1023.96875 /end CHARACTERISTIC
/begin CHARACTERISTIC VVT_V_EXH_SP_V_MIN "vvt position setpoint change negtive max,when vehicle speed low" VALUE 0x0002038C __SWORD_S 0 u_cam_vec -1024.000000 1023.96875 /end CHARACTERISTIC
/begin CHARACTERISTIC VVT_V_EXH_SP_V_MAX "vvt position setpoint change positive max,when vehicle speed low" VALUE 0x0002038C __SWORD_S 0 u_cam_vec -1024.000000 1023.96875 /end CHARACTERISTIC
/begin CHARACTERISTIC VVT_V_SP_CHG_LMT_VSPD_THR "vvt position setpoint change low speed limit thr" VALUE 0x0002038C __UWORD_S 0 u_vspd 0 511.9921875 /end CHARACTERISTIC
/begin CHARACTERISTIC VVT_V_IDL_EN_EXT_DLY "idle vvt control delay,when idle vvt conds not met" VALUE 0x0002038C __UWORD_S 0 u_2x_tmr 0 1023.984375 /end CHARACTERISTIC
/begin CHARACTERISTIC VVT_V_IDL_EN_OIL_T_MAX "idle vvt control enable oil temp thr" VALUE 0x0002038C __SWORD_S 0 u_deg_C -256.000000 255.9921875 /end CHARACTERISTIC
/begin CHARACTERISTIC VVT_V_IDL_EN_OIL_T_MIN "idle vvt control enable oil temp thr" VALUE 0x0002038C __SWORD_S 0 u_deg_C -256.000000 255.9921875 /end CHARACTERISTIC
/begin CHARACTERISTIC VVT_V_IDL_EN_VSPD_MIN "idle vvt control enable vehicle speed thr" VALUE 0x0002038C __UWORD_S 0 u_vspd 0.0 511.9921875 /end CHARACTERISTIC
/begin CHARACTERISTIC VVT_M_INTK_B1_P_NEG_GN "vvt p control negtive gain" MAP 0x00020320 __SWORD_S 0 u_fac_n2_p2 -2 1.99993896484375 FORMAT "%4.3" SYMBOL_LINK "VVT_M_INTK_B1_P_NEG_GN" 4
 /begin AXIS_DESCR COM_AXIS sys_oil_p u_kPa_0_1024 5 0.000000 1023.984375 AXIS_PTS_REF VVT_X_OIL_P_A /end AXIS_DESCR
 /begin AXIS_DESCR COM_AXIS sys_oil_t u_deg_C 5 -256.000000 255.9921875 AXIS_PTS_REF VVT_X_OIL_T_A /end AXIS_DESCR
/end CHARACTERISTIC
/begin CHARACTERISTIC VVT_M_INTK_B1_P_POS_GN "vvt p control positive gain" MAP 0x00020320 __SWORD_S 0 u_fac_n2_p2 -2 1.99993896484375 FORMAT "%4.3" SYMBOL_LINK "VVT_M_INTK_B1_P_POS_GN" 4
 /begin AXIS_DESCR COM_AXIS sys_oil_p u_kPa_0_1024 5 0.000000 1023.984375 AXIS_PTS_REF VVT_X_OIL_P_A /end AXIS_DESCR
 /begin AXIS_DESCR COM_AXIS sys_oil_t u_deg_C 5 -256.000000 255.9921875 AXIS_PTS_REF VVT_X_OIL_T_A /end AXIS_DESCR
/end CHARACTERISTIC
/begin CHARACTERISTIC VVT_M_EXH_B1_P_POS_GN "vvt p control positive gain" MAP 0x00020320 __SWORD_S 0 u_fac_n2_p2 -2 1.99993896484375 FORMAT "%4.3" SYMBOL_LINK "VVT_M_EXH_B1_P_POS_GN" 4
 /begin AXIS_DESCR COM_AXIS sys_oil_p u_kPa_0_1024 5 0.000000 1023.984375 AXIS_PTS_REF VVT_X_OIL_P_A /end AXIS_DESCR
 /begin AXIS_DESCR COM_AXIS sys_oil_t u_deg_C 5 -256.000000 255.9921875 AXIS_PTS_REF VVT_X_OIL_T_A /end AXIS_DESCR
/end CHARACTERISTIC
/begin CHARACTERISTIC VVT_M_EXH_B1_P_NEG_GN "vvt p control negtive gain" MAP 0x00020320 __SWORD_S 0 u_fac_n2_p2 -2 1.99993896484375 FORMAT "%4.3" SYMBOL_LINK "VVT_M_EXH_B1_P_NEG_GN" 4
 /begin AXIS_DESCR COM_AXIS sys_oil_p u_kPa_0_1024 5 0.000000 1023.984375 AXIS_PTS_REF VVT_X_OIL_P_A /end AXIS_DESCR
 /begin AXIS_DESCR COM_AXIS sys_oil_t u_deg_C 5 -256.000000 255.9921875 AXIS_PTS_REF VVT_X_OIL_T_A /end AXIS_DESCR
/end CHARACTERISTIC
/begin CHARACTERISTIC VVT_M_INTK_B1_I_POS_GN "vvt i control positive gain" MAP 0x00020320 __SWORD_S 0 u_fac_n2_p2 -2 1.99993896484375 FORMAT "%4.3" SYMBOL_LINK "VVT_M_INTK_B1_I_POS_GN" 4
 /begin AXIS_DESCR FIX_AXIS sys_oil_p u_kPa_0_1024 3 0 1000 /begin FIX_AXIS_PAR_LIST 0 25600 64000 /end FIX_AXIS_PAR_LIST /end AXIS_DESCR
 /begin AXIS_DESCR FIX_AXIS sys_oil_t u_deg_C 3 -15 130 /begin FIX_AXIS_PAR_LIST -3840 6400 16640 /end FIX_AXIS_PAR_LIST /end AXIS_DESCR
/end CHARACTERISTIC
/begin CHARACTERISTIC VVT_M_INTK_B1_I_NEG_GN "vvt i control negtive gain" MAP 0x00020320 __SWORD_S 0 u_fac_n2_p2 -2 1.99993896484375 FORMAT "%4.3" SYMBOL_LINK "VVT_M_INTK_B1_I_NEG_GN" 4
 /begin AXIS_DESCR FIX_AXIS sys_oil_p u_kPa_0_1024 3 0 1000 /begin FIX_AXIS_PAR_LIST 0 25600 64000 /end FIX_AXIS_PAR_LIST /end AXIS_DESCR
 /begin AXIS_DESCR FIX_AXIS sys_oil_t u_deg_C 3 -15 130 /begin FIX_AXIS_PAR_LIST -3840 6400 16640 /end FIX_AXIS_PAR_LIST /end AXIS_DESCR
/end CHARACTERISTIC
/begin CHARACTERISTIC VVT_M_EXH_B1_I_POS_GN "vvt i control positive gain" MAP 0x00020320 __SWORD_S 0 u_fac_n2_p2 -2 1.99993896484375 FORMAT "%4.3" SYMBOL_LINK "VVT_M_EXH_B1_I_POS_GN" 4
 /begin AXIS_DESCR FIX_AXIS sys_oil_p u_kPa_0_1024 3 0 1000 /begin FIX_AXIS_PAR_LIST 0 25600 64000 /end FIX_AXIS_PAR_LIST /end AXIS_DESCR
 /begin AXIS_DESCR FIX_AXIS sys_oil_t u_deg_C 3 -15 130 /begin FIX_AXIS_PAR_LIST -3840 6400 16640 /end FIX_AXIS_PAR_LIST /end AXIS_DESCR
/end CHARACTERISTIC
/begin CHARACTERISTIC VVT_M_EXH_B1_I_NEG_GN "vvt i control negtive gain" MAP 0x00020320 __SWORD_S 0 u_fac_n2_p2 -2 1.99993896484375 FORMAT "%4.3" SYMBOL_LINK "VVT_M_EXH_B1_I_NEG_GN" 4
 /begin AXIS_DESCR FIX_AXIS sys_oil_p u_kPa_0_1024 3 0 1000 /begin FIX_AXIS_PAR_LIST 0 25600 64000 /end FIX_AXIS_PAR_LIST /end AXIS_DESCR
 /begin AXIS_DESCR FIX_AXIS sys_oil_t u_deg_C 3 -15 130 /begin FIX_AXIS_PAR_LIST -3840 6400 16640 /end FIX_AXIS_PAR_LIST /end AXIS_DESCR
/end CHARACTERISTIC
/begin CHARACTERISTIC VVT_M_INTK_B1_D_POS_GN "vvt d control positive gain" MAP 0x00020320 __SWORD_S 0 u_fac_n2_p2 -2 1.99993896484375 FORMAT "%4.3" SYMBOL_LINK "VVT_M_INTK_B1_D_POS_GN" 4
 /begin AXIS_DESCR FIX_AXIS sys_oil_p u_kPa_0_1024 3 0 1000 /begin FIX_AXIS_PAR_LIST 0 25600 64000 /end FIX_AXIS_PAR_LIST /end AXIS_DESCR
 /begin AXIS_DESCR FIX_AXIS sys_oil_t u_deg_C 3 -15 130 /begin FIX_AXIS_PAR_LIST -3840 6400 16640 /end FIX_AXIS_PAR_LIST /end AXIS_DESCR
/end CHARACTERISTIC
/begin CHARACTERISTIC VVT_M_INTK_B1_D_NEG_GN "vvt d control negtive gain" MAP 0x00020320 __SWORD_S 0 u_fac_n2_p2 -2 1.99993896484375 FORMAT "%4.3" SYMBOL_LINK "VVT_M_INTK_B1_D_NEG_GN" 4
 /begin AXIS_DESCR FIX_AXIS sys_oil_p u_kPa_0_1024 3 0 1000 /begin FIX_AXIS_PAR_LIST 0 25600 64000 /end FIX_AXIS_PAR_LIST /end AXIS_DESCR
 /begin AXIS_DESCR FIX_AXIS sys_oil_t u_deg_C 3 -15 130 /begin FIX_AXIS_PAR_LIST -3840 6400 16640 /end FIX_AXIS_PAR_LIST /end AXIS_DESCR
/end CHARACTERISTIC
/begin CHARACTERISTIC VVT_M_EXH_B1_D_POS_GN "vvt d control negtive gain" MAP 0x00020320 __SWORD_S 0 u_fac_n2_p2 -2 1.99993896484375 FORMAT "%4.3" SYMBOL_LINK "VVT_M_EXH_B1_D_POS_GN" 4
 /begin AXIS_DESCR FIX_AXIS sys_oil_p u_kPa_0_1024 3 0 1000 /begin FIX_AXIS_PAR_LIST 0 25600 64000 /end FIX_AXIS_PAR_LIST /end AXIS_DESCR
 /begin AXIS_DESCR FIX_AXIS sys_oil_t u_deg_C 3 -15 130 /begin FIX_AXIS_PAR_LIST -3840 6400 16640 /end FIX_AXIS_PAR_LIST /end AXIS_DESCR
/end CHARACTERISTIC
/begin CHARACTERISTIC VVT_M_EXH_B1_D_NEG_GN "vvt d control negtive gain" MAP 0x00020320 __SWORD_S 0 u_fac_n2_p2 -2 1.99993896484375 FORMAT "%4.3" SYMBOL_LINK "VVT_M_EXH_B1_D_NEG_GN" 4
 /begin AXIS_DESCR FIX_AXIS sys_oil_p u_kPa_0_1024 3 0 1000 /begin FIX_AXIS_PAR_LIST 0 25600 64000 /end FIX_AXIS_PAR_LIST /end AXIS_DESCR
 /begin AXIS_DESCR FIX_AXIS sys_oil_t u_deg_C 3 -15 130 /begin FIX_AXIS_PAR_LIST -3840 6400 16640 /end FIX_AXIS_PAR_LIST /end AXIS_DESCR
/end CHARACTERISTIC
/begin AXIS_PTS VVT_X_POS_ERR_A "vvt position error" 0x0002006C NO_INPUT_QUANTITY SSV__SWORD_S 0 u_iga 9 -256.000000 255.9921875 FORMAT "%4.2" DEPOSIT ABSOLUTE SYMBOL_LINK "VVT_X_POS_ERR_A" 2 /end AXIS_PTS
/begin CHARACTERISTIC VVT_C_INTK_P_ERR_FAC "vvt p control position error gain" CURVE 0x000200B0 __UWORD_S 0 u_fac_2 0 1.999969482421875 FORMAT "%4.3" SYMBOL_LINK "VVT_C_INTK_P_ERR_FAC" 2
 /begin AXIS_DESCR COM_AXIS vvt_intk_b1_pos_err u_iga 9 -256.000000 255.9921875 AXIS_PTS_REF VVT_X_POS_ERR_A /end AXIS_DESCR
/end CHARACTERISTIC
/begin CHARACTERISTIC VVT_C_EXH_P_ERR_FAC "vvt p control position error gain" CURVE 0x000200B0 __UWORD_S 0 u_fac_2 0 1.999969482421875 FORMAT "%4.3" SYMBOL_LINK "VVT_C_EXH_P_ERR_FAC" 2
 /begin AXIS_DESCR COM_AXIS vvt_exh_b1_pos_err u_iga 9 -256.000000 255.9921875 AXIS_PTS_REF VVT_X_POS_ERR_A /end AXIS_DESCR
/end CHARACTERISTIC
/begin CHARACTERISTIC VVT_C_INTK_I_INIT "vvt i control initial value" CURVE 0x000200B0 __SWORD_S 0 u_fac_n2_p2 -2 1.99993896484375 FORMAT "%4.3" SYMBOL_LINK "VVT_C_INTK_I_INIT" 2
 /begin AXIS_DESCR FIX_AXIS sys_oil_t u_deg_C 9 -40 152 /begin FIX_AXIS_PAR_LIST -5120 -2048 1024 4096 7168 10240 13312 16384 19456 /end FIX_AXIS_PAR_LIST /end AXIS_DESCR
/end CHARACTERISTIC
/begin CHARACTERISTIC VVT_C_EXH_I_INIT "vvt i control initial value" CURVE 0x000200B0 __SWORD_S 0 u_fac_n2_p2 -2 1.99993896484375 FORMAT "%4.3" SYMBOL_LINK "VVT_C_EXH_I_INIT" 2
 /begin AXIS_DESCR FIX_AXIS sys_oil_t u_deg_C 9 -40 152 /begin FIX_AXIS_PAR_LIST -5120 -2048 1024 4096 7168 10240 13312 16384 19456 /end FIX_AXIS_PAR_LIST /end AXIS_DESCR
/end CHARACTERISTIC
/begin CHARACTERISTIC VVT_M_INTK_SP_V_MAX "intake vvt setpoint velocity max" MAP 0x00020320 __SBYTE_S 0 u_cam_vec_b -1024.0 1016.0 FORMAT "%3.1" SYMBOL_LINK "VVT_M_INTK_SP_V_MAX" 3
 /begin AXIS_DESCR FIX_AXIS sys_eng_spd u_espd 9 800 4000 /begin FIX_AXIS_PAR_LIST 6400 9600 12800 16000 19200 22400 25600 28800 32000 /end FIX_AXIS_PAR_LIST /end AXIS_DESCR
 /begin AXIS_DESCR COM_AXIS sys_oil_t u_deg_C 5 -256.000000 255.9921875 AXIS_PTS_REF VVT_X_OIL_T_A /end AXIS_DESCR
/end CHARACTERISTIC
/begin CHARACTERISTIC VVT_M_INTK_SP_V_MIN "intake vvt setpoint velocity min" MAP 0x00020320 __SBYTE_S 0 u_cam_vec_b -1024.0 1016.0 FORMAT "%3.1" SYMBOL_LINK "VVT_M_INTK_SP_V_MIN" 3
 /begin AXIS_DESCR FIX_AXIS sys_eng_spd u_espd 9 800 4000 /begin FIX_AXIS_PAR_LIST 6400 9600 12800 16000 19200 22400 25600 28800 32000 /end FIX_AXIS_PAR_LIST /end AXIS_DESCR
 /begin AXIS_DESCR COM_AXIS sys_oil_t u_deg_C 5 -256.000000 255.9921875 AXIS_PTS_REF VVT_X_OIL_T_A /end AXIS_DESCR
/end CHARACTERISTIC
/begin CHARACTERISTIC VVT_M_EXH_SP_V_MAX "exhaust vvt setpoint velocity max" MAP 0x00020320 __SBYTE_S 0 u_cam_vec_b -1024.0 1016.0 FORMAT "%3.1" SYMBOL_LINK "VVT_M_EXH_SP_V_MAX" 3
 /begin AXIS_DESCR FIX_AXIS sys_eng_spd u_espd 9 800 4000 /begin FIX_AXIS_PAR_LIST 6400 9600 12800 16000 19200 22400 25600 28800 32000 /end FIX_AXIS_PAR_LIST /end AXIS_DESCR
 /begin AXIS_DESCR COM_AXIS sys_oil_t u_deg_C 5 -256.000000 255.9921875 AXIS_PTS_REF VVT_X_OIL_T_A /end AXIS_DESCR
/end CHARACTERISTIC
/begin CHARACTERISTIC VVT_M_EXH_SP_V_MIN "exhaust vvt setpoint velocity min" MAP 0x00020320 __SBYTE_S 0 u_cam_vec_b -1024.0 1016.0 FORMAT "%3.1" SYMBOL_LINK "VVT_M_EXH_SP_V_MIN" 3
 /begin AXIS_DESCR FIX_AXIS sys_eng_spd u_espd 9 800 4000 /begin FIX_AXIS_PAR_LIST 6400 9600 12800 16000 19200 22400 25600 28800 32000 /end FIX_AXIS_PAR_LIST /end AXIS_DESCR
 /begin AXIS_DESCR COM_AXIS sys_oil_t u_deg_C 5 -256.000000 255.9921875 AXIS_PTS_REF VVT_X_OIL_T_A /end AXIS_DESCR
/end CHARACTERISTIC
/begin CHARACTERISTIC VVT_C_INTK_SP_OIL_FAC "vvt intake setpoint oil temp factor" CURVE 0x000200B0 __UWORD_S 0 u_fac_4 0 3.99993896484375 FORMAT "%4.3" SYMBOL_LINK "VVT_C_INTK_SP_OIL_FAC" 2
 /begin AXIS_DESCR COM_AXIS sys_oil_t u_deg_C 9 -256.000000 255.9921875 AXIS_PTS_REF VVT_X_OIL_T_B /end AXIS_DESCR
/end CHARACTERISTIC
/begin CHARACTERISTIC VVT_C_EXH_SP_OIL_FAC "vvt intake setpoint oil temp factor" CURVE 0x000200B0 __UWORD_S 0 u_fac_4 0 3.99993896484375 FORMAT "%4.3" SYMBOL_LINK "VVT_C_EXH_SP_OIL_FAC" 2
 /begin AXIS_DESCR COM_AXIS sys_oil_t u_deg_C 9 -256.000000 255.9921875 AXIS_PTS_REF VVT_X_OIL_T_B /end AXIS_DESCR
/end CHARACTERISTIC
/begin CHARACTERISTIC VVT_C_EXH_IDL_SP "idle vvt exh setpoint" CURVE 0x000200B0 __SBYTE_S 0 u_iga_64n_64p_b -64 63.5 SYMBOL_LINK "VVT_C_EXH_IDL_SP" 2
 /begin AXIS_DESCR COM_AXIS sys_oil_t u_deg_C 9 -256.000000 255.9921875 AXIS_PTS_REF VVT_X_OIL_T_B /end AXIS_DESCR
/end CHARACTERISTIC
/begin CHARACTERISTIC VVT_C_INTK_IDL_SP "idle vvt intake setpoint" CURVE 0x000200B0 __SBYTE_S 0 u_iga_64n_64p_b -64 63.5 SYMBOL_LINK "VVT_C_INTK_IDL_SP" 2
 /begin AXIS_DESCR COM_AXIS sys_oil_t u_deg_C 9 -256.000000 255.9921875 AXIS_PTS_REF VVT_X_OIL_T_B /end AXIS_DESCR
/end CHARACTERISTIC
/begin AXIS_PTS VVT_X_OIL_T_B "vvt oil temp" 0x0002006C NO_INPUT_QUANTITY SSV__SWORD_S 0 u_iga 9 -256.000000 255.9921875 FORMAT "%4.2" DEPOSIT ABSOLUTE SYMBOL_LINK "VVT_X_OIL_T_B" 2 /end AXIS_PTS
/begin CHARACTERISTIC VVT_V_T_ZONE_LO "vvt relearn temp zone low" VALUE 0x0002038C __SWORD_S 0 u_deg_C -256.000000 255.9921875 /end CHARACTERISTIC
/begin CHARACTERISTIC VVT_V_T_ZONE_HI "vvt relearn temp zone high" VALUE 0x0002038C __SWORD_S 0 u_deg_C -256.000000 255.9921875 /end CHARACTERISTIC
/begin COMPU_METHOD u_volt_32 "voltage" RAT_FUNC "%6.4" "V" COEFFS 0.0 1.0 0.000000 0.0 0.0 0.00048828125 /end COMPU_METHOD
/begin COMPU_METHOD u_volt_512n_512p "voltage" RAT_FUNC "%5.2" "V" COEFFS 0.0 1.0 0.000000 0.0 0.0 0.015625 /end COMPU_METHOD
/begin COMPU_METHOD u_volt_32n_32p "voltage" RAT_FUNC "%5.2" "V" COEFFS 0.0 1.0 0.000000 0.0 0.0 0.0009765625 /end COMPU_METHOD
/begin COMPU_METHOD u_kPa_0_256 "press" RAT_FUNC "%5.2" "kPa" COEFFS 0.0 1.0 0.000000 0.0 0.0 0.00390625 /end COMPU_METHOD
/begin COMPU_METHOD u_kPa_0_1024 "press" RAT_FUNC "%5.2" "kPa" COEFFS 0.0 1.0 0.000000 0.0 0.0 0.015625 /end COMPU_METHOD
/begin COMPU_METHOD u_kPa_0_32768 "press" RAT_FUNC "%6.1" "kPa" COEFFS 0.0 1.0 0.000000 0.0 0.0 0.5 /end COMPU_METHOD
/begin COMPU_METHOD u_fac_512 "factor" RAT_FUNC "%5.1" "fac" COEFFS 0.0 1.0 0.000000 0.0 0.0 0.0078125 /end COMPU_METHOD
/begin COMPU_METHOD u_fac_32 "factor" RAT_FUNC "%8.6" "fac" COEFFS 0.0 1.0 0.000000 0.0 0.0 0.00048828125 /end COMPU_METHOD
/begin COMPU_METHOD u_fac_4 "factor" RAT_FUNC "%5.4" "fac" COEFFS 0.0 1.0 0.000000 0.0 0.0 0.00006103515625 /end COMPU_METHOD
/begin COMPU_METHOD u_fac_2 "factor" RAT_FUNC "%3.2" "fac" COEFFS 0.0 1.0 0.000000 0.0 0.0 0.000030517578125 /end COMPU_METHOD
/begin COMPU_METHOD u_fac_1 "factor" RAT_FUNC "%4.3" "fac" COEFFS 0.0 1.0 0.000000 0.0 0.0 0.0000152587890625 /end COMPU_METHOD
/begin COMPU_METHOD u_fac_n2_p2 "factor" RAT_FUNC "%3.2" "fac" COEFFS 0.0 1.0 0.000000 0.0 0.0 0.00006103515625 /end COMPU_METHOD
/begin COMPU_METHOD u_fac_n32_p32 "factor" RAT_FUNC "%4.2" "fac" COEFFS 0.0 1.0 0.000000 0.0 0.0 0.0009765625 /end COMPU_METHOD
/begin COMPU_METHOD u_deg_K "degK" RAT_FUNC "%6.2" "K" COEFFS 0.0 1.0 0.0 0.0 0.0 0.03125 /end COMPU_METHOD
/begin COMPU_METHOD u_deg_C "degC" RAT_FUNC "%5.2" "¡æ" COEFFS 0.0 1.0 0.0 0.0 0.0 0.0078125 /end COMPU_METHOD
/begin COMPU_METHOD u_deg_C_b "degC" RAT_FUNC "%3.0" "¡æ" COEFFS 0.0 1.0 0.0 0.0 0.0 2.0 /end COMPU_METHOD
/begin COMPU_METHOD u_filter "filter" RAT_FUNC "%11.10" "coef" COEFFS 0.0 1.0 0.0 0.0 0.0 0.0000152587890625 /end COMPU_METHOD
/begin COMPU_METHOD u_cam_spd "cam speed" RAT_FUNC "%7.3" "deg/s" COEFFS 0.0 1.0 0.0 0.0 0.0 0.125 /end COMPU_METHOD
/begin COMPU_METHOD u_cnts "counts" RAT_FUNC "%3.0" "cnts" COEFFS 0.0 1.0 0.0 0.0 0.0 1.0 /end COMPU_METHOD
/begin COMPU_METHOD u_min "min timer" RAT_FUNC "%5.0" "min" COEFFS 0.0 1.0 0.0 0.0 0.0 1.00 /end COMPU_METHOD
/begin COMPU_METHOD u_base_tmr "3.9 timer" RAT_FUNC "%4.3" "s" COEFFS 0.0 1.0 0.0 0.0 0.0 0.00390625 /end COMPU_METHOD
/begin COMPU_METHOD u_1x_tmr "7.81 timer" RAT_FUNC "%4.3" "s" COEFFS 0.0 1.0 0.0 0.0 0.0 0.0078125 /end COMPU_METHOD
/begin COMPU_METHOD u_2x_tmr "15.6 timer" RAT_FUNC "%6.2" "s" COEFFS 0.0 1.0 0.0 0.0 0.0 0.015625 /end COMPU_METHOD
/begin COMPU_METHOD u_4x_tmr "31.2 timer" RAT_FUNC "%6.2" "s" COEFFS 0.0 1.0 0.0 0.0 0.0 0.03125 /end COMPU_METHOD
/begin COMPU_METHOD u_8x_tmr "62.5 timer" RAT_FUNC "%6.2" "s" COEFFS 0.0 1.0 0.0 0.0 0.0 0.0625 /end COMPU_METHOD
/begin COMPU_METHOD u_16x_tmr "125 timer" RAT_FUNC "%5.1" "s" COEFFS 0.0 1.0 0.0 0.0 0.0 0.125 /end COMPU_METHOD
/begin COMPU_METHOD u_1s_tmr "1 sec timer" RAT_FUNC "%5.0" "s" COEFFS 0.0 1.0 0.0 0.0 0.0 1.0 /end COMPU_METHOD
/begin COMPU_METHOD u_500m_tmr "500ms timer" RAT_FUNC "%5.0" "s" COEFFS 0.0 1.0 0.0 0.0 0.0 0.5 /end COMPU_METHOD
/begin COMPU_METHOD b_true "" TAB_VERB "%6.3" "" COMPU_TAB_REF b_true /end COMPU_METHOD
/begin COMPU_VTAB b_true "" TAB_VERB 2 0 "FALSE" 1 "TRUE" /end COMPU_VTAB
/begin COMPU_METHOD b_enable "" TAB_VERB "%6.3" "" COMPU_TAB_REF b_enable /end COMPU_METHOD
/begin COMPU_VTAB b_enable "" TAB_VERB 2 0 "DISABLE" 1 "ENABLE" /end COMPU_VTAB
/begin COMPU_METHOD u_etc_tst_mod "" TAB_VERB "%6.3" "" COMPU_TAB_REF u_etc_tst_mod /end COMPU_METHOD
/begin COMPU_VTAB u_etc_tst_mod "" TAB_VERB 4 0 "INACTV" 1 "DIS_OUT" 2 "DC_SP" 3 "ETC_SP" /end COMPU_VTAB
/begin COMPU_METHOD u_thro_ctrl_st "" TAB_VERB "%6.3" "" COMPU_TAB_REF u_thro_ctrl_st /end COMPU_METHOD
/begin COMPU_VTAB u_thro_ctrl_st "" TAB_VERB 3 0 "SHUT_DOWN" 1 "OUT_CTRL" 2 "NORMAL" /end COMPU_VTAB
/begin COMPU_METHOD u_thro_tps_st "" TAB_VERB "%6.3" "" COMPU_TAB_REF u_thro_tps_st /end COMPU_METHOD
/begin COMPU_VTAB u_thro_tps_st "" TAB_VERB 8 0 "12_FINE" 1 "1_OUT" 2 "12_CORR" 3 "1_OUT_12_CORR" 4 "2_OUT" 5 "12_OUT" 6 "2_OUT_12_CORR" 7 "12_OUT_12_CORR" /end COMPU_VTAB
/begin COMPU_METHOD u_thro_tps_st_r "" TAB_VERB "%6.3" "" COMPU_TAB_REF u_thro_tps_st_r /end COMPU_METHOD
/begin COMPU_VTAB u_thro_tps_st_r "" TAB_VERB 8 0 "12_OUT_12_CORR" 1 "2_OUT_12_CORR" 2 "12_OUT" 3 "2_OUT" 4 "1_OUT_12_CORR" 5 "12_CORR" 6 "1_OUT" 7 "12_FINE" /end COMPU_VTAB
/begin COMPU_METHOD u_thro_sp_typ "" TAB_VERB "%6.3" "" COMPU_TAB_REF u_thro_sp_typ /end COMPU_METHOD
/begin COMPU_VTAB u_thro_sp_typ "" TAB_VERB 3 0 "NONE" 1 "SHORT" 2 "LONG" /end COMPU_VTAB
/begin COMPU_METHOD u_o2_ht_st "" TAB_VERB "%4.0" "" COMPU_TAB_REF u_o2_ht_st /end COMPU_METHOD
/begin COMPU_VTAB u_o2_ht_st "" TAB_VERB 6 0 "OFF" 1 "DEW" 2 "INC" 3 "MAX" 4 "DEC" 5 "STDY" /end COMPU_VTAB
/begin COMPU_METHOD u_dew_st "" TAB_VERB "%4.0" "" COMPU_TAB_REF u_dew_st /end COMPU_METHOD
/begin COMPU_VTAB u_dew_st "" TAB_VERB 3 0 "NOT_REACH" 1 "REACH" 2 "UNKOWN" /end COMPU_VTAB
/begin COMPU_METHOD u_espd "engine speed" RAT_FUNC "%5.2" "rpm" COEFFS 0.0 1.0 0.000000 0.0 0.0 0.125 /end COMPU_METHOD
/begin COMPU_METHOD u_espd_b "engine speed" RAT_FUNC "%5.2" "rpm" COEFFS 0.0 1.0 0.000000 0.0 0.0 8.0 /end COMPU_METHOD
/begin COMPU_METHOD u_vspd "vehicle speed" RAT_FUNC "%5.2" "kph" COEFFS 0.0 1.0 0.000000 0.0 0.0 0.0078125 /end COMPU_METHOD
/begin COMPU_METHOD u_pct "percentage" RAT_FUNC "%5.2" "%" COEFFS 0.0 1.0 0.000000 0.0 0.0 0.0030517578125 /end COMPU_METHOD
/begin COMPU_METHOD u_pct_1 "percentage" RAT_FUNC "%5.2" "%" COEFFS 0.0 1.0 0.000000 0.0 0.0 0.00152587890625 /end COMPU_METHOD
/begin COMPU_METHOD u_pct_8 "percentage" RAT_FUNC "%5.2" "%" COEFFS 0.0 1.0 0.000000 0.0 0.0 0.01220703125 /end COMPU_METHOD
/begin COMPU_METHOD u_pct_s "percentage" RAT_FUNC "%5.2" "%" COEFFS 0.0 1.0 0.000000 0.0 0.0 0.006103515625 /end COMPU_METHOD
/begin COMPU_METHOD u_pct_b_s "percentage" RAT_FUNC "%4.2" "%" COEFFS 0.0 1.0 0.000000 0.0 0.0 1.5625 /end COMPU_METHOD
/begin COMPU_METHOD u_pct_r "real pct" RAT_FUNC "%5.2" "%" COEFFS 0.0 1.0 0.000000 0.0 0.0 0.001953125 /end COMPU_METHOD
/begin COMPU_METHOD u_pct_r_s "real pct" RAT_FUNC "%5.2" "%" COEFFS 0.0 1.0 0.000000 0.0 0.0 0.00390625 /end COMPU_METHOD
/begin COMPU_METHOD u_pct_r_lo_s "real pct" RAT_FUNC "%5.2" "%" COEFFS 0.0 1.0 0.000000 0.0 0.0 0.0078125 /end COMPU_METHOD
/begin COMPU_METHOD u_g_per_sec "g per second" RAT_FUNC "%5.2" "g/s" COEFFS 0.0 1.0 0.000000 0.0 0.0 0.0078125 /end COMPU_METHOD
/begin COMPU_METHOD u_kPa_0_4096 "IMEP" RAT_FUNC "%6.2" "kPa" COEFFS 0.0 1.0 0.000000 0.0 0.0 0.0625 /end COMPU_METHOD
/begin COMPU_METHOD u_iga_abs "ignition angle" RAT_FUNC "%3.1" "Deg" COEFFS 0.0 1.0 0.000000 0.0 0.0 0.015625 /end COMPU_METHOD
/begin COMPU_METHOD u_cam_vec "cam speed" RAT_FUNC "%6.2" "Deg/s" COEFFS 0.0 1.0 0.000000 0.0 0.0 0.03125 /end COMPU_METHOD
/begin COMPU_METHOD u_cam_vec_b "cam speed" RAT_FUNC "%4.0" "Deg/s" COEFFS 0.0 1.0 0.000000 0.0 0.0 8.0 /end COMPU_METHOD
/begin COMPU_METHOD u_iga "ignition angle" RAT_FUNC "%3.1" "Deg" COEFFS 0.0 1.0 0.000000 0.0 0.0 0.0078125 /end COMPU_METHOD
/begin COMPU_METHOD u_cam_ang_hi "cam angle high res" RAT_FUNC "%4.2" "Deg" COEFFS 0.0 1.0 0.000000 0.0 0.0 0.0009765625 /end COMPU_METHOD
/begin COMPU_METHOD u_iga_64n_64p_b "ignition angle" RAT_FUNC "%3.1" "Deg" COEFFS 0.0 1.0 0.000000 0.0 0.0 0.5 /end COMPU_METHOD
/begin COMPU_METHOD u_gram_l_65536 "gram" RAT_FUNC "%8.3" "g" COEFFS 0.0 1.0 0.000000 0.0 0.0 0.0000152587890625 /end COMPU_METHOD
/begin COMPU_METHOD x_pct "percent" RAT_FUNC "%5.2" "%" COEFFS 0.0 1.0 0.0 0.0 0.0 1.0 /end COMPU_METHOD
/begin COMPU_METHOD x_cnts "counts" RAT_FUNC "%3.0" "cnts" COEFFS 0.0 1.0 0.0 0.0 0.0 1.0 /end COMPU_METHOD
/begin COMPU_METHOD x_vspd "vehicle speed" RAT_FUNC "%5.2" "kph" COEFFS 0.0 1.0 0.0 0.0 0.0 1.0 /end COMPU_METHOD
/begin COMPU_METHOD x_ang "counts" RAT_FUNC "%3.0" "deg" COEFFS 0.0 1.0 0.0 0.0 0.0 1.0 /end COMPU_METHOD
/begin COMPU_METHOD u_freq "freq" RAT_FUNC "%6.1" "Hz" COEFFS 0.0 1.0 0.000000 0.0 0.0 0.25 /end COMPU_METHOD
/begin COMPU_METHOD u_espd_128 "engine speed" RAT_FUNC "%7.4" "rpm" COEFFS 0.0 1.0 0.000000 0.0 0.0 0.001953125 /end COMPU_METHOD
/begin COMPU_METHOD u_espd_per_sec "engine speed rate" RAT_FUNC "%6.0" "rpm/s" COEFFS 0.0 1.0 0.0 0.0 0.0 8.0 /end COMPU_METHOD
/begin COMPU_METHOD u_espd_n4096_p4096 "engine speed" RAT_FUNC "%6.2" "rpm" COEFFS 0.0 1.0 0.0 0.0 0.0 0.125 /end COMPU_METHOD
/begin COMPU_METHOD u_espd_n256_p256 "engine speed" RAT_FUNC "%6.2" "rpm" COEFFS 0.0 1.0 0.0 0.0 0.0 0.0078125 /end COMPU_METHOD
/begin COMPU_METHOD u_fac_16_b "factor" RAT_FUNC "%4.2" "fac" COEFFS 0.0 1.0 0.000000 0.0 0.0 0.0625 /end COMPU_METHOD
/begin COMPU_METHOD u_idl_st "" TAB_VERB "%6.3" "" COMPU_TAB_REF u_idl_st /end COMPU_METHOD
/begin COMPU_VTAB u_idl_st "" TAB_VERB 6 0 "OPEN_LOOP" 1 "NORMAL_PID" 2 "NORMAL_PD" 3 "OVERRUN_PID" 4 "OVERRUN_PD" 5 "LAUNCH_PD" /end COMPU_VTAB
/begin COMPU_METHOD x_AC_status "" TAB_VERB "%10.4" "" COMPU_TAB_REF x_AC_status /end COMPU_METHOD
/begin COMPU_VTAB x_AC_status "" TAB_VERB 2 0 "AC_OFF" 1 "AC_ON" /end COMPU_VTAB
/begin COMPU_METHOD u_at_gr_typ_1 "" TAB_VERB "%5.0" "" COMPU_TAB_REF u_at_gr_typ_1 /end COMPU_METHOD
/begin COMPU_VTAB u_at_gr_typ_1 "" TAB_VERB 10 0 "PARK" 1 "REVERSE" 2 "NEUTRAL" 3 "1ST" 4 "2ND" 5 "3RD" 6 "4TH" 7 "5TH" 8 "ERROR" 9 "DRIVE" /end COMPU_VTAB
/begin COMPU_METHOD u_o2_loc "" TAB_VERB "%5.0" "" COMPU_TAB_REF u_o2_loc /end COMPU_METHOD
/begin COMPU_VTAB u_o2_loc "" TAB_VERB 2 0 "UP" 1 "DOWN" /end COMPU_VTAB
/begin COMPU_METHOD u_osht_dir "" TAB_VERB "%5.0" "" COMPU_TAB_REF u_osht_dir /end COMPU_METHOD
/begin COMPU_VTAB u_osht_dir "" TAB_VERB 2 0 "INCREASE" 1 "DECREASE" /end COMPU_VTAB
/begin COMPU_METHOD u_srly_cfg "" TAB_VERB "%6.3" "" COMPU_TAB_REF u_srly_cfg /end COMPU_METHOD
/begin COMPU_VTAB u_srly_cfg "" TAB_VERB 3 0 "UNUSE" 2 "USE" 4 "LEARN" /end COMPU_VTAB
/begin COMPU_METHOD u_crk_sw_cfg "" TAB_VERB "%6.3" "" COMPU_TAB_REF u_crk_sw_cfg /end COMPU_METHOD
/begin COMPU_VTAB u_crk_sw_cfg "" TAB_VERB 2 1 "BUTTON" 2 "SWITCH" /end COMPU_VTAB
/begin COMPU_METHOD u_crk_dis_cfg "" TAB_VERB "%6.3" "" COMPU_TAB_REF u_crk_dis_cfg /end COMPU_METHOD
/begin COMPU_VTAB u_crk_dis_cfg "" TAB_VERB 5 0 "NONE" 1 "VALID_GEAR_IN" 2 "GEAR_IN" 3 "BRAKE_OFF_OR_GEAR_IN" 4 "DRV_TRAIN_GEAR_IN" /end COMPU_VTAB
/begin COMPU_METHOD u_thro_drv_mode "" TAB_VERB "%6.3" "" COMPU_TAB_REF u_thro_drv_mode /end COMPU_METHOD
/begin COMPU_VTAB u_thro_drv_mode "" TAB_VERB 3 0 "FORCE_IDL" 1 "LMT_PERF" 2 "NORM" /end COMPU_VTAB
/begin COMPU_METHOD u_thro_drv_mode_r "" TAB_VERB "%6.3" "" COMPU_TAB_REF u_thro_drv_mode_r /end COMPU_METHOD
/begin COMPU_VTAB u_thro_drv_mode_r "" TAB_VERB 3 0 "NORM" 1 "LMT_PERF" 2 "FORCE_IDL" /end COMPU_VTAB
/begin COMPU_METHOD u_thro_drv_st "" TAB_VERB "%6.3" "" COMPU_TAB_REF u_thro_drv_st /end COMPU_METHOD
/begin COMPU_VTAB u_thro_drv_st "" TAB_VERB 4 0 "PASS" 1 "BRAKE_FAIL" 2 "VSS_FAIL" 3 "BRAKE_VSS_FAIL" /end COMPU_VTAB
/begin COMPU_METHOD u_thro_drv_st_r "" TAB_VERB "%6.3" "" COMPU_TAB_REF u_thro_drv_st_r /end COMPU_METHOD
/begin COMPU_VTAB u_thro_drv_st_r "" TAB_VERB 4 0 "BRAKE_VSS_FAIL" 1 "VSS_FAIL" 2 "BRAKE_FAIL" 3 "PASS" /end COMPU_VTAB
/begin COMPU_METHOD u_thro_pedal_st "" TAB_VERB "%6.3" "" COMPU_TAB_REF u_thro_pedal_st /end COMPU_METHOD
/begin COMPU_VTAB u_thro_pedal_st "" TAB_VERB 4 0 "FAIL" 1 "FAIL_LMT" 2 "FAIL_OPRTN" 3 "NORMAL" /end COMPU_VTAB
/begin COMPU_METHOD u_thro_pedal_st_r "" TAB_VERB "%6.3" "" COMPU_TAB_REF u_thro_pedal_st_r /end COMPU_METHOD
/begin COMPU_VTAB u_thro_pedal_st_r "" TAB_VERB 4 0 "NORMAL" 1 "FAIL_OPRTN" 2 "FAIL_LMT" 3 "FAIL" /end COMPU_VTAB
/begin COMPU_METHOD u_thro_actr_st "" TAB_VERB "%6.3" "" COMPU_TAB_REF u_thro_actr_st /end COMPU_METHOD
/begin COMPU_VTAB u_thro_actr_st "" TAB_VERB 4 0 "PASS" 1 "ACT_FAIL" 2 "RTN_FAIL" 3 "ACT_RTN_FAIL" /end COMPU_VTAB
/begin COMPU_METHOD u_thro_actr_st_r "" TAB_VERB "%6.3" "" COMPU_TAB_REF u_thro_actr_st_r /end COMPU_METHOD
/begin COMPU_VTAB u_thro_actr_st_r "" TAB_VERB 4 0 "ACT_RTN_FAIL" 1 "RTN_FAIL" 2 "ACT_FAIL" 3 "PASS" /end COMPU_VTAB
/begin COMPU_METHOD u_thro_pow_st "" TAB_VERB "%6.3" "" COMPU_TAB_REF u_thro_pow_st /end COMPU_METHOD
/begin COMPU_VTAB u_thro_pow_st "" TAB_VERB 3 0 "ENG_OFF" 1 "POW_MNG" 2 "NORMAL" /end COMPU_VTAB
/begin COMPU_METHOD u_thro_pow_st_r "" TAB_VERB "%6.3" "" COMPU_TAB_REF u_thro_pow_st_r /end COMPU_METHOD
/begin COMPU_VTAB u_thro_pow_st_r "" TAB_VERB 3 0 "NORMAL" 1 "POW_MNG" 2 "ENG_OFF" /end COMPU_VTAB
/begin COMPU_METHOD u_thro_air_st "" TAB_VERB "%6.3" "" COMPU_TAB_REF u_thro_air_st /end COMPU_METHOD
/begin COMPU_VTAB u_thro_air_st "" TAB_VERB 4 0 "PASS" 1 "MAF_FAIL" 2 "MAP_FAIL" 3 "MAF_MAP_FAIL" /end COMPU_VTAB
/begin COMPU_METHOD u_thro_air_st_r "" TAB_VERB "%6.3" "" COMPU_TAB_REF u_thro_air_st_r /end COMPU_METHOD
/begin COMPU_VTAB u_thro_air_st_r "" TAB_VERB 4 0 "MAF_MAP_FAIL" 1 "MAP_FAIL" 2 "MAF_FAIL" 3 "PASS" /end COMPU_VTAB
/begin COMPU_METHOD u_thro_pps_cor_st "" TAB_VERB "%6.3" "" COMPU_TAB_REF u_thro_pps_cor_st /end COMPU_METHOD
/begin COMPU_VTAB u_thro_pps_cor_st "" TAB_VERB 2 0 "PASS" 1 "FAIL" /end COMPU_VTAB
/begin COMPU_METHOD u_thro_pps_cor_st_r "" TAB_VERB "%6.3" "" COMPU_TAB_REF u_thro_pps_cor_st_r /end COMPU_METHOD
/begin COMPU_VTAB u_thro_pps_cor_st_r "" TAB_VERB 2 0 "FAIL" 1 "PASS" /end COMPU_VTAB
/begin COMPU_METHOD u_thro_pps_range_st "" TAB_VERB "%6.3" "" COMPU_TAB_REF u_thro_pps_range_st /end COMPU_METHOD
/begin COMPU_VTAB u_thro_pps_range_st "" TAB_VERB 4 0 "PASS" 1 "PPS1_FAIL" 2 "PPS2_FAIL" 3 "PPS12_FAIL" /end COMPU_VTAB
/begin COMPU_METHOD u_thro_pps_range_st_r "" TAB_VERB "%6.3" "" COMPU_TAB_REF u_thro_pps_range_st_r /end COMPU_METHOD
/begin COMPU_VTAB u_thro_pps_range_st_r "" TAB_VERB 4 0 "PPS12_FAIL" 1 "PPS2_FAIL" 2 "PPS1_FAIL" 3 "PASS" /end COMPU_VTAB
/begin COMPU_METHOD u_thro_fail_st "" TAB_VERB "%6.3" "" COMPU_TAB_REF u_thro_fail_st /end COMPU_METHOD
/begin COMPU_VTAB u_thro_fail_st "" TAB_VERB 6 0 "ENG_SHUT_DWN" 1 "FORCE_IDL_POW_MNG" 2 "FORCE_IDL" 3 "LMT_PERF_POW_MNG" 4 "LMT_PERF" 5 "NORM" /end COMPU_VTAB
/begin COMPU_METHOD u_thro_fail_st_r "" TAB_VERB "%6.3" "" COMPU_TAB_REF u_thro_fail_st_r /end COMPU_METHOD
/begin COMPU_VTAB u_thro_fail_st_r "" TAB_VERB 6 0 "NORM" 1 "LMT_PERF" 2 "LMT_PERF_POW_MNG" 3 "FORCE_IDL" 4 "FORCE_IDL_POW_MNG" 5 "ENG_SHUT_DWN" /end COMPU_VTAB
/begin COMPU_METHOD u_thro_fail_idx "" TAB_VERB "%10.4" "" COMPU_TAB_REF u_thro_fail_idx /end COMPU_METHOD
/begin COMPU_VTAB u_thro_fail_idx "" TAB_VERB 31 0 "MAIN_REGISTER" 1 "MAIN_STACK" 2 "MAIN_RAM" 3 "MAIN_ROM_CHECKSUM" 4 "MAIN_CPU_CLOCK" 5 "MAIN_AD_CONVERTER" 6 "MAIN_CONTROLLER_NOT_PROG" 7 "DUAL_PATH_PRIMARY" 8 "DUAL_PATH_REDUNDANT" 9 "PROCESS_SEQUENCING" 10 "COMPUTER_OPERATING_PROPERLY" 11 "ETC_DRIVER_OUTPUT_FAULT" 12 "SW_VERSION_ERROR" 13 "MAIN_CHK_SHUTOFF_TMR_EXPRD" 14 "CHK_C_AND_R_CNTR_ZERO" 15 "AD_RESP_TST_FAILED" 16 "AD_RESP_PPS1_NA_FAILED" 17 "NOT_USED" 18 "NOT_USED" 19 "NOT_USED" 20 "CRANK_BACKUP_ACTIVE" 21 "VEHICLE_COMMUNICATION" 22 "ENGINE_OVERTEMP" 23 "TRANSMISSION_OPERATION" 24 "SEVERE_MISFIRE" 25 "TORQUE_CONTROL_DIAG" 26 "VREF_A" 27 "VREF_B" 28 "DESIRED_TORQUE_RATNL_GRP1" 29 "DESIRED_TORQUE_RATNL_GRP2" 30 "NOT_USED" /end COMPU_VTAB
/begin COMPU_METHOD u_thro_fail_idx_r "" TAB_VERB "%10.4" "" COMPU_TAB_REF u_thro_fail_idx_r /end COMPU_METHOD
/begin COMPU_VTAB u_thro_fail_idx_r "" TAB_VERB 31 0 "NOT_USED" 1 "DESIRED_TORQUE_RATNL_GRP2" 2 "DESIRED_TORQUE_RATNL_GRP1" 3 "VREF_B" 4 "VREF_A" 5 "TORQUE_CONTROL_DIAG" 6 "SEVERE_MISFIRE" 7 "TRANSMISSION_OPERATION" 8 "ENGINE_OVERTEMP" 9 "VEHICLE_COMMUNICATION" 10 "CRANK_BACKUP_ACTIVE" 11 "NOT_USED" 12 "NOT_USED" 13 "NOT_USED" 14 "AD_RESP_APS1_NA_FAILED" 15 "AD_RESP_TST_FAILED" 16 "CHK_C_AND_R_CNTR_ZERO" 17 "MAIN_CHK_SHUTOFF_TMR_EXPRD" 18 "SW_VERSION_ERROR" 19 "ETC_DRIVER_OUTPUT_FAULT" 20 "COMPUTER_OPERATING_PROPERLY" 21 "PROCESS_SEQUENCING" 22 "DUAL_PATH_REDUNDANT" 23 "DUAL_PATH_PRIMARY" 24 "MAIN_CONTROLLER_NOT_PROG" 25 "MAIN_AD_CONVERTER" 26 "MAIN_CPU_CLOCK" 27 "MAIN_ROM_CHECKSUM" 28 "MAIN_RAM" 29 "MAIN_STACK" 30 "MAIN_REGISTER" /end COMPU_VTAB
/begin COMPU_METHOD u_mot_dir "" TAB_VERB "%6.3" "" COMPU_TAB_REF u_mot_dir /end COMPU_METHOD
/begin COMPU_VTAB u_mot_dir "" TAB_VERB 2 0 "OPEN" 1 "CLOSE" /end COMPU_VTAB
/begin COMPU_METHOD u_spd_grad "speed gradient" RAT_FUNC "%5.2" "rev/s2" COEFFS 0.0 1.0 0.0 0.0 0.0 0.015625 /end COMPU_METHOD
/begin COMPU_METHOD u_idle_ps_typ "" TAB_VERB "%4.0" "" COMPU_TAB_REF u_idle_ps_typ /end COMPU_METHOD
/begin COMPU_VTAB u_idle_ps_typ "" TAB_VERB 3 0 "NONE" 1 "SENSOR" 2 "SWITCH" /end COMPU_VTAB
/begin COMPU_METHOD u_eload_cfg "" TAB_VERB "%4.0" "" COMPU_TAB_REF u_eload_cfg /end COMPU_METHOD
/begin COMPU_VTAB u_eload_cfg "" TAB_VERB 5 0 "NONE" 1 "CAN" 2 "HW" 3 "SYS_BLOWER" 4 "SYS_HEADLIGHT" /end COMPU_VTAB
/begin COMPU_METHOD u_idl_lrn_cell "" TAB_VERB "%4.0" "" COMPU_TAB_REF u_idl_lrn_cell /end COMPU_METHOD
/begin COMPU_VTAB u_idl_lrn_cell "" TAB_VERB 7 0 "PN_AC" 1 "PN_NO_AC" 2 "D_AC" 3 "D_NO_AC" 4 "R_AC" 5 "R_NO_AC" 6 "NUMBER_OF_CELL" /end COMPU_VTAB
/begin COMPU_METHOD u_ethst_sp_typ "" TAB_VERB "%10.4" "" COMPU_TAB_REF u_ethst_sp_typ /end COMPU_METHOD
/begin COMPU_VTAB u_ethst_sp_typ "" TAB_VERB 4 0 "TAB_A" 1 "TAB_B" 2 "TAB_C" 3 "NONE" /end COMPU_VTAB
/begin FUNCTION thro "throttle control"
 /begin DEF_CHARACTERISTIC THRO_C_SP_NORM_MAX THRO_V_TST_EN THRO_V_TST_MODE THRO_V_TST_EN_ESPD THRO_V_KEYON_MOV_DUR THRO_C_KEYON_MOV_SP THRO_X_KEYON_DUR THRO_V_SP_DEC_MISC_FIL THRO_V_SP_DEC_CRUZ_FIL THRO_V_SP_DEC_LMT_FIL THRO_V_SP_INC_MISC_FIL THRO_V_SP_INC_CRUZ_FIL THRO_V_SP_INC_LMT_FIL THRO_C_SP_NORM_FIL THRO_C_SP_LMT_MAX THRO_V_SP_TST THRO_C_SP_STOP_SHRT THRO_X_STOP_TMR_A THRO_M_DRV_CMD_MODE THRO_C_SP_HYB_CRK_MAX THRO_M_THRO_ST_CFG THRO_M_POW_CTRL_CFG THRO_M_PEDAL_ST_CFG THRO_C_FAIL_ST_CFG THRO_C_SP_LMT_MAX_R THRO_C_SP_NORM_MAX_R THRO_V_SP_TST_R THRO_C_FAIL_ST_CFG_R THRO_M_DRV_CMD_MODE_R THRO_M_POW_CTRL_CFG_R THRO_M_PEDAL_ST_CFG_R THRO_M_THRO_ST_CFG_R THRO_V_TST_DTY THRO_V_TST_DIR THRO_V_CLS_DTY_MAX THRO_V_OPN_DTY_MAX THRO_V_PWM_FREQ THRO_V_MOT_D_DB THRO_V_MOT_FRIC_CLS_TRM THRO_V_MOT_FRIC_OPN_TRM THRO_V_MOT_INT_MIN THRO_V_MOT_INT_MAX THRO_C_MOT_VLT_TO_DTY_FAC THRO_C_MOT_D_TRM THRO_C_MOT_I_TRM THRO_C_MOT_P_TRM THRO_C_MOT_SPRING_TRM THRO_X_TPS_DELTA_A THRO_C_OPN_LONG_DTY_MAX THRO_C_CLS_LONG_DTY_MAX THRO_V_STUCK_D_MAX THRO_V_STUCK_ERR_INT_MIN THRO_V_STUCK_RUN_ERR_MIN THRO_C_MOT_STUCK_TRM THRO_C_MOT_STOP_STUCK_TRM THRO_V_STUCK_CTRL_DUR THRO_V_STUCK_CTRL_OFF_MIN THRO_V_MOT_IDL_I_DB THRO_C_MOT_I_DB /end DEF_CHARACTERISTIC
 /begin OUT_MEASUREMENT thro_keyon_mov_en thro_keyon_mov_tmr thro_keyon_mov_sp thro_ctrl_volt_fn thro_ctrl_st thro_tps_st thro_tps_st_r thro_stop_sp_typ thro_mot_stuck thro_lrn_mov_actv thro_pos_sp thro_pos_err thro_stop_tmr thro_sp_dlt thro_actr_st thro_actr_st_r thro_pedal_st thro_pedal_st_r thro_drv_cmd_st thro_drv_cmd_st_r thro_air_st thro_throt_st thro_pps_cor_st thro_pps_cor_st_r thro_pps_range_st thro_pps_range_st_r thro_air_st_r thro_throt_st_r thro_pos_err_d thro_fric_ctrl_tmr thro_stuck_ctrl_tmr thro_force_tps_cor_fl /end OUT_MEASUREMENT
/end FUNCTION
/begin FUNCTION osht "O2 heater"
 /begin DEF_CHARACTERISTIC OSHT_X_KEYON_ECT OSHT_C_SS_VLT_INIT_SP OSHT_C_DTY_MAX_SP OSHT_V_HI_SPD_DTY OSHT_C_DO2_MAX_DUR OSHT_V_RMP_DWN_DUR OSHT_C_RMP_UP_DUR OSHT_C_FCO_ON_DLY OSHT_C_FCO_OFF_DLY OSHT_V_ESPD_HI_THR OSHT_C_UO2_DLY_BIAS OSHT_C_DO2_DLY_BIAS OSHT_C_UO2_DLY OSHT_C_DO2_DLY OSHT_C_EXH_T_VLD_DLY OSHT_X_EXH_T_C OSHT_M_DO2_SS_VLT_SP OSHT_M_UO2_SS_VLT_SP OSHT_X_EXH_T_A OSHT_X_EXH_T_B OSHT_M_DO2_FCO_VLT_SP OSHT_M_UO2_FCO_VLT_SP OSHT_X_AIR_FLW_A OSHT_C_FL_ON_DLY OSHT_M_DTY_FIL OSHT_C_EXH_T_FIL OSHT_C_EXH_T_HYB_FIL OSHT_C_DO2_DEW_VLT_SP OSHT_V_BIAS_EN_SOAK_MAX OSHT_C_FUEL_ACCUM_THR OSHT_X_KEYON_ECT_A OSHT_V_FUEL_TO_T_FAC OSHT_C_STP_T_DEC OSHT_V_EN_VOLT_MAX OSHT_V_HOT_STRT_ECT OSHT_V_HOT_STRT_DLT OSHT_V_HOT_STRT_SOAK OSHT_C_UO2_DEW_VLT_SP OSHT_C_UO2_MAX_DUR OSHT_C_HYB_IDL_VLT_INIT_SP OSHT_C_HYB_FCO_VLT_INIT_SP OSHT_V_HYB_FCO_DUR_MAX OSHT_V_HYB_STOP_DUR_MAX OSHT_V_HYB_EXH_CLD_THR OSHT_V_WARM_UP_HYB_DIS /end DEF_CHARACTERISTIC
 /begin OUT_MEASUREMENT osht_ht_en_met osht_uo2_ht_st osht_do2_ht_st osht_mdl_exh_t osht_mdl_exh_t_mmv osht_eng_stp_tmr osht_eng_stop_actv osht_eng_stop_actv_lst osht_hyb_restart osht_uo2_dew_reach osht_do2_dew_reach osht_uo2_dew_reach_nv osht_do2_dew_reach_nv osht_fuel_int osht_fuel_int_met osht_fuel_int_thr osht_uo2_dly_bias osht_do2_dly_bias osht_uo2_ht_dly osht_do2_ht_dly osht_uo2_dly_tmr osht_do2_dly_tmr osht_uo2_ht_dly_fn osht_do2_ht_dly_fn osht_eng_warm_fn osht_cool_exh_t_mmv osht_uo2_rmp_tmr osht_do2_rmp_tmr osht_ht_ss osht_mdl_exh_vld osht_uo2_dty_base osht_do2_dty_base osht_uo2_ht_vlt osht_do2_ht_vlt osht_mdl_exh_vld_tmr osht_ovr_temp osht_uo2_fco_actv osht_do2_fco_actv osht_uo2_dty_fn osht_do2_dty_fn /end OUT_MEASUREMENT
/end FUNCTION
/begin FUNCTION aux "auxiliary control"
 /begin DEF_CHARACTERISTIC AUX_V_BPUMP_EN_VSPD AUX_V_BPUMP_EN_RUN AUX_V_BPUMP_EN_DLY AUX_V_BPUMP_OFF_MIN AUX_V_BPUMP_ON_MAX AUX_C_BPUMP_OFF_P AUX_C_BPUMP_ON_P AUX_V_BPUMP_INST AUX_V_BPUMP_HYB_EN AUX_V_SRLY_KEY_ON_DLY AUX_V_SRLY_CRK_ON_DLY AUX_V_SRLY_ON_MIN AUX_V_SRLY_NCRK_ON_MAX AUX_C_SRLY_ON_DUR AUX_C_SRLY_FN_DLY AUX_C_SRLY_HYB_FN_DLY AUX_V_SRLY_CFG AUX_V_SRLY_CRK_CFG AUX_V_SRLY_DIS_CFG AUX_V_SRLY_WRM_FN_SEG AUX_V_SRLY_HOT_FN_SEG AUX_V_SRLY_CLD_FN_SEG AUX_V_SRLY_HYB_FN_SEG AUX_V_SRLY_OVRHT_ACTV_CNTS AUX_V_SRLY_OVRHT_EXT_CNTS AUX_V_SRLY_OVRHT_DEC_CNTS AUX_V_SRLY_OVRHT_INC_CNTS AUX_V_SRLY_OVRHT_STCK_INC_CNTS AUX_V_SRLY_CRK_TM_FIL AUX_V_SRLY_LRN_VLT AUX_V_SRLY_STCK_VLT AUX_V_SRLY_PRECRK_EN AUX_V_SRLY_FCO_RUN_MAX AUX_V_SRLY_FCO_RST_DLY AUX_V_SRLY_FCO_FL_DLY AUX_C_SRLY_FN_ESPD AUX_X_ECT_A AUX_V_SRLY_CRK_REQ_CAN AUX_V_SRLY_DOUBLE_INST AUX_C_SRLY_CRK_DUR_MAX AUX_X_ECT_B AUX_V_SRLY_DRVTRAIN_INST AUX_V_OLMP_OFF_ESPD_HI AUX_V_OLMP_OFF_ESPD_LO AUX_V_OLMP_ENG_OFF_ON AUX_C_OLMP_INIT_DLY AUX_V_OLMP_INIT_DLY_ESPD AUX_V_OLMP_INIT_DLY_ESPD_HYS AUX_V_OLMP_DLY_ESPD_THR AUX_V_OLMP_ESPD_LO_DLY AUX_V_OLMP_ESPD_HI_DLY AUX_V_OLMP_OFF_DLY AUX_V_FPUMP_PRM_ON_DUR AUX_V_FPUMP_STOP_ON_DUR AUX_V_FLV_LOW_LO_THR AUX_V_FLV_LOW_HI_THR AUX_V_FLV_LO_LAMP_ON_DLY AUX_V_FLV_LO_LAMP_OFF_DLY AUX_V_ETHST_LD_FIL AUX_V_ETHST_ECT_FIL AUX_V_ETHST_EN_VSPD AUX_V_ETHST_EN_LD AUX_C_ETHST_PWM_VLT_FAC AUX_X_BAT_VLT_A AUX_V_ETHST_AMB_T_LO AUX_V_ETHST_AMB_T_MID AUX_V_ETHST_AMB_T_HI AUX_V_ETHST_DFLT_SP_C AUX_V_ETHST_DFLT_SP_B AUX_V_ETHST_DFLT_SP_A AUX_M_ETHST_SP_A AUX_X_LD_A AUX_X_ESPD_A AUX_M_ETHST_SP_B AUX_X_VSPD_A AUX_X_IAT_A AUX_M_ETHST_SP_C AUX_X_LD_B AUX_X_VSPD_B AUX_C_ETHST_PWM_DTY_MIN AUX_X_ECT_C AUX_C_ETHST_PWM_DTY_MAX AUX_X_ECT_D AUX_V_ETHST_PWM_DTY_DFLT AUX_V_ETHST_BYPASS_ABM_T AUX_M_ETHST_PWM_DTY_BASE AUX_X_LD_C AUX_X_ECT_SP_A AUX_X_LD_C AUX_V_ETHST_INT_DB AUX_C_ETHST_P AUX_X_ECT_ERR_A AUX_C_ETHST_I_DLT AUX_X_ECT_ERR_B AUX_C_ETHST_FULL_OPN_DTY AUX_X_ECT_E AUX_C_ETHST_FULL_OPN_DUR AUX_X_ECT_F AUX_V_ETHST_I_MAX AUX_V_ETHST_I_MIN /end DEF_CHARACTERISTIC
 /begin OUT_MEASUREMENT aux_ethst_ect_mmv aux_ethst_ect_sp aux_ethst_sp_a aux_ethst_sp_b aux_ethst_sp_c aux_ethst_sp_typ aux_ethst_ctrl_en aux_ethst_flw_pct_mmv aux_ethst_dty_bs aux_ethst_p_dty aux_ethst_int_dty aux_ethst_dty_raw aux_ethst_dty_fnl aux_ethst_int_dty_dlt /end OUT_MEASUREMENT
/end FUNCTION
/begin FUNCTION vvt ""
 /begin DEF_CHARACTERISTIC VVT_X_ESPD_A VVT_M_INTK_SP VVT_M_EXH_SP VVT_C_EN_DLY_SS VVT_C_EN_DLY_CAT_HT VVT_X_ECT_A VVT_C_EXH_DEC_SP VVT_V_FCUT_CLN_EN_ESPD VVT_X_ABS_POS_A VVT_X_OIL_T_A VVT_X_OIL_P_A VVT_M_INTK_LNCH_DUR VVT_C_EXH_IDL_SP VVT_C_INTK_IDL_SP VVT_M_INTK_LNCH_POS_BIAS VVT_M_INTK_LNCH_NEG_BIAS VVT_M_EXH_LNCH_POS_BIAS VVT_M_EXH_LNCH_NEG_BIAS VVT_M_EXH_LNCH_DUR VVT_V_LNCH_EXT_FIL VVT_V_LNCH_EN_ESPD_MAX VVT_V_LNCH_EN_OIL_T_MIN VVT_V_LNCH_EN_POS_DLT_MIN VVT_V_INTK_D_POS_DB VVT_V_INTK_D_NEG_DB VVT_V_INTK_I_DIS_FAC VVT_V_INTK_I_EN_VLV_SPD_MAX VVT_M_INTK_I_TRANS_EN_DLY VVT_V_INTK_I_TRANS_CHG_THR VVT_V_INTK_I_TRANS_DLT_THR VVT_V_EXH_POS_MIN VVT_V_EXH_POS_MAX VVT_C_EXH_REF_TOOTH VVT_V_INTK_POS_MIN VVT_V_INTK_POS_MAX VVT_C_INTK_REF_TOOTH VVT_C_EN_DLY_RUN_TM VVT_C_EN_OIL_T_MAX VVT_C_EN_OIL_T_MIN VVT_C_EN_ESPD_MIN VVT_V_INTK_OP_ATDC_BASE VVT_V_EXH_CL_ATDC_BASE VVT_V_INTK_SP_V_MIN VVT_V_INTK_SP_V_MAX VVT_V_SP_CHG_LMT_VSPD_THR VVT_V_IDL_EN_EXT_DLY VVT_V_IDL_EN_OIL_T_MAX VVT_V_IDL_EN_OIL_T_MIN VVT_V_IDL_EN_VSPD_MIN VVT_C_IDL_EN_ESPD_MIN VVT_M_INTK_B1_P_NEG_GN VVT_M_INTK_B1_P_POS_GN VVT_M_EXH_B1_P_POS_GN VVT_M_EXH_B1_P_NEG_GN VVT_M_INTK_B1_I_POS_GN VVT_M_INTK_B1_I_NEG_GN VVT_M_EXH_B1_I_POS_GN VVT_M_EXH_B1_I_NEG_GN VVT_M_INTK_B1_D_POS_GN VVT_M_INTK_B1_D_NEG_GN VVT_M_EXH_B1_D_POS_GN VVT_M_EXH_B1_D_NEG_GN VVT_C_INTK_P_ERR_FAC VVT_C_EXH_P_ERR_FAC VVT_X_POS_ERR_A VVT_C_INTK_I_INIT VVT_C_EXH_I_INIT VVT_V_EXH_D_POS_DB VVT_V_EXH_D_NEG_DB VVT_V_EXH_I_DIS_FAC VVT_V_EXH_I_TRANS_DLT_THR VVT_M_EXH_I_TRANS_EN_DLY VVT_V_EXH_I_TRANS_CHG_THR VVT_V_EXH_I_EN_VLV_SPD_MAX VVT_M_INTK_SP_V_MAX VVT_M_INTK_SP_V_MIN VVT_V_EXH_SP_V_MIN VVT_V_EXH_SP_V_MAX VVT_C_INTK_SP_OIL_FAC VVT_C_EXH_SP_OIL_FAC VVT_X_OIL_T_B VVT_M_EXH_SP_V_MAX VVT_M_EXH_SP_V_MIN VVT_V_T_ZONE_LO VVT_V_T_ZONE_HI /end DEF_CHARACTERISTIC
 /begin OUT_MEASUREMENT vvt_vlv_ovlp_ang vvt_b1_intk_sp vvt_b1_intk_act vvt_b1_exh_act vvt_intk_abs_sp_lmtd vvt_intk_sp_dlt vvt_actv_cnds_met vvt_intk_b1_pos_err vvt_exh_b1_pos_err vvt_b1_exh_sp vvt_intk_err_rt vvt_exh_err_rt /end OUT_MEASUREMENT
/end FUNCTION
/begin FUNCTION offt "" /begin DEF_CHARACTERISTIC /end DEF_CHARACTERISTIC /begin OUT_MEASUREMENT offt_off_dur_nv offt_flt_actv /end OUT_MEASUREMENT /end FUNCTION
/begin FUNCTION ensc_espd_sp ""
 /begin DEF_CHARACTERISTIC ENSC_V_IDL_DFLT ENSC_M_IDL_DR ENSC_M_IDL_PN ENSC_M_IDL_R ENSC_V_IDL_RAMP_EN ENSC_C_IDL_INC_STP ENSC_C_IDL_DEC_STP ENSC_M_IDL_VSPD_BIAS_R ENSC_M_IDL_VSPD_BIAS_D ENSC_C_IDL_BIAS_ST_HYB ENSC_C_IDL_BIAS_ST_PN ENSC_C_IDL_BIAS_ST_R ENSC_C_IDL_BIAS_ST_D ENSC_V_IDL_CAT_HT_BIAS_EN ENSC_V_IDL_ST_BIAS_EXIT_FAC ENSC_C_IDL_ST_BIAS_HLD_DUR ENSC_C_IDL_ST_BIAS_DCY_DLY ENSC_V_IDL_ST_BIAS_DCY_FAC ENSC_M_IDL_VSPD_BIAS ENSC_V_IDL_DEV_BIAS_DB ENSC_V_IDL_DEV_BIAS_FAC ENSC_V_IDL_DEV_BIAS_MAX ENSC_C_IDL_DEV_BIAS_DCY_FAC_PN ENSC_C_IDL_DEV_BIAS_DCY_FAC_DR ENSC_V_IDL_AC_BIAS_HLD_DUR ENSC_C_IDL_AC_BIAS_R ENSC_C_IDL_AC_BIAS_PN ENSC_M_IDL_AC_BIAS_D ENSC_V_IDL_AC_BIAS_INC_STP ENSC_V_IDL_AC_BIAS_DEC_STP ENSC_V_IDL_PUC_BIAS ENSC_V_IDL_PUC_BIAS_DCY_FAC ENSC_V_IDL_PUC_BIAS_DCY_DLY ENSC_V_IDL_ELD1_BIAS ENSC_V_IDL_ELD2_BIAS ENSC_C_IDL_FLWR_BIAS ENSC_C_IDL_FLWR_BIAS_PN ENSC_V_IDL_FLWR_RMP_VSPD_THR ENSC_V_ESPD_DEV_FILT_DFLT ENSC_V_IDL_FLWR_BIAS_RMP_STP ENSC_V_IDL_FLWR_BIAS_DCY_THR ENSC_V_IDL_FLWR_BIAS_HLD_DUR ENSC_V_IDL_FLWR_BIAS_DCY_DLY ENSC_V_IDL_FLWR_BIAS_DCY_FAC ENSC_V_IDL_FLWR_BIAS_DCY_FAC_PN ENSC_V_IDL_IAT_BIAS_ECT_THR ENSC_V_IDL_IAT_BIAS_IAT_THR ENSC_C_IDL_IAT_BIAS ENSC_V_IDL_BAT_EN_BAT_VLT ENSC_V_IDL_BAT_DIS_BAT_VLT ENSC_V_IDL_BAT_EN_DLY ENSC_V_IDL_BAT_DIS_DLY ENSC_V_IDL_BAT_RMP_STP ENSC_V_IDL_BAT_BIAS ENSC_V_IDL_PS_DFLT ENSC_V_IDL_PS_D ENSC_V_IDL_PS_PN ENSC_V_PS_ACTV_PRES_THR ENSC_V_IDL_PS_INC_STP ENSC_V_IDL_PS_DEC_STP ENSC_V_IDL_PS_DEC_DLY ENSC_V_IDL_EVAM_AC ENSC_V_IDL_EVAM ENSC_V_IDL_EVAM_AC_PN ENSC_V_IDL_EVAM_PN ENSC_C_NIDL_SP_MIN ENSC_V_IDL_EVAM_DCY_STP ENSC_V_IDL_EVAM_DCY_DLY ENSC_V_IDL_AMT_CREEP_MIN ENSC_V_IDL_CAT_HT_PN ENSC_V_IDL_CAT_HT_DR ENSC_V_IDL_ETC_LMT ENSC_V_IDL_ETC_LMT_PN ENSC_C_IDL_MAX ENSC_V_IDL_BKOF_VSPD_HI ENSC_V_IDL_BKOF_VSPD_LO ENSC_V_IDL_BKOF_D1 ENSC_V_IDL_BKOF_D2 ENSC_V_IDL_BKOF_R ENSC_C_IDL_BKOF_LNCH ENSC_C_IDL_BKOF_VSPD_FAC ENSC_V_IDL_BKOF_LNCH_CFG ENSC_V_IDL_BKOF_LNCH_MIN ENSC_V_IDL_BKOF_DEC_STP ENSC_V_IDL_BKOF_DCY_FAC ENSC_V_ESPD_DEV_FIL ENSC_V_IDL_SP_FIL_INC ENSC_V_IDL_SP_FIL_DEC ENSC_V_IDL_ALT_BIAS_ECT_MIN ENSC_V_IDL_ALT_BIAS_DFLT ENSC_V_IDL_ALT_BIAS_PWM_THR ENSC_V_IDL_ALT_BIAS_INC_DLY ENSC_C_IDL_ALT_BIAS_INC_STP ENSC_V_IDL_ALT_BIAS_DEC_DLY ENSC_C_IDL_ALT_BIAS_DEC_STP ENSC_X_ALT_PWM ENSC_V_IDL_ALT_BIAS_MAX_R_AC ENSC_V_IDL_ALT_BIAS_MAX_R ENSC_V_IDL_ALT_BIAS_MAX_D_AC ENSC_V_IDL_ALT_BIAS_MAX_D ENSC_V_IDL_ALT_BIAS_MAX_PN_AC ENSC_V_IDL_ALT_BIAS_MAX_PN /end DEF_CHARACTERISTIC
 /begin OUT_MEASUREMENT ensc_idl_sp ensc_idl_bas ensc_idl_st_hyb ensc_idl_cat_ht_bias ensc_idl_st_bias ensc_idl_st_bias_dcy_fn ensc_idl_st_bias_dcy_stat ensc_idl_st_bias_exit_stat ensc_idl_dev_bias ensc_idl_ac_bias ensc_idl_eld_bias ensc_idl_iat_bias ensc_idl_dev_bias_espd_dev ensc_idl_brk_off_dcy_stat ensc_idl_ps_dcy_stat ensc_idl_ps_en ensc_idl_bat_bias_en ensc_idl_ps ensc_idl_evam ensc_idl_can ensc_idl_cat_ht_min ensc_idl_ps_conds_met ensc_idl_evam_actv ensc_idl_brk_off_min ensc_espd_dev ensc_espd_dev_avg ensc_espd_dev_filt ensc_espd_delt ensc_idl_sp_filt ensc_espd_filt_dev ensc_idl_sp_no_puc_flwr_bias /end OUT_MEASUREMENT
/end FUNCTION
/begin FUNCTION ensc_idle_conditions ""
 /begin DEF_CHARACTERISTIC ENSC_V_ELD1_CFG ENSC_V_ELD2_CFG ENSC_V_IDL_ELD_CTRL_EN ENSC_V_AT_GR_ENG_DLY_VSPD_MAX ENSC_C_AT_GR_ENG_DLY_MAP_THR_IN ENSC_C_AT_GR_ENG_DLY_MAP_THR_OUT ENSC_V_AT_GR_ENG_DLY_TISS_TMP_THR ENSC_V_AT_GR_ENG_DLY_TISS_IN_THR ENSC_V_AT_GR_ENG_DLY_TISS_OUT_THR ENSC_V_MT_IN_GR_CONDS_EN ENSC_V_MT_IN_GR_CLTCH_CFG ENSC_V_IDL_LOAD_TRANS_ACOFF ENSC_V_IDL_LOAD_TRANS_ACON ENSC_V_IDL_LOAD_TRANS_FANOFF ENSC_V_IDL_LOAD_TRANS_FANON ENSC_V_IDL_LOAD_TRANS_ELDOFF ENSC_V_IDL_LOAD_TRANS_ELDON ENSC_V_IDL_LOAD_TRANS_ATINGR ENSC_V_IDL_LOAD_TRANS_ATOUTGR ENSC_V_IDL_LOAD_TRANS_NIDL ENSC_C_IDL_LOAD_TRANS_PS ENSC_V_IDL_LOAD_TRANS_PS_P_DEV_THR /end DEF_CHARACTERISTIC
 /begin OUT_MEASUREMENT ensc_veh_in_gear ensc_mt_in_gr ensc_idl_ps_typ ensc_ac_conds_met_prev ensc_ac_stat_chg ensc_eld1_conds_met ensc_eld2_conds_met ensc_eld1_stat_chg ensc_eld2_stat_chg ensc_gr_lever_old ensc_gr_shft_actv ensc_shft_dly_stat ensc_gr_shft_fn ensc_at_gr_eng_stat ensc_dr_shft_dly_stat ensc_dr_shft_fn ensc_at_gr_eng_stat_old ensc_at_gr_eng_stat_trans ensc_trans_eng_dly ensc_idl_load_trans_stat ensc_idl_load_trans_dur ensc_idl_lrn_cell_chg ensc_idl_adp_cell /end OUT_MEASUREMENT
/end FUNCTION
/begin FUNCTION ensc_idle_state ""
 /begin DEF_CHARACTERISTIC ENSC_C_NM_PID_ACOFF_MAP ENSC_C_NM_PID_ACON_MAP ENSC_V_NM_PID_MT_CFG ENSC_V_OR_IDL_VSPD_THR ENSC_V_NM_IDL_MT_CFG ENSC_V_VSS_FAULT_IDL_I_CFG ENSC_V_IDL_I_DEV_SUM_CFG ENSC_V_VSS_FAULT_IDL_I_CFG ENSC_V_NM_IDL_DLY ENSC_V_OR_PD_ACOFF_MAP_MIN ENSC_V_OR_PD_ACOFF_MAP_MAX ENSC_V_OR_PD_ACON_MAP_MIN ENSC_V_OR_PD_ACON_MAP_MAX ENSC_V_OR_PD_MAP_HYS ENSC_V_OR_PID_ACOFF_MAP_MIN ENSC_V_OR_PID_ACOFF_MAP_MAX ENSC_V_OR_PID_ACON_MAP_MIN ENSC_V_OR_PID_ACON_MAP_MAX ENSC_V_OR_PID_MAP_HYS ENSC_V_OR_IDL_MAP_MET_TM_MIN ENSC_V_OR_IDL_DLY ENSC_V_LNCH_PD_EN ENSC_V_IGA_CL_VSPD_MAX ENSC_C_IDL_PID_ST_DLY ENSC_C_IDL_PD_ST_DLY /end DEF_CHARACTERISTIC
 /begin OUT_MEASUREMENT ensc_eng_idl ensc_idl_st ensc_nm_pid_conds_met ensc_nm_pd_conds_met ensc_nm_pid_en ensc_nm_pd_en ensc_or_pd_conds_met ensc_or_pid_conds_met ensc_or_pd_en ensc_or_pid_en ensc_iga_cl_conds_met ensc_idl_pid_st_dly /end OUT_MEASUREMENT
/end FUNCTION
/begin RECORD_LAYOUT __UBYTE_S FNC_VALUES 1 UBYTE COLUMN_DIR DIRECT /end RECORD_LAYOUT
/begin RECORD_LAYOUT __UWORD_S FNC_VALUES 1 UWORD COLUMN_DIR DIRECT /end RECORD_LAYOUT
/begin RECORD_LAYOUT __ULONG_S FNC_VALUES 1 ULONG COLUMN_DIR DIRECT /end RECORD_LAYOUT
/begin RECORD_LAYOUT __SBYTE_S FNC_VALUES 1 SBYTE COLUMN_DIR DIRECT /end RECORD_LAYOUT
/begin RECORD_LAYOUT __SWORD_S FNC_VALUES 1 SWORD COLUMN_DIR DIRECT /end RECORD_LAYOUT
/begin RECORD_LAYOUT SSV__UWORD_S AXIS_PTS_X 1 UWORD INDEX_INCR DIRECT /end RECORD_LAYOUT
/begin RECORD_LAYOUT SSV__SWORD_S AXIS_PTS_X 1 SWORD INDEX_INCR DIRECT /end RECORD_LAYOUT
/end MODULE
/end PROJECT
