ASAP2_VERSION 1 60
/begin PROJECT FC33 ""
/begin HEADER "" VERSION "1.0" /end HEADER
/begin MODULE FC33 ""
/begin MOD_COMMON "" BYTE_ORDER MSB_FIRST ALIGNMENT_LONG 2 ALIGNMENT_WORD 1 /end MOD_COMMON
/begin MEASUREMENT ensc_idl_flw "total idle flow" SWORD u_pct 0 0 -100.0 99.9969482421875 ECU_ADDRESS 0x4000DA4E /end MEASUREMENT
/begin MEASUREMENT ensc_idl_flw_cl "closed loop idle flow" SWORD u_pct 0 0 -100.0 99.9969482421875 ECU_ADDRESS 0x4000DA4E /end MEASUREMENT
/begin MEASUREMENT ensc_idl_flw_ol "open loop idle flow" SWORD u_pct 0 0 -100.0 99.9969482421875 ECU_ADDRESS 0x4000DA4E /end MEASUREMENT
/begin MEASUREMENT ensc_idl_flw_i "I term of CL idle flow" SWORD u_pct 0 0 -100.0 99.9969482421875 ECU_ADDRESS 0x4000DA4E /end MEASUREMENT
/begin MEASUREMENT ensc_idl_flw_p "P term of CL idle flow" SWORD u_pct_1 0 0 -50.0 49.9984741210937 ECU_ADDRESS 0x4000DA4E FORMAT "%5.3" /end MEASUREMENT
/begin MEASUREMENT ensc_idl_flw_d "D term of CL idle flow" SWORD u_pct_1 0 0 -50.0 49.9984741210937 ECU_ADDRESS 0x4000DA4E FORMAT "%5.3" /end MEASUREMENT
/begin MEASUREMENT ensc_idl_flw_fast "fast term idle flow after ramp control" SWORD u_pct_1 0 0 -50.0 49.9984741210937 ECU_ADDRESS 0x4000DA4E FORMAT "%5.3" /end MEASUREMENT
/begin MEASUREMENT ensc_idl_flw_slow_raw "Raw slow term idle flow(including I term and OL term)" SWORD u_pct 0 0 -100.0 99.9969482421875 ECU_ADDRESS 0x4000DA4E /end MEASUREMENT
/begin MEASUREMENT ensc_idl_flw_slow "slow term idle flow after ramp control" SWORD u_pct 0 0 -100.0 99.9969482421875 ECU_ADDRESS 0x4000DA4E /end MEASUREMENT
/begin MEASUREMENT ensc_idl_tq_slow "slow idle torque converted from ensc_idl_flw_slow" SWORD u_tq_1024 0 0 -1024.0 1023.96875 ECU_ADDRESS 0x4000DA4E FORMAT "%6.2" /end MEASUREMENT
/begin MEASUREMENT ensc_idl_tq_fast "fast idle torque converted from ensc_idl_flw_fast" SWORD u_tq_1024 0 0 -1024.0 1023.96875 ECU_ADDRESS 0x4000DA4E FORMAT "%6.2" /end MEASUREMENT
/begin MEASUREMENT ensc_idl_flw_wrm "warm term of OL idle flow" UWORD u_pct_1 0 0 0 99.9984741210937 ECU_ADDRESS 0x4000DA4E FORMAT "%5.3" /end MEASUREMENT
/begin MEASUREMENT ensc_idl_flw_trans "transmission compensation term of OL idle flow" SWORD u_pct 0 0 -100.0 99.9969482421875 ECU_ADDRESS 0x4000DA4E /end MEASUREMENT
/begin MEASUREMENT ensc_idl_flw_conv "converter compensation term of OL idle flow" UWORD u_pct 0 0 0 199.9969482421875 ECU_ADDRESS 0x4000DA4E /end MEASUREMENT
/begin MEASUREMENT ensc_idl_flw_lnch "launch compensation term of OL idle flow" UWORD u_pct 0 0 0 199.9969482421875 ECU_ADDRESS 0x4000DA4E /end MEASUREMENT
/begin MEASUREMENT ensc_idl_flw_lnch_i_ol "launch integral compensation term of OL idle flow" SWORD u_pct 0 0 -100.0 99.9969482421875 ECU_ADDRESS 0x4000DA4E /end MEASUREMENT
/begin MEASUREMENT ensc_idl_flw_ac "AC compensation term of OL idle flow" UWORD u_pct 0 0 0 199.9969482421875 ECU_ADDRESS 0x4000DA4E /end MEASUREMENT
/begin MEASUREMENT ensc_idl_flw_or "overrun idle compensation term of OL idle flow" SWORD u_pct 0 0 -100.0 99.9969482421875 ECU_ADDRESS 0x4000DA4E /end MEASUREMENT
/begin MEASUREMENT ensc_idl_flw_fan "fan compensation term of OL idle flow" UWORD u_pct_1 0 0 0 99.9984741210937 ECU_ADDRESS 0x4000DA4E FORMAT "%5.3" /end MEASUREMENT
/begin MEASUREMENT ensc_idl_flw_eld "eload compensation term of OL idle flow" UWORD u_pct_1 0 0 0 99.9984741210937 ECU_ADDRESS 0x4000DA4E FORMAT "%5.3" /end MEASUREMENT
/begin MEASUREMENT ensc_idl_flw_ps "PS idle compensation term of OL idle flow" SWORD u_pct 0 0 -100.0 99.9969482421875 ECU_ADDRESS 0x4000DA4E /end MEASUREMENT
/begin MEASUREMENT ensc_idl_flw_antistall "anti-stall compensation term of OL idle flow" UWORD u_pct_1 0 0 0 99.9984741210937 ECU_ADDRESS 0x4000DA4E FORMAT "%5.3" /end MEASUREMENT
/begin MEASUREMENT ensc_idl_flw_bat "low Battery idle compensation term of OL idle flow" SWORD u_pct 0 0 -100.0 99.9969482421875 ECU_ADDRESS 0x4000DA4E /end MEASUREMENT
/begin MEASUREMENT ensc_idl_flw_crp "AMT compensation term of OL idle flow" SWORD u_pct_1 0 0 -50.0 49.9984741210937 ECU_ADDRESS 0x4000DA4E FORMAT "%5.3" /end MEASUREMENT
/begin MEASUREMENT ensc_btm_cltch_release_1st "flag indicated that bottom clutch is released first time after engine run" UBYTE b_true 0 0 0.00 1.00 BIT_MASK 0x1 ECU_ADDRESS 0x400050DA FORMAT "%1.0" /end MEASUREMENT
/begin MEASUREMENT ensc_idl_flw_wrm_pn "gear PN cell warm term flow" UWORD u_pct_1 0 0 0 99.9984741210937 ECU_ADDRESS 0x4000DA4E FORMAT "%5.3" /end MEASUREMENT
/begin MEASUREMENT ensc_idl_flw_wrm_r "gear R cell warm term flow" UWORD u_pct_1 0 0 0 99.9984741210937 ECU_ADDRESS 0x4000DA4E FORMAT "%5.3" /end MEASUREMENT
/begin MEASUREMENT ensc_idl_flw_wrm_d "gear D cell warm term flow" UWORD u_pct_1 0 0 0 99.9984741210937 ECU_ADDRESS 0x4000DA4E FORMAT "%5.3" /end MEASUREMENT
/begin MEASUREMENT ensc_idl_flw_wrm_pn_mx "gear PN cell max warm term flow" UWORD u_pct_1 0 0 0 99.9984741210937 ECU_ADDRESS 0x4000DA4E FORMAT "%5.3" /end MEASUREMENT
/begin MEASUREMENT ensc_idl_flw_wrm_d_mx "gear D cell max warm term flow" UWORD u_pct_1 0 0 0 99.9984741210937 ECU_ADDRESS 0x4000DA4E FORMAT "%5.3" /end MEASUREMENT
/begin MEASUREMENT ensc_idl_flw_wrm_r_mx "gear R cell max warm term flow" UWORD u_pct_1 0 0 0 99.9984741210937 ECU_ADDRESS 0x4000DA4E FORMAT "%5.3" /end MEASUREMENT
/begin MEASUREMENT ensc_idl_flw_wrm_dcy_fac "decay factor of warm term flow" UWORD u_fac_1 0 0 0.0 0.999984741210937 ECU_ADDRESS 0x4000DA4E /end MEASUREMENT
/begin MEASUREMENT ensc_idl_flw_wrm_mt_dcy_fac "decay factor of MT bias warm term flow" UWORD u_fac_1 0 0 0.0 0.999984741210937 ECU_ADDRESS 0x4000DA4E /end MEASUREMENT
/begin MEASUREMENT ensc_idl_flw_wrm_mt_en "enable status of MT bias term" UBYTE b_true 0 0 0.00 1.00 BIT_MASK 0x1 ECU_ADDRESS 0x400050DA FORMAT "%1.0" /end MEASUREMENT
/begin MEASUREMENT ensc_idl_flw_wrm_mt "MT bias of warm term when clutch is closed" UWORD u_pct_1 0 0 0 99.9984741210937 ECU_ADDRESS 0x4000DA4E FORMAT "%5.3" /end MEASUREMENT
/begin MEASUREMENT ensc_en_gr_st_prev "previous engaged gear status(D or R)" UBYTE u_at_gr_typ_1 0 0 0 9 ECU_ADDRESS 0x4000DA4E FORMAT "%1.0" /end MEASUREMENT
/begin MEASUREMENT ensc_gr_shft_1st "first gear shift happened this key cycle" UBYTE b_true 0 0 0.00 1.00 BIT_MASK 0x1 ECU_ADDRESS 0x400050DA FORMAT "%1.0" /end MEASUREMENT
/begin MEASUREMENT ensc_dr_shft_st "true means a directly D2R or R2D gear shift happened" UBYTE b_true 0 0 0.00 1.00 BIT_MASK 0x1 ECU_ADDRESS 0x400050DA FORMAT "%1.0" /end MEASUREMENT
/begin MEASUREMENT ensc_dr_shft_flw_en "true means idle Flow compensation enabled when directly D2R or R2D gear shift" UBYTE b_true 0 0 0.00 1.00 BIT_MASK 0x1 ECU_ADDRESS 0x400050DA FORMAT "%1.0" /end MEASUREMENT
/begin MEASUREMENT ensc_trans_flw_rmp_dly "delay time before ramp control of transmission flow compensation when AT gear shift" UWORD u_2x_tmr 0 0 0.0 1023.984375 ECU_ADDRESS 0x4000DA4E /end MEASUREMENT
/begin MEASUREMENT ensc_trans_flw_rmp_tgt "target transmission flow compensation when AT gear shift" SWORD u_pct 0 0 -100.0 99.9969482421875 ECU_ADDRESS 0x4000DA4E /end MEASUREMENT
/begin MEASUREMENT ensc_trans_flw_rmp_dur "ramp control duration(2Xtime counts) of transmission flow compensation when AT gear shift" UWORD u_cnts 0 0 0.00 65535.00 ECU_ADDRESS 0x4000440A FORMAT "%5.0" /end MEASUREMENT
/begin MEASUREMENT ensc_trans_flw_rmp_rate "ramp control rate of transmission flow compensation when AT gear shift" SWORD u_pct 0 0 -100.0 99.9969482421875 ECU_ADDRESS 0x4000DA4E /end MEASUREMENT
/begin MEASUREMENT ensc_trans_flw_hld_dur "transmission compensation flow hold duration when ensc_dr_shft_flw_en==true" UWORD u_2x_tmr 0 0 0.0 1023.984375 ECU_ADDRESS 0x4000DA4E /end MEASUREMENT
/begin MEASUREMENT ensc_trans_flw_hld "transmission compensation flow hold value when ensc_dr_shft_flw_en==true" SWORD u_pct 0 0 -100.0 99.9969482421875 ECU_ADDRESS 0x4000DA4E /end MEASUREMENT
/begin MEASUREMENT ensc_trans_flw_rmp_thr "time threshold to ramp the hold flow of transmission compensation" UWORD u_2x_tmr 0 0 0.0 1023.984375 ECU_ADDRESS 0x4000DA4E /end MEASUREMENT
/begin MEASUREMENT ensc_trans_eng_dly_bias "bias term of ensc_trans_eng_dly" SWORD u_2x_tmr 0 0 -512.0 511.984375 ECU_ADDRESS 0x4000DA4E /end MEASUREMENT
/begin MEASUREMENT ensc_gr_shft_st "gear shift status" UBYTE u_at_gr_shft_typ 0 0 0 12 ECU_ADDRESS 0x4000DA4E FORMAT "%1.0" /end MEASUREMENT
/begin MEASUREMENT ensc_idl_flw_conv_fac "factor to calculate torque convertor idle flow compensation" UWORD u_fac_1 0 0 0.0 0.999984741210937 ECU_ADDRESS 0x40001706 /end MEASUREMENT
/begin MEASUREMENT ensc_lnch_i_ol_dev "integral deviation to calculate launch I term flow" SWORD u_pct 0 0 -100.0 99.9969482421875 ECU_ADDRESS 0x400040AA /end MEASUREMENT
/begin MEASUREMENT ensc_idl_flw_lnch_ect_fac "engine coolant temperature factor of launch idle flow" UWORD u_fac_2 0 0 0.0 1.999969482421875 ECU_ADDRESS 0x40003D06 FORMAT "%4.3" /end MEASUREMENT
/begin MEASUREMENT ensc_ac_flw_dcy_stat "true means idle AC flow compensation is decaying" UBYTE b_true 0 0 0.00 1.00 BIT_MASK 0x1 ECU_ADDRESS 0x40003F41 FORMAT "%1.0" /end MEASUREMENT
/begin MEASUREMENT ensc_ac_hl_stat "true means AC heavy load condition met" UBYTE b_true 0 0 0.00 1.00 BIT_MASK 0x1 ECU_ADDRESS 0x40003F41 FORMAT "%1.0" /end MEASUREMENT
/begin MEASUREMENT ensc_idl_flw_st_hld_stat "true means start idle flow hold duration finished" UBYTE b_true 0 0 0.00 1.00 BIT_MASK 0x1 ECU_ADDRESS 0x40003F41 FORMAT "%1.0" /end MEASUREMENT
/begin MEASUREMENT ensc_idl_flw_fan_lo "low speed fan transient compensation term" UWORD u_pct_1 0 0 0 99.9984741210937 ECU_ADDRESS 0x400040F2 FORMAT "%5.3" /end MEASUREMENT
/begin MEASUREMENT ensc_idl_flw_fan_hi "high speed fan transient compensation term" UWORD u_pct_1 0 0 0 99.9984741210937 ECU_ADDRESS 0x400040F2 FORMAT "%5.3" /end MEASUREMENT
/begin MEASUREMENT ensc_idl_flw_eload1 "Eload1 idle flow compensation term" UWORD u_pct_1 0 0 0 99.9984741210937 ECU_ADDRESS 0x400040F2 FORMAT "%5.3" /end MEASUREMENT
/begin MEASUREMENT ensc_idl_flw_eload2 "Eload2 idle flow compensation term" UWORD u_pct_1 0 0 0 99.9984741210937 ECU_ADDRESS 0x400040F2 FORMAT "%5.3" /end MEASUREMENT
/begin MEASUREMENT ensc_antistl_actv "True means anti stall control active" UBYTE b_true 0 0 0.00 1.00 BIT_MASK 0x1 ECU_ADDRESS 0x40003F41 FORMAT "%1.0" /end MEASUREMENT
/begin MEASUREMENT ensc_antistl_vspd_thr "vehicle speed threshold above which ensc_idl_flw_antistall will be 0 " UWORD u_vspd 0 0 0.0 511.9921875 ECU_ADDRESS 0x4000505E /end MEASUREMENT
/begin MEASUREMENT ensc_idl_sp_chg_stat "true means idle engine speed setpoint changed large" UBYTE b_true 0 0 0.00 1.00 BIT_MASK 0x1 ECU_ADDRESS 0x40003F41 FORMAT "%1.0" /end MEASUREMENT
/begin MEASUREMENT ensc_nidl_actv "true means neutral idle control active" UBYTE b_true 0 0 0.00 1.00 BIT_MASK 0x1 ECU_ADDRESS 0x40003F41 FORMAT "%1.0" /end MEASUREMENT
/begin MEASUREMENT ensc_idl_flw_nidl "neutral idle control compensation term of OL idle flow" SWORD u_pct 0 0 -100.0 99.9969482421875 ECU_ADDRESS 0x4000402A /end MEASUREMENT
/begin MEASUREMENT ensc_nidl_rmp_in "ramp in status of neutral idle control" UBYTE b_true 0 0 0.00 1.00 BIT_MASK 0x1 ECU_ADDRESS 0x40003F41 FORMAT "%1.0" /end MEASUREMENT
/begin MEASUREMENT ensc_nidl_rmp_out "ramp out status of neutral idle control" UBYTE b_true 0 0 0.00 1.00 BIT_MASK 0x1 ECU_ADDRESS 0x40003F41 FORMAT "%1.0" /end MEASUREMENT
/begin MEASUREMENT ensc_nidl_trans_stat "transition status of neutral idle control" UBYTE b_true 0 0 0.00 1.00 BIT_MASK 0x1 ECU_ADDRESS 0x40003F41 FORMAT "%1.0" /end MEASUREMENT
/begin MEASUREMENT ensc_nidl_dly_stat "delay status of neutral idle control" UBYTE b_true 0 0 0.00 1.00 BIT_MASK 0x1 ECU_ADDRESS 0x40003F41 FORMAT "%1.0" /end MEASUREMENT
/begin MEASUREMENT ensc_nidl_rmp_in_dly "delay time to enable ramp in process of neutral idle control" UWORD u_2x_tmr 0 0 0.0 1023.984375 ECU_ADDRESS 0x40004032 /end MEASUREMENT
/begin MEASUREMENT ensc_nidl_rmp_in_dur "duration of neutral idle ramp in flow applied" UWORD u_2x_tmr 0 0 0.0 1023.984375 ECU_ADDRESS 0x40004032 /end MEASUREMENT
/begin MEASUREMENT ensc_nidl_flw_rmp_in "ramp in flow compensation of neutral idle control" SWORD u_pct 0 0 -100.0 99.9969482421875 ECU_ADDRESS 0x4000402A /end MEASUREMENT
/begin MEASUREMENT ensc_cvt_flw_en "true means CVT idle flow compensation enable" UBYTE b_true 0 0 0.00 1.00 BIT_MASK 0x1 ECU_ADDRESS 0x40003F41 FORMAT "%1.0" /end MEASUREMENT
/begin MEASUREMENT ensc_idl_flw_crp_hld "true means creep idle flow will be held " UBYTE b_true 0 0 0.00 1.00 BIT_MASK 0x1 ECU_ADDRESS 0x40003F41 FORMAT "%1.0" /end MEASUREMENT
/begin MEASUREMENT ensc_idl_flw_crp_rmp_dis "true measns creep idle flow normal ramp will be diabled due to tip out" UBYTE b_true 0 0 0.00 1.00 BIT_MASK 0x1 ECU_ADDRESS 0x40003F41 FORMAT "%1.0" /end MEASUREMENT
/begin MEASUREMENT ensc_tq_req_pct_old "total requested torque percent last loop" UWORD u_pct 0 0 0.0 199.996948242187 ECU_ADDRESS 0x400046B6 /end MEASUREMENT
/begin MEASUREMENT ensc_idl_flw_crp_raw "raw value(before ramp) of creep idle flow" SWORD u_pct_1 0 0 -50.0 49.9984741210937 ECU_ADDRESS 0x400040D2 FORMAT "%5.3" /end MEASUREMENT
/begin MEASUREMENT ensc_tq_crp_hld_thr "flywheel torque threshold  below which creep flow hold can be enabled" SWORD u_tq 0 0 -2048 2047.9375 ECU_ADDRESS 0x400017F6 FORMAT "%6.2" /end MEASUREMENT
/begin MEASUREMENT ensc_idl_flw_adp_slw_nv_d "Slow adp I term flow when gear D" SWORD u_pct 0 0 -100.0 99.9969482421875 ECU_ADDRESS 0x40004090 /end MEASUREMENT
/begin MEASUREMENT ensc_idl_flw_adp_slw_nv_d_ac "Slow adp I term flow when gear D and AC on" SWORD u_pct 0 0 -100.0 99.9969482421875 ECU_ADDRESS 0x40004090 /end MEASUREMENT
/begin MEASUREMENT ensc_idl_flw_adp_slw_nv_r "Slow adp I term flow when gear R" SWORD u_pct 0 0 -100.0 99.9969482421875 ECU_ADDRESS 0x40004090 /end MEASUREMENT
/begin MEASUREMENT ensc_idl_flw_adp_slw_nv_r_ac "Slow adp I term flow when gear R and AC on" SWORD u_pct 0 0 -100.0 99.9969482421875 ECU_ADDRESS 0x40004090 /end MEASUREMENT
/begin MEASUREMENT ensc_idl_flw_adp_fst_nv_d "fast adp I term flow when gear D" SWORD u_pct 0 0 -100.0 99.9969482421875 ECU_ADDRESS 0x40004090 /end MEASUREMENT
/begin MEASUREMENT ensc_idl_flw_adp_fst_nv_d_ac "fast adp I term flow when gear D and AC on" SWORD u_pct 0 0 -100.0 99.9969482421875 ECU_ADDRESS 0x40004090 /end MEASUREMENT
/begin MEASUREMENT ensc_idl_flw_adp_fst_nv_r "fast adp I term flow when gear R" SWORD u_pct 0 0 -100.0 99.9969482421875 ECU_ADDRESS 0x40004090 /end MEASUREMENT
/begin MEASUREMENT ensc_idl_flw_adp_fst_nv_r_ac "fast adp I term flow when gear R and AC on" SWORD u_pct 0 0 -100.0 99.9969482421875 ECU_ADDRESS 0x40004090 /end MEASUREMENT
/begin MEASUREMENT ensc_idl_st_pd_en "true means start PD idle control is active" UBYTE b_true 0 0 0.00 1.00 BIT_MASK 0x1 ECU_ADDRESS 0x40003F41 FORMAT "%1.0" /end MEASUREMENT
/begin MEASUREMENT ensc_ld_chg_pid_rsn "reason of load change PID factor enabled" UBYTE u_idl_ld_chg_rsn 0 0 0.00 2.00 ECU_ADDRESS 0x4000557B FORMAT "%5.0" /end MEASUREMENT
/begin MEASUREMENT ensc_ld_chg_pid_pri "priority of load change PID factor control" UBYTE u_cnts 0 0 0 255 ECU_ADDRESS 0x40005C74 /end MEASUREMENT
/begin MEASUREMENT ensc_ld_chg_fac_p "P term factor when load change PID factor enabled" UWORD u_fac_64 0 0 0.0 63.9990234375 ECU_ADDRESS 0x40003518 /end MEASUREMENT
/begin MEASUREMENT ensc_ld_chg_fac_i "I term factor when load change PID factor enabled" UWORD u_fac_64 0 0 0.0 63.9990234375 ECU_ADDRESS 0x40003518 /end MEASUREMENT
/begin MEASUREMENT ensc_ld_chg_fac_d "D term factor when load change PID factor enabled" UWORD u_fac_64 0 0 0.0 63.9990234375 ECU_ADDRESS 0x40003518 /end MEASUREMENT
/begin MEASUREMENT ensc_i_dev_total "total I term deviation to calculate Idle I flow" SWORD u_pct 0 0 -100.0 99.9969482421875 ECU_ADDRESS 0x40004090 /end MEASUREMENT
/begin MEASUREMENT ensc_i_dev_bas "base I term deviation" SWORD u_pct 0 0 -100.0 99.9969482421875 ECU_ADDRESS 0x40004090 /end MEASUREMENT
/begin MEASUREMENT ensc_i_dev_dly_cnt "delay counter to calculate I term deviation" UBYTE u_cnts 0 0 0 255 ECU_ADDRESS 0x40005C74 /end MEASUREMENT
/begin MEASUREMENT ensc_antistl_i_dev_actv "true means I term deviation calculation due to anti-stall active" UBYTE b_true 0 0 0.00 1.00 BIT_MASK 0x1 ECU_ADDRESS 0x40003F41 FORMAT "%1.0" /end MEASUREMENT
/begin MEASUREMENT ensc_i_dev_sum_rst "idle sum reset I term deviation" SWORD u_pct 0 0 -100.0 99.9969482421875 ECU_ADDRESS 0x40004090 /end MEASUREMENT
/begin MEASUREMENT ensc_i_sum_dev_pn_ac "sum of I term deviation when gear PN and AC ON" SWORD u_pct 0 0 -100.0 99.9969482421875 ECU_ADDRESS 0x40004090 /end MEASUREMENT
/begin MEASUREMENT ensc_i_sum_dev_pn "sum of I term deviation when gear PN and AC OFF" SWORD u_pct 0 0 -100.0 99.9969482421875 ECU_ADDRESS 0x40004090 SYMBOL_LINK "ensc_i_sum_dev_pn" 2 /end MEASUREMENT
/begin MEASUREMENT ensc_i_sum_dev_d_ac "sum of I term deviation when gear D and AC ON" SWORD u_pct 0 0 -100.0 99.9969482421875 ECU_ADDRESS 0x40004090 SYMBOL_LINK "ensc_i_sum_dev_d_ac" 4 /end MEASUREMENT
/begin MEASUREMENT ensc_i_sum_dev_d "sum of I term deviation when gear D and AC OFF" SWORD u_pct 0 0 -100.0 99.9969482421875 ECU_ADDRESS 0x40004090 SYMBOL_LINK "ensc_i_sum_dev_d" 6 /end MEASUREMENT
/begin MEASUREMENT ensc_i_sum_dev_r_ac "sum of I term deviation when gear R and AC ON" SWORD u_pct 0 0 -100.0 99.9969482421875 ECU_ADDRESS 0x40004090 SYMBOL_LINK "ensc_i_sum_dev_r_ac" 8 /end MEASUREMENT
/begin MEASUREMENT ensc_i_sum_dev_r "sum of I term deviation when gear R and AC OFF" SWORD u_pct 0 0 -100.0 99.9969482421875 ECU_ADDRESS 0x40004090 SYMBOL_LINK "ensc_i_sum_dev_r" 10 /end MEASUREMENT
/begin MEASUREMENT ensc_i_sum_dev_rst_stat_ac "status indicated reset of I sum deviation enabled when AC ON" UBYTE b_true 0 0 0.00 1.00 BIT_MASK 0x1 ECU_ADDRESS 0x40003F41 FORMAT "%1.0" /end MEASUREMENT
/begin MEASUREMENT ensc_i_sum_dev_rst_stat "status indicated reset of I sum deviation enabled when AC OFF" UBYTE b_true 0 0 0.00 1.00 BIT_MASK 0x1 ECU_ADDRESS 0x40003F41 FORMAT "%1.0" /end MEASUREMENT
/begin MEASUREMENT ensc_i_sum_dev_max "max I term sum deviation threshold" SWORD u_pct 0 0 -100.0 99.9969482421875 ECU_ADDRESS 0x40004090 /end MEASUREMENT
/begin MEASUREMENT ensc_idl_diag_stat "condtion related to I term deviation to determinate idle speed diag" UBYTE b_true 0 0 0.00 1.00 BIT_MASK 0x1 ECU_ADDRESS 0x40003F41 FORMAT "%1.0" /end MEASUREMENT
/begin MEASUREMENT ensc_idl_mod "idle control mode used to lookup ENSC_M_I_SUM_DEV_MAX/MIN" UBYTE u_idl_mode 0 0 0 4 ECU_ADDRESS 0x40004094 FORMAT "%1.0" /end MEASUREMENT
/begin MEASUREMENT ensc_idl_mod_old "previous loop value of ensc_idl_mod" UBYTE u_idl_mode 0 0 0 4 ECU_ADDRESS 0x40004094 FORMAT "%1.0" /end MEASUREMENT
/begin MEASUREMENT ensc_i_sum_dev_thr_fil_stat "true means ensc_i_sum_dev_max/min is filtering during ensc_idl_mod change" UBYTE b_true 0 0 0.00 1.00 BIT_MASK 0x1 ECU_ADDRESS 0x40003F41 FORMAT "%1.0" /end MEASUREMENT
/begin MEASUREMENT ensc_i_sum_dev_min "min I term sum deviation threshold" SWORD u_pct 0 0 -100.0 99.9969482421875 ECU_ADDRESS 0x40004090 /end MEASUREMENT
/begin MEASUREMENT ensc_i_sum_dev_min_tgt "target value of min I term sum deviation when ensc_idl_mod changed" SWORD u_pct 0 0 -100.0 99.9969482421875 ECU_ADDRESS 0x40004090 /end MEASUREMENT
/begin MEASUREMENT ensc_i_sum_dev_max_tgt "target value of max I term sum deviation when ensc_idl_mod changed" SWORD u_pct 0 0 -100.0 99.9969482421875 ECU_ADDRESS 0x40004090 /end MEASUREMENT
/begin MEASUREMENT ensc_stab_idl_met_d_ac "true means stable idle condition met this key cycle when gear D and AC ON" UBYTE b_true 0 0 0.00 1.00 BIT_MASK 0x1 ECU_ADDRESS 0x40003F41 FORMAT "%1.0" /end MEASUREMENT
/begin MEASUREMENT ensc_stab_idl_met_d "true means stable idle condition met this key cycle when gear D and AC OFF" UBYTE b_true 0 0 0.00 1.00 BIT_MASK 0x1 ECU_ADDRESS 0x40003F41 FORMAT "%1.0" /end MEASUREMENT
/begin MEASUREMENT ensc_stab_idl_met_r_ac "true means stable idle condition met this key cycle when gear R and AC ON" UBYTE b_true 0 0 0.00 1.00 BIT_MASK 0x1 ECU_ADDRESS 0x40003F41 FORMAT "%1.0" /end MEASUREMENT
/begin MEASUREMENT ensc_stab_idl_met_r "true means stable idle condition met this key cycle when gear R and AC OFF" UBYTE b_true 0 0 0.00 1.00 BIT_MASK 0x1 ECU_ADDRESS 0x40003F41 FORMAT "%1.0" /end MEASUREMENT
/begin MEASUREMENT ensc_idl_flw_adp_fst_nv_pn_ac "fast adp I term flow when gear PN  and AC on" SWORD u_pct 0 0 -100.0 99.9969482421875 ECU_ADDRESS 0x40004090 /end MEASUREMENT
/begin MEASUREMENT ensc_idl_flw_adp_fst_nv_pn "fast adp I term flow when gear PN" SWORD u_pct 0 0 -100.0 99.9969482421875 ECU_ADDRESS 0x40004090 /end MEASUREMENT
/begin MEASUREMENT ensc_idl_flw_adp_slw_nv_pn_ac "slow adp I term flow when gear PN  and AC on" SWORD u_pct 0 0 -100.0 99.9969482421875 ECU_ADDRESS 0x40004090 /end MEASUREMENT
/begin MEASUREMENT ensc_idl_flw_adp_slw_nv_pn "slow adp I term flow when gear PN" SWORD u_pct 0 0 -100.0 99.9969482421875 ECU_ADDRESS 0x40004090 /end MEASUREMENT
/begin MEASUREMENT ensc_idl_flw_adp_fst_curr "current fast adp I term flow" SWORD u_pct 0 0 -100.0 99.9969482421875 ECU_ADDRESS 0x40004090 /end MEASUREMENT
/begin MEASUREMENT ensc_idl_flw_adp_slw_curr "current slow adp I term flow" SWORD u_pct 0 0 -100.0 99.9969482421875 ECU_ADDRESS 0x40004090 /end MEASUREMENT
/begin MEASUREMENT ensc_i_dev_adp_fst "I term deviation added to fast adp" SWORD u_pct 0 0 -100.0 99.9969482421875 ECU_ADDRESS 0x40004090 /end MEASUREMENT
/begin MEASUREMENT ensc_i_dev_wrm "I term deviation added to warm term flow" SWORD u_pct 0 0 -100.0 99.9969482421875 ECU_ADDRESS 0x40004090 /end MEASUREMENT
/begin MEASUREMENT ensc_stab_idl_conds_met "true means stable idle conditions met" UBYTE b_true 0 0 0.00 1.00 BIT_MASK 0x1 ECU_ADDRESS 0x40003F41 FORMAT "%1.0" /end MEASUREMENT
/begin MEASUREMENT ensc_ps_hi_ld_stat "true means PS load is high" UBYTE b_true 0 0 0.00 1.00 BIT_MASK 0x1 ECU_ADDRESS 0x40003F41 FORMAT "%1.0" /end MEASUREMENT
/begin MEASUREMENT ensc_idl_flw_p_fac "factor used to calculate P term flow" SWORD u_fac_n4_p4 0 0 -4 3.9998779296875 ECU_ADDRESS 0x40003090 FORMAT "%4.3" /end MEASUREMENT
/begin MEASUREMENT ensc_idl_flw_d_fac "factor used to calculate D term flow" SWORD u_fac_n4_p4 0 0 -4 3.9998779296875 ECU_ADDRESS 0x40003090 FORMAT "%4.3" /end MEASUREMENT
/begin MEASUREMENT ensc_idl_flw_fast_raw "raw fast term idle flow before ramp control" SWORD u_pct_1 0 0 -50.0 49.9984741210937 ECU_ADDRESS 0x40004170 FORMAT "%5.3" /end MEASUREMENT
/begin MEASUREMENT ensc_idl_st_trans_stat "transition status of idle control state" UBYTE u_idl_st_trans 0 0 0 3 ECU_ADDRESS 0x40004094 FORMAT "%1.0" /end MEASUREMENT
/begin MEASUREMENT ensc_idl_flw_fast_rmp_stat "fast idle flow ramp status" UBYTE b_true 0 0 0 1.0 BIT_MASK 0x1 ECU_ADDRESS 0x40004FD2 FORMAT "%1.0" /end MEASUREMENT
/begin MEASUREMENT ensc_idl_i_update_1st_stat "true means idle sp increase due to EVAM" UBYTE b_true 0 0 0.00 1.00 BIT_MASK 0x1 ECU_ADDRESS 0x4000540C FORMAT "%1.0" /end MEASUREMENT
/begin MEASUREMENT ensc_idl_i_ref "reference value of idle I term flow" SWORD u_pct 0 0 -100.0 99.9969482421875 ECU_ADDRESS 0x40004090 /end MEASUREMENT
/begin MEASUREMENT ensc_stab_idl_tmr "stable idle timer to determinate update of slow adp and I deviation sum" UWORD u_2x_tmr 0 0 0.0 1023.984375 ECU_ADDRESS 0x40004040 SYMBOL_LINK "ensc_stab_idl_tmr" 84 /end MEASUREMENT
/begin MEASUREMENT ente_fan_ac_st "ac on fan request type" UBYTE u_fan_req_typ 0 0 0.00 4.00 ECU_ADDRESS 0x4000440A FORMAT "%1.0" /end MEASUREMENT
/begin MEASUREMENT ente_fan_vspd_st "ac on fan request type" UBYTE u_fan_req_typ 0 0 0.00 4.00 ECU_ADDRESS 0x4000440A FORMAT "%1.0" /end MEASUREMENT
/begin MEASUREMENT ente_fan_ac_actv "fan control ac active" UBYTE b_true 0 0 0.00 1.00 BIT_MASK 0x1 ECU_ADDRESS 0x4000440A FORMAT "%1.0" /end MEASUREMENT
/begin MEASUREMENT ente_fan_req_st "fan request state" UBYTE u_fan_ctrl_typ 0 0 0.00 3.00 ECU_ADDRESS 0x4000440A FORMAT "%1.0" /end MEASUREMENT
/begin MEASUREMENT ente_fan_ctrl_st "fan request state" UBYTE u_fan_ctrl_typ 0 0 0.00 3.00 ECU_ADDRESS 0x4000440A FORMAT "%1.0" /end MEASUREMENT
/begin MEASUREMENT ente_fan_req_pwm "pwm fan request duty" UWORD u_pct 0 0 0.0 100 ECU_ADDRESS 0x4000440A FORMAT "%4.1" /end MEASUREMENT
/begin MEASUREMENT ente_fan_act_pwm "pwm fan actual duty" UWORD u_pct 0 0 0.0 100 ECU_ADDRESS 0x4000440A FORMAT "%4.1" /end MEASUREMENT
/begin MEASUREMENT ente_fan_offr_typ "fan key off run state" UBYTE u_fan_ctrl_typ 0 0 0.00 3.00 ECU_ADDRESS 0x4000440A FORMAT "%1.0" /end MEASUREMENT
/begin MEASUREMENT ente_fan_offr_actv "fan key off run active" UBYTE b_true 0 0 0.00 1.00 BIT_MASK 0x1 ECU_ADDRESS 0x4000440A FORMAT "%1.0" /end MEASUREMENT
/begin MEASUREMENT ente_fan_offr_dur "fan off run duration" UWORD u_16x_tmr 0 0 0.00 8191.875 ECU_ADDRESS 0x4000440A /end MEASUREMENT
/begin MEASUREMENT ente_fan_ctrl_chg_off_dly "fan control state change to off delay" UWORD u_16x_tmr 0 0 0.00 8191.875 ECU_ADDRESS 0x4000440A SYMBOL_LINK "ente_fan_ctrl_chg_dly" 0 /end MEASUREMENT
/begin MEASUREMENT ente_fan_ctrl_chg_low_dly "fan control state change to low delay" UWORD u_16x_tmr 0 0 0.00 8191.875 ECU_ADDRESS 0x4000440A SYMBOL_LINK "ente_fan_ctrl_chg_dly" 2 /end MEASUREMENT
/begin MEASUREMENT ente_fan_ctrl_chg_med_dly "fan control state change to med delay" UWORD u_16x_tmr 0 0 0.00 8191.875 ECU_ADDRESS 0x4000440A SYMBOL_LINK "ente_fan_ctrl_chg_dly" 4 /end MEASUREMENT
/begin MEASUREMENT ente_fan_ctrl_chg_high_dly "fan control state change to high delay" UWORD u_16x_tmr 0 0 0.00 8191.875 ECU_ADDRESS 0x4000440A SYMBOL_LINK "ente_fan_ctrl_chg_dly" 6 /end MEASUREMENT
/begin MEASUREMENT ente_fan_low_en_thr "fan low state enable thr" SWORD u_deg_C 0 0 -256 255.9921875 ECU_ADDRESS 0x4000440A /end MEASUREMENT
/begin MEASUREMENT ente_fan_typ "fan type" UBYTE u_fan_typ 0 0 0.00 1.00 ECU_ADDRESS 0x4000440A FORMAT "%1.0" /end MEASUREMENT
/begin MEASUREMENT chrg_surg_pv_en "Anti surge pedal fast release condition met." UBYTE b_true 0 0 0.00 1.00 BIT_MASK 0x1 ECU_ADDRESS 0x400033EF FORMAT "%1.0" /end MEASUREMENT
/begin MEASUREMENT chrg_cp_en "Charger control enable.Charger pressure setpoint is larger than the threshold and the control is enable." UBYTE b_true 0 0 0.00 1.00 BIT_MASK 0x1 ECU_ADDRESS 0x400033EF FORMAT "%1.0" /end MEASUREMENT
/begin MEASUREMENT chrg_cp_hi "Actual charger pressure is larger than setpoint,and then the high flag is set." UBYTE b_true 0 0 0.00 1.00 BIT_MASK 0x1 ECU_ADDRESS 0x400033EF FORMAT "%1.0" /end MEASUREMENT
/begin MEASUREMENT chrg_cl_en "Charger pressure close loop control is enable when actual charger pressure is larger than threshold." UBYTE b_true 0 0 0.00 1.00 BIT_MASK 0x1 ECU_ADDRESS 0x400033EF FORMAT "%1.0" /end MEASUREMENT
/begin MEASUREMENT chrg_i_rst_en "Charger close loop control I term reset flag set." UBYTE b_true 0 0 0.00 1.00 BIT_MASK 0x1 ECU_ADDRESS 0x400033EF FORMAT "%1.0" /end MEASUREMENT
/begin MEASUREMENT chrg_wgpwm_fac_chng "Waste gate pwm factor cell changed flag set." UBYTE b_true 0 0 0.00 1.00 BIT_MASK 0x1 ECU_ADDRESS 0x400033EF FORMAT "%1.0" /end MEASUREMENT
/begin MEASUREMENT chrg_wgpwm_fac_adp_en "Waste gate factor adaption learning enable." UBYTE b_true 0 0 0.00 1.00 BIT_MASK 0x1 ECU_ADDRESS 0x400033EF FORMAT "%1.0" /end MEASUREMENT
/begin MEASUREMENT chrg_wgpwm_fac_rmp "Waste gate pwm factor ramp to target factor active." UBYTE b_true 0 0 0.00 1.00 BIT_MASK 0x1 ECU_ADDRESS 0x400033EF FORMAT "%1.0" /end MEASUREMENT
/begin MEASUREMENT chrg_surg_pv_rls_cnt "Anti surge pedal release count." UBYTE u_cnts 0 0 0.00 255.00 ECU_ADDRESS 0x400050DA FORMAT "%1.0" /end MEASUREMENT
/begin MEASUREMENT chrg_cp_buff_idx "To calculate charger pressure change,it need buffered the previous charger pressure.This is the buffer index." UBYTE u_cnts 0 0 0.00 255.00 ECU_ADDRESS 0x400050DA FORMAT "%1.0" /end MEASUREMENT
/begin MEASUREMENT chrg_std_cflw_mmv "Filted standard charger flow." UWORD u_fac_4 0 0 0.00 3.99993896484375 ECU_ADDRESS 0x400050DA FORMAT "%4.3" /end MEASUREMENT
/begin MEASUREMENT chrg_cpa_raw "Actual charger pressure raw value." UWORD u_kPa_0_4096 0 0 0.00 4095.937500 ECU_ADDRESS 0x400050DA FORMAT "%1.0" /end MEASUREMENT
/begin MEASUREMENT chrg_cpa_dlt_raw "Actual charger pressure raw value." SWORD u_kPa_2048n_2048p 0 0 -2048.00 2047.9375 ECU_ADDRESS 0x400050DA FORMAT "%%5.1" /end MEASUREMENT
/begin MEASUREMENT chrg_cpa_dlt_mmv "Filted delta actual charger pressure." SWORD u_kPa_2048n_2048p 0 0 -2048.00 2047.9375 ECU_ADDRESS 0x400050DA FORMAT "%5.1" /end MEASUREMENT
/begin MEASUREMENT chrg_cp_err "Charger pressure error.Absolute value of actual charger pressure sub charger pressure setpoint." UWORD u_kPa_0_4096 0 0 0.00 4095.937500 ECU_ADDRESS 0x400050DA FORMAT "%5.1" /end MEASUREMENT
/begin MEASUREMENT chrg_cp_err_s "Signed charger pressure error." SWORD u_kPa_2048n_2048p 0 0 -2048.00 2047.9375 ECU_ADDRESS 0x400050DA FORMAT "%5.1" /end MEASUREMENT
/begin MEASUREMENT chrg_cl_cor "Charger close loop control correction term.I term + P term OR I term - P term." UWORD u_kPa_2048n_2048p_bias 0 0 -2048.00 2047.9375 ECU_ADDRESS 0x400050DA FORMAT "%5.1" /end MEASUREMENT
/begin MEASUREMENT chrg_i_dlt "Charger close loop control I term delta from error * I gain." ULONG u_kPa_0_4096l 0 0 0.00 4095.9999 ECU_ADDRESS 0x400050DA FORMAT "%5.1" /end MEASUREMENT
/begin MEASUREMENT chrg_i_h "Charger close loop control I term (high resolustion value)." ULONG u_kPa_2048n_2048pl 0 0 -2048.00 2047.0 ECU_ADDRESS 0x400050DA FORMAT "%1.0" /end MEASUREMENT
/begin MEASUREMENT chrg_cp_sp_max_eng_ltd "Max charger pressure setpoint limited by engine hardware." UWORD u_kPa_0_512 0 0 0.00 511.9921875 ECU_ADDRESS 0x400050DA FORMAT "%5.1" /end MEASUREMENT
/begin MEASUREMENT chrg_cp_sp_max_c_ltd "Max charger pressure setpoint limited by charger hardware." UWORD u_kPa_0_512 0 0 0.00 511.9921875 ECU_ADDRESS 0x400050DA FORMAT "%5.1" /end MEASUREMENT
/begin MEASUREMENT chrg_map "Filted manifold absolute pressure used in charger model." UWORD u_kPa_0_4096 0 0 0.00 4095.937500 ECU_ADDRESS 0x400050DA FORMAT "%5.1" /end MEASUREMENT
/begin MEASUREMENT chrg_cp_sp_max_rt_ltd "Max charger pressure setpoint limited by increment rate." UWORD u_kPa_0_4096 0 0 0.00 4095.937500 ECU_ADDRESS 0x400050DA FORMAT "%5.1" /end MEASUREMENT
/begin MEASUREMENT chrg_cp_sp_raw "Charger pressure raw setpoint before step limited." UWORD u_kPa_0_4096 0 0 0.00 4095.937500 ECU_ADDRESS 0x400050DA FORMAT "%5.1" /end MEASUREMENT
/begin MEASUREMENT chrg_wg_dphr_dltp_sp "Diaphragm delta pressure setpoint." UWORD u_kPa_0_4096 0 0 0.00 4095.937500 ECU_ADDRESS 0x400050DA FORMAT "%5.1" /end MEASUREMENT
/begin MEASUREMENT chrg_wg_dphr_p_sp "Diaphragm pressure setpoint." UWORD u_kPa_0_4096 0 0 0.00 4095.937500 ECU_ADDRESS 0x400050DA FORMAT "%5.1" /end MEASUREMENT
/begin MEASUREMENT chrg_wg_dltp_sp "Delta pressure setpoint for waste gate solenoid." UWORD u_kPa_0_4096 0 0 0.00 4095.937500 ECU_ADDRESS 0x400050DA FORMAT "%5.1" /end MEASUREMENT
/begin MEASUREMENT chrg_wg_dltp_cl_sp "Close loop delta pressure setpoint for solenoid." UWORD u_kPa_0_4096 0 0 0.00 4095.937500 ECU_ADDRESS 0x400050DA FORMAT "%5.1" /end MEASUREMENT
/begin MEASUREMENT chrg_wg_dltp_ol_sp "Open loop delta pressure setpoint for solenoid." UWORD u_kPa_0_4096 0 0 0.00 4095.937500 ECU_ADDRESS 0x400050DA FORMAT "%5.1" /end MEASUREMENT
/begin MEASUREMENT chrg_wg_dltp_max "Max delta pressure of solenoid.Charger pressure sub ambitient pressure." UWORD u_kPa_0_4096 0 0 0.00 4095.937500 ECU_ADDRESS 0x400050DA FORMAT "%5.1" /end MEASUREMENT
/begin MEASUREMENT chrg_surg_pv "Anti surge pedal value.TPS or APS." UWORD u_pct_r 0 0 0.00 100.00 ECU_ADDRESS 0x400050DA FORMAT "%5.1" /end MEASUREMENT
/begin MEASUREMENT chrg_wgpwm_raw "Raw waste gate pwm without factor correction." UWORD u_pct_dc 0 0 0.00 100.00 ECU_ADDRESS 0x400050DA FORMAT "%5.1" /end MEASUREMENT
/begin MEASUREMENT chrg_wgpwm_bias "Waste gate pwm bias during gear shifting." SWORD u_pct 0 0 0.00 100.00 ECU_ADDRESS 0x400050DA FORMAT "%5.1" /end MEASUREMENT
/begin MEASUREMENT chrg_cmpr_pq_sp_max "Max available pressure quotient setpoint of compressor.Include base value and intake air temperature bias." UWORD u_fac_8 0 0 0.00 7.9998779296875 ECU_ADDRESS 0x400050DA FORMAT "%3.2" /end MEASUREMENT
/begin MEASUREMENT chrg_cmpr_pq_sp_max_amp_bias "Max available pressure quotient setpoint of compressor ambitient pressure bias.This bias value is substracted by the base value." UWORD u_fac_8 0 0 0.00 7.9998779296875 ECU_ADDRESS 0x400050DA FORMAT "%3.2" /end MEASUREMENT
/begin MEASUREMENT chrg_wgpwm_fac_tgt "Target waste gate pwm factor which lookuped from cell." UWORD u_fac_2 0 0 0.00 1.999969482421875 ECU_ADDRESS 0x400050DA /end MEASUREMENT
/begin MEASUREMENT chrg_surg_en "Anti surge enable." UBYTE b_true 0 0 0.00 1.00 BIT_MASK 0x1 ECU_ADDRESS 0x400033EF FORMAT "%1.0" /end MEASUREMENT
/begin MEASUREMENT chrg_wgpwm_fac_cell "Current active waste gate factor cell." UBYTE u_cnts 0 0 0.00 255.00 ECU_ADDRESS 0x400050DA /end MEASUREMENT
/begin MEASUREMENT chrg_wgpwm_fac_disp_idx "Waste gate factor display index." UBYTE u_cnts 0 0 0.00 255.00 ECU_ADDRESS 0x400050DA /end MEASUREMENT
/begin MEASUREMENT chrg_cpa_inc_rt "Charger pressure increase rate between calibrated interval peroid." UWORD u_kPa_0_512 0 0 0.00 511.9921875 ECU_ADDRESS 0x400050DA /end MEASUREMENT
/begin MEASUREMENT chrg_cp_sp "Charger pressure setpoint." UWORD u_kPa_0_4096 0 0 0.00 4095.937500 ECU_ADDRESS 0x400050DA FORMAT "%5.1" /end MEASUREMENT
/begin MEASUREMENT chrg_cp_sp_lo "Charger pressure setpoint low limit." UWORD u_kPa_0_4096 0 0 0.00 4095.937500 ECU_ADDRESS 0x400050DA FORMAT "%5.1" /end MEASUREMENT
/begin MEASUREMENT chrg_i "Charger close loop control I term." UWORD u_kPa_2048n_2048p_bias 0 0 -2048.00 2047.9375 ECU_ADDRESS 0x400050DA FORMAT "%5.1" /end MEASUREMENT
/begin MEASUREMENT chrg_cp_sp_eng_max "Max charger pressure setpoint limited by engine raw." UWORD u_kPa_0_512 0 0 0.00 511.9921875 ECU_ADDRESS 0x400050DA /end MEASUREMENT
/begin MEASUREMENT chrg_cp_sp_max "Max charger pressure setpoint limit. Including charger limit and engine limit." UWORD u_kPa_0_512 0 0 0.00 511.9921875 ECU_ADDRESS 0x400050DA /end MEASUREMENT
/begin MEASUREMENT chrg_p "Charger close loop control P term." UWORD u_kPa_0_4096 0 0 0.00 4095.937500 ECU_ADDRESS 0x400050DA FORMAT "%5.2" /end MEASUREMENT
/begin MEASUREMENT chrg_wgpwm "Final waste gate pwm after factor correction." UWORD u_pct_dc 0 0 0.00 100.00 ECU_ADDRESS 0x400050DA /end MEASUREMENT
/begin MEASUREMENT chrg_wgpwm_fac "Current waste gate pwm factor." UWORD u_fac_2 0 0 0.00 1.999969482421875 ECU_ADDRESS 0x400050DA /end MEASUREMENT
/begin MEASUREMENT chrg_wgpwm_fac_disp_val "Waste gate factor display value." UWORD u_fac_2 0 0 0.00 1.999969482421875 ECU_ADDRESS 0x400050DA /end MEASUREMENT
/begin MEASUREMENT chrg_eng_load "Altitude compensated virtual engine load, used  to look up the spring-loaded wastegate diaphragm base delta pressure." UWORD u_pct_8 0 0 0 799.987790 ECU_ADDRESS 0x40004EBC /end MEASUREMENT
/begin MEASUREMENT chrg_mx_bstp_sp_amp_bias "Max boost pressure setpoint ambient pressure bias." UWORD u_kPa_0_512 0 0 0.00 511.9921875 ECU_ADDRESS 0x400050DA /end MEASUREMENT
/begin MEASUREMENT chrg_wg_dphr_p_sp_cor "Corrected Diaphragm pressure setpoint." UWORD u_kPa_0_4096 0 0 0.00 4095.937500 ECU_ADDRESS 0x400050DA FORMAT "%5.1" /end MEASUREMENT
/begin AXIS_PTS ENSC_X_VSPD_A "vspd breakpoint" 0x284C8 sys_veh_spd SSV__UWORD_S 0 u_vspd 8 0 511.9921875 DEPOSIT ABSOLUTE SYMBOL_LINK "ENSC_X_VSPD_A" 2 /end AXIS_PTS
/begin AXIS_PTS ENSC_X_VSPD_B "axis of vehicle speed" 0x0002006C sys_veh_spd SSV__UWORD_S 0 u_vspd 5 0.000000 511.992188 DEPOSIT ABSOLUTE SYMBOL_LINK "ENSC_X_VSPD_B" 2 /end AXIS_PTS
/begin AXIS_PTS ENSC_X_ECT_A "ect breakpoint" 0x0002006C sys_ect SSV__SWORD_S 0 u_deg_C 5 -256.000000 255.9921875 FORMAT "%4.1" DEPOSIT ABSOLUTE SYMBOL_LINK "ENSC_X_ECT_A" 2 /end AXIS_PTS
/begin AXIS_PTS ENSC_X_VSPD_D "axis of vehicle speed" 0x27BB8 sys_veh_spd SSV__UWORD_S 0 u_vspd 8 0.000000 511.992188 DEPOSIT ABSOLUTE SYMBOL_LINK "ENSC_X_VSPD_D" 2 /end AXIS_PTS
/begin CHARACTERISTIC ENSC_C_IDL_FLW_AMP_FAC "amp factor to calculate total idle flow" CURVE 0x000200B0 __SWORD_S 0 u_fac_2 -1 0.999969482421875 FORMAT "%4.3" SYMBOL_LINK "ENSC_C_IDL_FLW_AMP_FAC" 2
 /begin AXIS_DESCR FIX_AXIS sys_amp u_kPa_0_256 7 45 105 /begin FIX_AXIS_PAR_LIST 11520 14080 16640 19200 21760 24320 26880 /end FIX_AXIS_PAR_LIST /end AXIS_DESCR
/end CHARACTERISTIC
/begin CHARACTERISTIC ENSC_V_IDL_FLW_RAMP_EN "True will enable ramp control of slow term idle flow" VALUE 0x0002038C __UBYTE_S 0 b_true 0 1 FORMAT "%5.2" /end CHARACTERISTIC
/begin CHARACTERISTIC ENSC_V_IDL_FLW_TO_TQ_GAIN "Gain for convert idle flow to torque" VALUE 0x0002038C __UBYTE_S 0 u_fac_b_255 0 255 /end CHARACTERISTIC
/begin CHARACTERISTIC ENSC_C_IDL_FLW_WRM_PN "idle warm term flow when in gear PN" CURVE 0x000200B0 __UWORD_S 0 u_pct_1 0 99.9984741210937 FORMAT "%5.3" SYMBOL_LINK "ENSC_C_IDL_FLW_WRM_PN" 2
 /begin AXIS_DESCR FIX_AXIS sys_ect u_deg_C 17 -40 120
  /begin FIX_AXIS_PAR_LIST -5120 -3840 -2560 -1280 0 1280 2560 3840 5120 6400 7680 8960 10240 11520 12800 14080 15360 /end FIX_AXIS_PAR_LIST
 /end AXIS_DESCR
/end CHARACTERISTIC
/begin CHARACTERISTIC ENSC_C_IDL_FLW_WRM_D "idle warm term flow when in gear D" CURVE 0x000200B0 __UWORD_S 0 u_pct_1 0 99.9984741210937 FORMAT "%5.3" SYMBOL_LINK "ENSC_C_IDL_FLW_WRM_D" 2
 /begin AXIS_DESCR FIX_AXIS sys_ect u_deg_C 17 -40 120
  /begin FIX_AXIS_PAR_LIST -5120 -3840 -2560 -1280 0 1280 2560 3840 5120 6400 7680 8960 10240 11520 12800 14080 15360 /end FIX_AXIS_PAR_LIST
 /end AXIS_DESCR
/end CHARACTERISTIC
/begin CHARACTERISTIC ENSC_C_IDL_FLW_WRM_R "idle warm term flow when in gear R" CURVE 0x000200B0 __UWORD_S 0 u_pct_1 0 99.9984741210937 FORMAT "%5.3" SYMBOL_LINK "ENSC_C_IDL_FLW_WRM_R" 2
 /begin AXIS_DESCR FIX_AXIS sys_ect u_deg_C 17 -40 120
  /begin FIX_AXIS_PAR_LIST -5120 -3840 -2560 -1280 0 1280 2560 3840 5120 6400 7680 8960 10240 11520 12800 14080 15360 /end FIX_AXIS_PAR_LIST
 /end AXIS_DESCR
/end CHARACTERISTIC
/begin CHARACTERISTIC ENSC_V_IDL_FLW_WRM_MX_BIAS "max warm term flow bias applied when in gear D" VALUE 0x0002038C __UWORD_S 0 u_pct_1 0 99.9984741210937 FORMAT "%5.3" /end CHARACTERISTIC
/begin CHARACTERISTIC ENSC_C_IDL_FLW_WRM_MT_BIAS "MT warm term flow bias applied when clutch pedal is released clutch is close" CURVE 0x000200B0 __UWORD_S 0 u_pct_1 0 99.9984741210937 FORMAT "%5.3" SYMBOL_LINK "ENSC_C_IDL_FLW_WRM_MT_BIAS" 2
 /begin AXIS_DESCR COM_AXIS sys_ect u_deg_C 7 -256 255.9921875 AXIS_PTS_REF ENSC_X_ECT_C /end AXIS_DESCR
/end CHARACTERISTIC
/begin AXIS_PTS ENSC_X_ECT_C "ect breakpoint" 0x0002006C sys_ect SSV__SWORD_S 0 u_deg_C 7 -256 255.9921875 FORMAT "%4.1" DEPOSIT ABSOLUTE SYMBOL_LINK "ENSC_X_ECT_C" 2 /end AXIS_PTS
/begin CHARACTERISTIC ENSC_C_IDL_FLW_WRM_DCY_FAC "decay factor of warm term flow" CURVE 0x000200B0 __UWORD_S 0 u_fac_1 0 0.999984741210937 SYMBOL_LINK "ENSC_C_IDL_FLW_WRM_DCY_FAC" 2
 /begin AXIS_DESCR FIX_AXIS sys_ect u_deg_C 17 -40 120
  /begin FIX_AXIS_PAR_LIST -5120 -3840 -2560 -1280 0 1280 2560 3840 5120 6400 7680 8960 10240 11520 12800 14080 15360 /end FIX_AXIS_PAR_LIST
 /end AXIS_DESCR
/end CHARACTERISTIC
/begin CHARACTERISTIC ENSC_C_IDL_FLW_WRM_DCY_DLY "decay delay of warm term flow" CURVE 0x000200B0 __UWORD_S 0 u_2x_tmr 0 1023.984375 SYMBOL_LINK "ENSC_C_IDL_FLW_WRM_DCY_DLY" 2
 /begin AXIS_DESCR FIX_AXIS sys_ect u_deg_C 17 -40 120
  /begin FIX_AXIS_PAR_LIST -5120 -3840 -2560 -1280 0 1280 2560 3840 5120 6400 7680 8960 10240 11520 12800 14080 15360 /end FIX_AXIS_PAR_LIST
 /end AXIS_DESCR
/end CHARACTERISTIC
/begin CHARACTERISTIC ENSC_C_IDL_FLW_WRM_MT_DCY_FAC_CLS "decay factor of MT warm term flow bias when clutch is close" CURVE 0x000200B0 __UWORD_S 0 u_fac_1 0 0.999984741210937 SYMBOL_LINK "ENSC_C_IDL_FLW_WRM_MT_DCY_FAC_CLS" 2
 /begin AXIS_DESCR COM_AXIS sys_ect u_deg_C 7 -256 255.9921875 AXIS_PTS_REF ENSC_X_ECT_B /end AXIS_DESCR
/end CHARACTERISTIC
/begin CHARACTERISTIC ENSC_C_IDL_FLW_WRM_MT_DCY_FAC_OP "decay factor of MT warm term flow bias when clutch is open" CURVE 0x000200B0 __UWORD_S 0 u_fac_1 0 0.999984741210937 SYMBOL_LINK "ENSC_C_IDL_FLW_WRM_MT_DCY_FAC_OP" 2
 /begin AXIS_DESCR COM_AXIS sys_ect u_deg_C 7 -256 255.9921875 AXIS_PTS_REF ENSC_X_ECT_B /end AXIS_DESCR
/end CHARACTERISTIC
/begin AXIS_PTS ENSC_X_ECT_B "ect breakpoint" 0x0002006C sys_ect SSV__SWORD_S 0 u_deg_C 7 -256 255.9921875 FORMAT "%4.1" DEPOSIT ABSOLUTE SYMBOL_LINK "ENSC_X_ECT_B" 2 /end AXIS_PTS
/begin CHARACTERISTIC ENSC_V_IDL_FLW_WRM_MX_DCY_FAC "decay factor of max warm term flow" VALUE 0x0002038C __UWORD_S 0 u_fac_1 0 0.999984741210937 /end CHARACTERISTIC
/begin CHARACTERISTIC ENSC_V_IDL_FLW_WRM_DCY_THR "engine speed deviation threshold above which decay of warm term Flow can be enabled" VALUE 0x0002038C __SWORD_S 0 u_espd -4096.0 4095.875 FORMAT "%6.2" /end CHARACTERISTIC
/begin CHARACTERISTIC ENSC_V_TRANS_FLW_RMP_CFG "ramp control configuration of transmission shift idle flow compensation" VALUE 0x0002038C __UBYTE_S 0 b_enable 0 1 FORMAT "%5.2" /end CHARACTERISTIC
/begin CHARACTERISTIC ENSC_V_TRANS_TMP_CFG "configuration of transmission temperature in idle control" VALUE 0x0002038C __UBYTE_S 0 b_trans_tmp 0 1 FORMAT "%5.2" /end CHARACTERISTIC
/begin CHARACTERISTIC ENSC_C_TRANS_FLW_DUR_ECT_FAC "engine coolant factor of transmission shift flow duration" CURVE 0x000200B0 __UWORD_S 0 u_fac_2 0 1.999969482421875 FORMAT "%4.3" SYMBOL_LINK "ENSC_C_TRANS_FLW_DUR_ECT_FAC" 2
 /begin AXIS_DESCR FIX_AXIS sys_ect u_deg_C 17 -40 120
  /begin FIX_AXIS_PAR_LIST -5120 -3840 -2560 -1280 0 1280 2560 3840 5120 6400 7680 8960 10240 11520 12800 14080 15360 /end FIX_AXIS_PAR_LIST
 /end AXIS_DESCR
/end CHARACTERISTIC
/begin CHARACTERISTIC ENSC_V_GR_SHFT_1ST_RUN_MAX "max Run time to determine first gear shift compensation" VALUE 0x0002038C __UWORD_S 0 u_1s_tmr 0 65535 /end CHARACTERISTIC
/begin CHARACTERISTIC ENSC_V_GR_SHFT_1ST_TMP_MAX "max temperature to determine first gear shift compensation" VALUE 0x0002038C __SWORD_S 0 u_deg_C -256 255.9921875 /end CHARACTERISTIC
/begin CHARACTERISTIC ENSC_C_TRANS_FLW_PN2R_1ST "idle flow compensation when AT gear shift from PN to R and ensc_gr_shft_1st==true" CURVE 0x000200B0 __SWORD_S 0 u_pct -100 99.996948 FORMAT "%4.2" SYMBOL_LINK "ENSC_C_TRANS_FLW_PN2R_1ST" 2
 /begin AXIS_DESCR FIX_AXIS sys_ect u_deg_C 17 -40 152
  /begin FIX_AXIS_PAR_LIST -5120 -3584 -2048 -512 1024 2560 4096 5632 7168 8704 10240 11776 13312 14848 16384 17920 19456 /end FIX_AXIS_PAR_LIST
 /end AXIS_DESCR
/end CHARACTERISTIC
/begin CHARACTERISTIC ENSC_V_TRANS_FLW_DUR_PN2R_1ST "duration of idle flow compensation when AT gear shift from PN to R and ensc_gr_shft_2st==true" VALUE 0x0002038C __UWORD_S 0 u_2x_tmr 0 1023.984375 /end CHARACTERISTIC
/begin CHARACTERISTIC ENSC_C_TRANS_FLW_PN2D_1ST "idle flow compensation when AT gear shift from PN to D and ensc_gr_shft_1st==true" CURVE 0x000200B0 __SWORD_S 0 u_pct -100 99.996948 FORMAT "%4.2" SYMBOL_LINK "ENSC_C_TRANS_FLW_PN2D_1ST" 2
 /begin AXIS_DESCR FIX_AXIS sys_ect u_deg_C 17 -40 152
  /begin FIX_AXIS_PAR_LIST -5120 -3584 -2048 -512 1024 2560 4096 5632 7168 8704 10240 11776 13312 14848 16384 17920 19456 /end FIX_AXIS_PAR_LIST
 /end AXIS_DESCR
/end CHARACTERISTIC
/begin CHARACTERISTIC ENSC_V_TRANS_FLW_DUR_PN2D_1ST "duration of idle flow compensation when AT gear shift from PN to D and ensc_gr_shft_2st==true" VALUE 0x0002038C __UWORD_S 0 u_2x_tmr 0 1023.984375 /end CHARACTERISTIC
/begin CHARACTERISTIC ENSC_C_TRANS_FLW_PN2R "idle flow compensation when AT gear shift from PN to R" CURVE 0x000200B0 __SWORD_S 0 u_pct -100 99.996948 FORMAT "%4.2" SYMBOL_LINK "ENSC_C_TRANS_FLW_PN2R" 2
 /begin AXIS_DESCR FIX_AXIS sys_ect u_deg_C 17 -40 152
  /begin FIX_AXIS_PAR_LIST -5120 -3584 -2048 -512 1024 2560 4096 5632 7168 8704 10240 11776 13312 14848 16384 17920 19456 /end FIX_AXIS_PAR_LIST
 /end AXIS_DESCR
/end CHARACTERISTIC
/begin CHARACTERISTIC ENSC_V_TRANS_FLW_DUR_PN2R "duration of idle flow compensation when AT gear shift from PN to R" VALUE 0x0002038C __UWORD_S 0 u_2x_tmr 0 1023.984375 /end CHARACTERISTIC
/begin CHARACTERISTIC ENSC_C_TRANS_FLW_PN2D "idle flow compensation when AT gear shift from PN to D" CURVE 0x000200B0 __SWORD_S 0 u_pct -100 99.996948 FORMAT "%4.2" SYMBOL_LINK "ENSC_C_TRANS_FLW_PN2D" 2
 /begin AXIS_DESCR FIX_AXIS sys_ect u_deg_C 17 -40 152
  /begin FIX_AXIS_PAR_LIST -5120 -3584 -2048 -512 1024 2560 4096 5632 7168 8704 10240 11776 13312 14848 16384 17920 19456 /end FIX_AXIS_PAR_LIST
 /end AXIS_DESCR
/end CHARACTERISTIC
/begin CHARACTERISTIC ENSC_V_TRANS_FLW_DUR_PN2D "duration of idle flow compensation when AT gear shift from PN to D" VALUE 0x0002038C __UWORD_S 0 u_2x_tmr 0 1023.984375 /end CHARACTERISTIC
/begin CHARACTERISTIC ENSC_C_TRANS_FLW_R2PN "idle flow compensation when AT gear shift from R to PN" CURVE 0x000200B0 __SWORD_S 0 u_pct -100 99.996948 FORMAT "%4.2" SYMBOL_LINK "ENSC_C_TRANS_FLW_R2PN" 2
 /begin AXIS_DESCR FIX_AXIS sys_ect u_deg_C 17 -40 152
  /begin FIX_AXIS_PAR_LIST -5120 -3584 -2048 -512 1024 2560 4096 5632 7168 8704 10240 11776 13312 14848 16384 17920 19456 /end FIX_AXIS_PAR_LIST
 /end AXIS_DESCR
/end CHARACTERISTIC
/begin CHARACTERISTIC ENSC_V_TRANS_FLW_DUR_R2PN "duration of idle flow compensation when AT gear shift from R to PN" VALUE 0x0002038C __UWORD_S 0 u_2x_tmr 0 1023.984375 /end CHARACTERISTIC
/begin CHARACTERISTIC ENSC_C_TRANS_FLW_D2PN "idle flow compensation when AT gear shift from D to PN" CURVE 0x000200B0 __SWORD_S 0 u_pct -100 99.996948 FORMAT "%4.2" SYMBOL_LINK "ENSC_C_TRANS_FLW_D2PN" 2
 /begin AXIS_DESCR FIX_AXIS sys_ect u_deg_C 17 -40 152
  /begin FIX_AXIS_PAR_LIST -5120 -3584 -2048 -512 1024 2560 4096 5632 7168 8704 10240 11776 13312 14848 16384 17920 19456 /end FIX_AXIS_PAR_LIST
 /end AXIS_DESCR
/end CHARACTERISTIC
/begin CHARACTERISTIC ENSC_V_TRANS_FLW_DUR_D2PN "duration of idle flow compensation when AT gear shift from D to PN" VALUE 0x0002038C __UWORD_S 0 u_2x_tmr 0 1023.984375 /end CHARACTERISTIC
/begin CHARACTERISTIC ENSC_C_TRANS_FLW_D2R "idle flow compensation when AT gear shift from D to R" CURVE 0x000200B0 __SWORD_S 0 u_pct -100 99.996948 FORMAT "%4.2" SYMBOL_LINK "ENSC_C_TRANS_FLW_D2R" 2
 /begin AXIS_DESCR FIX_AXIS sys_ect u_deg_C 17 -40 152
  /begin FIX_AXIS_PAR_LIST -5120 -3584 -2048 -512 1024 2560 4096 5632 7168 8704 10240 11776 13312 14848 16384 17920 19456 /end FIX_AXIS_PAR_LIST
 /end AXIS_DESCR
/end CHARACTERISTIC
/begin CHARACTERISTIC ENSC_V_TRANS_FLW_DUR_D2R "duration of idle flow compensation when AT gear shift from D to R" VALUE 0x0002038C __UWORD_S 0 u_2x_tmr 0 1023.984375 /end CHARACTERISTIC
/begin CHARACTERISTIC ENSC_C_TRANS_FLW_R2D "idle flow compensation when AT gear shift from R to D" CURVE 0x000200B0 __SWORD_S 0 u_pct -100 99.996948 FORMAT "%4.2" SYMBOL_LINK "ENSC_C_TRANS_FLW_R2D" 2
 /begin AXIS_DESCR FIX_AXIS sys_ect u_deg_C 17 -40 152
  /begin FIX_AXIS_PAR_LIST -5120 -3584 -2048 -512 1024 2560 4096 5632 7168 8704 10240 11776 13312 14848 16384 17920 19456 /end FIX_AXIS_PAR_LIST
 /end AXIS_DESCR
/end CHARACTERISTIC
/begin CHARACTERISTIC ENSC_V_TRANS_FLW_DUR_R2D "duration of idle flow compensation when AT gear shift from R to D" VALUE 0x0002038C __UWORD_S 0 u_2x_tmr 0 1023.984375 /end CHARACTERISTIC
/begin CHARACTERISTIC ENSC_C_TRANS_ENG_DLY_P2R_1ST "delay time before transmission gear shift engaged when from P to R and ensc_gr_shft_1st==true" CURVE 0x000200B0 __UWORD_S 0 u_2x_tmr 0 1023.984375 SYMBOL_LINK "ENSC_C_TRANS_ENG_DLY_P2R_1ST" 2
 /begin AXIS_DESCR COM_AXIS NO_INPUT_QUANTITY u_deg_C 17 -256 255.9921875 AXIS_PTS_REF ENSC_X_TMP /end AXIS_DESCR
/end CHARACTERISTIC
/begin CHARACTERISTIC ENSC_C_TRANS_FLW_RMP_DLY_P2R_1ST "delay time before ramp control of transmission flow compensation when AT gear shift from P to R and ensc_gr_shft_1st==true" CURVE 0x000200B0 __UWORD_S 0 u_2x_tmr 0 1023.984375 SYMBOL_LINK "ENSC_C_TRANS_FLW_RMP_DLY_P2R_1ST" 2
 /begin AXIS_DESCR COM_AXIS NO_INPUT_QUANTITY u_deg_C 17 -256 255.9921875 AXIS_PTS_REF ENSC_X_TMP /end AXIS_DESCR
/end CHARACTERISTIC
/begin CHARACTERISTIC ENSC_C_TRANS_ENG_DLY_N2R_1ST "delay time before transmission gear shift engaged when from N to R and ensc_gr_shft_1st==true" CURVE 0x000200B0 __UWORD_S 0 u_2x_tmr 0 1023.984375 SYMBOL_LINK "ENSC_C_TRANS_ENG_DLY_N2R_1ST" 2
 /begin AXIS_DESCR COM_AXIS NO_INPUT_QUANTITY u_deg_C 17 -256 255.9921875 AXIS_PTS_REF ENSC_X_TMP /end AXIS_DESCR
/end CHARACTERISTIC
/begin CHARACTERISTIC ENSC_C_TRANS_FLW_RMP_DLY_N2R_1ST "delay time before ramp control of transmission flow compensation when AT gear shift from N to R and ensc_gr_shft_1st==true" CURVE 0x000200B0 __UWORD_S 0 u_2x_tmr 0 1023.984375 SYMBOL_LINK "ENSC_C_TRANS_FLW_RMP_DLY_N2R_1ST" 2
 /begin AXIS_DESCR COM_AXIS NO_INPUT_QUANTITY u_deg_C 17 -256 255.9921875 AXIS_PTS_REF ENSC_X_TMP /end AXIS_DESCR
/end CHARACTERISTIC
/begin CHARACTERISTIC ENSC_C_TRANS_ENG_DLY_N2D_1ST "delay time before transmission gear shift engaged when from N to D and ensc_gr_shft_1st==true" CURVE 0x000200B0 __UWORD_S 0 u_2x_tmr 0 1023.984375 SYMBOL_LINK "ENSC_C_TRANS_ENG_DLY_N2D_1ST" 2
 /begin AXIS_DESCR COM_AXIS NO_INPUT_QUANTITY u_deg_C 17 -256 255.9921875 AXIS_PTS_REF ENSC_X_TMP /end AXIS_DESCR
/end CHARACTERISTIC
/begin CHARACTERISTIC ENSC_C_TRANS_FLW_RMP_DLY_N2D_1ST "delay time before ramp control of transmission flow compensation when AT gear shift from N to D and ensc_gr_shft_1st==true" CURVE 0x000200B0 __UWORD_S 0 u_2x_tmr 0 1023.984375 SYMBOL_LINK "ENSC_C_TRANS_FLW_RMP_DLY_N2D_1ST" 2
 /begin AXIS_DESCR COM_AXIS NO_INPUT_QUANTITY u_deg_C 17 -256 255.9921875 AXIS_PTS_REF ENSC_X_TMP /end AXIS_DESCR
/end CHARACTERISTIC
/begin CHARACTERISTIC ENSC_C_TRANS_ENG_DLY_P2D_1ST "delay time before transmission gear shift engaged when from P to D and ensc_gr_shft_1st==true" CURVE 0x000200B0 __UWORD_S 0 u_2x_tmr 0 1023.984375 SYMBOL_LINK "ENSC_C_TRANS_ENG_DLY_P2D_1ST" 2
 /begin AXIS_DESCR COM_AXIS NO_INPUT_QUANTITY u_deg_C 17 -256 255.9921875 AXIS_PTS_REF ENSC_X_TMP /end AXIS_DESCR
/end CHARACTERISTIC
/begin CHARACTERISTIC ENSC_C_TRANS_FLW_RMP_DLY_P2D_1ST "delay time before ramp control of transmission flow compensation when AT gear shift from P to D and ensc_gr_shft_1st==true" CURVE 0x000200B0 __UWORD_S 0 u_2x_tmr 0 1023.984375 SYMBOL_LINK "ENSC_C_TRANS_FLW_RMP_DLY_P2D_1ST" 2
 /begin AXIS_DESCR COM_AXIS NO_INPUT_QUANTITY u_deg_C 17 -256 255.9921875 AXIS_PTS_REF ENSC_X_TMP /end AXIS_DESCR
/end CHARACTERISTIC
/begin CHARACTERISTIC ENSC_C_TRANS_ENG_DLY_P2R "delay time before transmission gear shift engaged when from P to R" CURVE 0x000200B0 __UWORD_S 0 u_2x_tmr 0 1023.984375 SYMBOL_LINK "ENSC_C_TRANS_ENG_DLY_P2R" 2
 /begin AXIS_DESCR COM_AXIS NO_INPUT_QUANTITY u_deg_C 17 -256 255.9921875 AXIS_PTS_REF ENSC_X_TMP /end AXIS_DESCR
/end CHARACTERISTIC
/begin CHARACTERISTIC ENSC_C_TRANS_FLW_RMP_DLY_P2R "delay time before ramp control of transmission flow compensation when AT gear shift from P to R" CURVE 0x000200B0 __UWORD_S 0 u_2x_tmr 0 1023.984375 SYMBOL_LINK "ENSC_C_TRANS_FLW_RMP_DLY_P2R" 2
 /begin AXIS_DESCR COM_AXIS NO_INPUT_QUANTITY u_deg_C 17 -256 255.9921875 AXIS_PTS_REF ENSC_X_TMP /end AXIS_DESCR
/end CHARACTERISTIC
/begin CHARACTERISTIC ENSC_C_TRANS_ENG_DLY_N2R "delay time before transmission gear shift engaged when from N to R" CURVE 0x000200B0 __UWORD_S 0 u_2x_tmr 0 1023.984375 SYMBOL_LINK "ENSC_C_TRANS_ENG_DLY_N2R" 2
 /begin AXIS_DESCR COM_AXIS NO_INPUT_QUANTITY u_deg_C 17 -256 255.9921875 AXIS_PTS_REF ENSC_X_TMP /end AXIS_DESCR
/end CHARACTERISTIC
/begin CHARACTERISTIC ENSC_C_TRANS_FLW_RMP_DLY_N2R "delay time before ramp control of transmission flow compensation when AT gear shift from N to R" CURVE 0x000200B0 __UWORD_S 0 u_2x_tmr 0 1023.984375 SYMBOL_LINK "ENSC_C_TRANS_FLW_RMP_DLY_N2R" 2
 /begin AXIS_DESCR COM_AXIS NO_INPUT_QUANTITY u_deg_C 17 -256 255.9921875 AXIS_PTS_REF ENSC_X_TMP /end AXIS_DESCR
/end CHARACTERISTIC
/begin CHARACTERISTIC ENSC_C_TRANS_ENG_DLY_R2P "delay time before transmission gear shift engaged when from R to P" CURVE 0x000200B0 __UWORD_S 0 u_2x_tmr 0 1023.984375 SYMBOL_LINK "ENSC_C_TRANS_ENG_DLY_R2P" 2
 /begin AXIS_DESCR COM_AXIS NO_INPUT_QUANTITY u_deg_C 17 -256 255.9921875 AXIS_PTS_REF ENSC_X_TMP /end AXIS_DESCR
/end CHARACTERISTIC
/begin CHARACTERISTIC ENSC_C_TRANS_FLW_RMP_DLY_R2P "delay time before ramp control of transmission flow compensation when AT gear shift from R to P" CURVE 0x000200B0 __UWORD_S 0 u_2x_tmr 0 1023.984375 SYMBOL_LINK "ENSC_C_TRANS_FLW_RMP_DLY_R2P" 2
 /begin AXIS_DESCR COM_AXIS NO_INPUT_QUANTITY u_deg_C 17 -256 255.9921875 AXIS_PTS_REF ENSC_X_TMP /end AXIS_DESCR
/end CHARACTERISTIC
/begin CHARACTERISTIC ENSC_C_TRANS_ENG_DLY_R2N "delay time before transmission gear shift engaged when from R to N" CURVE 0x000200B0 __UWORD_S 0 u_2x_tmr 0 1023.984375 SYMBOL_LINK "ENSC_C_TRANS_ENG_DLY_R2N" 2
 /begin AXIS_DESCR COM_AXIS NO_INPUT_QUANTITY u_deg_C 17 -256 255.9921875 AXIS_PTS_REF ENSC_X_TMP /end AXIS_DESCR
/end CHARACTERISTIC
/begin CHARACTERISTIC ENSC_C_TRANS_FLW_RMP_DLY_R2N "delay time before ramp control of transmission flow compensation when AT gear shift from R to N" CURVE 0x000200B0 __UWORD_S 0 u_2x_tmr 0 1023.984375 SYMBOL_LINK "ENSC_C_TRANS_FLW_RMP_DLY_R2N" 2
 /begin AXIS_DESCR COM_AXIS NO_INPUT_QUANTITY u_deg_C 17 -256 255.9921875 AXIS_PTS_REF ENSC_X_TMP /end AXIS_DESCR
/end CHARACTERISTIC
/begin CHARACTERISTIC ENSC_C_TRANS_ENG_DLY_P2N "delay time before transmission gear shift engaged when from P to N" CURVE 0x000200B0 __UWORD_S 0 u_2x_tmr 0 1023.984375 SYMBOL_LINK "ENSC_C_TRANS_ENG_DLY_P2N" 2
 /begin AXIS_DESCR COM_AXIS NO_INPUT_QUANTITY u_deg_C 17 -256 255.9921875 AXIS_PTS_REF ENSC_X_TMP /end AXIS_DESCR
/end CHARACTERISTIC
/begin CHARACTERISTIC ENSC_C_TRANS_ENG_DLY_N2P "delay time before transmission gear shift engaged when from N to P" CURVE 0x000200B0 __UWORD_S 0 u_2x_tmr 0 1023.984375 SYMBOL_LINK "ENSC_C_TRANS_ENG_DLY_N2P" 2
 /begin AXIS_DESCR COM_AXIS NO_INPUT_QUANTITY u_deg_C 17 -256 255.9921875 AXIS_PTS_REF ENSC_X_TMP /end AXIS_DESCR
/end CHARACTERISTIC
/begin CHARACTERISTIC ENSC_C_TRANS_ENG_DLY_D2N "delay time before transmission gear shift engaged when from D to N" CURVE 0x000200B0 __UWORD_S 0 u_2x_tmr 0 1023.984375 SYMBOL_LINK "ENSC_C_TRANS_ENG_DLY_D2N" 2
 /begin AXIS_DESCR COM_AXIS NO_INPUT_QUANTITY u_deg_C 17 -256 255.9921875 AXIS_PTS_REF ENSC_X_TMP /end AXIS_DESCR
/end CHARACTERISTIC
/begin CHARACTERISTIC ENSC_C_TRANS_FLW_RMP_DLY_D2N "delay time before ramp control of transmission flow compensation when AT gear shift from D to N" CURVE 0x000200B0 __UWORD_S 0 u_2x_tmr 0 1023.984375 SYMBOL_LINK "ENSC_C_TRANS_FLW_RMP_DLY_D2N" 2
 /begin AXIS_DESCR COM_AXIS NO_INPUT_QUANTITY u_deg_C 17 -256 255.9921875 AXIS_PTS_REF ENSC_X_TMP /end AXIS_DESCR
/end CHARACTERISTIC
/begin CHARACTERISTIC ENSC_C_TRANS_ENG_DLY_N2D "delay time before transmission gear shift engaged when from N to D" CURVE 0x000200B0 __UWORD_S 0 u_2x_tmr 0 1023.984375 SYMBOL_LINK "ENSC_C_TRANS_ENG_DLY_N2D" 2
 /begin AXIS_DESCR COM_AXIS NO_INPUT_QUANTITY u_deg_C 17 -256 255.9921875 AXIS_PTS_REF ENSC_X_TMP /end AXIS_DESCR
/end CHARACTERISTIC
/begin CHARACTERISTIC ENSC_C_TRANS_FLW_RMP_DLY_N2D "delay time before ramp control of transmission flow compensation when AT gear shift from N to D" CURVE 0x000200B0 __UWORD_S 0 u_2x_tmr 0 1023.984375 SYMBOL_LINK "ENSC_C_TRANS_FLW_RMP_DLY_N2D" 2
 /begin AXIS_DESCR COM_AXIS NO_INPUT_QUANTITY u_deg_C 17 -256 255.9921875 AXIS_PTS_REF ENSC_X_TMP /end AXIS_DESCR
/end CHARACTERISTIC
/begin CHARACTERISTIC ENSC_C_TRANS_ENG_DLY_D2P "delay time before transmission gear shift engaged when from D to P" CURVE 0x000200B0 __UWORD_S 0 u_2x_tmr 0 1023.984375 SYMBOL_LINK "ENSC_C_TRANS_ENG_DLY_D2P" 2
 /begin AXIS_DESCR COM_AXIS NO_INPUT_QUANTITY u_deg_C 17 -256 255.9921875 AXIS_PTS_REF ENSC_X_TMP /end AXIS_DESCR
/end CHARACTERISTIC
/begin CHARACTERISTIC ENSC_C_TRANS_FLW_RMP_DLY_D2P "delay time before ramp control of transmission flow compensation when AT gear shift from D to P" CURVE 0x000200B0 __UWORD_S 0 u_2x_tmr 0 1023.984375 SYMBOL_LINK "ENSC_C_TRANS_FLW_RMP_DLY_D2P" 2
 /begin AXIS_DESCR COM_AXIS NO_INPUT_QUANTITY u_deg_C 17 -256 255.9921875 AXIS_PTS_REF ENSC_X_TMP /end AXIS_DESCR
/end CHARACTERISTIC
/begin CHARACTERISTIC ENSC_C_TRANS_ENG_DLY_P2D "delay time before transmission gear shift engaged when from P to D" CURVE 0x000200B0 __UWORD_S 0 u_2x_tmr 0 1023.984375 SYMBOL_LINK "ENSC_C_TRANS_ENG_DLY_P2D" 2
 /begin AXIS_DESCR COM_AXIS NO_INPUT_QUANTITY u_deg_C 17 -256 255.9921875 AXIS_PTS_REF ENSC_X_TMP /end AXIS_DESCR
/end CHARACTERISTIC
/begin CHARACTERISTIC ENSC_C_TRANS_FLW_RMP_DLY_P2D "delay time before ramp control of transmission flow compensation when AT gear shift from P to D" CURVE 0x000200B0 __UWORD_S 0 u_2x_tmr 0 1023.984375 SYMBOL_LINK "ENSC_C_TRANS_FLW_RMP_DLY_P2D" 2
 /begin AXIS_DESCR COM_AXIS NO_INPUT_QUANTITY u_deg_C 17 -256 255.9921875 AXIS_PTS_REF ENSC_X_TMP /end AXIS_DESCR
/end CHARACTERISTIC
/begin CHARACTERISTIC ENSC_C_TRANS_ENG_DLY_D2R "delay time before transmission gear shift engaged when from D to R" CURVE 0x000200B0 __UWORD_S 0 u_2x_tmr 0 1023.984375 SYMBOL_LINK "ENSC_C_TRANS_ENG_DLY_D2R" 2
 /begin AXIS_DESCR COM_AXIS NO_INPUT_QUANTITY u_deg_C 17 -256 255.9921875 AXIS_PTS_REF ENSC_X_TMP /end AXIS_DESCR
/end CHARACTERISTIC
/begin CHARACTERISTIC ENSC_C_TRANS_FLW_RMP_DLY_D2R "delay time before ramp down of transmission flow compensation when AT gear shift from D to R" CURVE 0x000200B0 __UWORD_S 0 u_2x_tmr 0 1023.984375 SYMBOL_LINK "ENSC_C_TRANS_FLW_RMP_DLY_D2R" 2
 /begin AXIS_DESCR COM_AXIS NO_INPUT_QUANTITY u_deg_C 17 -256 255.9921875 AXIS_PTS_REF ENSC_X_TMP /end AXIS_DESCR
/end CHARACTERISTIC
/begin CHARACTERISTIC ENSC_C_TRANS_FLW_HLD_DUR_D2R "transmission compensation flow hold duration when ensc_dr_shft_flw_en==true and gear shift from D to R" CURVE 0x000200B0 __UWORD_S 0 u_2x_tmr 0 1023.984375 SYMBOL_LINK "ENSC_C_TRANS_FLW_HLD_DUR_D2R" 2
 /begin AXIS_DESCR COM_AXIS NO_INPUT_QUANTITY u_deg_C 17 -256 255.9921875 AXIS_PTS_REF ENSC_X_TMP /end AXIS_DESCR
/end CHARACTERISTIC
/begin CHARACTERISTIC ENSC_C_TRANS_FLW_RMP_THR_D2R "time threshold to ramp the hold flow when AT gear shift from D to R" CURVE 0x000200B0 __UWORD_S 0 u_2x_tmr 0 1023.984375 SYMBOL_LINK "ENSC_C_TRANS_FLW_RMP_THR_D2R" 2
 /begin AXIS_DESCR COM_AXIS NO_INPUT_QUANTITY u_deg_C 17 -256 255.9921875 AXIS_PTS_REF ENSC_X_TMP /end AXIS_DESCR
/end CHARACTERISTIC
/begin CHARACTERISTIC ENSC_C_TRANS_ENG_DLY_R2D "delay time before transmission gear shift engaged when from R to D" CURVE 0x000200B0 __UWORD_S 0 u_2x_tmr 0 1023.984375 SYMBOL_LINK "ENSC_C_TRANS_ENG_DLY_R2D" 2
 /begin AXIS_DESCR COM_AXIS NO_INPUT_QUANTITY u_deg_C 17 -256 255.9921875 AXIS_PTS_REF ENSC_X_TMP /end AXIS_DESCR
/end CHARACTERISTIC
/begin CHARACTERISTIC ENSC_C_TRANS_FLW_RMP_DLY_R2D "delay time before ramp down of transmission flow compensation when AT gear shift from R to D" CURVE 0x000200B0 __UWORD_S 0 u_2x_tmr 0 1023.984375 SYMBOL_LINK "ENSC_C_TRANS_FLW_RMP_DLY_R2D" 2
 /begin AXIS_DESCR COM_AXIS NO_INPUT_QUANTITY u_deg_C 17 -256 255.9921875 AXIS_PTS_REF ENSC_X_TMP /end AXIS_DESCR
/end CHARACTERISTIC
/begin CHARACTERISTIC ENSC_C_TRANS_FLW_HLD_DUR_R2D "transmission compensation flow hold duration when ensc_dr_shft_flw_en==true and gear shift from R to D" CURVE 0x000200B0 __UWORD_S 0 u_2x_tmr 0 1023.984375 SYMBOL_LINK "ENSC_C_TRANS_FLW_HLD_DUR_R2D" 2
 /begin AXIS_DESCR COM_AXIS NO_INPUT_QUANTITY u_deg_C 17 -256 255.9921875 AXIS_PTS_REF ENSC_X_TMP /end AXIS_DESCR
/end CHARACTERISTIC
/begin CHARACTERISTIC ENSC_C_TRANS_FLW_RMP_THR_R2D "time threshold to ramp the hold flow when AT gear shift from R to D" CURVE 0x000200B0 __UWORD_S 0 u_2x_tmr 0 1023.984375 SYMBOL_LINK "ENSC_C_TRANS_FLW_RMP_THR_R2D" 2
 /begin AXIS_DESCR COM_AXIS NO_INPUT_QUANTITY u_deg_C 17 -256 255.9921875 AXIS_PTS_REF ENSC_X_TMP /end AXIS_DESCR
/end CHARACTERISTIC
/begin AXIS_PTS ENSC_X_TMP "" 0x0002006C NO_INPUT_QUANTITY SSV__SWORD_S 0 u_deg_C 17 -256.000000 255.9921875 FORMAT "%4.1" DEPOSIT ABSOLUTE SYMBOL_LINK "ENSC_X_TMP" 2 /end AXIS_PTS
/begin CHARACTERISTIC ENSC_C_TRANS_ENG_DLY_INGR_BIAS "bias of gear shift engaged delay time when in gear direction(ig.PN to DR)" CURVE 0x000200B0 __SWORD_S 0 u_2x_tmr -512 511.984375 FORMAT "%5.2" SYMBOL_LINK "ENSC_C_TRANS_ENG_DLY_INGR_BIAS" 2
 /begin AXIS_DESCR COM_AXIS sys_eng_spd u_espd 5 0.000000 8191.875000 FORMAT "%6.2" AXIS_PTS_REF ENSC_X_ESPD /end AXIS_DESCR
/end CHARACTERISTIC
/begin CHARACTERISTIC ENSC_C_TRANS_ENG_DLY_OUTGR_BIAS "bias of gear shift engaged delay time when out gear direction(ig.DR to PN)" CURVE 0x000200B0 __SWORD_S 0 u_2x_tmr -512 511.984375 FORMAT "%5.2" SYMBOL_LINK "ENSC_C_TRANS_ENG_DLY_OUTGR_BIAS" 2
 /begin AXIS_DESCR COM_AXIS sys_eng_spd u_espd 5 0.000000 8191.875000 FORMAT "%6.2" AXIS_PTS_REF ENSC_X_ESPD /end AXIS_DESCR
/end CHARACTERISTIC
/begin CHARACTERISTIC ENSC_C_TRANS_ENG_DLY_DR_BIAS "bias of gear shift engaged delay time when directly D to R or R to D" CURVE 0x000200B0 __SWORD_S 0 u_2x_tmr -512 511.984375 FORMAT "%5.2" SYMBOL_LINK "ENSC_C_TRANS_ENG_DLY_DR_BIAS" 2
 /begin AXIS_DESCR COM_AXIS sys_eng_spd u_espd 5 0.000000 8191.875000 FORMAT "%6.2" AXIS_PTS_REF ENSC_X_ESPD /end AXIS_DESCR
/end CHARACTERISTIC
/begin AXIS_PTS ENSC_X_ESPD "engine speed breakpoint" 0x0002006C sys_eng_spd SSV__UWORD_S 0 u_espd 5 0.000000 8191.875000 FORMAT "%6.2" DEPOSIT ABSOLUTE SYMBOL_LINK "ENSC_X_ESPD" 2 /end AXIS_PTS
/begin AXIS_PTS ENSC_X_OIL_T "oil temperature breakpoint" 0x20090 NO_INPUT_QUANTITY SSV__SWORD_S 0 u_deg_C 8 -256 255.9921875 DEPOSIT ABSOLUTE SYMBOL_LINK "ENSC_X_OIL_T" 2 /end AXIS_PTS
/begin AXIS_PTS ENSC_X_ESPD_SP "espd sp breakpoint" 0x291C4 ensc_idl_sp SSV__UWORD_S 0 u_espd 6 0.000000 8191.875000 FORMAT "%5.1" DEPOSIT ABSOLUTE SYMBOL_LINK "ENSC_X_ESPD_SP" 2 /end AXIS_PTS
/begin CHARACTERISTIC ENSC_M_IDL_FLW_CONV_R "Torque convertor idle flow compensation when in gear R" MAP 0x35EEA __UWORD_S 0 u_pct 0 199.99694824219 SYMBOL_LINK "ENSC_M_IDL_FLW_CONV_R" 4
 /begin AXIS_DESCR COM_AXIS ensc_idl_sp u_espd 6 0.000000 8191.875000 AXIS_PTS_REF ENSC_X_ESPD_SP /end AXIS_DESCR
 /begin AXIS_DESCR COM_AXIS NO_INPUT_QUANTITY u_deg_C 8 -256.000000 255.9921875 AXIS_PTS_REF ENSC_X_OIL_T /end AXIS_DESCR
/end CHARACTERISTIC
/begin CHARACTERISTIC ENSC_M_IDL_FLW_CONV_D "Torque convertor idle flow compensation when in gear D" MAP 0x35EEA __UWORD_S 0 u_pct 0 199.99694824219 SYMBOL_LINK "ENSC_M_IDL_FLW_CONV_D" 4
 /begin AXIS_DESCR COM_AXIS ensc_idl_sp u_espd 6 0.000000 8191.875000 AXIS_PTS_REF ENSC_X_ESPD_SP /end AXIS_DESCR
 /begin AXIS_DESCR COM_AXIS NO_INPUT_QUANTITY u_deg_C 8 -256.000000 255.9921875 AXIS_PTS_REF ENSC_X_OIL_T /end AXIS_DESCR
/end CHARACTERISTIC
/begin CHARACTERISTIC ENSC_M_IDL_FLW_CONV_PN "Torque convertor idle flow compensation when in gear PN" MAP 0x35EEA __UWORD_S 0 u_pct 0 199.99694824219 SYMBOL_LINK "ENSC_M_IDL_FLW_CONV_PN" 4
 /begin AXIS_DESCR COM_AXIS ensc_idl_sp u_espd 6 0.000000 8191.875000 AXIS_PTS_REF ENSC_X_ESPD_SP /end AXIS_DESCR
 /begin AXIS_DESCR COM_AXIS NO_INPUT_QUANTITY u_deg_C 8 -256.000000 255.9921875 AXIS_PTS_REF ENSC_X_OIL_T /end AXIS_DESCR
/end CHARACTERISTIC
/begin CHARACTERISTIC ENSC_M_IDL_FLW_CONV_VSPD_EN_THR "max vehicle speed threshold to enable torque convertor idle flow" MAP 0x35EEA __UWORD_S 0 u_vspd 0 511.992188 FORMAT "%4.1" SYMBOL_LINK "ENSC_M_IDL_FLW_CONV_VSPD_EN_THR" 4
 /begin AXIS_DESCR FIX_AXIS NO_INPUT_QUANTITY u_gear_3 3 0 2 /begin FIX_AXIS_PAR_LIST 0 1 2 /end FIX_AXIS_PAR_LIST /end AXIS_DESCR
 /begin AXIS_DESCR FIX_AXIS sys_ect u_deg_C 6 -30 40 /begin FIX_AXIS_PAR_LIST -3840 -2560 -1280 0 2560 5120 /end FIX_AXIS_PAR_LIST /end AXIS_DESCR
/end CHARACTERISTIC
/begin CHARACTERISTIC ENSC_C_IDL_FLW_CONV_VSPD_DIS_HYS "vehicle speed hysteresis to disable torque convertor idle flow" CURVE 0x35EEA __UWORD_S 0 u_vspd 0 511.992188 FORMAT "%4.1" SYMBOL_LINK "ENSC_C_IDL_FLW_CONV_VSPD_DIS_HYS" 2
 /begin AXIS_DESCR FIX_AXIS NO_INPUT_QUANTITY u_gear_3 3 0 2 /begin FIX_AXIS_PAR_LIST 0 1 2 /end FIX_AXIS_PAR_LIST /end AXIS_DESCR
/end CHARACTERISTIC
/begin CHARACTERISTIC ENSC_C_IDL_FLW_CONV_VSPD_RMP_HYS "vehicle speed hysteresis for the ramp control of torque convertor idle flow" CURVE 0x35EEA __UWORD_S 0 u_vspd 0 511.992188 FORMAT "%4.1" SYMBOL_LINK "ENSC_C_IDL_FLW_CONV_VSPD_RMP_HYS" 2
 /begin AXIS_DESCR FIX_AXIS NO_INPUT_QUANTITY u_gear_3 3 0 2 /begin FIX_AXIS_PAR_LIST 0 1 2 /end FIX_AXIS_PAR_LIST /end AXIS_DESCR
/end CHARACTERISTIC
/begin CHARACTERISTIC ENSC_V_IDL_FLW_CONV_RMP_DN_STP "ramp down step of torque convertor idle flow" VALUE 0x22E84 __UWORD_S 0 u_pct 0.0 199.996948 /end CHARACTERISTIC
/begin CHARACTERISTIC ENSC_C_IDL_FLW_CONV_RMP_UP_STP "ramp up step of torque convertor idle flow" CURVE 0x35EEA __UWORD_S 0 u_pct 0 199.99694824219 SYMBOL_LINK "ENSC_C_IDL_FLW_CONV_RMP_UP_STP" 2
 /begin AXIS_DESCR COM_AXIS NO_INPUT_QUANTITY u_espd 6 0.000000 8191.875000 AXIS_PTS_REF ENSC_X_ESPD_DEV_A /end AXIS_DESCR
/end CHARACTERISTIC
/begin AXIS_PTS ENSC_X_ESPD_DEV_A "" 0x291C4 NO_INPUT_QUANTITY SSV__UWORD_S 0 u_espd 6 0.000000 8191.875000 FORMAT "%6.2" DEPOSIT ABSOLUTE SYMBOL_LINK "ENSC_X_ESPD_DEV_A" 2 /end AXIS_PTS
/begin CHARACTERISTIC ENSC_C_IDL_FLW_CONV_FAC "factor to calculate torque convertor idle flow" CURVE 0x209FA __UWORD_S 0 u_fac_1 0 0.999984741210937 SYMBOL_LINK "ENSC_C_IDL_FLW_CONV_FAC" 2
 /begin AXIS_DESCR COM_AXIS NO_INPUT_QUANTITY u_fac_1 6 0 0.999984741210937 AXIS_PTS_REF ENSC_X_FAC /end AXIS_DESCR
/end CHARACTERISTIC
/begin AXIS_PTS ENSC_X_FAC "" 0x291C4 NO_INPUT_QUANTITY SSV__UWORD_S 0 u_fac_1 6 0 0.999984741210937 DEPOSIT ABSOLUTE SYMBOL_LINK "ENSC_X_FAC" 2 /end AXIS_PTS
/begin CHARACTERISTIC ENSC_V_IDL_FLW_CONV_FIL "filter coefficient of torque convertor idle flow term" VALUE 0x20686 __UWORD_S 0 u_fac_1 0 0.999984741210937 /end CHARACTERISTIC
/begin CHARACTERISTIC ENSC_V_IDL_FLW_LNCH_DCY_FAC "decay factor of launch idle flow when launch mode is disable" VALUE 0x20686 __UWORD_S 0 u_fac_1 0 0.999984741210937 /end CHARACTERISTIC
/begin CHARACTERISTIC ENSC_V_IDL_FLW_LNCH_I_MAX "max limit of launch I idle flow compensation" VALUE 0x22E84 __SWORD_S 0 u_pct -100.0 99.996948 /end CHARACTERISTIC
/begin CHARACTERISTIC ENSC_C_IDL_FLW_LNCH "Launch idle flow when clutch pedal sensor is PWM or analog" CURVE 0x35EEA __UWORD_S 0 u_pct 0 199.99694824219 SYMBOL_LINK "ENSC_C_IDL_FLW_LNCH" 2
 /begin AXIS_DESCR COM_AXIS NO_INPUT_QUANTITY u_pct_0_1 8 0.000000 0.999984741210937 AXIS_PTS_REF ENSC_X_PCT /end AXIS_DESCR
/end CHARACTERISTIC
/begin AXIS_PTS ENSC_X_PCT "" 0x291C4 NO_INPUT_QUANTITY SSV__UWORD_S 0 u_pct_0_1 8 0 0.999984741210937 DEPOSIT ABSOLUTE SYMBOL_LINK "ENSC_X_PCT" 2 /end AXIS_PTS
/begin CHARACTERISTIC ENSC_V_IDL_FLW_LNCH "Launch idle flow" VALUE 0x22E84 __UWORD_S 0 u_pct 0.0 199.996948 /end CHARACTERISTIC
/begin CHARACTERISTIC ENSC_V_IDL_FLW_LNCH_DCY_THR "ensc_espd_dev threshold to begin decay of launch Flow when launch mode is still enabled" VALUE 0x22E92 __SWORD_S 0 u_espd -4096 4095.875 FORMAT "%5.1" /end CHARACTERISTIC
/begin CHARACTERISTIC ENSC_V_IDL_FLW_LNCH_DCY_FAC_HIDEV "decay factor of launch idle flow when launch mode is enable and ensc_espd_dev higher than threshold" VALUE 0x20E8C __UWORD_S 0 u_fac_1 0 0.999984741210937 /end CHARACTERISTIC
/begin CHARACTERISTIC ENSC_V_IDL_FLW_LNCH_REC_THR "ensc_espd_dev threshold to recover launch Flow" VALUE 0x22E92 __SWORD_S 0 u_espd -4096 4095.875 FORMAT "%5.1" /end CHARACTERISTIC
/begin CHARACTERISTIC ENSC_C_IDL_FLW_LNCH_ECT_FAC "engine coolant temperature factor of launch idle flow" CURVE 0x208C2 __UWORD_S 0 u_fac_2 0 1.999969482421875 FORMAT "%4.3" SYMBOL_LINK "ENSC_C_IDL_FLW_LNCH_ECT_FAC" 2
 /begin AXIS_DESCR COM_AXIS sys_ect u_deg_C 10 -256 255.9921875 AXIS_PTS_REF ENSC_X_ECT_F /end AXIS_DESCR
/end CHARACTERISTIC
/begin AXIS_PTS ENSC_X_ECT_F "ect breakpoint" 0x37A08 sys_ect SSV__SWORD_S 0 u_deg_C 10 -256 255.9921875 FORMAT "%4.1" DEPOSIT ABSOLUTE SYMBOL_LINK "ENSC_X_ECT_F" 2 /end AXIS_PTS
/begin CHARACTERISTIC ENSC_V_AC_HL_OFFT_MIN "min off timer threshold to enable AC heavy load condition" VALUE 0x209F6 __UWORD_S 0 u_min 0 65535 /end CHARACTERISTIC
/begin CHARACTERISTIC ENSC_V_AC_HL_OFFT_MAX "max off timer threshold to enable AC heavy load condition" VALUE 0x209F6 __UWORD_S 0 u_min 0 65535 /end CHARACTERISTIC
/begin CHARACTERISTIC ENSC_V_AC_HL_KEYON_ECT_MIN "min key on coolant threshold to enable AC heavy load condition" VALUE 0x20906 __SWORD_S 0 u_deg_C -256 255.9921875 /end CHARACTERISTIC
/begin CHARACTERISTIC ENSC_V_AC_HL_KEYON_IAT_MIN "min key on intake air temperature threshold to enable AC heavy load condition" VALUE 0x20906 __SWORD_S 0 u_deg_C -256 255.9921875 /end CHARACTERISTIC
/begin CHARACTERISTIC ENSC_V_AC_HL_IAT_MIN "min intake air temperature threshold to enable AC heavy load condition" VALUE 0x20906 __SWORD_S 0 u_deg_C -256 255.9921875 /end CHARACTERISTIC
/begin CHARACTERISTIC ENSC_V_AC_HL_MIN_AC_OFF_TIM "min AC off time threshold to enable AC heavy load condition" VALUE 0x27F60 __UWORD_S 0 u_16x_tmr 0 8191.875 /end CHARACTERISTIC
/begin CHARACTERISTIC ENSC_C_AC_FLW_LO_HL "AC transient flow when AC press low and heavy load condition met" CURVE 0x2041C __UWORD_S 0 u_pct 0 199.996948242187 SYMBOL_LINK "ENSC_C_AC_FLW_LO_HL" 2
 /begin AXIS_DESCR FIX_AXIS sys_iat u_deg_C 11 -20 80 /begin FIX_AXIS_PAR_LIST -2560 -1280 0 1280 2560 3840 5120 6400 7680 8960 10240 /end FIX_AXIS_PAR_LIST /end AXIS_DESCR
/end CHARACTERISTIC
/begin CHARACTERISTIC ENSC_C_AC_FLW_LO "AC transient flow when AC press low" CURVE 0x2041C __UWORD_S 0 u_pct 0 199.996948242187 SYMBOL_LINK "ENSC_C_AC_FLW_LO" 2
 /begin AXIS_DESCR FIX_AXIS sys_iat u_deg_C 11 -20 80 /begin FIX_AXIS_PAR_LIST -2560 -1280 0 1280 2560 3840 5120 6400 7680 8960 10240 /end FIX_AXIS_PAR_LIST /end AXIS_DESCR
/end CHARACTERISTIC
/begin CHARACTERISTIC ENSC_C_AC_FLW_HI "AC transient flow when AC press high" CURVE 0x2041C __UWORD_S 0 u_pct 0 199.996948242187 SYMBOL_LINK "ENSC_C_AC_FLW_HI" 2
 /begin AXIS_DESCR FIX_AXIS NO_INPUT_QUANTITY u_AC_load 11 0 10 /begin FIX_AXIS_PAR_LIST 0 1 2 3 4 5 6 7 8 9 10 /end FIX_AXIS_PAR_LIST /end AXIS_DESCR
/end CHARACTERISTIC
/begin CHARACTERISTIC ENSC_C_AC_FLW_HI_HL "AC transient flow when AC press high and heavy load condition met" CURVE 0x2041C __UWORD_S 0 u_pct 0 199.996948242187 SYMBOL_LINK "ENSC_C_AC_FLW_HI_HL" 2
 /begin AXIS_DESCR FIX_AXIS NO_INPUT_QUANTITY u_AC_load 11 0 10 /begin FIX_AXIS_PAR_LIST 0 1 2 3 4 5 6 7 8 9 10 /end FIX_AXIS_PAR_LIST /end AXIS_DESCR
/end CHARACTERISTIC
/begin CHARACTERISTIC ENSC_V_AC_FLW_DCY_FAC_HL "AC transient flow decay factor when heavyload condition met" VALUE 0x20E8C __UWORD_S 0 u_fac_1 0 0.999984741210937 /end CHARACTERISTIC
/begin CHARACTERISTIC ENSC_V_AC_FLW_DCY_FAC "AC transient flow decay factor" VALUE 0x20E8C __UWORD_S 0 u_fac_1 0 0.999984741210937 /end CHARACTERISTIC
/begin CHARACTERISTIC ENSC_V_AC_FLW_DCY_DLY "AC transient flow decay delay" VALUE 0x65F46 __UWORD_S 0 u_2x_tmr 0 1023.984375 /end CHARACTERISTIC
/begin CHARACTERISTIC ENSC_C_IDL_FLW_ST "engine start idle flow compensation" CURVE 0x2041C __UWORD_S 0 u_pct 0 199.996948242187 SYMBOL_LINK "ENSC_C_IDL_FLW_ST" 2
 /begin AXIS_DESCR FIX_AXIS sys_ect u_deg_C 17 -40 152
  /begin FIX_AXIS_PAR_LIST -5120 -3584 -2048 -512 1024 2560 4096 5632 7168 8704 10240 11776 13312 14848 16384 17920 19456 /end FIX_AXIS_PAR_LIST
 /end AXIS_DESCR
/end CHARACTERISTIC
/begin CHARACTERISTIC ENSC_V_IDL_FLW_HRST "hot restart idle flow compensation" VALUE 0x22E84 __UWORD_S 0 u_pct 0.0 199.996948 /end CHARACTERISTIC
/begin CHARACTERISTIC ENSC_C_IDL_FLW_ST_HLD_DUR "hold duration of start idle flow" CURVE 0x2041C __UWORD_S 0 u_2x_tmr 0 1023.984375 SYMBOL_LINK "ENSC_C_IDL_FLW_ST_HLD_DUR" 2
 /begin AXIS_DESCR FIX_AXIS sys_ect u_deg_C 17 -40 152
  /begin FIX_AXIS_PAR_LIST -5120 -3584 -2048 -512 1024 2560 4096 5632 7168 8704 10240 11776 13312 14848 16384 17920 19456 /end FIX_AXIS_PAR_LIST
 /end AXIS_DESCR
/end CHARACTERISTIC
/begin CHARACTERISTIC ENSC_C_IDL_FLW_ST_DCY_DLY "decay delay of start idle flow" CURVE 0x2041C __UWORD_S 0 u_2x_tmr 0 1023.984375 SYMBOL_LINK "ENSC_C_IDL_FLW_ST_DCY_DLY" 2
 /begin AXIS_DESCR FIX_AXIS sys_ect u_deg_C 17 -40 152
  /begin FIX_AXIS_PAR_LIST -5120 -3584 -2048 -512 1024 2560 4096 5632 7168 8704 10240 11776 13312 14848 16384 17920 19456 /end FIX_AXIS_PAR_LIST
 /end AXIS_DESCR
/end CHARACTERISTIC
/begin CHARACTERISTIC ENSC_V_IDL_FLW_ST_DCY_FAC "decay factor of start idle flow" VALUE 0x20E8C __UWORD_S 0 u_fac_1 0 0.999984741210937 /end CHARACTERISTIC
/begin CHARACTERISTIC ENSC_C_IDL_FLW_OR "overrun idle flow compensation" CURVE 0x36328 __SWORD_S 0 u_pct -100 99.996948 FORMAT "%4.2" SYMBOL_LINK "ENSC_C_IDL_FLW_OR" 2
 /begin AXIS_DESCR COM_AXIS sys_veh_spd u_vspd 17 0.000000 511.992188 AXIS_PTS_REF ENSC_X_VSPD_C /end AXIS_DESCR
/end CHARACTERISTIC
/begin AXIS_PTS ENSC_X_VSPD_C "axis of vehicle speed" 0x27BB8 sys_veh_spd SSV__UWORD_S 0 u_vspd 17 0.000000 511.992188 DEPOSIT ABSOLUTE SYMBOL_LINK "ENSC_X_VSPD_C" 2 /end AXIS_PTS
/begin CHARACTERISTIC ENSC_V_BAT_VLT_FIL "filter coefficient of battery voltage" VALUE 0x27C44 __UWORD_S 0 u_filter 0 0.9999847412109375 FORMAT "%4.3" /end CHARACTERISTIC
/begin CHARACTERISTIC ENSC_V_IDL_FLW_BAT_EN_DLY "engine run time delay to enable battery voltage idle flow compensation" VALUE 0x21AAE __UWORD_S 0 u_2x_tmr 0 1023.984375 /end CHARACTERISTIC
/begin CHARACTERISTIC ENSC_C_IDL_FLW_BAT "battery voltage idle flow compensation" CURVE 0x36328 __SWORD_S 0 u_pct -100 99.996948 FORMAT "%4.2" SYMBOL_LINK "ENSC_C_IDL_FLW_BAT" 2
 /begin AXIS_DESCR COM_AXIS NO_INPUT_QUANTITY u_volt_32 11 0.000000 31.99951171875 AXIS_PTS_REF ENSC_X_BAT_VLT /end AXIS_DESCR
/end CHARACTERISTIC
/begin AXIS_PTS ENSC_X_BAT_VLT "voltage breakpoint" 0x2E1A4 NO_INPUT_QUANTITY SSV__UWORD_S 0 u_volt_32 11 0.000000 31.99951171875 FORMAT "%3.1" DEPOSIT ABSOLUTE SYMBOL_LINK "ENSC_X_BAT_VLT" 2 /end AXIS_PTS
/begin CHARACTERISTIC ENSC_V_BAT_VLT_DFLT "default battery voltage used to lookup ENSC_C_IDL_FLW_BAT when engine not run or delay not finish" VALUE 0x21C28 __UWORD_S 0 u_volt_32 0 31.99951171875 FORMAT "%4.2" /end CHARACTERISTIC
/begin CHARACTERISTIC ENSC_V_IDL_FLW_FAN_LO "low speed fan transient compensation flow" VALUE 0x379E4 __UWORD_S 0 u_pct_1 0 99.9984741210937 FORMAT "%5.3" /end CHARACTERISTIC
/begin CHARACTERISTIC ENSC_V_IDL_FLW_FAN_LO_DCY_FAC "decay factor of low speed fan transient compensation flow" VALUE 0x20E8C __UWORD_S 0 u_fac_1 0 0.999984741210937 /end CHARACTERISTIC
/begin CHARACTERISTIC ENSC_V_IDL_FLW_FAN_LO_DCY_DLY "decay delay of low speed fan transient compensation flow" VALUE 0x65F46 __UWORD_S 0 u_2x_tmr 0 1023.984375 /end CHARACTERISTIC
/begin CHARACTERISTIC ENSC_V_IDL_FLW_FAN_HI "high speed fan transient compensation flow" VALUE 0x379E4 __UWORD_S 0 u_pct_1 0 99.9984741210937 FORMAT "%5.3" /end CHARACTERISTIC
/begin CHARACTERISTIC ENSC_V_IDL_FLW_FAN_HI_DCY_FAC "decay factor of high speed fan transient compensation flow" VALUE 0x20E8C __UWORD_S 0 u_fac_1 0 0.999984741210937 /end CHARACTERISTIC
/begin CHARACTERISTIC ENSC_V_IDL_FLW_FAN_HI_DCY_DLY "decay delay of high speed fan transient compensation flow" VALUE 0x65F46 __UWORD_S 0 u_2x_tmr 0 1023.984375 /end CHARACTERISTIC
/begin CHARACTERISTIC ENSC_V_IDL_FLW_ELOAD1 "Eload1 compensation flow" VALUE 0x379E4 __UWORD_S 0 u_pct_1 0 99.9984741210937 FORMAT "%5.3" /end CHARACTERISTIC
/begin CHARACTERISTIC ENSC_V_IDL_FLW_ELOAD1_DCY_DLY "decay delay of Eload1 compensation flow" VALUE 0x65F46 __UWORD_S 0 u_2x_tmr 0 1023.984375 /end CHARACTERISTIC
/begin CHARACTERISTIC ENSC_V_IDL_FLW_ELOAD1_DCY_FAC "decay factor of Eload1 compensation flow" VALUE 0x20E8C __UWORD_S 0 u_fac_1 0 0.999984741210937 /end CHARACTERISTIC
/begin CHARACTERISTIC ENSC_V_IDL_FLW_ELOAD2 "Eload2 compensation flow" VALUE 0x379E4 __UWORD_S 0 u_pct_1 0 99.9984741210937 FORMAT "%5.3" /end CHARACTERISTIC
/begin CHARACTERISTIC ENSC_V_IDL_FLW_ELOAD2_DCY_DLY "decay delay of Eload2 compensation flow" VALUE 0x65F46 __UWORD_S 0 u_2x_tmr 0 1023.984375 /end CHARACTERISTIC
/begin CHARACTERISTIC ENSC_V_IDL_FLW_ELOAD2_DCY_FAC "decay factor of Eload2 compensation flow" VALUE 0x20E8C __UWORD_S 0 u_fac_1 0 0.999984741210937 /end CHARACTERISTIC
/begin CHARACTERISTIC ENSC_C_IDL_FLW_PS_BAS "base PS idle flow compensation when PS sensor type is switch" CURVE 0x36424 __SWORD_S 0 u_pct -100 99.996948 FORMAT "%4.2" SYMBOL_LINK "ENSC_C_IDL_FLW_PS_BAS" 2
 /begin AXIS_DESCR FIX_AXIS sys_ect u_deg_C 8 -40 128 /begin FIX_AXIS_PAR_LIST -5120 -2048 1024 4096 7168 10240 13312 16384 /end FIX_AXIS_PAR_LIST /end AXIS_DESCR
/end CHARACTERISTIC
/begin CHARACTERISTIC ENSC_V_IDL_FLW_PS_BIAS_DR_AC "PS idle flow compensation bias when PS sensor type is switch and gear DRï¼ŒAC on" VALUE 0x22E84 __SWORD_S 0 u_pct -100.0 99.996948 /end CHARACTERISTIC
/begin CHARACTERISTIC ENSC_V_IDL_FLW_PS_BIAS_DR "PS idle flow compensation bias when PS sensor type is switch and gear DRï¼ŒAC off" VALUE 0x22E84 __SWORD_S 0 u_pct -100.0 99.996948 /end CHARACTERISTIC
/begin CHARACTERISTIC ENSC_V_IDL_FLW_PS_BIAS_PN_AC "PS idle flow compensation bias when PS sensor type is switch and gear PNï¼ŒAC on" VALUE 0x22E84 __SWORD_S 0 u_pct -100.0 99.996948 /end CHARACTERISTIC
/begin CHARACTERISTIC ENSC_V_IDL_FLW_PS_BIAS_PN "PS idle flow compensation bias when PS sensor type is switch and gear PNï¼ŒAC off" VALUE 0x22E84 __SWORD_S 0 u_pct -100.0 99.996948 /end CHARACTERISTIC
/begin CHARACTERISTIC ENSC_C_IDL_FLW_PS_ESPD_FAC "engine speed factor of PS idle flow compensation" CURVE 0x2A3EC __UWORD_S 0 u_fac_2 0 1.999969482421875 FORMAT "%4.3" SYMBOL_LINK "ENSC_C_IDL_FLW_PS_ESPD_FAC" 2
 /begin AXIS_DESCR COM_AXIS sys_eng_spd u_espd 10 0.000000 8191.875000 AXIS_PTS_REF ENSC_X_ESPD_A /end AXIS_DESCR
/end CHARACTERISTIC
/begin AXIS_PTS ENSC_X_ESPD_A "espd breakpoint" 0x291C4 sys_eng_spd SSV__UWORD_S 0 u_espd 10 0.000000 8191.875000 FORMAT "%6.2" DEPOSIT ABSOLUTE SYMBOL_LINK "ENSC_X_ESPD_A" 2 /end AXIS_PTS
/begin CHARACTERISTIC ENSC_C_IDL_FLW_PS_TRANS "transient PS idle flow compensation when PS sensor type is switch" CURVE 0x36424 __SWORD_S 0 u_pct -100 99.996948 FORMAT "%4.2" SYMBOL_LINK "ENSC_C_IDL_FLW_PS_TRANS" 2
 /begin AXIS_DESCR FIX_AXIS sys_ect u_deg_C 8 -40 128 /begin FIX_AXIS_PAR_LIST -5120 -2048 1024 4096 7168 10240 13312 16384 /end FIX_AXIS_PAR_LIST /end AXIS_DESCR
/end CHARACTERISTIC
/begin CHARACTERISTIC ENSC_C_IDL_FLW_PS_TRANS_DUR "duration of transient PS idle flow compensation" CURVE 0x36424 __UWORD_S 0 u_2x_tmr 0 1023.984375 SYMBOL_LINK "ENSC_C_IDL_FLW_PS_TRANS_DUR" 2
 /begin AXIS_DESCR FIX_AXIS sys_ect u_deg_C 8 -40 128 /begin FIX_AXIS_PAR_LIST -5120 -2048 1024 4096 7168 10240 13312 16384 /end FIX_AXIS_PAR_LIST /end AXIS_DESCR
/end CHARACTERISTIC
/begin CHARACTERISTIC ENSC_V_IDL_FLW_PS_TRANS_EN_DLY "when PS active, delay time threshold to enable PS transient flow compensation" VALUE 0x65F46 __UWORD_S 0 u_2x_tmr 0 1023.984375 /end CHARACTERISTIC
/begin CHARACTERISTIC ENSC_V_IDL_FLW_PS_TRANS_DCY_DLY "decay delay of transient PS idle flow compensation" VALUE 0x65F46 __UWORD_S 0 u_2x_tmr 0 1023.984375 /end CHARACTERISTIC
/begin CHARACTERISTIC ENSC_V_IDL_FLW_PS_TRANS_DCY_FAC "decay factor of transient PS idle flow compensation" VALUE 0x20E8C __UWORD_S 0 u_fac_1 0 0.999984741210937 /end CHARACTERISTIC
/begin CHARACTERISTIC ENSC_C_IDL_FLW_PS "PS idle flow compensation when PS sensor type is sensor" CURVE 0x36328 __SWORD_S 0 u_pct -100 99.996948 FORMAT "%4.2" SYMBOL_LINK "ENSC_C_IDL_FLW_PS" 2
 /begin AXIS_DESCR COM_AXIS sys_ps_p u_kPa_0_32768 5 0 32767.5 AXIS_PTS_REF ENSC_X_PS_P /end AXIS_DESCR
/end CHARACTERISTIC
/begin AXIS_PTS ENSC_X_PS_P "" 0x65E4A sys_ps_p SSV__UWORD_S 0 u_kPa_0_32768 5 0 32767.5 DEPOSIT ABSOLUTE SYMBOL_LINK "ENSC_X_PS_P" 2 /end AXIS_PTS
/begin CHARACTERISTIC ENSC_C_IDL_FLW_PS_BIAS_DELTP_R "delta PS pressure bias of PS flow when PS sensor type is sensor and gear R" CURVE 0x36328 __SWORD_S 0 u_pct -100 99.996948 FORMAT "%4.2" SYMBOL_LINK "ENSC_C_IDL_FLW_PS_BIAS_DELTP_R" 2
 /begin AXIS_DESCR COM_AXIS NO_INPUT_QUANTITY u_kPa_0_32768 9 -16384 16383.5 AXIS_PTS_REF ENSC_X_PS_DELTP /end AXIS_DESCR
/end CHARACTERISTIC
/begin CHARACTERISTIC ENSC_C_IDL_FLW_PS_BIAS_DELTP "delta PS pressure bias of PS flow when PS sensor type is sensor" CURVE 0x36328 __SWORD_S 0 u_pct -100 99.996948 FORMAT "%4.2" SYMBOL_LINK "ENSC_C_IDL_FLW_PS_BIAS_DELTP" 2
 /begin AXIS_DESCR COM_AXIS NO_INPUT_QUANTITY u_kPa_0_32768 9 -16384 16383.5 AXIS_PTS_REF ENSC_X_PS_DELTP /end AXIS_DESCR
/end CHARACTERISTIC
/begin AXIS_PTS ENSC_X_PS_DELTP "" 0x65E4A NO_INPUT_QUANTITY SSV__SWORD_S 0 u_kPa_0_32768 9 -16384 16383.5 DEPOSIT ABSOLUTE SYMBOL_LINK "ENSC_X_PS_DELTP" 2 /end AXIS_PTS
/begin CHARACTERISTIC ENSC_C_IDL_FLW_PS_DCY_STP "decay step of PS idle flow compensation when PS sensor type is sensor" CURVE 0x209A8 __SWORD_S 0 u_pct -100 99.996948 FORMAT "%4.2" SYMBOL_LINK "ENSC_C_IDL_FLW_PS_DCY_STP" 2
 /begin AXIS_DESCR FIX_AXIS sys_ect u_deg_C 17 -40 120
  /begin FIX_AXIS_PAR_LIST -5120 -3840 -2560 -1280 0 1280 2560 3840 5120 6400 7680 8960 10240 11520 12800 14080 15360 /end FIX_AXIS_PAR_LIST
 /end AXIS_DESCR
/end CHARACTERISTIC
/begin CHARACTERISTIC ENSC_V_IDL_FLW_PSOFF "transient PS OFF idle flow compensation when PS sensor type is switch" VALUE 0x22E84 __SWORD_S 0 u_pct -100.0 99.996948 /end CHARACTERISTIC
/begin CHARACTERISTIC ENSC_V_IDL_FLW_PSOFF_DLY "when PS inactive, delay time threshold to enable PS OFF transient flow compensation" VALUE 0x65F46 __UWORD_S 0 u_2x_tmr 0 1023.984375 /end CHARACTERISTIC
/begin CHARACTERISTIC ENSC_V_IDL_FLW_PSOFF_DUR "duration of PS OFF transient idle flow compensation" VALUE 0x65F46 __UWORD_S 0 u_2x_tmr 0 1023.984375 /end CHARACTERISTIC
/begin CHARACTERISTIC ENSC_V_IDL_FLW_PSOFF_DCY_DLY "decay delay of PS OFF transient idle flow compensation" VALUE 0x65F46 __UWORD_S 0 u_2x_tmr 0 1023.984375 /end CHARACTERISTIC
/begin CHARACTERISTIC ENSC_V_IDL_FLW_PSOFF_DCY_FAC "decay factor of PS OFF transient idle flow compensation" VALUE 0x20E8C __UWORD_S 0 u_fac_1 0 0.999984741210937 /end CHARACTERISTIC
/begin CHARACTERISTIC ENSC_C_ANTISTL_EN_DEV_THR "threshold of ensc_espd_filt_dev below which anti stall control will be active" CURVE 0x361FC __SWORD_S 0 u_espd -4096 4095.875 FORMAT "%6.2" SYMBOL_LINK "ENSC_C_ANTISTL_EN_DEV_THR" 2
 /begin AXIS_DESCR COM_AXIS ensc_idl_sp u_espd 5 0.000000 8191.875000 AXIS_PTS_REF ENSC_X_ESPD_SP_A /end AXIS_DESCR
/end CHARACTERISTIC
/begin AXIS_PTS ENSC_X_ESPD_SP_A "espd sp breakpoint" 0x291C4 ensc_idl_sp SSV__UWORD_S 0 u_espd 5 0.000000 8191.875000 FORMAT "%6.2" DEPOSIT ABSOLUTE SYMBOL_LINK "ENSC_X_ESPD_SP_A" 2 /end AXIS_PTS
/begin CHARACTERISTIC ENSC_V_ANTISTL_RUN_MIN "min engine runtime to enable anti stall control" VALUE 0x21ABA __UWORD_S 0 u_1s_tmr 0 65535 /end CHARACTERISTIC
/begin CHARACTERISTIC ENSC_V_ANTISTL_VSPD_MAX "max vehicle speed to enable anti stall control" VALUE 0x39FE6 __UWORD_S 0 u_vspd 0 511.9921875 /end CHARACTERISTIC
/begin CHARACTERISTIC ENSC_V_ANTISTL_VSPD_HYS "vehicle speed hysterisis to calculate ensc_antistl_vspd_thr" VALUE 0x39FE6 __UWORD_S 0 u_vspd 0 511.9921875 /end CHARACTERISTIC
/begin CHARACTERISTIC ENSC_V_ANTISTL_IDL_SP_DELT_THR "threshold of idle speed setpoint delta(compared with last loop) to determine ensc_idl_sp_chg_stat" VALUE 0x21CB6 __UWORD_S 0 u_espd 0 8191.875 FORMAT "%5.1" /end CHARACTERISTIC
/begin CHARACTERISTIC ENSC_V_ANTISTL_FLW_DR "anti stall idle flow compensation when ensc_veh_in_gear==true" VALUE 0x379E4 __UWORD_S 0 u_pct_1 0 99.9984741210937 FORMAT "%5.3" /end CHARACTERISTIC
/begin CHARACTERISTIC ENSC_V_ANTISTL_FLW_PN "anti stall idle flow compensation when ensc_veh_in_gear==false" VALUE 0x379E4 __UWORD_S 0 u_pct_1 0 99.9984741210937 FORMAT "%5.3" /end CHARACTERISTIC
/begin CHARACTERISTIC ENSC_V_ANTISTL_FLW_DCY_STP "decay step of anti stall idle flow compensation" VALUE 0x379E4 __UWORD_S 0 u_pct_1 0 99.9984741210937 FORMAT "%5.3" /end CHARACTERISTIC
/begin CHARACTERISTIC ENSC_V_ANTISTL_DIS_DEV_THR "threshold of ensc_espd_filt_dev above which anti stall idle flow will begin to decay" VALUE 0x379E2 __SWORD_S 0 u_espd -4096.0 4095.875 FORMAT "%6.2" /end CHARACTERISTIC
/begin CHARACTERISTIC ENSC_C_IDL_FLW_PWM_FAN "idle warm term flow when in gear R" CURVE 0x365A4 __UWORD_S 0 u_pct_1 0 99.9984741210937 FORMAT "%5.3" SYMBOL_LINK "ENSC_C_IDL_FLW_PWM_FAN" 2
 /begin AXIS_DESCR FIX_AXIS ente_fan_act_pwm u_pct 21 0 100
  /begin FIX_AXIS_PAR_LIST 0 1638 3276 4915 6553 8192 9830 11468 13107 14745 16384 18022 19660 21299 22937 24576 26214 27852 29491 31129 32768 /end FIX_AXIS_PAR_LIST
 /end AXIS_DESCR
/end CHARACTERISTIC
/begin CHARACTERISTIC ENSC_V_NIDL_TRANS_TMP_CFG "configuration of transmission temperature in neutral idle control" VALUE 0x36BD0 __UBYTE_S 0 b_trans_tmp 0 1 FORMAT "%5.2" /end CHARACTERISTIC
/begin CHARACTERISTIC ENSC_C_NIDL_RMP_IN_DLY_R "delay time before ramp in flow compensation of NIDL is applied when gear shift R2D" CURVE 0x21FE6 __UWORD_S 0 u_2x_tmr 0.0 1023.984375 SYMBOL_LINK "ENSC_C_NIDL_RMP_IN_DLY_R" 2
 /begin AXIS_DESCR FIX_AXIS NO_INPUT_QUANTITY u_deg_C 17 -40 152
  /begin FIX_AXIS_PAR_LIST -5120 -3584 -2048 -512 1024 2560 4096 5632 7168 8704 10240 11776 13312 14848 16384 17920 19456 /end FIX_AXIS_PAR_LIST
 /end AXIS_DESCR
/end CHARACTERISTIC
/begin CHARACTERISTIC ENSC_C_NIDL_RMP_IN_DLY_N "delay time before ramp in flow compensation of NIDL is applied when gear shift N2D" CURVE 0x21FE6 __UWORD_S 0 u_2x_tmr 0.0 1023.984375 SYMBOL_LINK "ENSC_C_NIDL_RMP_IN_DLY_N" 2
 /begin AXIS_DESCR FIX_AXIS NO_INPUT_QUANTITY u_deg_C 17 -40 152
  /begin FIX_AXIS_PAR_LIST -5120 -3584 -2048 -512 1024 2560 4096 5632 7168 8704 10240 11776 13312 14848 16384 17920 19456 /end FIX_AXIS_PAR_LIST
 /end AXIS_DESCR
/end CHARACTERISTIC
/begin CHARACTERISTIC ENSC_C_NIDL_RMP_IN_DLY "delay time before ramp in flow compensation of NIDL is applied when ensc_shft_dly_stat==0" CURVE 0x21FE6 __UWORD_S 0 u_2x_tmr 0.0 1023.984375 SYMBOL_LINK "ENSC_C_NIDL_RMP_IN_DLY" 2
 /begin AXIS_DESCR FIX_AXIS NO_INPUT_QUANTITY u_deg_C 17 -40 152
  /begin FIX_AXIS_PAR_LIST -5120 -3584 -2048 -512 1024 2560 4096 5632 7168 8704 10240 11776 13312 14848 16384 17920 19456 /end FIX_AXIS_PAR_LIST
 /end AXIS_DESCR
/end CHARACTERISTIC
/begin CHARACTERISTIC ENSC_V_NIDL_RMP_IN_DUR_R "duration of neutral idle ramp in flow applied when gear shift R2D" VALUE 0x35E8A __UWORD_S 0 u_2x_tmr 0 1023.984375 /end CHARACTERISTIC
/begin CHARACTERISTIC ENSC_V_NIDL_RMP_IN_DUR_N "duration of neutral idle ramp in flow applied when gear shift N2D" VALUE 0x35E8A __UWORD_S 0 u_2x_tmr 0 1023.984375 /end CHARACTERISTIC
/begin CHARACTERISTIC ENSC_V_NIDL_RMP_IN_DUR "duration of neutral idle ramp in flow applied when ensc_shft_dly_stat==0" VALUE 0x35E8A __UWORD_S 0 u_2x_tmr 0 1023.984375 /end CHARACTERISTIC
/begin CHARACTERISTIC ENSC_C_NIDL_FLW_RMP_IN_R "ramp in flow compensation of neutral idle control when gear shift R2D" CURVE 0x36370 __SWORD_S 0 u_pct -100 99.996948 FORMAT "%4.2" SYMBOL_LINK "ENSC_C_NIDL_FLW_RMP_IN_R" 2
 /begin AXIS_DESCR FIX_AXIS NO_INPUT_QUANTITY u_deg_C 17 -40 152
  /begin FIX_AXIS_PAR_LIST -5120 -3584 -2048 -512 1024 2560 4096 5632 7168 8704 10240 11776 13312 14848 16384 17920 19456 /end FIX_AXIS_PAR_LIST
 /end AXIS_DESCR
/end CHARACTERISTIC
/begin CHARACTERISTIC ENSC_C_NIDL_FLW_RMP_IN_N "ramp in flow compensation of neutral idle control when gear shift N2D" CURVE 0x36370 __SWORD_S 0 u_pct -100 99.996948 FORMAT "%4.2" SYMBOL_LINK "ENSC_C_NIDL_FLW_RMP_IN_N" 2
 /begin AXIS_DESCR FIX_AXIS NO_INPUT_QUANTITY u_deg_C 17 -40 152
  /begin FIX_AXIS_PAR_LIST -5120 -3584 -2048 -512 1024 2560 4096 5632 7168 8704 10240 11776 13312 14848 16384 17920 19456 /end FIX_AXIS_PAR_LIST
 /end AXIS_DESCR
/end CHARACTERISTIC
/begin CHARACTERISTIC ENSC_C_NIDL_FLW_RMP_IN "ramp in flow compensation of neutral idle control when ensc_shft_dly_stat==0" CURVE 0x36370 __SWORD_S 0 u_pct -100 99.996948 FORMAT "%4.2" SYMBOL_LINK "ENSC_C_NIDL_FLW_RMP_IN" 2
 /begin AXIS_DESCR FIX_AXIS NO_INPUT_QUANTITY u_deg_C 17 -40 152
  /begin FIX_AXIS_PAR_LIST -5120 -3584 -2048 -512 1024 2560 4096 5632 7168 8704 10240 11776 13312 14848 16384 17920 19456 /end FIX_AXIS_PAR_LIST
 /end AXIS_DESCR
/end CHARACTERISTIC
/begin CHARACTERISTIC ENSC_V_NIDL_RMP_IN_DLY_THR "transmission input shift speed gradient threshold above which ramp in delay of NIDL will be bypassed" VALUE 0x202FC __SWORD_S 0 u_spd_grad -512 511.984375 /end CHARACTERISTIC
/begin CHARACTERISTIC ENSC_V_NIDL_RMP_IN_DUR_THR "transmission input shift speed gradient threshold above which ramp in duration of NIDL will be bypassed" VALUE 0x202FC __SWORD_S 0 u_spd_grad -512 511.984375 /end CHARACTERISTIC
/begin CHARACTERISTIC ENSC_C_NIDL_FLW "neutral idle control compensation of OL idle flow" CURVE 0x363DC __SWORD_S 0 u_pct -100 99.996948 FORMAT "%4.2" SYMBOL_LINK "ENSC_C_NIDL_FLW" 2
 /begin AXIS_DESCR FIX_AXIS NO_INPUT_QUANTITY u_deg_C 17 -40 152
  /begin FIX_AXIS_PAR_LIST -5120 -3584 -2048 -512 1024 2560 4096 5632 7168 8704 10240 11776 13312 14848 16384 17920 19456 /end FIX_AXIS_PAR_LIST
 /end AXIS_DESCR
/end CHARACTERISTIC
/begin CHARACTERISTIC ENSC_C_NIDL_RMP_OUT_DLY_R "delay time before ramp out flow compensation of NIDL is applied when gear shift R2D" CURVE 0x21FE6 __UWORD_S 0 u_2x_tmr 0.0 1023.984375 SYMBOL_LINK "ENSC_C_NIDL_RMP_OUT_DLY_R" 2
 /begin AXIS_DESCR FIX_AXIS NO_INPUT_QUANTITY u_deg_C 17 -40 152
  /begin FIX_AXIS_PAR_LIST -5120 -3584 -2048 -512 1024 2560 4096 5632 7168 8704 10240 11776 13312 14848 16384 17920 19456 /end FIX_AXIS_PAR_LIST
 /end AXIS_DESCR
/end CHARACTERISTIC
/begin CHARACTERISTIC ENSC_C_NIDL_RMP_OUT_DLY_N "delay time before ramp out flow compensation of NIDL is applied when gear shift N2D" CURVE 0x21FE6 __UWORD_S 0 u_2x_tmr 0.0 1023.984375 SYMBOL_LINK "ENSC_C_NIDL_RMP_OUT_DLY_N" 2
 /begin AXIS_DESCR FIX_AXIS NO_INPUT_QUANTITY u_deg_C 17 -40 152
  /begin FIX_AXIS_PAR_LIST -5120 -3584 -2048 -512 1024 2560 4096 5632 7168 8704 10240 11776 13312 14848 16384 17920 19456 /end FIX_AXIS_PAR_LIST
 /end AXIS_DESCR
/end CHARACTERISTIC
/begin CHARACTERISTIC ENSC_C_NIDL_RMP_OUT_DLY "delay time before ramp out flow compensation of NIDL is applied" CURVE 0x21FE6 __UWORD_S 0 u_2x_tmr 0.0 1023.984375 SYMBOL_LINK "ENSC_C_NIDL_RMP_OUT_DLY" 2
 /begin AXIS_DESCR FIX_AXIS NO_INPUT_QUANTITY u_deg_C 17 -40 152
  /begin FIX_AXIS_PAR_LIST -5120 -3584 -2048 -512 1024 2560 4096 5632 7168 8704 10240 11776 13312 14848 16384 17920 19456 /end FIX_AXIS_PAR_LIST
 /end AXIS_DESCR
/end CHARACTERISTIC
/begin CHARACTERISTIC ENSC_V_NIDL_RMP_OUT_DUR_R "duration of neutral idle ramp out flow applied when gear shift R2D" VALUE 0x35E8A __UWORD_S 0 u_2x_tmr 0 1023.984375 /end CHARACTERISTIC
/begin CHARACTERISTIC ENSC_V_NIDL_RMP_OUT_DUR_N "duration of neutral idle ramp out flow applied when gear shift N2D" VALUE 0x35E8A __UWORD_S 0 u_2x_tmr 0 1023.984375 /end CHARACTERISTIC
/begin CHARACTERISTIC ENSC_V_NIDL_RMP_OUT_DUR "duration of neutral idle ramp out flow applied" VALUE 0x35E8A __UWORD_S 0 u_2x_tmr 0 1023.984375 /end CHARACTERISTIC
/begin CHARACTERISTIC ENSC_C_NIDL_FLW_RMP_OUT_R "ramp out flow compensation of neutral idle control when gear shift R2D" CURVE 0x36370 __SWORD_S 0 u_pct -100 99.996948 FORMAT "%4.2" SYMBOL_LINK "ENSC_C_NIDL_FLW_RMP_OUT_R" 2
 /begin AXIS_DESCR FIX_AXIS NO_INPUT_QUANTITY u_deg_C 17 -40 152
  /begin FIX_AXIS_PAR_LIST -5120 -3584 -2048 -512 1024 2560 4096 5632 7168 8704 10240 11776 13312 14848 16384 17920 19456 /end FIX_AXIS_PAR_LIST
 /end AXIS_DESCR
/end CHARACTERISTIC
/begin CHARACTERISTIC ENSC_C_NIDL_FLW_RMP_OUT_N "ramp out flow compensation of neutral idle control when gear shift N2D" CURVE 0x36370 __SWORD_S 0 u_pct -100 99.996948 FORMAT "%4.2" SYMBOL_LINK "ENSC_C_NIDL_FLW_RMP_OUT_N" 2
 /begin AXIS_DESCR FIX_AXIS NO_INPUT_QUANTITY u_deg_C 17 -40 152
  /begin FIX_AXIS_PAR_LIST -5120 -3584 -2048 -512 1024 2560 4096 5632 7168 8704 10240 11776 13312 14848 16384 17920 19456 /end FIX_AXIS_PAR_LIST
 /end AXIS_DESCR
/end CHARACTERISTIC
/begin CHARACTERISTIC ENSC_C_NIDL_FLW_RMP_OUT "ramp out flow compensation of neutral idle control" CURVE 0x36370 __SWORD_S 0 u_pct -100 99.996948 FORMAT "%4.2" SYMBOL_LINK "ENSC_C_NIDL_FLW_RMP_OUT" 2
 /begin AXIS_DESCR FIX_AXIS NO_INPUT_QUANTITY u_deg_C 17 -40 152
  /begin FIX_AXIS_PAR_LIST -5120 -3584 -2048 -512 1024 2560 4096 5632 7168 8704 10240 11776 13312 14848 16384 17920 19456 /end FIX_AXIS_PAR_LIST
 /end AXIS_DESCR
/end CHARACTERISTIC
/begin CHARACTERISTIC ENSC_V_NIDL_RMP_OUT_DLY_THR "transmission input shift speed gradient threshold below which ramp out delay of NIDL will be bypassed" VALUE 0x202FC __SWORD_S 0 u_spd_grad -512 511.984375 /end CHARACTERISTIC
/begin CHARACTERISTIC ENSC_C_IDL_FLW_CVT_BIAS_CFG "configuration to enable CVT OL flow compensation based on CVT clutch status" CURVE 0x35EEA __UBYTE_S 0 b_true 0 1 FORMAT "%1.0"
 /begin AXIS_DESCR FIX_AXIS NO_INPUT_QUANTITY u_cvt_clutch_status 4 0 3 /begin FIX_AXIS_PAR_LIST 0 1 2 3 /end FIX_AXIS_PAR_LIST /end AXIS_DESCR
/end CHARACTERISTIC
/begin CHARACTERISTIC ENSC_V_CRP_VSPD_MAX "max vehicle speed threshold to enable creep compensation" VALUE 0x2D7A6 __UWORD_S 0 u_vspd 0 511.9921875 FORMAT "%4.1" /end CHARACTERISTIC
/begin CHARACTERISTIC ENSC_C_IDL_FLW_CRP "AMT/CVT creep compensation term of OL idle flow" CURVE 0x21C34 __SWORD_S 0 u_pct_1 -50.0 49.9984741210937 FORMAT "%4.2" SYMBOL_LINK "ENSC_C_IDL_FLW_CRP" 2
 /begin AXIS_DESCR COM_AXIS NO_INPUT_QUANTITY u_tq 10 -2048 2047.9375 AXIS_PTS_REF ENSC_X_CRP_TQ /end AXIS_DESCR
/end CHARACTERISTIC
/begin AXIS_PTS ENSC_X_CRP_TQ "" 0x311F4 NO_INPUT_QUANTITY SSV__SWORD_S 0 u_tq 10 -2048 2047.9375 FORMAT "%6.2" DEPOSIT ABSOLUTE SYMBOL_LINK "ENSC_X_CRP_TQ" 2 /end AXIS_PTS
/begin CHARACTERISTIC ENSC_C_IDL_FLW_CRP_FAC "factor of creep idle flow based on ensc_espd_dev" CURVE 0x20470 __UWORD_S 0 u_fac_4 0 3.99993896484375 FORMAT "%4.3" SYMBOL_LINK "ENSC_C_IDL_FLW_CRP_FAC" 2
 /begin AXIS_DESCR COM_AXIS ensc_espd_dev u_espd 7 -4096 4095.875 AXIS_PTS_REF ENSC_X_ESPD_DEV_B /end AXIS_DESCR
/end CHARACTERISTIC
/begin AXIS_PTS ENSC_X_ESPD_DEV_B "" 0x291C4 ensc_espd_dev SSV__SWORD_S 0 u_espd 7 -4096 4095.875 FORMAT "%6.2" DEPOSIT ABSOLUTE SYMBOL_LINK "ENSC_X_ESPD_DEV_B" 2 /end AXIS_PTS
/begin CHARACTERISTIC ENSC_V_IDL_FLW_CRP_RMP_EN "True will enable normal ramp control of creep idle flow" VALUE 0x37118 __UBYTE_S 0 b_true 0 1 FORMAT "%5.2" /end CHARACTERISTIC
/begin CHARACTERISTIC ENSC_V_IDL_FLW_CRP_ZERO_DB "zero deadband of creep idle flow" VALUE 0x22E84 __UWORD_S 0 u_pct 0.0 199.996948 /end CHARACTERISTIC
/begin CHARACTERISTIC ENSC_V_IDL_FLW_CRP_RST_EN "True will reset creep flow to 0, when creep condition not met and idle state is not open or launch" VALUE 0x37118 __UBYTE_S 0 b_true 0 1 FORMAT "%5.2" /end CHARACTERISTIC
/begin CHARACTERISTIC ENSC_V_IDL_FLW_CRP_RMP_THR "delta value between ensc_idl_flw_crp and ensc_idl_flw_crp_raw to enable ramp control" VALUE 0x22E84 __UWORD_S 0 u_pct 0.0 199.996948 /end CHARACTERISTIC
/begin CHARACTERISTIC ENSC_V_IDL_FLW_CRP_RMP_STP_INC "increase step of creep flow ramp control" VALUE 0x22E84 __UWORD_S 0 u_pct 0.0 199.996948 /end CHARACTERISTIC
/begin CHARACTERISTIC ENSC_V_IDL_FLW_CRP_RMP_STP_DEC "decrease step of creep flow ramp control" VALUE 0x22E84 __UWORD_S 0 u_pct 0.0 199.996948 /end CHARACTERISTIC
/begin CHARACTERISTIC ENSC_V_IDL_FLW_I_DFLT_D "default idle I term flow when gear D" VALUE 0x23F4C __SWORD_S 0 u_pct -100 99.996948242187 /end CHARACTERISTIC
/begin CHARACTERISTIC ENSC_V_IDL_FLW_I_DFLT_R "default idle I term flow when gear R" VALUE 0x23F4C __SWORD_S 0 u_pct -100 99.996948242187 /end CHARACTERISTIC
/begin CHARACTERISTIC ENSC_V_IDL_FLW_I_DFLT_AC_BIAS "AC bias of default idle I term flow" VALUE 0x37FA8 __UWORD_S 0 u_pct_1 0 99.9984741210937 FORMAT "%5.3" /end CHARACTERISTIC
/begin CHARACTERISTIC ENSC_V_IDL_ST_PD_EN "true means start PD idle control can be enabled" VALUE 0x229A4 __UBYTE_S 0 b_true 0 1 FORMAT "%5.2" /end CHARACTERISTIC
/begin CHARACTERISTIC ENSC_V_LD_CHG_PID_FAC_EN "TRUE will enable idle PID flow factor when load change happen" VALUE 0x229A4 __UBYTE_S 0 b_true 0 1 FORMAT "%5.2" /end CHARACTERISTIC
/begin CHARACTERISTIC ENSC_V_LD_CHG_PID_FAC_RUN_MIN "min engine runtime to enable load change PID factor" VALUE 0x20D6C __UWORD_S 0 u_1s_tmr 0 65535 /end CHARACTERISTIC
/begin CHARACTERISTIC ENSC_V_AC_ON_PID_FAC_DUR "hold duration of PID factor when load change due to AC ON" VALUE 0x3D18A __UWORD_S 0 u_2x_tmr 0 1023.984375 /end CHARACTERISTIC
/begin CHARACTERISTIC ENSC_V_AC_OFF_PID_FAC_DUR "hold duration of PID factor when load change due to AC OFF" VALUE 0x3D18A __UWORD_S 0 u_2x_tmr 0 1023.984375 /end CHARACTERISTIC
/begin CHARACTERISTIC ENSC_V_GR_SHFT_PID_FAC_DUR "hold duration of PID factor when load change due to AT gear shift" VALUE 0x3D18A __UWORD_S 0 u_2x_tmr 0 1023.984375 /end CHARACTERISTIC
/begin CHARACTERISTIC ENSC_C_LD_CHG_PID_FAC_PRI "priority of different load change reason" CURVE 0x35EEA __UBYTE_S 0 u_cnts 0 3 FORMAT "%4.1"
 /begin AXIS_DESCR FIX_AXIS NO_INPUT_QUANTITY u_pid_fac_rsn 2 0 1 /begin FIX_AXIS_PAR_LIST 0 1 /end FIX_AXIS_PAR_LIST /end AXIS_DESCR
/end CHARACTERISTIC
/begin CHARACTERISTIC ENSC_C_GR_SHFT_FAC_NM_P "P term factor when load change due to AT gear shift and normal idle control enable" CURVE 0x3D870 __UWORD_S 0 u_fac_64 0.0 63.9990234375 SYMBOL_LINK "ENSC_C_GR_SHFT_FAC_NM_P" 2
 /begin AXIS_DESCR COM_AXIS sys_ect u_deg_C 5 -256.000000 255.9921875 AXIS_PTS_REF ENSC_X_ECT_D /end AXIS_DESCR
/end CHARACTERISTIC
/begin CHARACTERISTIC ENSC_C_GR_SHFT_FAC_NM_I "I term factor when load change due to AT gear shift and normal idle control enable" CURVE 0x3D870 __UWORD_S 0 u_fac_64 0.0 63.9990234375 SYMBOL_LINK "ENSC_C_GR_SHFT_FAC_NM_I" 2
 /begin AXIS_DESCR COM_AXIS sys_ect u_deg_C 5 -256.000000 255.9921875 AXIS_PTS_REF ENSC_X_ECT_D /end AXIS_DESCR
/end CHARACTERISTIC
/begin CHARACTERISTIC ENSC_C_GR_SHFT_FAC_NM_D "D term factor when load change due to AT gear shift and normal idle control enable" CURVE 0x3D870 __UWORD_S 0 u_fac_64 0.0 63.9990234375 SYMBOL_LINK "ENSC_C_GR_SHFT_FAC_NM_D" 2
 /begin AXIS_DESCR COM_AXIS sys_ect u_deg_C 5 -256.000000 255.9921875 AXIS_PTS_REF ENSC_X_ECT_D /end AXIS_DESCR
/end CHARACTERISTIC
/begin AXIS_PTS ENSC_X_ECT_D "ect breakpoint" 0x36494 sys_ect SSV__SWORD_S 0 u_deg_C 5 -256.000000 255.9921875 FORMAT "%4.1" DEPOSIT ABSOLUTE SYMBOL_LINK "ENSC_X_ECT_D" 2 /end AXIS_PTS
/begin CHARACTERISTIC ENSC_V_GR_SHFT_FAC_OR_P "P term factor when load change due to AT gear shift and overrun idle control enable" VALUE 0x2004E __UWORD_S 0 u_fac_64 0.0 63.9990234375 /end CHARACTERISTIC
/begin CHARACTERISTIC ENSC_V_GR_SHFT_FAC_OR_I "I term factor when load change due to AT gear shift and overrun idle control enable" VALUE 0x2004E __UWORD_S 0 u_fac_64 0.0 63.9990234375 /end CHARACTERISTIC
/begin CHARACTERISTIC ENSC_V_GR_SHFT_FAC_OR_D "D term factor when load change due to AT gear shift and overrun idle control enable" VALUE 0x2004E __UWORD_S 0 u_fac_64 0.0 63.9990234375 /end CHARACTERISTIC
/begin CHARACTERISTIC ENSC_V_AC_FAC_NM_P "P term factor when load change due to AC transition and normal idle control enable" VALUE 0x2004E __UWORD_S 0 u_fac_64 0.0 63.9990234375 /end CHARACTERISTIC
/begin CHARACTERISTIC ENSC_V_AC_FAC_NM_I "I term factor when load change due to AC transition and normal idle control enable" VALUE 0x2004E __UWORD_S 0 u_fac_64 0.0 63.9990234375 /end CHARACTERISTIC
/begin CHARACTERISTIC ENSC_V_AC_FAC_NM_D "D term factor when load change due to AC transition and normal idle control enable" VALUE 0x2004E __UWORD_S 0 u_fac_64 0.0 63.9990234375 /end CHARACTERISTIC
/begin CHARACTERISTIC ENSC_V_AC_FAC_OR_P "P term factor when load change due to AC transition and overrun idle control enable" VALUE 0x2004E __UWORD_S 0 u_fac_64 0.0 63.9990234375 /end CHARACTERISTIC
/begin CHARACTERISTIC ENSC_V_AC_FAC_OR_I "I term factor when load change due to AC transition and overrun idle control enable" VALUE 0x2004E __UWORD_S 0 u_fac_64 0.0 63.9990234375 /end CHARACTERISTIC
/begin CHARACTERISTIC ENSC_V_AC_FAC_OR_D "D term factor when load change due to AC transition and overrun idle control enable" VALUE 0x2004E __UWORD_S 0 u_fac_64 0.0 63.9990234375 /end CHARACTERISTIC
/begin CHARACTERISTIC ENSC_V_LD_CHG_FAC_P_INC_STP "P term factor increase step when load change PID factor enabled" VALUE 0x2004E __UWORD_S 0 u_fac_64 0.0 63.9990234375 /end CHARACTERISTIC
/begin CHARACTERISTIC ENSC_V_LD_CHG_FAC_P_DEC_STP "P term factor decrease step when load change PID factor enabled" VALUE 0x2004E __UWORD_S 0 u_fac_64 0.0 63.9990234375 /end CHARACTERISTIC
/begin CHARACTERISTIC ENSC_V_LD_CHG_FAC_I_INC_STP "I term factor increase step when load change PID factor enabled" VALUE 0x2004E __UWORD_S 0 u_fac_64 0.0 63.9990234375 /end CHARACTERISTIC
/begin CHARACTERISTIC ENSC_V_LD_CHG_FAC_I_DEC_STP "I term factor decrease step when load change PID factor enabled" VALUE 0x2004E __UWORD_S 0 u_fac_64 0.0 63.9990234375 /end CHARACTERISTIC
/begin CHARACTERISTIC ENSC_V_LD_CHG_FAC_D_INC_STP "D term factor increase step when load change PID factor enabled" VALUE 0x2004E __UWORD_S 0 u_fac_64 0.0 63.9990234375 /end CHARACTERISTIC
/begin CHARACTERISTIC ENSC_V_LD_CHG_FAC_D_DEC_STP "D term factor decrease step when load change PID factor enabled" VALUE 0x2004E __UWORD_S 0 u_fac_64 0.0 63.9990234375 /end CHARACTERISTIC
/begin CHARACTERISTIC ENSC_V_LNCH_I_OL_EN "True means enable launch I term flow in open loop idle control" VALUE 0x229A4 __UBYTE_S 0 b_true 0 1 FORMAT "%5.2" /end CHARACTERISTIC
/begin CHARACTERISTIC ENSC_V_LNCH_I_OL_ESPD_DB "engine speed deviation low deadband to enable open loop launch I term" VALUE 0x37FA6 __SWORD_S 0 u_espd -4096.0 4095.875 FORMAT "%6.2" /end CHARACTERISTIC
/begin CHARACTERISTIC ENSC_V_I_RPM_DEV_FAC "factor of ensc_espd_dev to calculate base I term deviation" VALUE 0x284C4 __UWORD_S 0 u_fac_1 0.010009765625 0.039993286132812 FORMAT "%6.5" /end CHARACTERISTIC
/begin CHARACTERISTIC ENSC_C_I_GN_LNCH "I gain to calculate I term deviation when launch mode enable" CURVE 0x35EEA __UWORD_S 0 u_fac_100 0 99.9984741210937 SYMBOL_LINK "ENSC_C_I_GN_LNCH" 2
 /begin AXIS_DESCR COM_AXIS ensc_espd_dev u_espd 21 -4096 4095.875 AXIS_PTS_REF ENSC_X_ESPD_DEV_C /end AXIS_DESCR
/end CHARACTERISTIC
/begin AXIS_PTS ENSC_X_ESPD_DEV_C "" 0x291C4 ensc_espd_dev SSV__SWORD_S 0 u_espd 21 -4096 4095.875 FORMAT "%6.2" DEPOSIT ABSOLUTE SYMBOL_LINK "ENSC_X_ESPD_DEV_C" 2 /end AXIS_PTS
/begin CHARACTERISTIC ENSC_V_NM_I_ESPD_DB "deadband of ensc_espd_dev to enable normal idle I term deviation " VALUE 0x3964E __UWORD_S 0 u_espd 0.0 8191.875 FORMAT "%6.2" /end CHARACTERISTIC
/begin CHARACTERISTIC ENSC_V_OR_I_ESPD_DB "deadband of ensc_espd_dev to enable overrun idle I term deviation" VALUE 0x3964E __UWORD_S 0 u_espd 0.0 8191.875 FORMAT "%6.2" /end CHARACTERISTIC
/begin CHARACTERISTIC ENSC_C_I_GN_ANTISTL "I gain to calculate I term deviation when ensc_antistl_actv==1" CURVE 0x35EEA __UWORD_S 0 u_fac_100 0 99.9984741210937 SYMBOL_LINK "ENSC_C_I_GN_ANTISTL" 2
 /begin AXIS_DESCR COM_AXIS ensc_espd_dev u_espd 21 -4096 4095.875 AXIS_PTS_REF ENSC_X_ESPD_DEV_C /end AXIS_DESCR
/end CHARACTERISTIC
/begin CHARACTERISTIC ENSC_V_LNCH_I_GN_EN "true will enable I gain calculation when trs_veh_strt_actv==1" VALUE 0x2DDC7 __UBYTE_S 0 b_true 0 1 FORMAT "%1.0" /end CHARACTERISTIC
/begin CHARACTERISTIC ENSC_V_I_GN_ANTISTL_OR_IDL_EN "true will enable launch I gain in overrun idle PID mode" VALUE 0x2DDC7 __UBYTE_S 0 b_true 0 1 FORMAT "%1.0" /end CHARACTERISTIC
/begin CHARACTERISTIC ENSC_C_I_GN_PN "I gain to calculate I term deviation when ensc_veh_in_gear==0" CURVE 0x35EEA __UWORD_S 0 u_fac_100 0 99.9984741210937 SYMBOL_LINK "ENSC_C_I_GN_PN" 2
 /begin AXIS_DESCR COM_AXIS ensc_espd_dev u_espd 21 -4096 4095.875 AXIS_PTS_REF ENSC_X_ESPD_DEV_C /end AXIS_DESCR
/end CHARACTERISTIC
/begin CHARACTERISTIC ENSC_C_I_GN_R "I gain to calculate I term deviation when gear R" CURVE 0x35EEA __UWORD_S 0 u_fac_100 0 99.9984741210937 SYMBOL_LINK "ENSC_C_I_GN_R" 2
 /begin AXIS_DESCR COM_AXIS ensc_espd_dev u_espd 21 -4096 4095.875 AXIS_PTS_REF ENSC_X_ESPD_DEV_C /end AXIS_DESCR
/end CHARACTERISTIC
/begin CHARACTERISTIC ENSC_C_I_GN_D "I gain to calculate I term deviation when gear D" CURVE 0x35EEA __UWORD_S 0 u_fac_100 0 99.9984741210937 SYMBOL_LINK "ENSC_C_I_GN_D" 2
 /begin AXIS_DESCR COM_AXIS ensc_espd_dev u_espd 21 -4096 4095.875 AXIS_PTS_REF ENSC_X_ESPD_DEV_C /end AXIS_DESCR
/end CHARACTERISTIC
/begin CHARACTERISTIC ENSC_V_I_GN_OR_POS "I gain to calculate I term deviation when ensc_espd_dev is positive in overrun PID" VALUE 0x21C38 __UWORD_S 0 u_fac_100 0 99.9984741210937 /end CHARACTERISTIC
/begin CHARACTERISTIC ENSC_V_I_GN_OR_NEG "I gain to calculate I term deviation when ensc_espd_dev is negative in overrun PID" VALUE 0x21C38 __UWORD_S 0 u_fac_100 0 99.9984741210937 /end CHARACTERISTIC
/begin CHARACTERISTIC ENSC_C_ANTISTL_I_DEV_ESPD_THR "engine speed threshold below which anti-stall I deviation calculation is enabled" CURVE 0x361FC __UWORD_S 0 u_espd 0 8191.875 FORMAT "%6.2" SYMBOL_LINK "ENSC_C_ANTISTL_I_DEV_ESPD_THR" 2
 /begin AXIS_DESCR COM_AXIS ensc_idl_sp u_espd 5 0.000000 8191.875000 AXIS_PTS_REF ENSC_X_ESPD_SP_A /end AXIS_DESCR
/end CHARACTERISTIC
/begin CHARACTERISTIC ENSC_V_ANTISTL_I_DEV_PN "anti-stall I deviation when ensc_veh_in_gear==0" VALUE 0x21C38 __UWORD_S 0 u_pct_1 0 99.9984741210937 FORMAT "%4.2" /end CHARACTERISTIC
/begin CHARACTERISTIC ENSC_V_ANTISTL_I_DEV_D "anti-stall I deviation when ensc_veh_in_gear==1" VALUE 0x21C38 __UWORD_S 0 u_pct_1 0 99.9984741210937 FORMAT "%4.2" /end CHARACTERISTIC
/begin CHARACTERISTIC ENSC_V_ANTISTL_I_DEV_PN_DLY "delay time to apply anti-stall I deviation when ensc_veh_in_gear==0" VALUE 0x3D22A __UWORD_S 0 u_2x_tmr 0 1023.984375 /end CHARACTERISTIC
/begin CHARACTERISTIC ENSC_V_ANTISTL_I_DEV_D_DLY "delay time to apply anti-stall I deviation when ensc_veh_in_gear==1" VALUE 0x3D22A __UWORD_S 0 u_2x_tmr 0 1023.984375 /end CHARACTERISTIC
/begin CHARACTERISTIC ENSC_V_I_SUM_DEV_RST_FAC "factor of ensc_i_sum_dev_max to calculate I term deviation sum reset high thresh" VALUE 0x229A0 __UWORD_S 0 u_fac_1 0 0.999984741210937 /end CHARACTERISTIC
/begin CHARACTERISTIC ENSC_V_I_SUM_RST_ESPD_FAC "factor of ensc_idl_sp to calculate I term deviation sum reset engine speed thresh" VALUE 0x229A0 __UWORD_S 0 u_fac_1 0 0.999984741210937 /end CHARACTERISTIC
/begin CHARACTERISTIC ENSC_V_I_DEV_RST_FAC_LO_ESPD "factor used to calculate ensc_i_dev_sum_rst when I term sum reset due to low espd" VALUE 0x229A0 __UWORD_S 0 u_fac_1 0 0.999984741210937 /end CHARACTERISTIC
/begin CHARACTERISTIC ENSC_V_I_DEV_RST_FAC_HI_SUM "factor used to calculate ensc_i_dev_sum_rst when I term sum reset due to high I deviation sum" VALUE 0x229A0 __UWORD_S 0 u_fac_1 0 0.999984741210937 /end CHARACTERISTIC
/begin CHARACTERISTIC ENSC_V_I_DEV_RST_FAC_DECLTCH "factor used to calculate ensc_i_dev_sum_rst when I term sum reset due to declutch and ensc_mt_in_gr=1" VALUE 0x229A0 __UWORD_S 0 u_fac_1 0 0.999984741210937 /end CHARACTERISTIC
/begin CHARACTERISTIC ENSC_V_I_DEV_RST_FAC_DECLTCH_MT_N "factor used to calculate ensc_i_dev_sum_rst when I term sum reset due to declutch and ensc_mt_in_gr=0" VALUE 0x229A0 __UWORD_S 0 u_fac_1 0 0.999984741210937 /end CHARACTERISTIC
/begin CHARACTERISTIC ENSC_V_I_SUM_RST_ESPD_FAC_DECLTCH "factor of ensc_idl_sp to calculate I term deviation sum reset engine speed thresh when declutch" VALUE 0x20D9A __UWORD_S 0 u_fac_2 0 1.999969482421875 FORMAT "%4.3" /end CHARACTERISTIC
/begin CHARACTERISTIC ENSC_V_THRO_ERR_ESPD_DEV_DB "ensc_espd_dev deadband when ETC position error is too large to set I deviation to ensc_i_dev_sum_rst" VALUE 0x22FCE __UWORD_S 0 u_espd 0 8191.875000 FORMAT "%6.2" /end CHARACTERISTIC
/begin CHARACTERISTIC ENSC_V_THRO_POS_ERR_MAX "ETC position error (thro_pos_err) above which positive I deviation may be not allowed" VALUE 0x22FCE __SWORD_S 0 u_pct_r_s -128 127.99609375 /end CHARACTERISTIC
/begin CHARACTERISTIC ENSC_V_THRO_NEG_ERR_MAX "ETC position error (thro_pos_err) below which negative I deviation may be not allowed" VALUE 0x22FCE __SWORD_S 0 u_pct_r_s -128 127.99609375 /end CHARACTERISTIC
/begin CHARACTERISTIC ENSC_V_I_SUM_DEV_THR_FIL "Filter coefficient of ensc_i_sum_dev_max/min when ensc_idl_mod changed" VALUE 0x36874 __UWORD_S 0 u_fac_1 0 0.999984741210937 /end CHARACTERISTIC
/begin CHARACTERISTIC ENSC_M_I_SUM_DEV_MIN "min allowed I term sum deviation" MAP 0x3B270 __SWORD_S 0 u_pct -100 99.996948 SYMBOL_LINK "ENSC_M_I_SUM_DEV_MIN" 4
 /begin AXIS_DESCR FIX_AXIS NO_INPUT_QUANTITY u_idl_mod 4 0 3 /begin FIX_AXIS_PAR_LIST 0 1 2 3 /end FIX_AXIS_PAR_LIST /end AXIS_DESCR
 /begin AXIS_DESCR FIX_AXIS sys_ect u_deg_C 17 -40 152
  /begin FIX_AXIS_PAR_LIST -5120 -3584 -2048 -512 1024 2560 4096 5632 7168 8704 10240 11776 13312 14848 16384 17920 19456 /end FIX_AXIS_PAR_LIST
 /end AXIS_DESCR
/end CHARACTERISTIC
/begin CHARACTERISTIC ENSC_M_I_SUM_DEV_MAX "max allowed I term sum deviation" MAP 0x3B270 __SWORD_S 0 u_pct -100 99.996948 SYMBOL_LINK "ENSC_M_I_SUM_DEV_MAX" 4
 /begin AXIS_DESCR FIX_AXIS NO_INPUT_QUANTITY u_idl_mod 4 0 3 /begin FIX_AXIS_PAR_LIST 0 1 2 3 /end FIX_AXIS_PAR_LIST /end AXIS_DESCR
 /begin AXIS_DESCR FIX_AXIS sys_ect u_deg_C 17 -40 152
  /begin FIX_AXIS_PAR_LIST -5120 -3584 -2048 -512 1024 2560 4096 5632 7168 8704 10240 11776 13312 14848 16384 17920 19456 /end FIX_AXIS_PAR_LIST
 /end AXIS_DESCR
/end CHARACTERISTIC
/begin CHARACTERISTIC ENSC_V_FLW_I_MIN_INIT_AC "min allowed slow ADP I term flow when initiation and cell AC ON" VALUE 0x22E84 __SWORD_S 0 u_pct -100.0 99.996948 /end CHARACTERISTIC
/begin CHARACTERISTIC ENSC_V_FLW_I_MAX_INIT_AC "max allowed slow ADP I term flow when initiation and cell AC ON" VALUE 0x22E84 __SWORD_S 0 u_pct -100.0 99.996948 /end CHARACTERISTIC
/begin CHARACTERISTIC ENSC_V_FLW_I_MIN_INIT "min allowed slow ADP I term flow when initiation and cell AC OFF" VALUE 0x22E84 __SWORD_S 0 u_pct -100.0 99.996948 /end CHARACTERISTIC
/begin CHARACTERISTIC ENSC_V_FLW_I_MAX_INIT "max allowed slow ADP I term flow when initiation and cell AC OFF" VALUE 0x22E84 __SWORD_S 0 u_pct -100.0 99.996948 /end CHARACTERISTIC
/begin CHARACTERISTIC ENSC_V_FLW_I_INIT_BIAS_AC "bias flow added to slow adp I term when initiation and cell AC ON" VALUE 0x37FA8 __UWORD_S 0 u_pct_1 0 99.9984741210937 FORMAT "%5.3" /end CHARACTERISTIC
/begin CHARACTERISTIC ENSC_V_FLW_I_INIT_BIAS "bias flow added to slow adp I term when initiation and cell AC OFF" VALUE 0x37FA8 __UWORD_S 0 u_pct_1 0 99.9984741210937 FORMAT "%5.3" /end CHARACTERISTIC
/begin CHARACTERISTIC ENSC_V_STAB_IDL_ECT_MIN "min engine coolant threshold of stable idle condition" VALUE 0x65E7C __SWORD_S 0 u_deg_C -256 255.9921875 /end CHARACTERISTIC
/begin CHARACTERISTIC ENSC_V_STAB_IDL_TIM_THR "min stable idle timer threshold of stable idle condition" VALUE 0x2976E __UWORD_S 0 u_2x_tmr 0 1023.984375 /end CHARACTERISTIC
/begin CHARACTERISTIC ENSC_V_STAB_IDL_ESPD_DEV_FIL_THR "threshold of ensc_espd_dev_filt to enbale stable idle timer" VALUE 0x2AB2E __UWORD_S 0 u_espd 0 8191.875000 FORMAT "%6.2" /end CHARACTERISTIC
/begin CHARACTERISTIC ENSC_V_STAB_IDL_ESPD_DEV_THR "threshold of ensc_espd_dev to enbale stable idle timer" VALUE 0x2AB2E __UWORD_S 0 u_espd 0 8191.875000 FORMAT "%6.2" /end CHARACTERISTIC
/begin CHARACTERISTIC ENSC_V_STAB_IDL_ESPD_CPS_THR "threshold of sys_espd_acl_v to enbale stable idle timer" VALUE 0x2AB2E __UWORD_S 0 u_espd 0 8191.875000 FORMAT "%6.2" /end CHARACTERISTIC
/begin CHARACTERISTIC ENSC_V_PS_HI_LD_THR "PS angle threshold to determinate PS high load status" VALUE 0x2A1D8 __SWORD_S 0 u_ps_angle -1024.000000 1023.96875 /end CHARACTERISTIC
/begin CHARACTERISTIC ENSC_V_FST_ADP_STL_INIT_RUN_MIN "Engine run time below which idle fast adp is not reinitialized when engine stall" VALUE 0x232DC __UWORD_S 0 u_1s_tmr 0 65535 /end CHARACTERISTIC
/begin CHARACTERISTIC ENSC_V_FST_ADP_STL_INIT_FAC "when engine stall this factor is used to scale the fast/slow adp delta which is then added to the slow adp to get a new fast adp" VALUE 0x37388 __UWORD_S 0 u_fac_1 0 0.999984741210937 /end CHARACTERISTIC
/begin CHARACTERISTIC ENSC_V_IDL_FLW_I_DFLT_N "default idle I term flow when gear PN" VALUE 0x23F4C __SWORD_S 0 u_pct -100 99.996948242187 /end CHARACTERISTIC
/begin CHARACTERISTIC ENSC_V_P_ESPD_DB_ST_PD "P term control deadband of ensc_espd_dev when ensc_idl_st_pd_en==1" VALUE 0x376F6 __UWORD_S 0 u_espd 0.0 8191.875 FORMAT "%6.2" /end CHARACTERISTIC
/begin CHARACTERISTIC ENSC_V_P_ESPD_DB_NM_PN_POS "P term control deadband of ensc_espd_dev when normal idle and ensc_espd_dev>0, ensc_veh_in_gear==0" VALUE 0x376F6 __UWORD_S 0 u_espd 0.0 8191.875 FORMAT "%6.2" /end CHARACTERISTIC
/begin CHARACTERISTIC ENSC_V_P_ESPD_DB_NM_D_POS "P term control deadband of ensc_espd_dev when normal idle and ensc_espd_dev>0, ensc_veh_in_gear==1" VALUE 0x376F6 __UWORD_S 0 u_espd 0.0 8191.875 FORMAT "%6.2" /end CHARACTERISTIC
/begin CHARACTERISTIC ENSC_V_P_ESPD_DB_NM_PN_NEG "P term control deadband of ensc_espd_dev when normal idle and ensc_espd_dev<=0, ensc_veh_in_gear==0" VALUE 0x376F6 __UWORD_S 0 u_espd 0.0 8191.875 FORMAT "%6.2" /end CHARACTERISTIC
/begin CHARACTERISTIC ENSC_V_P_ESPD_DB_NM_D_NEG "P term control deadband of ensc_espd_dev when normal idle and ensc_espd_dev<=0, ensc_veh_in_gear==1" VALUE 0x376F6 __UWORD_S 0 u_espd 0.0 8191.875 FORMAT "%6.2" /end CHARACTERISTIC
/begin CHARACTERISTIC ENSC_V_P_ESPD_DB_OR_POS "P term control deadband of ensc_espd_dev when overrun idle and ensc_espd_dev>0" VALUE 0x376F6 __UWORD_S 0 u_espd 0.0 8191.875 FORMAT "%6.2" /end CHARACTERISTIC
/begin CHARACTERISTIC ENSC_V_P_ESPD_DB_OR_NEG "P term control deadband of ensc_espd_dev when overrun idle and ensc_espd_dev<=0" VALUE 0x376F6 __UWORD_S 0 u_espd 0.0 8191.875 FORMAT "%6.2" /end CHARACTERISTIC
/begin CHARACTERISTIC ENSC_C_P_FAC_NM "factor used to calculate P term flow when normal idle" CURVE 0x3370E __SWORD_S 0 u_fac_n4_p4 -4 3.9998779296875 FORMAT "%4.3" SYMBOL_LINK "ENSC_C_P_FAC_NM" 2
 /begin AXIS_DESCR COM_AXIS sys_ect u_deg_C 10 -256.000000 255.9921875 AXIS_PTS_REF ENSC_X_ECT_E /end AXIS_DESCR
/end CHARACTERISTIC
/begin AXIS_PTS ENSC_X_ECT_E "ect breakpoint" 0x36494 sys_ect SSV__SWORD_S 0 u_deg_C 10 -256.000000 255.9921875 FORMAT "%4.1" DEPOSIT ABSOLUTE SYMBOL_LINK "ENSC_X_ECT_E" 2 /end AXIS_PTS
/begin CHARACTERISTIC ENSC_C_P_FAC_OR_POS "factor used to calculate P term flow when overrun idle and ensc_espd_dev>0" CURVE 0x3370E __SWORD_S 0 u_fac_n4_p4 -4 3.9998779296875 FORMAT "%4.3" SYMBOL_LINK "ENSC_C_P_FAC_OR_POS" 2
 /begin AXIS_DESCR COM_AXIS sys_ect u_deg_C 10 -256.000000 255.9921875 AXIS_PTS_REF ENSC_X_ECT_E /end AXIS_DESCR
/end CHARACTERISTIC
/begin CHARACTERISTIC ENSC_C_P_FAC_OR_NEG "factor used to calculate P term flow when overrun idle and ensc_espd_dev<=0" CURVE 0x3370E __SWORD_S 0 u_fac_n4_p4 -4 3.9998779296875 FORMAT "%4.3" SYMBOL_LINK "ENSC_C_P_FAC_OR_NEG" 2
 /begin AXIS_DESCR COM_AXIS sys_ect u_deg_C 10 -256.000000 255.9921875 AXIS_PTS_REF ENSC_X_ECT_E /end AXIS_DESCR
/end CHARACTERISTIC
/begin CHARACTERISTIC ENSC_V_P_FAC_LNCH_PD_POS "factor used to calculate P term flow when launch PD and ensc_espd_dev>0" VALUE 0x23FF4 __SWORD_S 0 u_fac_n4_p4 -4 3.9998779296875 FORMAT "%4.3" /end CHARACTERISTIC
/begin CHARACTERISTIC ENSC_V_P_FAC_LNCH_PD_NEG "factor used to calculate P term flow when launch PD and ensc_espd_dev<=0" VALUE 0x23FF4 __SWORD_S 0 u_fac_n4_p4 -4 3.9998779296875 FORMAT "%4.3" /end CHARACTERISTIC
/begin CHARACTERISTIC ENSC_V_FLW_P_MAX "max allowed P term flow when ensc_idl_st!=NORMAL_PID" VALUE 0x3D214 __SWORD_S 0 u_pct_1 -50 49.9984741210937 FORMAT "%5.3" /end CHARACTERISTIC
/begin CHARACTERISTIC ENSC_V_FLW_P_MIN "min allowed P term flow when ensc_idl_st!=NORMAL_PID" VALUE 0x3D214 __SWORD_S 0 u_pct_1 -50 49.9984741210937 FORMAT "%5.3" /end CHARACTERISTIC
/begin CHARACTERISTIC ENSC_C_FLW_P_ST_PD "P term flow used when ensc_idl_st_pd_en==1" CURVE 0x37FBC __SWORD_S 0 u_pct_1 -50 49.9984741210937 FORMAT "%5.3" SYMBOL_LINK "ENSC_C_FLW_P_ST_PD" 2
 /begin AXIS_DESCR COM_AXIS ensc_espd_dev u_espd 33 -4096 4095.875 AXIS_PTS_REF ENSC_X_ESPD_DEV_D /end AXIS_DESCR
/end CHARACTERISTIC
/begin AXIS_PTS ENSC_X_ESPD_DEV_D "" 0x291C4 ensc_espd_dev SSV__SWORD_S 0 u_espd 33 -4096 4095.875 FORMAT "%6.2" DEPOSIT ABSOLUTE SYMBOL_LINK "ENSC_X_ESPD_DEV_D" 2 /end AXIS_PTS
/begin CHARACTERISTIC ENSC_C_FLW_P_LNCH "P term flow used when trs_veh_strt_actv==1" CURVE 0x37FBC __SWORD_S 0 u_pct_1 -50 49.9984741210937 FORMAT "%5.3" SYMBOL_LINK "ENSC_C_FLW_P_LNCH" 2
 /begin AXIS_DESCR COM_AXIS ensc_espd_dev u_espd 33 -4096 4095.875 AXIS_PTS_REF ENSC_X_ESPD_DEV_D /end AXIS_DESCR
/end CHARACTERISTIC
/begin CHARACTERISTIC ENSC_C_FLW_P_PN "P term flow used when ensc_veh_in_gear==0" CURVE 0x37FBC __SWORD_S 0 u_pct_1 -50 49.9984741210937 FORMAT "%5.3" SYMBOL_LINK "ENSC_C_FLW_P_PN" 2
 /begin AXIS_DESCR COM_AXIS ensc_espd_dev u_espd 33 -4096 4095.875 AXIS_PTS_REF ENSC_X_ESPD_DEV_D /end AXIS_DESCR
/end CHARACTERISTIC
/begin CHARACTERISTIC ENSC_C_FLW_P_DR_SHFT "P term flow used when ensc_dr_shft_dly_stat==1" CURVE 0x37FBC __SWORD_S 0 u_pct_1 -50 49.9984741210937 FORMAT "%5.3" SYMBOL_LINK "ENSC_C_FLW_P_DR_SHFT" 2
 /begin AXIS_DESCR COM_AXIS ensc_espd_dev u_espd 33 -4096 4095.875 AXIS_PTS_REF ENSC_X_ESPD_DEV_D /end AXIS_DESCR
/end CHARACTERISTIC
/begin CHARACTERISTIC ENSC_C_FLW_P "default P term flow when other conditions not met" CURVE 0x37FBC __SWORD_S 0 u_pct_1 -50 49.9984741210937 FORMAT "%5.3" SYMBOL_LINK "ENSC_C_FLW_P" 2
 /begin AXIS_DESCR COM_AXIS ensc_espd_dev u_espd 33 -4096 4095.875 AXIS_PTS_REF ENSC_X_ESPD_DEV_D /end AXIS_DESCR
/end CHARACTERISTIC
/begin CHARACTERISTIC ENSC_M_FLW_P_OR "P term flow used when in overrun idle state" MAP 0x205AA __SWORD_S 0 u_pct_1 -50 49.9984741210937 FORMAT "%5.3" SYMBOL_LINK "ENSC_M_FLW_P_OR" 4
 /begin AXIS_DESCR FIX_AXIS NO_INPUT_QUANTITY u_idl_gr 7 0 6 /begin FIX_AXIS_PAR_LIST 0 1 2 3 4 5 6 /end FIX_AXIS_PAR_LIST /end AXIS_DESCR
 /begin AXIS_DESCR COM_AXIS ensc_espd_dev u_espd 17 -4096 4095.875 AXIS_PTS_REF ENSC_X_ESPD_DEV_E /end AXIS_DESCR
/end CHARACTERISTIC
/begin AXIS_PTS ENSC_X_ESPD_DEV_E "" 0x291C4 ensc_espd_dev SSV__SWORD_S 0 u_espd 17 -4096 4095.875 FORMAT "%6.2" DEPOSIT ABSOLUTE SYMBOL_LINK "ENSC_X_ESPD_DEV_E" 2 /end AXIS_PTS
/begin CHARACTERISTIC ENSC_C_D_EIT_DB_ST_PD "D term control deadband of EIT(engine inertia torq) when ensc_idl_st_pd_en==1" CURVE 0x35EEA __SWORD_S 0 u_tq -2048 2047.9375 FORMAT "%6.2"
 /begin AXIS_DESCR FIX_AXIS NO_INPUT_QUANTITY u_der_db 2 0 1 /begin FIX_AXIS_PAR_LIST 0 1 /end FIX_AXIS_PAR_LIST /end AXIS_DESCR
/end CHARACTERISTIC
/begin CHARACTERISTIC ENSC_C_D_EIT_DB_OR "D term control deadband of EIT(engine inertia torq) when in overrun idle state" CURVE 0x35EEA __SWORD_S 0 u_tq -2048 2047.9375 FORMAT "%6.2"
 /begin AXIS_DESCR FIX_AXIS NO_INPUT_QUANTITY u_der_db 2 0 1 /begin FIX_AXIS_PAR_LIST 0 1 /end FIX_AXIS_PAR_LIST /end AXIS_DESCR
/end CHARACTERISTIC
/begin CHARACTERISTIC ENSC_C_D_EIT_DB_LNCH_PD "D term control deadband of EIT(engine inertia torq) when in launch PD idle state" CURVE 0x35EEA __SWORD_S 0 u_tq -2048 2047.9375 FORMAT "%6.2"
 /begin AXIS_DESCR FIX_AXIS NO_INPUT_QUANTITY u_der_db 2 0 1 /begin FIX_AXIS_PAR_LIST 0 1 /end FIX_AXIS_PAR_LIST /end AXIS_DESCR
/end CHARACTERISTIC
/begin CHARACTERISTIC ENSC_C_D_EIT_DB "default D term control deadband of EIT(engine inertia torq) when other conditions not met" CURVE 0x35EEA __SWORD_S 0 u_tq -2048 2047.9375 FORMAT "%6.2"
 /begin AXIS_DESCR FIX_AXIS NO_INPUT_QUANTITY u_der_db 2 0 1 /begin FIX_AXIS_PAR_LIST 0 1 /end FIX_AXIS_PAR_LIST /end AXIS_DESCR
/end CHARACTERISTIC
/begin CHARACTERISTIC ENSC_C_D_EIT_DB_LDCHG "D term control deadband of EIT(engine inertia torq) when ensc_ld_chg_pid_rsn!=NoReason" CURVE 0x35EEA __SWORD_S 0 u_tq -2048 2047.9375 FORMAT "%6.2"
 /begin AXIS_DESCR FIX_AXIS NO_INPUT_QUANTITY u_der_db 2 0 1 /begin FIX_AXIS_PAR_LIST 0 1 /end FIX_AXIS_PAR_LIST /end AXIS_DESCR
/end CHARACTERISTIC
/begin CHARACTERISTIC ENSC_C_D_ESPD_DB_ST_PD "D term control deadband of ensc_espd_dev when ensc_idl_st_pd_en==1" CURVE 0x35EEA __SWORD_S 0 u_espd -4096 4095.875 FORMAT "%6.2"
 /begin AXIS_DESCR FIX_AXIS NO_INPUT_QUANTITY u_der_db 2 0 1 /begin FIX_AXIS_PAR_LIST 0 1 /end FIX_AXIS_PAR_LIST /end AXIS_DESCR
/end CHARACTERISTIC
/begin CHARACTERISTIC ENSC_C_D_ESPD_DB_OR "D term control deadband of ensc_espd_dev when in overrun idle state" CURVE 0x35EEA __SWORD_S 0 u_espd -4096 4095.875 FORMAT "%6.2"
 /begin AXIS_DESCR FIX_AXIS NO_INPUT_QUANTITY u_der_db 2 0 1 /begin FIX_AXIS_PAR_LIST 0 1 /end FIX_AXIS_PAR_LIST /end AXIS_DESCR
/end CHARACTERISTIC
/begin CHARACTERISTIC ENSC_C_D_ESPD_DB_LNCH_PD "D term control deadband of ensc_espd_dev when in launch PD idle state" CURVE 0x35EEA __SWORD_S 0 u_espd -4096 4095.875 FORMAT "%6.2"
 /begin AXIS_DESCR FIX_AXIS NO_INPUT_QUANTITY u_der_db 2 0 1 /begin FIX_AXIS_PAR_LIST 0 1 /end FIX_AXIS_PAR_LIST /end AXIS_DESCR
/end CHARACTERISTIC
/begin CHARACTERISTIC ENSC_C_D_ESPD_DB "default D term control deadband of ensc_espd_dev when other conditions not met" CURVE 0x35EEA __SWORD_S 0 u_espd -4096 4095.875 FORMAT "%6.2"
 /begin AXIS_DESCR FIX_AXIS NO_INPUT_QUANTITY u_der_db 2 0 1 /begin FIX_AXIS_PAR_LIST 0 1 /end FIX_AXIS_PAR_LIST /end AXIS_DESCR
/end CHARACTERISTIC
/begin CHARACTERISTIC ENSC_C_FLW_D_ST_PD "D term flow used when ensc_idl_st_pd_en==1" CURVE 0x37FBC __SWORD_S 0 u_pct_1 -50 49.9984741210937 FORMAT "%5.3" SYMBOL_LINK "ENSC_C_FLW_D_ST_PD" 2
 /begin AXIS_DESCR FIX_AXIS NO_INPUT_QUANTITY u_tq 19 -128 128
  /begin FIX_AXIS_PAR_LIST -2048 -1024 -512 -256 -128 -64 -32 -16 -8 0 8 16 32 64 128 256 512 1024 2048 /end FIX_AXIS_PAR_LIST
 /end AXIS_DESCR
/end CHARACTERISTIC
/begin CHARACTERISTIC ENSC_C_FLW_D_OR "D term flow used when in overrun idle state" CURVE 0x37FBC __SWORD_S 0 u_pct_1 -50 49.9984741210937 FORMAT "%5.3" SYMBOL_LINK "ENSC_C_FLW_D_OR" 2
 /begin AXIS_DESCR FIX_AXIS NO_INPUT_QUANTITY u_tq 19 -128 128
  /begin FIX_AXIS_PAR_LIST -2048 -1024 -512 -256 -128 -64 -32 -16 -8 0 8 16 32 64 128 256 512 1024 2048 /end FIX_AXIS_PAR_LIST
 /end AXIS_DESCR
/end CHARACTERISTIC
/begin CHARACTERISTIC ENSC_C_FLW_D "default D term flow when other conditions not met" CURVE 0x37FBC __SWORD_S 0 u_pct_1 -50 49.9984741210937 FORMAT "%5.3" SYMBOL_LINK "ENSC_C_FLW_D" 2
 /begin AXIS_DESCR FIX_AXIS NO_INPUT_QUANTITY u_tq 19 -128 128
  /begin FIX_AXIS_PAR_LIST -2048 -1024 -512 -256 -128 -64 -32 -16 -8 0 8 16 32 64 128 256 512 1024 2048 /end FIX_AXIS_PAR_LIST
 /end AXIS_DESCR
/end CHARACTERISTIC
/begin CHARACTERISTIC ENSC_C_FLW_D_DR_SHFT "D term flow used when ensc_dr_shft_dly_stat==1" CURVE 0x37FBC __SWORD_S 0 u_pct_1 -50 49.9984741210937 FORMAT "%5.3" SYMBOL_LINK "ENSC_C_FLW_D_DR_SHFT" 2
 /begin AXIS_DESCR FIX_AXIS NO_INPUT_QUANTITY u_tq 19 -128 128
  /begin FIX_AXIS_PAR_LIST -2048 -1024 -512 -256 -128 -64 -32 -16 -8 0 8 16 32 64 128 256 512 1024 2048 /end FIX_AXIS_PAR_LIST
 /end AXIS_DESCR
/end CHARACTERISTIC
/begin CHARACTERISTIC ENSC_C_FLW_D_LNCH "D term flow used when trs_veh_strt_actv==1" CURVE 0x37FBC __SWORD_S 0 u_pct_1 -50 49.9984741210937 FORMAT "%5.3" SYMBOL_LINK "ENSC_C_FLW_D_LNCH" 2
 /begin AXIS_DESCR FIX_AXIS NO_INPUT_QUANTITY u_tq 19 -128 128
  /begin FIX_AXIS_PAR_LIST -2048 -1024 -512 -256 -128 -64 -32 -16 -8 0 8 16 32 64 128 256 512 1024 2048 /end FIX_AXIS_PAR_LIST
 /end AXIS_DESCR
/end CHARACTERISTIC
/begin CHARACTERISTIC ENSC_C_D_FAC_OR "coolant factor used to calculate D term flow when overrun idle" CURVE 0x3370E __SWORD_S 0 u_fac_n4_p4 -4 3.9998779296875 FORMAT "%4.3" SYMBOL_LINK "ENSC_C_D_FAC_OR" 2
 /begin AXIS_DESCR COM_AXIS sys_ect u_deg_C 10 -256.000000 255.9921875 AXIS_PTS_REF ENSC_X_ECT_E /end AXIS_DESCR
/end CHARACTERISTIC
/begin CHARACTERISTIC ENSC_C_D_FAC "coolant factor used to calculate D term flow when overrun idle and launch PD not met" CURVE 0x3370E __SWORD_S 0 u_fac_n4_p4 -4 3.9998779296875 FORMAT "%4.3" SYMBOL_LINK "ENSC_C_D_FAC" 2
 /begin AXIS_DESCR COM_AXIS sys_ect u_deg_C 10 -256.000000 255.9921875 AXIS_PTS_REF ENSC_X_ECT_E /end AXIS_DESCR
/end CHARACTERISTIC
/begin CHARACTERISTIC ENSC_V_FLW_FAST_RMP_IN_STP "ramp in step of idle PD fast Flow when overrun or launch PD idle control enabled" VALUE 0x37FA8 __UWORD_S 0 u_pct_1 0 99.9984741210937 FORMAT "%5.3" /end CHARACTERISTIC
/begin CHARACTERISTIC ENSC_V_FLW_FAST_RMP_OUT_STP "ramp out step of idle PD fast Flow when open loop idle control enabled" VALUE 0x37FA8 __UWORD_S 0 u_pct_1 0 99.9984741210937 FORMAT "%5.3" /end CHARACTERISTIC
/begin CHARACTERISTIC ENSC_V_FLW_SLOW_RMP_THR "deviation threshold of ensc_idl_flw_slow_raw and ensc_idl_flw_slow to enable ramp of slow idle flow" VALUE 0x23F4C __UWORD_S 0 u_pct 0 199.996948242187 /end CHARACTERISTIC
/begin CHARACTERISTIC ENSC_V_FLW_SLOW_RMP_STP_INC "increase step of slow idle flow when ramp control active" VALUE 0x23F4C __UWORD_S 0 u_pct 0 199.996948242187 /end CHARACTERISTIC
/begin CHARACTERISTIC ENSC_V_FLW_SLOW_RMP_STP_DEC "decrease step of slow idle flow when ramp control active" VALUE 0x23F4C __UWORD_S 0 u_pct 0 199.996948242187 /end CHARACTERISTIC
/begin CHARACTERISTIC ENSC_V_IDL_I_REF_TIM_THR "min stable idle timer threshold to update ensc_idl_i_ref" VALUE 0x2976E __UWORD_S 0 u_2x_tmr 0 1023.984375 /end CHARACTERISTIC
/begin CHARACTERISTIC ENSC_V_IDL_I_REF_LO "low limit of ensc_idl_i_ref" VALUE 0x22E84 __SWORD_S 0 u_pct -100.0 99.996948 /end CHARACTERISTIC
/begin CHARACTERISTIC ENSC_V_IDL_I_REF_HI "high limit of ensc_idl_i_ref" VALUE 0x22E84 __SWORD_S 0 u_pct -100.0 99.996948 /end CHARACTERISTIC
/begin CHARACTERISTIC CHRG_C_WGPWM_FAC_CPA_BND "Waste gate pwm factor for different actual charger pressure has different cell factor.This cal is the cell boundary." CURVE 0x000200B0 __UWORD_S 0 u_kPa_0_4096 0 4095.9375 FORMAT "%4.3"
 /begin AXIS_DESCR FIX_AXIS NO_INPUT_QUANTITY u_cnts 4 0 3 /begin FIX_AXIS_PAR_LIST 0 1 2 3 /end FIX_AXIS_PAR_LIST /end AXIS_DESCR
/end CHARACTERISTIC
/begin CHARACTERISTIC CHRG_C_WGPWM_FAC_DLTP_BND "Waste gate pwm factor for different open loop delta pressure has different cell factor.This cal is the cell boundary." CURVE 0x000200B0 __UWORD_S 0 u_kPa_0_4096 0 4095.9375 FORMAT "%4.3"
 /begin AXIS_DESCR FIX_AXIS NO_INPUT_QUANTITY u_cnts 4 0 3 /begin FIX_AXIS_PAR_LIST 0 1 2 3 /end FIX_AXIS_PAR_LIST /end AXIS_DESCR
/end CHARACTERISTIC
/begin CHARACTERISTIC CHRG_C_SURG_PV_MIN "Anti surge enable min pedal value for different gear." CURVE 0x000200B0 __UWORD_S 0 u_pct_r 0 127.998046875 FORMAT "%4.3"
 /begin AXIS_DESCR FIX_AXIS tq_veh_gr_st u_tq_gr_typ 11 0 10 /begin FIX_AXIS_PAR_LIST 0 1 2 3 4 5 6 7 8 9 10 /end FIX_AXIS_PAR_LIST /end AXIS_DESCR
/end CHARACTERISTIC
/begin CHARACTERISTIC CHRG_V_SURG_EN "Anti surge function is enable." VALUE 0x0002038C __UBYTE_S 0 b_true 0 1 FORMAT "%1.0" BIT_MASK 0x1 /end CHARACTERISTIC
/begin CHARACTERISTIC CHRG_V_RST_I "Reset charger close loop control I term value when gear shifting if this cal is true.Keep I term value when gear shifting if this cal is false." VALUE 0x0002038C __UBYTE_S 0 b_true 0 1 FORMAT "%1.0" BIT_MASK 0x1 /end CHARACTERISTIC
/begin CHARACTERISTIC CHRG_V_TPS_PQ_LMT_CP "Throttle pressure quotient limited charger pressure if the cal is true." VALUE 0x0002038C __UBYTE_S 0 b_true 0 1 FORMAT "%1.0" BIT_MASK 0x1 /end CHARACTERISTIC
/begin CHARACTERISTIC CHRG_V_WG_TO_AMP "Waste gate solenoid connect to ambitient if true,else it connected to air filter outlet." VALUE 0x0002038C __UBYTE_S 0 b_true 0 1 FORMAT "%1.0" BIT_MASK 0x1 /end CHARACTERISTIC
/begin CHARACTERISTIC CHRG_V_SURG_PV_CNT "Anti surge pedal release count." VALUE 0x0002038C __UBYTE_S 0 u_cnts 0 255 /end CHARACTERISTIC
/begin CHARACTERISTIC CHRG_V_CP_BUF_CNT "To calculate charger pressure increase rate,using current charger pressure sub previous charger pressure buffer.This cal is the interval peroid between the current and previous value." VALUE 0x0002038C __UBYTE_S 0 u_cnts 0 255 /end CHARACTERISTIC
/begin CHARACTERISTIC CHRG_V_SURG_PV_CFG "Pedal value configuration: TPS or APS." VALUE 0x0002038C __UBYTE_S 0 u_surg_pv_cfg 0 1 FORMAT "%1.0" /end CHARACTERISTIC
/begin CHARACTERISTIC CHRG_V_CPA_DLT_FIL "Actual charger pressure delta filter." VALUE 0x0002038C __UWORD_S 0 u_fac_1 0 0.999984741210937 /end CHARACTERISTIC
/begin CHARACTERISTIC CHRG_V_AMP_STD "Standard ambitient pressure for charger enable calculation." VALUE 0x0002038C __UWORD_S 0 u_kPa_0_4096 0 4095.9375 FORMAT "%4.3" /end CHARACTERISTIC
/begin CHARACTERISTIC CHRG_V_CL_EN_BIAS "Actual charger pressure larger than the diaphragm pressure setpoint bias this cal,then the charger close loop control is enable." VALUE 0x0002038C __UWORD_S 0 u_kPa_2048n_2048p_bias -2048 2047.9375 FORMAT "%4.3" /end CHARACTERISTIC
/begin CHARACTERISTIC CHRG_V_CP_THR "Charger control threshold.If charger pressure setpoint larger than this threshold,charger control is enable." VALUE 0x0002038C __UWORD_S 0 u_kPa_0_4096 0 4095.9375 FORMAT "%4.3" /end CHARACTERISTIC
/begin CHARACTERISTIC CHRG_V_CPA_RT_I_EN_THR "Close loop control I term update actual charger pressure increase rate threshold." VALUE 0x0002038C __UWORD_S 0 u_kPa_0_512 0 511.9921875 /end CHARACTERISTIC
/begin CHARACTERISTIC CHRG_V_CP_I_RST_THR "Charger control I term reset when actual pressure and setpoint error exceed this threshold." VALUE 0x0002038C __UWORD_S 0 u_kPa_0_4096 0 4095.9375 FORMAT "%4.3" /end CHARACTERISTIC
/begin CHARACTERISTIC CHRG_V_WGPWM_FAC_CPA_HYS "Waste gate pwm factor for different actual charger pressure has different cell factor.This cal is the cell boundary hysteresis." VALUE 0x0002038C __UWORD_S 0 u_kPa_0_4096 0 4095.9375 FORMAT "%4.3" /end CHARACTERISTIC
/begin CHARACTERISTIC CHRG_V_WGPWM_FAC_DLTP_HYS "Waste gate pwm factor for different open loop delta pressure has different cell factor.This cal is the cell boundary hysteresis." VALUE 0x0002038C __UWORD_S 0 u_kPa_0_4096 0 4095.9375 FORMAT "%4.3" /end CHARACTERISTIC
/begin CHARACTERISTIC CHRG_V_WGPWM_ADP_MAX_CPA "Waste gate pwm adaption learning enable max actual charger pressure." VALUE 0x0002038C __UWORD_S 0 u_kPa_0_4096 0 4095.9375 FORMAT "%4.3" /end CHARACTERISTIC
/begin CHARACTERISTIC CHRG_V_WGPWM_ADP_MAX_CPA_ERR "Waste gate pwm adaption learning enable max charger pressure error." VALUE 0x0002038C __UWORD_S 0 u_kPa_0_4096 0 4095.9375 FORMAT "%4.3" /end CHARACTERISTIC
/begin CHARACTERISTIC CHRG_V_WGPWM_ADP_MAP_BIAS "Manifold absolute pressure bias to enable waste gate pwm adaption learning." VALUE 0x0002038C __UWORD_S 0 u_kPa_0_4096 0 4095.9375 FORMAT "%4.3" /end CHARACTERISTIC
/begin CHARACTERISTIC CHRG_V_WGPWM_ADP_MIN_ESPD "Waste gate pwm adaption learning enable min engine speed." VALUE 0x0002038C __UWORD_S 0 u_cnts 0 65535 FORMAT "%4.3" /end CHARACTERISTIC
/begin CHARACTERISTIC CHRG_V_SURG_TPS_INC_RT "Exit anti surge TPS increase rate." VALUE 0x0002038C __UWORD_S 0 u_pct_r 0 127.998046875 FORMAT "%4.3" /end CHARACTERISTIC
/begin CHARACTERISTIC CHRG_V_SURG_MIN_TPS "Anti surge min throttle position." VALUE 0x0002038C __UWORD_S 0 u_pct_r 0 127.998046875 FORMAT "%4.3" /end CHARACTERISTIC
/begin CHARACTERISTIC CHRG_V_SURG_PVR_THR "Anti surge release pedal change rate threshold." VALUE 0x0002038C __UWORD_S 0 u_pct_r 0 127.998046875 FORMAT "%4.3" /end CHARACTERISTIC
/begin CHARACTERISTIC CHRG_V_WGPWM_MAX "Waste gate pwm max value limit." VALUE 0x0002038C __UWORD_S 0 u_pct_dc 0 127.998046875 FORMAT "%4.3" /end CHARACTERISTIC
/begin CHARACTERISTIC CHRG_V_WGPWM_MIN "Waste gate pwm min value limit." VALUE 0x0002038C __UWORD_S 0 u_pct_dc 0 127.998046875 FORMAT "%4.3" /end CHARACTERISTIC
/begin CHARACTERISTIC CHRG_V_WGPWM_FAC_ADP_STP "Waste gate pwm factor adaption learning step." VALUE 0x0002038C __UWORD_S 0 u_fac_2 0 1.999969482421875 FORMAT "%4.3" /end CHARACTERISTIC
/begin CHARACTERISTIC CHRG_V_WGPWM_FAC_MAX "Waste gate pwm factor max limit." VALUE 0x0002038C __UWORD_S 0 u_fac_2 0 1.999969482421875 FORMAT "%4.3" /end CHARACTERISTIC
/begin CHARACTERISTIC CHRG_V_WGPWM_FAC_MIN "Waste gate pwm factor min limit." VALUE 0x0002038C __UWORD_S 0 u_fac_2 0 1.999969482421875 FORMAT "%4.3" /end CHARACTERISTIC
/begin CHARACTERISTIC CHRG_V_WGPWM_FAC_RMP_STP "Waste gate pwm factor ramp step." VALUE 0x0002038C __UWORD_S 0 u_fac_2 0 1.999969482421875 FORMAT "%4.3" /end CHARACTERISTIC
/begin CHARACTERISTIC CHRG_V_SURG_MAX_TM "Anti surge max enable time." VALUE 0x0002038C __UWORD_S 0 u_2x_tmr 0 1023.984375 /end CHARACTERISTIC
/begin CHARACTERISTIC CHRG_V_WGPWM_ADP_DLY "Waste gate pwm factor Adaption learning step delay time." VALUE 0x0002038C __UBYTE_S 0 u_4x_tmr 0 7.96875 FORMAT "%4.2" /end CHARACTERISTIC
/begin CHARACTERISTIC CHRG_V_SURG_MIN_VSPD "Anti surge enable min vehicle speed." VALUE 0x0002038C __UWORD_S 0 u_vspd 0 511.9921875 /end CHARACTERISTIC
/begin CHARACTERISTIC CHRG_C_CP_SP_MAX_INC_STP "When max charger pressure setpoint rate limit is increased,the increase step is changed with the APS.  X:APS" CURVE 0x000200B0 __UWORD_S 0 u_kPa_0_512 0 511.9921875
 /begin AXIS_DESCR FIX_AXIS NO_INPUT_QUANTITY u_pct 11 0 100
  /begin FIX_AXIS_PAR_LIST 0 3276.8 6553.6 9830.4 13107.2 16384 19660.8 22937.6 26214.4 29491.2 32768 /end FIX_AXIS_PAR_LIST
 /end AXIS_DESCR
/end CHARACTERISTIC
/begin CHARACTERISTIC CHRG_M_CP_SP_MAX "Max compressed pressure setpoint. X:Engine speed.Y:Intercooler temperature." MAP 0x00020320 __UWORD_S 0 u_kPa_0_512 0 511.9921875 SYMBOL_LINK "CHRG_M_CP_SP_MAX" 4
 /begin AXIS_DESCR COM_AXIS sys_eng_spd u_espd 15 0 8191.875 AXIS_PTS_REF CHRG_X_ESPD_A /end AXIS_DESCR
 /begin AXIS_DESCR COM_AXIS afm_intcl_out_t u_deg_C 10 -256.000000 255.9921875 AXIS_PTS_REF CHRG_X_INTCT_A /end AXIS_DESCR
/end CHARACTERISTIC
/begin AXIS_PTS CHRG_X_ESPD_A "" 0x0002006C sys_eng_spd SSV__UWORD_S 0 u_espd 15 0 8191.875 DEPOSIT ABSOLUTE SYMBOL_LINK "CHRG_X_ESPD_A" 2 /end AXIS_PTS
/begin AXIS_PTS CHRG_X_ESPD_B "" 0x0002006C sys_eng_spd SSV__UWORD_S 0 u_espd 15 0 8191.875 DEPOSIT ABSOLUTE SYMBOL_LINK "CHRG_X_ESPD_B" 2 /end AXIS_PTS
/begin AXIS_PTS CHRG_X_INTCT_A "" 0x0002006C afm_intcl_out_t SSV__SWORD_S 0 u_deg_C 10 -256 255.9921875 DEPOSIT ABSOLUTE SYMBOL_LINK "CHRG_X_INTCT_A" 2 /end AXIS_PTS
/begin CHARACTERISTIC CHRG_C_CP_SP_MAX_INC_EN_BIAS "Only actual charger pressure is larger than waste gate diaphragm pressure setpoint,the max limit by step is increased by step.This cal is the bias between diapham pressure setpoint and actual charger pressure.X:APS." CURVE 0x000200B0 __UWORD_S 0 u_kPa_0_4096 0 4095.9375 FORMAT "%4.3"
 /begin AXIS_DESCR FIX_AXIS NO_INPUT_QUANTITY u_pct 11 0 100
  /begin FIX_AXIS_PAR_LIST 0 3276.8 6553.6 9830.4 13107.2 16384 19660.8 22937.6 26214.4 29491.2 32768 /end FIX_AXIS_PAR_LIST
 /end AXIS_DESCR
/end CHARACTERISTIC
/begin CHARACTERISTIC CHRG_M_WG_DPHR_DLTP_SP_BIAS "Diaphragm delta pressure setpoint bias.X:Ambicient pressure.Y:Engine speed." MAP 0x00020320 __SWORD_S 0 u_kPa_128n_128p -128 127.99609375 SYMBOL_LINK "CHRG_M_WG_DPHR_DLTP_SP_BIAS" 4
 /begin AXIS_DESCR COM_AXIS sys_eng_spd u_espd 15 0 8191.875 AXIS_PTS_REF CHRG_X_ESPD_B /end AXIS_DESCR
 /begin AXIS_DESCR COM_AXIS sys_amp u_kPa_0_256 6 0.000000 255.996094 AXIS_PTS_REF CHRG_X_AMP_A /end AXIS_DESCR
/end CHARACTERISTIC
/begin AXIS_PTS CHRG_X_AMP_A "" 0x0002006C sys_amp SSV__UWORD_S 0 u_kPa_0_256 6 0.000000 255.996094 DEPOSIT ABSOLUTE SYMBOL_LINK "CHRG_X_AMP_A" 2 /end AXIS_PTS
/begin AXIS_PTS CHRG_X_AMP_B "" 0x0002006C sys_amp SSV__UWORD_S 0 u_kPa_0_256 6 0.000000 255.996094 DEPOSIT ABSOLUTE SYMBOL_LINK "CHRG_X_AMP_B" 2 /end AXIS_PTS
/begin CHARACTERISTIC CHRG_M_WG_DPHR_DLTP_SP_BS "Diaphragm delta pressure setpoint base.X:Engine speed.Y:air load per cylinder." MAP 0x00020320 __UWORD_S 0 u_kPa_0_4096 0 4095.9375 FORMAT "%4.3" SYMBOL_LINK "CHRG_M_WG_DPHR_DLTP_SP_BS" 4
 /begin AXIS_DESCR COM_AXIS sys_eng_spd u_espd 15 0 8191.875 AXIS_PTS_REF CHRG_X_ESPD_B /end AXIS_DESCR
 /begin AXIS_DESCR COM_AXIS chrg_eng_load u_pct_8 14 0.000000 799.987793 AXIS_PTS_REF CHRG_X_MAF_PCT /end AXIS_DESCR
/end CHARACTERISTIC
/begin AXIS_PTS CHRG_X_MAF_PCT "" 0x0002006C chrg_eng_load SSV__UWORD_S 0 u_pct_8 14 0.000000 799.987793 DEPOSIT ABSOLUTE SYMBOL_LINK "CHRG_X_MAF_PCT" 2 /end AXIS_PTS
/begin CHARACTERISTIC CHRG_M_WGPWM "Waste gate pwm.  X:chrg_wg_dltp_max. Y:chrg_wg_dltp_sp." MAP 0x00020320 __UWORD_S 0 u_pct_dc 0 127.998046875 FORMAT "%4.3" SYMBOL_LINK "CHRG_M_WGPWM" 4
 /begin AXIS_DESCR COM_AXIS chrg_wg_dltp_max u_kPa_0_4096 16 0.000000 4095.937500 AXIS_PTS_REF CHRG_X_DLTP_A /end AXIS_DESCR
 /begin AXIS_DESCR COM_AXIS chrg_wg_dltp_sp u_kPa_0_4096 16 0.000000 4095.937500 AXIS_PTS_REF CHRG_X_DLTP_B /end AXIS_DESCR
/end CHARACTERISTIC
/begin AXIS_PTS CHRG_X_DLTP_A "" 0x0002006C chrg_wg_dltp_max SSV__UWORD_S 0 u_kPa_0_4096 16 0.000000 4095.937500 FORMAT "%5.2" DEPOSIT ABSOLUTE SYMBOL_LINK "CHRG_X_DLTP_A" 2 /end AXIS_PTS
/begin AXIS_PTS CHRG_X_DLTP_B "" 0x0002006C chrg_wg_dltp_sp SSV__UWORD_S 0 u_kPa_0_4096 16 0.000000 4095.937500 FORMAT "%5.2" DEPOSIT ABSOLUTE SYMBOL_LINK "CHRG_X_DLTP_B" 2 /end AXIS_PTS
/begin CHARACTERISTIC CHRG_M_WGPWM_BIAS "Waste gate pwm bias when gear shifting.X:Signed charger pressure error.Y:Filted actual charger pressure delta." MAP 0x00020320 __SWORD_S 0 u_pct -100 99.996948 FORMAT "%4.3" SYMBOL_LINK "CHRG_M_WGPWM_BIAS" 4
 /begin AXIS_DESCR COM_AXIS chrg_cpa_dlt_mmv u_kPa_2048n_2048p 11 -2048.000000 2047.937500 AXIS_PTS_REF CHRG_X_CPA_ERR_C /end AXIS_DESCR
 /begin AXIS_DESCR COM_AXIS chrg_cp_err_s u_kPa_2048n_2048p 11 -2048.000000 2047.937500 AXIS_PTS_REF CHRG_X_CPA_ERR_A /end AXIS_DESCR
/end CHARACTERISTIC
/begin AXIS_PTS CHRG_X_CPA_ERR_A "" 0x0002006C chrg_cp_err_s SSV__SWORD_S 0 u_kPa_2048n_2048p 11 -2048.000000 2047.937500 DEPOSIT ABSOLUTE SYMBOL_LINK "CHRG_X_CPA_ERR_A" 2 /end AXIS_PTS
/begin AXIS_PTS CHRG_X_CPA_ERR_C "" 0x0002006C chrg_cpa_dlt_mmv SSV__SWORD_S 0 u_kPa_2048n_2048p 11 -2048.000000 2047.937500 DEPOSIT ABSOLUTE SYMBOL_LINK "CHRG_X_CPA_ERR_C" 2 /end AXIS_PTS
/begin CHARACTERISTIC CHRG_C_CP_I_GN "Charger close loop control I term gain.X:Charger pressure error." CURVE 0x000200B0 __UWORD_S 0 u_fac_1 0 0.999984741210937 SYMBOL_LINK "CHRG_C_CP_I_GN" 2
 /begin AXIS_DESCR COM_AXIS chrg_cp_err u_kPa_0_4096 4 0.000000 4095.937500 AXIS_PTS_REF CHRG_X_CPA_ERR_B /end AXIS_DESCR
/end CHARACTERISTIC
/begin AXIS_PTS CHRG_X_CPA_ERR_B "" 0x0002006C NO_INPUT_QUANTITY SSV__UWORD_S 0 u_kPa_0_4096 4 0.000000 4095.937500 FORMAT "%5.2" DEPOSIT ABSOLUTE SYMBOL_LINK "CHRG_X_CPA_ERR_B" 2 /end AXIS_PTS
/begin CHARACTERISTIC CHRG_C_CP_P_GN "Charger close loop control P term gain.X:Charger pressure error." CURVE 0x000200B0 __UBYTE_S 0 u_fac_2_b 0 1.9921875 FORMAT "%4.3" SYMBOL_LINK "CHRG_C_CP_P_GN" 2
 /begin AXIS_DESCR COM_AXIS chrg_cp_err u_kPa_0_4096 4 0.000000 4095.937500 AXIS_PTS_REF CHRG_X_CPA_ERR_B /end AXIS_DESCR
/end CHARACTERISTIC
/begin CHARACTERISTIC CHRG_M_DPHR_DLTP_SP_AMP_FAC "This cal is the factor for cylinder air load.Lookup air load for diaphragm base delta pressure." MAP 0x00020320 __UWORD_S 0 u_fac_4 0 3.99993896484375 FORMAT "%4.3" SYMBOL_LINK "CHRG_M_DPHR_DLTP_SP_AMP_FAC" 4
 /begin AXIS_DESCR COM_AXIS sys_eng_spd u_espd 15 0 8191.875 AXIS_PTS_REF CHRG_X_ESPD_B /end AXIS_DESCR
 /begin AXIS_DESCR COM_AXIS sys_amp u_kPa_0_256 6 0.000000 255.996094 AXIS_PTS_REF CHRG_X_AMP_A /end AXIS_DESCR
/end CHARACTERISTIC
/begin CHARACTERISTIC CHRG_M_CMPR_PQ_SP_MAX_IAT_BIAS "Max available pressure quotient setpoint of compressor bias due to intake air temperature different." MAP 0x00020320 __SWORD_S 0 u_fac_n1_p1 -1 0.999969482421875 FORMAT "%4.3" SYMBOL_LINK "CHRG_M_CMPR_PQ_SP_MAX_IAT_BIAS" 4
 /begin AXIS_DESCR COM_AXIS sys_eng_spd u_espd 15 0 8191.875 AXIS_PTS_REF CHRG_X_ESPD_A /end AXIS_DESCR
 /begin AXIS_DESCR COM_AXIS sys_iat u_deg_C 5 -256 255.9921875 AXIS_PTS_REF CHRG_X_IAT_A /end AXIS_DESCR
/end CHARACTERISTIC
/begin AXIS_PTS CHRG_X_IAT_A "" 0x0002006C NO_INPUT_QUANTITY SSV__SWORD_S 0 u_deg_C 5 -256 255.9921875 DEPOSIT ABSOLUTE SYMBOL_LINK "CHRG_X_IAT_A" 2 /end AXIS_PTS
/begin CHARACTERISTIC CHRG_M_CMPR_PQ_SP_MAX "Max available pressure quotient setpoint of compressor.X:Engine speed.Y:Ambitient pressure." MAP 0x00020320 __UWORD_S 0 u_fac_8 0 7.9998779296875 FORMAT "%3.2" SYMBOL_LINK "CHRG_M_CMPR_PQ_SP_MAX" 4
 /begin AXIS_DESCR COM_AXIS sys_eng_spd u_espd 15 0 8191.875 AXIS_PTS_REF CHRG_X_ESPD_A /end AXIS_DESCR
 /begin AXIS_DESCR COM_AXIS sys_amp u_kPa_0_256 6 0.000000 255.996094 AXIS_PTS_REF CHRG_X_AMP_B /end AXIS_DESCR
/end CHARACTERISTIC
/begin CHARACTERISTIC CHRG_M_PQ_SP_MAX_AMP_BIAS "Max charger pressure quotient setpoint ambitient pressure bias." MAP 0x00020320 __UWORD_S 0 u_fac_8 0 7.9998779296875 FORMAT "%3.2" SYMBOL_LINK "CHRG_M_PQ_SP_MAX_AMP_BIAS" 4
 /begin AXIS_DESCR FIX_AXIS sys_amp u_kPa_0_256 6 55 105 /begin FIX_AXIS_PAR_LIST 14080 16640 19200 21760 24320 26880 /end FIX_AXIS_PAR_LIST /end AXIS_DESCR
 /begin AXIS_DESCR COM_AXIS chrg_std_cflw_mmv u_fac_4 16 0.000000 3.99993896484375 AXIS_PTS_REF CHRG_X_STD_CFLW_MMV /end AXIS_DESCR
/end CHARACTERISTIC
/begin AXIS_PTS CHRG_X_STD_CFLW_MMV "" 0x0002006C NO_INPUT_QUANTITY SSV__UWORD_S 0 u_fac_4 16 0.000000 3.99993896484375 FORMAT "%5.2" DEPOSIT ABSOLUTE SYMBOL_LINK "CHRG_X_STD_CFLW_MMV" 2 /end AXIS_PTS
/begin CHARACTERISTIC CHRG_M_PQ_SP_MAX_AMP_BIAS_M "Max charger pressure quotient setpoint ambitient pressure bias when TCU in manual mode." MAP 0x00020320 __UWORD_S 0 u_fac_8 0 7.9998779296875 FORMAT "%3.2" SYMBOL_LINK "CHRG_M_PQ_SP_MAX_AMP_BIAS_M" 4
 /begin AXIS_DESCR FIX_AXIS sys_amp u_kPa_0_256 6 55 105 /begin FIX_AXIS_PAR_LIST 14080 16640 19200 21760 24320 26880 /end FIX_AXIS_PAR_LIST /end AXIS_DESCR
 /begin AXIS_DESCR COM_AXIS chrg_std_cflw_mmv u_fac_4 16 0.000000 3.99993896484375 AXIS_PTS_REF CHRG_X_STD_CFLW_MMV /end AXIS_DESCR
/end CHARACTERISTIC
/begin CHARACTERISTIC CHRG_M_MX_BSTP_SP_AMP_BIAS "Max boost pressure setpoint ambient pressure bias.X:Engine speed.Y:Ambitient pressure." MAP 0x00020320 __UBYTE_S 0 u_kPa_0_128b 0 127.5 FORMAT "%3.2" SYMBOL_LINK "CHRG_M_MX_BSTP_SP_AMP_BIAS" 3
 /begin AXIS_DESCR COM_AXIS sys_eng_spd u_espd 17 0 8191.875 AXIS_PTS_REF CHRG_X_ESPD_C /end AXIS_DESCR
 /begin AXIS_DESCR FIX_AXIS sys_amp u_kPa_0_256 6 0.000000 255.996094 /begin FIX_AXIS_PAR_LIST 10480 16640 19200 21760 24320 26880 /end FIX_AXIS_PAR_LIST /end AXIS_DESCR
/end CHARACTERISTIC
/begin AXIS_PTS CHRG_X_ESPD_C "" 0x0002006C sys_eng_spd SSV__UWORD_S 0 u_espd 17 0 8191.875 DEPOSIT ABSOLUTE SYMBOL_LINK "CHRG_X_ESPD_C" 2 /end AXIS_PTS
/begin CHARACTERISTIC CHRG_V_WGPWM_CP_SP_THRSH "" VALUE 0x0002038C __UWORD_S 0 u_pct_r 0 127.998046875 /end CHARACTERISTIC
/begin CHARACTERISTIC CHRG_V_MX_CMPR_ERR_CP_SP_THRSH "" VALUE 0x0002038C __UWORD_S 0 u_kPa_0_512 0 511.9921875 /end CHARACTERISTIC
/begin CHARACTERISTIC CHRG_V_MX_CMPR_ERR_CP_SP_HYST "" VALUE 0x0002038C __UWORD_S 0 u_kPa_0_512 0 511.9921875 /end CHARACTERISTIC
/begin CHARACTERISTIC CHRG_V_WG_CLS_INC_PWM "TRUE/FALSE if the WasteGate closes when the Commanded WasteGate DutyCycle Increases/Decreases." VALUE 0x0002038C __UBYTE_S 0 b_true 0 1 FORMAT "%1.0" /end CHARACTERISTIC
/begin CHARACTERISTIC CHRG_C_STD_FLW_FIL "Standard flow filter" CURVE 0x000200B0 __UWORD_S 0 u_filter 0 0.999984741210937 FORMAT "%4.3" SYMBOL_LINK "CHRG_C_STD_FLW_FIL" 2
 /begin AXIS_DESCR COM_AXIS afm_std_flw u_m3_per_s 10 0.000000 3.99993896484375 AXIS_PTS_REF CHRG_X_FLW_A /end AXIS_DESCR
/end CHARACTERISTIC
/begin AXIS_PTS CHRG_X_FLW_A "" 0x0002006C afm_std_flw SSV__UWORD_S 0 u_m3_per_s 10 0.000000 3.99993896484375 DEPOSIT ABSOLUTE SYMBOL_LINK "CHRG_X_FLW_A" 2 /end AXIS_PTS
/begin CHARACTERISTIC CHRG_V_RCV_OPN "Compressor RCV default open." VALUE 0x0002038C __UBYTE_S 0 b_true 0 1 FORMAT "%1.0" /end CHARACTERISTIC
/begin CHARACTERISTIC CHRG_V_RCV_CLS_MIN "Compressor RCV close min loops,loop time is 15.6ms." VALUE 0x0002038C __UWORD_S 0 u_cnts 0 65535 FORMAT "%5.0" /end CHARACTERISTIC
/begin CHARACTERISTIC CHRG_V_SP_DLY "Index delay used in compressor pressure setpoint rate  calculation." VALUE 0x0002038C __UWORD_S 0 u_cnts 0 65535 FORMAT "%5.0" /end CHARACTERISTIC
/begin CHARACTERISTIC CHRG_V_DEC_EXT_DLY "Deceleration is over, CMPR control remains active for this period (looptime)." VALUE 0x0002038C __UWORD_S 0 u_cnts 0 65535 FORMAT "%5.0" /end CHARACTERISTIC
/begin CHARACTERISTIC CHRG_V_CP_SP_FILT "Filter coefficient for compressor pressure setpoint." VALUE 0x0002038C __UWORD_S 0 u_filter 0 0.9999847412109375 FORMAT "%4.3" /end CHARACTERISTIC
/begin CHARACTERISTIC CHRG_V_BUF_RT_USE "True:buffer based compressor pressure setpoint rate calculation; False:filtered based rate." VALUE 0x0002038C __UBYTE_S 0 b_true 0 1 FORMAT "%1.0" /end CHARACTERISTIC
/begin CHARACTERISTIC CHRG_C_SURG_LN "Charger surge line." CURVE 0x000200B0 __UWORD_S 0 u_fac_1 0 0.9999847412109375 SYMBOL_LINK "CHRG_C_SURG_LN" 2
 /begin AXIS_DESCR COM_AXIS afm_bstp2amp_rt u_fac_8 10 0.000000 7.9998779296875 AXIS_PTS_REF CHRG_X_PQ_A /end AXIS_DESCR
/end CHARACTERISTIC
/begin AXIS_PTS CHRG_X_PQ_A "" 0x0002006C afm_bstp2amp_rt SSV__UWORD_S 0 u_fac_8 10 0.000000 7.9998779296875 FORMAT "%5.4" DEPOSIT ABSOLUTE SYMBOL_LINK "CHRG_X_PQ_A" 2 /end AXIS_PTS
/begin CHARACTERISTIC CHRG_C_SURG_LN_HYS "Charger surge line hysteresis." CURVE 0x000200B0 __UWORD_S 0 u_fac_1 0 0.9999847412109375 SYMBOL_LINK "CHRG_C_SURG_LN_HYS" 2
 /begin AXIS_DESCR COM_AXIS afm_bstp2amp_rt u_fac_8 10 0.000000 7.9998779296875 AXIS_PTS_REF CHRG_X_PQ_A /end AXIS_DESCR
/end CHARACTERISTIC
/begin CHARACTERISTIC CHRG_C_CP_SP_DEC_RT_THRSH "Compressor pressure setpoint deceleration rate (this ratio cal*AMP)to enable RCV control." CURVE 0x000200B0 __SWORD_S 0 u_fac_n512_p512 -512 511.984375 SYMBOL_LINK "CHRG_C_CP_SP_DEC_RT_THRSH" 2
 /begin AXIS_DESCR COM_AXIS sys_amp u_kPa_0_256 5 0.000000 255.996094 AXIS_PTS_REF CHRG_X_AMP_C /end AXIS_DESCR
/end CHARACTERISTIC
/begin AXIS_PTS CHRG_X_AMP_C "" 0x0002006C sys_amp SSV__UWORD_S 0 u_kPa_0_256 5 0.000000 255.996094 DEPOSIT ABSOLUTE SYMBOL_LINK "CHRG_X_AMP_C" 2 /end AXIS_PTS
/begin CHARACTERISTIC CHRG_C_CP_SP_ACC_RT_THRSH "Compressor pressure setpoint acceleration rate (this ratio cal*AMP)to disable RCV control." CURVE 0x000200B0 __SWORD_S 0 u_fac_n512_p512 -512 511.984375 SYMBOL_LINK "CHRG_C_CP_SP_ACC_RT_THRSH" 2
 /begin AXIS_DESCR COM_AXIS sys_amp u_kPa_0_256 5 0.000000 255.996094 AXIS_PTS_REF CHRG_X_AMP_D /end AXIS_DESCR
/end CHARACTERISTIC
/begin AXIS_PTS CHRG_X_AMP_D "" 0x0002006C sys_amp SSV__UWORD_S 0 u_kPa_0_256 5 0.000000 255.996094 DEPOSIT ABSOLUTE SYMBOL_LINK "CHRG_X_AMP_D" 2 /end AXIS_PTS
/begin CHARACTERISTIC CHRG_C_CP_SP_THRSH_HI "Compressor pressure setpoint above threshold(this ratio cal*AMP)to disable RCV control." CURVE 0x000200B0 __UWORD_S 0 u_fac_512 0 511.9921875 FORMAT "%5.2" SYMBOL_LINK "CHRG_C_CP_SP_THRSH_HI" 2
 /begin AXIS_DESCR COM_AXIS sys_amp u_kPa_0_256 5 0.000000 255.996094 AXIS_PTS_REF CHRG_X_AMP_E /end AXIS_DESCR
/end CHARACTERISTIC
/begin AXIS_PTS CHRG_X_AMP_E "" 0x0002006C sys_amp SSV__UWORD_S 0 u_kPa_0_256 5 0.000000 255.996094 DEPOSIT ABSOLUTE SYMBOL_LINK "CHRG_X_AMP_E" 2 /end AXIS_PTS
/begin CHARACTERISTIC CHRG_C_CP_SP_THRSH_LO "Compressor pressure setpoint below threshold(this ratio cal*AMP)to enable RCV control." CURVE 0x000200B0 __UWORD_S 0 u_fac_512 0 511.9921875 FORMAT "%5.2" SYMBOL_LINK "CHRG_C_CP_SP_THRSH_LO" 2
 /begin AXIS_DESCR COM_AXIS sys_amp u_kPa_0_256 5 0.000000 255.996094 AXIS_PTS_REF CHRG_X_AMP_F /end AXIS_DESCR
/end CHARACTERISTIC
/begin AXIS_PTS CHRG_X_AMP_F "" 0x0002006C sys_amp SSV__UWORD_S 0 u_kPa_0_256 5 0.000000 255.996094 DEPOSIT ABSOLUTE SYMBOL_LINK "CHRG_X_AMP_F" 2 /end AXIS_PTS
/begin CHARACTERISTIC ENTE_V_FAN_TYP "fan type" VALUE 0x0002038C __UBYTE_S 0 u_fan_typ 0 1 FORMAT "%1.0" /end CHARACTERISTIC
/begin CHARACTERISTIC ENTE_V_AC_LOAD_TYP "ac load type" VALUE 0x0002038C __UBYTE_S 0 u_acld_typ 0 2 FORMAT "%1.0" /end CHARACTERISTIC
/begin CHARACTERISTIC ENTE_V_AC_PRES_HI "ac press high" VALUE 0x0002038C __SWORD_S 0 u_kPa_4096n_4096p -4096 4095.875 /end CHARACTERISTIC
/begin CHARACTERISTIC ENTE_V_AC_PRES_MED "ac press med" VALUE 0x0002038C __SWORD_S 0 u_kPa_4096n_4096p -4096 4095.875 /end CHARACTERISTIC
/begin CHARACTERISTIC ENTE_V_AC_PRES_LO "ac press med" VALUE 0x0002038C __SWORD_S 0 u_kPa_4096n_4096p -4096 4095.875 /end CHARACTERISTIC
/begin CHARACTERISTIC ENTE_V_AC_P_HI_HYS "ac press high hys" VALUE 0x0002038C __SWORD_S 0 u_kPa_4096n_4096p -4096 4095.875 /end CHARACTERISTIC
/begin CHARACTERISTIC ENTE_V_AC_P_MED_HYS "ac press high hys" VALUE 0x0002038C __SWORD_S 0 u_kPa_4096n_4096p -4096 4095.875 /end CHARACTERISTIC
/begin CHARACTERISTIC ENTE_V_AC_P_LO_HYS "ac press high hys" VALUE 0x0002038C __SWORD_S 0 u_kPa_4096n_4096p -4096 4095.875 /end CHARACTERISTIC
/begin CHARACTERISTIC ENTE_V_AC_T_HI "ac evap temp high" VALUE 0x0002038C __SWORD_S 0 u_deg_C -256 255.9921875 FORMAT "%4.1" /end CHARACTERISTIC
/begin CHARACTERISTIC ENTE_V_AC_T_MED "ac evap temp med" VALUE 0x0002038C __SWORD_S 0 u_deg_C -256 255.9921875 FORMAT "%4.1" /end CHARACTERISTIC
/begin CHARACTERISTIC ENTE_V_AC_T_LO "ac evap temp low" VALUE 0x0002038C __SWORD_S 0 u_deg_C -256 255.9921875 FORMAT "%4.1" /end CHARACTERISTIC
/begin CHARACTERISTIC ENTE_V_AC_T_HYS "ac evap temp hys" VALUE 0x0002038C __SWORD_S 0 u_deg_C -256 255.9921875 FORMAT "%4.1" /end CHARACTERISTIC
/begin CHARACTERISTIC ENTE_V_VSPD_MED "vehicle speed med" VALUE 0x0002038C __UWORD_S 0 u_vspd 0.0 511.9921875 FORMAT "%4.1" /end CHARACTERISTIC
/begin CHARACTERISTIC ENTE_V_VSPD_MED_HYS "vehicle speed med" VALUE 0x0002038C __UWORD_S 0 u_vspd 0.0 511.9921875 FORMAT "%4.1" /end CHARACTERISTIC
/begin CHARACTERISTIC ENTE_V_VSPD_HI "vehicle speed high" VALUE 0x0002038C __UWORD_S 0 u_vspd 0.0 511.9921875 FORMAT "%4.1" /end CHARACTERISTIC
/begin CHARACTERISTIC ENTE_V_FAN_PWM_VSPD_HI "vehicle speed high thr" VALUE 0x0002038C __UWORD_S 0 u_vspd 0.0 511.9921875 FORMAT "%4.1" /end CHARACTERISTIC
/begin CHARACTERISTIC ENTE_V_VSPD_HI_HYS "vehicle speed med" VALUE 0x0002038C __UWORD_S 0 u_vspd 0.0 511.9921875 FORMAT "%4.1" /end CHARACTERISTIC
/begin CHARACTERISTIC ENTE_V_ETHM_HI_THR "electronically controlled thermostat request high thr" VALUE 0x0002038C __SWORD_S 0 u_deg_C -256 255.9921875 FORMAT "%4.1" /end CHARACTERISTIC
/begin CHARACTERISTIC ENTE_V_ETHM_HI_HYS "electronically controlled thermostat request high hys" VALUE 0x0002038C __SWORD_S 0 u_deg_C -256 255.9921875 FORMAT "%4.1" /end CHARACTERISTIC
/begin CHARACTERISTIC ENTE_M_FAN_ON_LO_THR "fan on ect thr lo" MAP 0x00020320 __SWORD_S 0 u_deg_C -256.0 255.9921875 FORMAT "%4.1"
 /begin AXIS_DESCR FIX_AXIS ente_fan_vspd_st u_fan_req_typ 3 2 4 /begin FIX_AXIS_PAR_LIST 2 3 4 /end FIX_AXIS_PAR_LIST /end AXIS_DESCR
 /begin AXIS_DESCR FIX_AXIS ente_fan_ac_st u_fan_req_typ 5 0 4 /begin FIX_AXIS_PAR_LIST 0 1 2 3 4 /end FIX_AXIS_PAR_LIST /end AXIS_DESCR
/end CHARACTERISTIC
/begin CHARACTERISTIC ENTE_M_FAN_ON_MED_THR "fan on ect thr med" MAP 0x00020320 __SWORD_S 0 u_deg_C -256.0 255.9921875 FORMAT "%4.1"
 /begin AXIS_DESCR FIX_AXIS ente_fan_vspd_st u_fan_req_typ 3 2 4 /begin FIX_AXIS_PAR_LIST 2 3 4 /end FIX_AXIS_PAR_LIST /end AXIS_DESCR
 /begin AXIS_DESCR FIX_AXIS ente_fan_ac_st u_fan_req_typ 5 0 4 /begin FIX_AXIS_PAR_LIST 0 1 2 3 4 /end FIX_AXIS_PAR_LIST /end AXIS_DESCR
/end CHARACTERISTIC
/begin CHARACTERISTIC ENTE_M_FAN_ON_HI_THR "fan on ect thr hi" MAP 0x00020320 __SWORD_S 0 u_deg_C -256.0 255.9921875 FORMAT "%4.1"
 /begin AXIS_DESCR FIX_AXIS ente_fan_vspd_st u_fan_req_typ 3 2 4 /begin FIX_AXIS_PAR_LIST 2 3 4 /end FIX_AXIS_PAR_LIST /end AXIS_DESCR
 /begin AXIS_DESCR FIX_AXIS ente_fan_ac_st u_fan_req_typ 5 0 4 /begin FIX_AXIS_PAR_LIST 0 1 2 3 4 /end FIX_AXIS_PAR_LIST /end AXIS_DESCR
/end CHARACTERISTIC
/begin CHARACTERISTIC ENTE_V_FAN_ON_LO_HYS "fan on ect hys lo" VALUE 0x0002038C __SWORD_S 0 u_deg_C -256 255.9921875 FORMAT "%4.1" /end CHARACTERISTIC
/begin CHARACTERISTIC ENTE_V_FAN_ON_MED_HYS "fan on ect hys med" VALUE 0x0002038C __SWORD_S 0 u_deg_C -256 255.9921875 FORMAT "%4.1" /end CHARACTERISTIC
/begin CHARACTERISTIC ENTE_V_FAN_ON_HI_HYS "fan on ect hys med" VALUE 0x0002038C __SWORD_S 0 u_deg_C -256 255.9921875 FORMAT "%4.1" /end CHARACTERISTIC
/begin CHARACTERISTIC ENTE_V_FAN_OFF_MIN "fan off time min before fan on" VALUE 0x0002038C __UWORD_S 0 u_16x_tmr 0.0 8191.875 /end CHARACTERISTIC
/begin CHARACTERISTIC ENTE_V_FAN_ON_MIN "fan on time min before fan off" VALUE 0x0002038C __UWORD_S 0 u_16x_tmr 0.0 8191.875 /end CHARACTERISTIC
/begin CHARACTERISTIC ENTE_V_FAN_REQ_ST_KP_MIN "fan request state keep duration min" VALUE 0x0002038C __UWORD_S 0 u_16x_tmr 0.0 8191.875 /end CHARACTERISTIC
/begin CHARACTERISTIC ENTE_V_FAN_EN_RUN_MIN "fan on enable runtime min" VALUE 0x0002038C __UWORD_S 0 u_1s_tmr 0.0 65535 /end CHARACTERISTIC
/begin CHARACTERISTIC ENTE_V_FAN_SPD_TYP "fan speed type" VALUE 0x0002038C __UBYTE_S 0 u_fan_spd_typ 1 3 FORMAT "%1.0" /end CHARACTERISTIC
/begin CHARACTERISTIC ENTE_V_FAN_ON_DLY "fan on delay" VALUE 0x0002038C __UWORD_S 0 u_16x_tmr 0.0 8191.875 /end CHARACTERISTIC
/begin CHARACTERISTIC ENTE_V_FAN_OFF_DLY "fan on delay" VALUE 0x0002038C __UWORD_S 0 u_16x_tmr 0.0 8191.875 /end CHARACTERISTIC
/begin CHARACTERISTIC ENTE_V_FAN_PWM_INC_STP "fan pwm increase step" VALUE 0x0002038C __UWORD_S 0 u_pct 0.0 199.996948 FORMAT "%4.1" /end CHARACTERISTIC
/begin CHARACTERISTIC ENTE_V_FAN_PWM_DEC_STP "fan pwm decrease step" VALUE 0x0002038C __UWORD_S 0 u_pct 0.0 199.996948 FORMAT "%4.1" /end CHARACTERISTIC
/begin CHARACTERISTIC ENTE_V_FAN_PWM_MIN "fan pwm min" VALUE 0x0002038C __UWORD_S 0 u_pct 0.0 199.996948 FORMAT "%4.1" /end CHARACTERISTIC
/begin CHARACTERISTIC ENTE_C_PWM_HILD_ACON_V_LO "high load,low vehicle speed pwm with ac on" CURVE 0x000200B0 __UWORD_S 0 u_pct 0 100 FORMAT "%4.1" SYMBOL_LINK "ENTE_C_PWM_HILD_ACON_V_LO" 2
 /begin AXIS_DESCR COM_AXIS sys_ect u_deg_C 10 -256.000000 255.9921875 AXIS_PTS_REF ENTE_X_ECT_A /end AXIS_DESCR
/end CHARACTERISTIC
/begin CHARACTERISTIC ENTE_C_PWM_HILD_ACON_V_HI "high load,high vehicle speed pwm with ac on" CURVE 0x000200B0 __UWORD_S 0 u_pct 0 100 FORMAT "%4.1" SYMBOL_LINK "ENTE_C_PWM_HILD_ACON_V_HI" 2
 /begin AXIS_DESCR COM_AXIS sys_ect u_deg_C 10 -256.000000 255.9921875 AXIS_PTS_REF ENTE_X_ECT_A /end AXIS_DESCR
/end CHARACTERISTIC
/begin CHARACTERISTIC ENTE_C_PWM_MEDLD_ACON_V_LO "med load,low vehicle speed pwm with ac on" CURVE 0x000200B0 __UWORD_S 0 u_pct 0 100 FORMAT "%4.1" SYMBOL_LINK "ENTE_C_PWM_MEDLD_ACON_V_LO" 2
 /begin AXIS_DESCR COM_AXIS sys_ect u_deg_C 10 -256.000000 255.9921875 AXIS_PTS_REF ENTE_X_ECT_A /end AXIS_DESCR
/end CHARACTERISTIC
/begin CHARACTERISTIC ENTE_C_PWM_MEDLD_ACON_V_MED "med load,med vehicle speed pwm with ac on" CURVE 0x000200B0 __UWORD_S 0 u_pct 0 100 FORMAT "%4.1" SYMBOL_LINK "ENTE_C_PWM_MEDLD_ACON_V_MED" 2
 /begin AXIS_DESCR COM_AXIS sys_ect u_deg_C 10 -256.000000 255.9921875 AXIS_PTS_REF ENTE_X_ECT_A /end AXIS_DESCR
/end CHARACTERISTIC
/begin CHARACTERISTIC ENTE_C_PWM_MEDLD_ACON_V_HI "med load,high vehicle speed pwm with ac on" CURVE 0x000200B0 __UWORD_S 0 u_pct 0 100 FORMAT "%4.1" SYMBOL_LINK "ENTE_C_PWM_MEDLD_ACON_V_HI" 2
 /begin AXIS_DESCR COM_AXIS sys_ect u_deg_C 10 -256.000000 255.9921875 AXIS_PTS_REF ENTE_X_ECT_A /end AXIS_DESCR
/end CHARACTERISTIC
/begin CHARACTERISTIC ENTE_C_PWM_LOLD_ACON_V_LO "low load,low vehicle speed pwm with ac on" CURVE 0x000200B0 __UWORD_S 0 u_pct 0 100 FORMAT "%4.1" SYMBOL_LINK "ENTE_C_PWM_LOLD_ACON_V_LO" 2
 /begin AXIS_DESCR COM_AXIS sys_ect u_deg_C 10 -256.000000 255.9921875 AXIS_PTS_REF ENTE_X_ECT_A /end AXIS_DESCR
/end CHARACTERISTIC
/begin CHARACTERISTIC ENTE_C_PWM_LOLD_ACON_V_MED "low load,med vehicle speed pwm with ac on" CURVE 0x000200B0 __UWORD_S 0 u_pct 0 100 FORMAT "%4.1" SYMBOL_LINK "ENTE_C_PWM_LOLD_ACON_V_MED" 2
 /begin AXIS_DESCR COM_AXIS sys_ect u_deg_C 10 -256.000000 255.9921875 AXIS_PTS_REF ENTE_X_ECT_A /end AXIS_DESCR
/end CHARACTERISTIC
/begin CHARACTERISTIC ENTE_C_PWM_LOLD_ACON_V_HI "low load,high vehicle speed pwm with ac on" CURVE 0x000200B0 __UWORD_S 0 u_pct 0 100 FORMAT "%4.1" SYMBOL_LINK "ENTE_C_PWM_LOLD_ACON_V_HI" 2
 /begin AXIS_DESCR COM_AXIS sys_ect u_deg_C 10 -256.000000 255.9921875 AXIS_PTS_REF ENTE_X_ECT_A /end AXIS_DESCR
/end CHARACTERISTIC
/begin CHARACTERISTIC ENTE_C_PWM_VLOLD_ACON "very low load,pwm with ac on" CURVE 0x000200B0 __UWORD_S 0 u_pct 0 100 FORMAT "%4.1" SYMBOL_LINK "ENTE_C_PWM_VLOLD_ACON" 2
 /begin AXIS_DESCR COM_AXIS sys_ect u_deg_C 10 -256.000000 255.9921875 AXIS_PTS_REF ENTE_X_ECT_A /end AXIS_DESCR
/end CHARACTERISTIC
/begin AXIS_PTS ENTE_X_ECT_A "" 0x0002006C sys_ect SSV__SWORD_S 0 u_deg_C 10 -256.000000 255.9921875 FORMAT "%4.1" DEPOSIT ABSOLUTE SYMBOL_LINK "ENTE_X_ECT_A" 2 /end AXIS_PTS
/begin CHARACTERISTIC ENTE_V_FAN_PWM_V_HI_T "pwm fan on high vehicle speed temp thr" VALUE 0x0002038C __SWORD_S 0 u_deg_C -256 255.9921875 FORMAT "%4.1" /end CHARACTERISTIC
/begin CHARACTERISTIC ENTE_V_FAN_PWM_V_MED_T "pwm fan on med vehicle speed temp thr" VALUE 0x0002038C __SWORD_S 0 u_deg_C -256 255.9921875 FORMAT "%4.1" /end CHARACTERISTIC
/begin CHARACTERISTIC ENTE_V_FAN_OFFR_EXT_VLT "pwm fan off run exit voltage" VALUE 0x0002038C __UWORD_S 0 u_volt_32 0 31.99951171875 FORMAT "%4.2" /end CHARACTERISTIC
/begin CHARACTERISTIC ENTE_V_FAN_PWM_T_HYS "pwm fan on med vehicle speed temp hys" VALUE 0x0002038C __SWORD_S 0 u_deg_C -256 255.9921875 FORMAT "%4.1" /end CHARACTERISTIC
/begin CHARACTERISTIC ENTE_C_PWM_ACOFF "fan pwm with ac off" CURVE 0x000200B0 __UWORD_S 0 u_pct 0 100 FORMAT "%4.1" SYMBOL_LINK "ENTE_C_PWM_ACOFF" 2
 /begin AXIS_DESCR COM_AXIS sys_ect u_deg_C 10 -256.000000 255.9921875 AXIS_PTS_REF ENTE_X_ECT_A /end AXIS_DESCR
/end CHARACTERISTIC
/begin CHARACTERISTIC ENTE_V_FAN_OFF_PWM "fan off pwm" VALUE 0x0002038C __UWORD_S 0 u_pct 0.0 199.996948 FORMAT "%4.1" /end CHARACTERISTIC
/begin CHARACTERISTIC ENTE_V_FAN_OFFR_EN_ECT "fan key off run enable ect" VALUE 0x0002038C __SWORD_S 0 u_deg_C -256 255.9921875 FORMAT "%4.1" /end CHARACTERISTIC
/begin CHARACTERISTIC ENTE_C_FAN_OFFR_EXT_ECT "fan key off run exit ect" CURVE 0x000200B0 __SWORD_S 0 u_deg_C -256 255.9921875 FORMAT "%4.1" SYMBOL_LINK "ENTE_C_FAN_OFFR_EXT_ECT" 2
 /begin AXIS_DESCR COM_AXIS ente_fan_offr_dur u_16x_tmr 5 0.0 8191.875 AXIS_PTS_REF ENTE_X_OFFR_DUR /end AXIS_DESCR
/end CHARACTERISTIC
/begin AXIS_PTS ENTE_X_OFFR_DUR "" 0x0002006C ente_fan_offr_dur SSV__UWORD_S 0 u_16x_tmr 5 0.0 8191.875 DEPOSIT ABSOLUTE SYMBOL_LINK "ENTE_X_OFFR_DUR" 2 /end AXIS_PTS
/begin CHARACTERISTIC ENTE_V_FAN_OFFR_EN_AC_P "fan key off run enable ac press" VALUE 0x0002038C __SWORD_S 0 u_kPa_4096n_4096p -4096 4095.875 /end CHARACTERISTIC
/begin CHARACTERISTIC ENTE_V_FAN_OFFR_EXT_AC_P "fan key off run exit ac press" VALUE 0x0002038C __SWORD_S 0 u_kPa_4096n_4096p -4096 4095.875 /end CHARACTERISTIC
/begin CHARACTERISTIC ENTE_V_FAN_OFFR_AC_P_HI "fan key off run ac press high" VALUE 0x0002038C __SWORD_S 0 u_kPa_4096n_4096p -4096 4095.875 /end CHARACTERISTIC
/begin CHARACTERISTIC ENTE_V_FAN_OFFR_AC_P_LO "fan key off run ac press high" VALUE 0x0002038C __SWORD_S 0 u_kPa_4096n_4096p -4096 4095.875 /end CHARACTERISTIC
/begin CHARACTERISTIC ENTE_V_FAN_OFFR_EN_RUN_MIN "fan key off run enable runtime min" VALUE 0x0002038C __UWORD_S 0 u_1s_tmr 0.0 65535 /end CHARACTERISTIC
/begin CHARACTERISTIC ENTE_V_FAN_OFFR_AC_P_DUR "fan key off runtime due to ac press high" VALUE 0x0002038C __UWORD_S 0 u_16x_tmr 0.0 8191.875 /end CHARACTERISTIC
/begin CHARACTERISTIC ENTE_C_FAN_OFFR_ECT_LVL "fan key off runtime ect level thr" VAL_BLK 0x000200B0 __SWORD_S 0 u_deg_C -256 255.9921875 NUMBER 4 FORMAT "%4.1" /end CHARACTERISTIC
/begin CHARACTERISTIC ENTE_V_FAN_OFFR_ECT_HI "fan key off run ect hi" VALUE 0x0002038C __SWORD_S 0 u_deg_C -256 255.9921875 FORMAT "%4.1" /end CHARACTERISTIC
/begin CHARACTERISTIC ENTE_V_FAN_OFFR_ECT_LO "fan key off run ect lo" VALUE 0x0002038C __SWORD_S 0 u_deg_C -256 255.9921875 FORMAT "%4.1" /end CHARACTERISTIC
/begin CHARACTERISTIC ENTE_V_FAN_OFFR_HI_TYP "fan key off run high type" VALUE 0x0002038C __UBYTE_S 0 u_fan_ctrl_typ 0 3 FORMAT "%1.0" /end CHARACTERISTIC
/begin CHARACTERISTIC ENTE_V_FAN_OFFR_MED_TYP "fan key off run med type" VALUE 0x0002038C __UBYTE_S 0 u_fan_ctrl_typ 0 3 FORMAT "%1.0" /end CHARACTERISTIC
/begin CHARACTERISTIC ENTE_C_FAN_OFFR_PWM "fan key off run pwm" CURVE 0x000200B0 __UWORD_S 0 u_pct 0 100 FORMAT "%4.1"
 /begin AXIS_DESCR FIX_AXIS ente_fan_offr_typ u_fan_ctrl_typ 4 0 3 /begin FIX_AXIS_PAR_LIST 0 1 2 3 /end FIX_AXIS_PAR_LIST /end AXIS_DESCR
/end CHARACTERISTIC
/begin CHARACTERISTIC ENTE_V_FAN_HI_BY_ACON "fan high active when ac on" VALUE 0x0002038C __UBYTE_S 0 b_true 0 1 FORMAT "%1.0" /end CHARACTERISTIC
/begin COMPU_METHOD u_volt_32 "voltage" RAT_FUNC "%6.4" "V" COEFFS 0.0 1.0 0.000000 0.0 0.0 0.00048828125 /end COMPU_METHOD
/begin COMPU_METHOD u_kPa_0_256 "press" RAT_FUNC "%5.2" "kPa" COEFFS 0.0 1.0 0.000000 0.0 0.0 0.00390625 /end COMPU_METHOD
/begin COMPU_METHOD u_kPa_0_512 "press" RAT_FUNC "%5.2" "kPa" COEFFS 0.0 1.0 0.000000 0.0 0.0 0.0078125 /end COMPU_METHOD
/begin COMPU_METHOD u_kPa_0_32768 "press" RAT_FUNC "%6.1" "kPa" COEFFS 0.0 1.0 0.000000 0.0 0.0 0.5 /end COMPU_METHOD
/begin COMPU_METHOD u_kPa_128n_128p "press" RAT_FUNC "%5.2" "kPa" COEFFS 0.0 1.0 0.000000 0.0 0.0 0.00390625 /end COMPU_METHOD
/begin COMPU_METHOD u_kPa_4096n_4096p "press" RAT_FUNC "%5.1" "kPa" COEFFS 0.0 1.0 0.000000 0.0 0.0 0.125 /end COMPU_METHOD
/begin COMPU_METHOD u_fac_512 "factor" RAT_FUNC "%5.1" "fac" COEFFS 0.0 1.0 0.000000 0.0 0.0 0.0078125 /end COMPU_METHOD
/begin COMPU_METHOD u_fac_64 "factor" RAT_FUNC "%4.2" "fac" COEFFS 0.0 1.0 0.000000 0.0 0.0 0.0009765625 /end COMPU_METHOD
/begin COMPU_METHOD u_fac_8 "factor" RAT_FUNC "%8.7" "fac" COEFFS 0.0 1.0 0.000000 0.0 0.0 0.0001220703125 /end COMPU_METHOD
/begin COMPU_METHOD u_fac_4 "factor" RAT_FUNC "%5.4" "fac" COEFFS 0.0 1.0 0.000000 0.0 0.0 0.00006103515625 /end COMPU_METHOD
/begin COMPU_METHOD u_fac_2 "factor" RAT_FUNC "%3.2" "fac" COEFFS 0.0 1.0 0.000000 0.0 0.0 0.000030517578125 /end COMPU_METHOD
/begin COMPU_METHOD u_fac_1 "factor" RAT_FUNC "%4.3" "fac" COEFFS 0.0 1.0 0.000000 0.0 0.0 0.0000152587890625 /end COMPU_METHOD
/begin COMPU_METHOD u_fac_2_b "factor" RAT_FUNC "%3.2" "fac" COEFFS 0.0 1.0 0.000000 0.0 0.0 0.0078125 /end COMPU_METHOD
/begin COMPU_METHOD u_fac_n1_p1 "factor" RAT_FUNC "%3.2" "fac" COEFFS 0.0 1.0 0.000000 0.0 0.0 0.000030517578125 /end COMPU_METHOD
/begin COMPU_METHOD u_fac_n4_p4 "factor" RAT_FUNC "%3.2" "fac" COEFFS 0.0 1.0 0.000000 0.0 0.0 0.0001220703125 /end COMPU_METHOD
/begin COMPU_METHOD u_fac_n512_p512 "factor" RAT_FUNC "%5.2" "fac" COEFFS 0.0 1.0 0.000000 0.0 0.0 0.015625 /end COMPU_METHOD
/begin COMPU_METHOD u_deg_C "degC" RAT_FUNC "%5.2" "¡æ" COEFFS 0.0 1.0 0.0 0.0 0.0 0.0078125 /end COMPU_METHOD
/begin COMPU_METHOD u_filter "filter" RAT_FUNC "%11.10" "coef" COEFFS 0.0 1.0 0.0 0.0 0.0 0.0000152587890625 /end COMPU_METHOD
/begin COMPU_METHOD u_cnts "counts" RAT_FUNC "%3.0" "cnts" COEFFS 0.0 1.0 0.0 0.0 0.0 1.0 /end COMPU_METHOD
/begin COMPU_METHOD u_min "min timer" RAT_FUNC "%5.0" "min" COEFFS 0.0 1.0 0.0 0.0 0.0 1.00 /end COMPU_METHOD
/begin COMPU_METHOD u_2x_tmr "15.6 timer" RAT_FUNC "%6.2" "s" COEFFS 0.0 1.0 0.0 0.0 0.0 0.015625 /end COMPU_METHOD
/begin COMPU_METHOD u_4x_tmr "31.2 timer" RAT_FUNC "%6.2" "s" COEFFS 0.0 1.0 0.0 0.0 0.0 0.03125 /end COMPU_METHOD
/begin COMPU_METHOD u_16x_tmr "125 timer" RAT_FUNC "%5.1" "s" COEFFS 0.0 1.0 0.0 0.0 0.0 0.125 /end COMPU_METHOD
/begin COMPU_METHOD u_1s_tmr "1 sec timer" RAT_FUNC "%5.0" "s" COEFFS 0.0 1.0 0.0 0.0 0.0 1.0 /end COMPU_METHOD
/begin COMPU_METHOD u_tq_1024 "torque" RAT_FUNC "%5.1" "Nm" COEFFS 0.0 1.0 0.000000 0.0 0.0 0.03125 /end COMPU_METHOD
/begin COMPU_METHOD b_true "" TAB_VERB "%6.3" "" COMPU_TAB_REF b_true /end COMPU_METHOD
/begin COMPU_VTAB b_true "" TAB_VERB 2 0 "FALSE" 1 "TRUE" /end COMPU_VTAB
/begin COMPU_METHOD b_enable "" TAB_VERB "%6.3" "" COMPU_TAB_REF b_enable /end COMPU_METHOD
/begin COMPU_VTAB b_enable "" TAB_VERB 2 0 "DISABLE" 1 "ENABLE" /end COMPU_VTAB
/begin COMPU_METHOD u_fan_typ "" TAB_VERB "%6.3" "" COMPU_TAB_REF u_fan_typ /end COMPU_METHOD
/begin COMPU_VTAB u_fan_typ "" TAB_VERB 2 0 "ONOFF" 1 "PWM" /end COMPU_VTAB
/begin COMPU_METHOD u_fan_spd_typ "" TAB_VERB "%6.3" "" COMPU_TAB_REF u_fan_spd_typ /end COMPU_METHOD
/begin COMPU_VTAB u_fan_spd_typ "" TAB_VERB 3 1 "ONE" 2 "TWO" 3 "THREE" /end COMPU_VTAB
/begin COMPU_METHOD u_acld_typ "" TAB_VERB "%6.3" "" COMPU_TAB_REF u_acld_typ /end COMPU_METHOD
/begin COMPU_VTAB u_acld_typ "" TAB_VERB 3 0 "PRESS_SNSR" 1 "PRESS_SWCH" 2 "EVAP_TEMP" /end COMPU_VTAB
/begin COMPU_METHOD u_fan_ctrl_typ "" TAB_VERB "%4.0" "" COMPU_TAB_REF u_fan_ctrl_typ /end COMPU_METHOD
/begin COMPU_VTAB u_fan_ctrl_typ "" TAB_VERB 4 0 "OFF" 1 "LOW" 2 "MED" 3 "HIGH" /end COMPU_VTAB
/begin COMPU_METHOD u_fan_req_typ "" TAB_VERB "%4.0" "" COMPU_TAB_REF u_fan_req_typ /end COMPU_METHOD
/begin COMPU_VTAB u_fan_req_typ "" TAB_VERB 5 0 "OFF" 1 "WEAK" 2 "LOW" 3 "MED" 4 "HIGH" /end COMPU_VTAB
/begin COMPU_METHOD u_espd "engine speed" RAT_FUNC "%5.2" "rpm" COEFFS 0.0 1.0 0.000000 0.0 0.0 0.125 /end COMPU_METHOD
/begin COMPU_METHOD u_vspd "vehicle speed" RAT_FUNC "%5.2" "kph" COEFFS 0.0 1.0 0.000000 0.0 0.0 0.0078125 /end COMPU_METHOD
/begin COMPU_METHOD u_pct "percentage" RAT_FUNC "%5.2" "%" COEFFS 0.0 1.0 0.000000 0.0 0.0 0.0030517578125 /end COMPU_METHOD
/begin COMPU_METHOD u_pct_1 "percentage" RAT_FUNC "%5.2" "%" COEFFS 0.0 1.0 0.000000 0.0 0.0 0.00152587890625 /end COMPU_METHOD
/begin COMPU_METHOD u_pct_8 "percentage" RAT_FUNC "%5.2" "%" COEFFS 0.0 1.0 0.000000 0.0 0.0 0.01220703125 /end COMPU_METHOD
/begin COMPU_METHOD u_pct_r "real pct" RAT_FUNC "%5.2" "%" COEFFS 0.0 1.0 0.000000 0.0 0.0 0.001953125 /end COMPU_METHOD
/begin COMPU_METHOD u_pct_r_s "real pct" RAT_FUNC "%5.2" "%" COEFFS 0.0 1.0 0.000000 0.0 0.0 0.00390625 /end COMPU_METHOD
/begin COMPU_METHOD u_kPa_0_4096 "IMEP" RAT_FUNC "%6.2" "kPa" COEFFS 0.0 1.0 0.000000 0.0 0.0 0.0625 /end COMPU_METHOD
/begin COMPU_METHOD u_tq "torque" RAT_FUNC "%5.1" "Nm" COEFFS 0.0 1.0 0.000000 0.0 0.0 0.0625 /end COMPU_METHOD
/begin COMPU_METHOD u_vvt_psn "vvt position" RAT_FUNC "%3.1" "Deg" COEFFS 0.0 1.0 0.000000 0.0 0.0 0.0009765625 /end COMPU_METHOD
/begin COMPU_METHOD x_imep "imep" RAT_FUNC "%6.2" "kpa" COEFFS 0.0 1.0 0.0 0.0 0.0 1.0 /end COMPU_METHOD
/begin COMPU_METHOD u_kPa_2048n_2048p "press" RAT_FUNC "%5.2" "kPa" COEFFS 0.0 1.0 0.000000 0.0 0.0 0.0625 /end COMPU_METHOD
/begin COMPU_METHOD u_kPa_2048n_2048pl "press" RAT_FUNC "%10.2" "kPa" COEFFS 0.0 1.0 2048.00 0.0 0.0 0.00000095367431640625 /end COMPU_METHOD
/begin COMPU_METHOD u_kPa_0_4096l "IMEP" RAT_FUNC "%10.2" "kPa" COEFFS 0.0 1.0 0.000000 0.0 0.0 0.00000095367431640625 /end COMPU_METHOD
/begin COMPU_METHOD u_kPa_0_128b "IMEP" RAT_FUNC "%10.2" "kPa" COEFFS 0.0 1.0 0.000000 0.0 0.0 0.5 /end COMPU_METHOD
/begin COMPU_METHOD u_pct_dc "duty cycle pct" RAT_FUNC "%5.2" "%" COEFFS 0.0 1.0 0.000000 0.0 0.0 0.0244140625 /end COMPU_METHOD
/begin COMPU_METHOD u_at_gr_typ_1 "" TAB_VERB "%5.0" "" COMPU_TAB_REF u_at_gr_typ_1 /end COMPU_METHOD
/begin COMPU_VTAB u_at_gr_typ_1 "" TAB_VERB 10 0 "PARK" 1 "REVERSE" 2 "NEUTRAL" 3 "1ST" 4 "2ND" 5 "3RD" 6 "4TH" 7 "5TH" 8 "ERROR" 9 "DRIVE" /end COMPU_VTAB
/begin COMPU_METHOD u_tq_gr_typ "" TAB_VERB "%5.0" "" COMPU_TAB_REF u_tq_gr_typ /end COMPU_METHOD
/begin COMPU_VTAB u_tq_gr_typ "" TAB_VERB 11 0 "GEAR_1" 1 "GEAR_2" 2 "GEAR_3" 3 "GEAR_4" 4 "GEAR_5" 5 "GEAR_6" 6 "GEAR_7" 7 "GEAR_8" 8 "UNKNOWN" 9 "PN" 10 "R" /end COMPU_VTAB
/begin COMPU_METHOD u_at_gr_shft_typ "" TAB_VERB "%5.0" "" COMPU_TAB_REF u_at_gr_shft_typ /end COMPU_METHOD
/begin COMPU_VTAB u_at_gr_shft_typ "" TAB_VERB 13 0 "No_Shift" 1 "PtoR" 2 "RtoN" 3 "NtoD" 4 "DtoN" 5 "NtoR" 6 "RtoP" 7 "RtoD" 8 "DtoR" 9 "PtoD" 10 "DtoP" 11 "PtoN" 12 "NtoP" /end COMPU_VTAB
/begin COMPU_METHOD b_trans_tmp "" TAB_VERB "%5.0" "" COMPU_TAB_REF b_trans_tmp /end COMPU_METHOD
/begin COMPU_VTAB b_trans_tmp "" TAB_VERB 2 0 "Trans_oil" 1 "Eng_coolant" /end COMPU_VTAB
/begin COMPU_METHOD u_fac_b_255 "factor" RAT_FUNC "%3.0" "fac" COEFFS 0.0 1.0 0.000000 0.0 0.0 1.0 /end COMPU_METHOD
/begin COMPU_METHOD u_surg_pv_cfg "" TAB_VERB "%5.0" "" COMPU_TAB_REF u_surg_pv_cfg /end COMPU_METHOD
/begin COMPU_VTAB u_surg_pv_cfg "" TAB_VERB 2 0 "Acc pedal" 1 "Virtual throttle" /end COMPU_VTAB
/begin COMPU_METHOD u_kPa_2048n_2048p_bias "press" RAT_FUNC "%5.2" "kPa" COEFFS 0.0 1.0 2048.0 0.0 0.0 0.0625 /end COMPU_METHOD
/begin COMPU_METHOD u_m3_per_s "cubic meter per second" RAT_FUNC "%5.4" "m3/s" COEFFS 0.0 1.0 0.000000 0.0 0.0 0.00006103515625 /end COMPU_METHOD
/begin COMPU_METHOD u_gear_3 "" TAB_VERB "%4.0" "" COMPU_TAB_REF u_gear_3 /end COMPU_METHOD
/begin COMPU_VTAB u_gear_3 "" TAB_VERB 3 0 "Gear1" 1 "Gear2" 2 "Gear3" /end COMPU_VTAB
/begin COMPU_METHOD u_pct_0_1 "percentage" RAT_FUNC "%5.4" "%" COEFFS 0.0 1.0 0.000000 0.0 0.0 0.0000152587890625 /end COMPU_METHOD
/begin COMPU_METHOD u_AC_load "" TAB_VERB "%10.4" "" COMPU_TAB_REF u_AC_load /end COMPU_METHOD
/begin COMPU_VTAB u_AC_load "" TAB_VERB 11 0 "0/-20" 1 "300/-10" 2 "600/0" 3 "900/10" 4 "1200/20" 5 "1500/30" 6 "1800/40" 7 "2100/50" 8 "2400/60" 9 "2700/70" 10 "3000/80" /end COMPU_VTAB
/begin COMPU_METHOD u_spd_grad "speed gradient" RAT_FUNC "%5.2" "rev/s2" COEFFS 0.0 1.0 0.0 0.0 0.0 0.015625 /end COMPU_METHOD
/begin COMPU_METHOD u_cvt_clutch_status "" TAB_VERB "%4.0" "" COMPU_TAB_REF u_cvt_clutch_status /end COMPU_METHOD
/begin COMPU_VTAB u_cvt_clutch_status "" TAB_VERB 4 0 "Open" 1 "Filling" 2 "Applied" 3 "Creeping" /end COMPU_VTAB
/begin COMPU_METHOD u_pid_fac_rsn "" TAB_VERB "%4.0" "" COMPU_TAB_REF u_pid_fac_rsn /end COMPU_METHOD
/begin COMPU_VTAB u_pid_fac_rsn "" TAB_VERB 2 0 "ACTransition" 1 "ATGearShift" /end COMPU_VTAB
/begin COMPU_METHOD u_idl_ld_chg_rsn "" TAB_VERB "%4.0" "" COMPU_TAB_REF u_idl_ld_chg_rsn /end COMPU_METHOD
/begin COMPU_VTAB u_idl_ld_chg_rsn "" TAB_VERB 3 0 "ACTransition" 1 "ATGearShift" 2 "NoReason" /end COMPU_VTAB
/begin COMPU_METHOD u_fac_100 "factor" RAT_FUNC "%6.4" "fac" COEFFS 0.0 1.0 0.000000 0.0 0.0 0.00152587890625 /end COMPU_METHOD
/begin COMPU_METHOD u_idl_mod "" TAB_VERB "%6.3" "" COMPU_TAB_REF u_idl_mod /end COMPU_METHOD
/begin COMPU_VTAB u_idl_mod "" TAB_VERB 4 0 "NORMAL" 1 "OVERRUN" 2 "LAUNCH" 3 "OTHER" /end COMPU_VTAB
/begin COMPU_METHOD u_idl_mode "" TAB_VERB "%6.3" "" COMPU_TAB_REF u_idl_mode /end COMPU_METHOD
/begin COMPU_VTAB u_idl_mode "" TAB_VERB 5 0 "NORMAL" 1 "OVERRUN" 2 "LAUNCH" 3 "OTHER" 4 "NUMBER_OF_MODE" /end COMPU_VTAB
/begin COMPU_METHOD u_ps_angle "angle" RAT_FUNC "%6.2" "angle" COEFFS 0.0 1.0 0.0 0.0 0.0 0.03125 /end COMPU_METHOD
/begin COMPU_METHOD u_idl_gr "" TAB_VERB "%6.3" "" COMPU_TAB_REF u_idl_gr /end COMPU_METHOD
/begin COMPU_VTAB u_idl_gr "" TAB_VERB 7 0 "gear1" 1 "Gear2" 2 "Gear3" 3 "Gear4" 4 "Gear5" 5 "PN" 6 "UNKNOWN" /end COMPU_VTAB
/begin COMPU_METHOD u_der_db "" TAB_VERB "%4.0" "" COMPU_TAB_REF u_der_db /end COMPU_METHOD
/begin COMPU_VTAB u_der_db "" TAB_VERB 2 0 "NEG" 1 "POS" /end COMPU_VTAB
/begin COMPU_METHOD u_idl_st_trans "" TAB_VERB "%6.3" "" COMPU_TAB_REF u_idl_st_trans /end COMPU_METHOD
/begin COMPU_VTAB u_idl_st_trans "" TAB_VERB 4 0 "OPEN_LOOP" 1 "OPEN2IDLE" 2 "IDLE" 3 "IDLE2OPEN" /end COMPU_VTAB
/begin FUNCTION ensc_idle_flow ""
 /begin DEF_CHARACTERISTIC ENSC_C_IDL_FLW_AMP_FAC ENSC_V_IDL_FLW_RAMP_EN ENSC_C_IDL_FLW_WRM_PN ENSC_C_IDL_FLW_WRM_D ENSC_C_IDL_FLW_WRM_R ENSC_V_IDL_FLW_WRM_MX_BIAS ENSC_C_IDL_FLW_WRM_MT_BIAS ENSC_C_IDL_FLW_WRM_DCY_FAC ENSC_C_IDL_FLW_WRM_DCY_DLY ENSC_C_IDL_FLW_WRM_MT_DCY_FAC_CLS ENSC_C_IDL_FLW_WRM_MT_DCY_FAC_OP ENSC_V_IDL_FLW_WRM_MX_DCY_FAC ENSC_V_IDL_FLW_WRM_DCY_THR ENSC_V_TRANS_FLW_RMP_CFG ENSC_V_TRANS_TMP_CFG ENSC_C_TRANS_FLW_DUR_ECT_FAC ENSC_V_GR_SHFT_1ST_RUN_MAX ENSC_V_GR_SHFT_1ST_TMP_MAX ENSC_C_TRANS_FLW_PN2R_1ST ENSC_V_TRANS_FLW_DUR_PN2R_1ST ENSC_C_TRANS_FLW_PN2D_1ST ENSC_V_TRANS_FLW_DUR_PN2D_1ST ENSC_V_TRANS_FLW_DUR_PN2R ENSC_C_TRANS_FLW_PN2D ENSC_C_TRANS_FLW_PN2R ENSC_V_TRANS_FLW_DUR_PN2D ENSC_C_TRANS_FLW_R2PN ENSC_V_TRANS_FLW_DUR_R2PN ENSC_C_TRANS_FLW_D2PN ENSC_V_TRANS_FLW_DUR_D2PN ENSC_C_TRANS_FLW_D2R ENSC_V_TRANS_FLW_DUR_D2R ENSC_C_TRANS_FLW_R2D ENSC_V_TRANS_FLW_DUR_R2D ENSC_C_TRANS_ENG_DLY_P2R_1ST ENSC_C_TRANS_FLW_RMP_DLY_P2R_1ST ENSC_C_TRANS_ENG_DLY_N2R_1ST ENSC_C_TRANS_FLW_RMP_DLY_N2R_1ST ENSC_C_TRANS_ENG_DLY_N2D_1ST ENSC_C_TRANS_FLW_RMP_DLY_N2D_1ST ENSC_C_TRANS_ENG_DLY_P2D_1ST ENSC_C_TRANS_FLW_RMP_DLY_P2D_1ST ENSC_C_TRANS_ENG_DLY_P2R ENSC_C_TRANS_FLW_RMP_DLY_P2R ENSC_C_TRANS_ENG_DLY_N2R ENSC_C_TRANS_FLW_RMP_DLY_N2R ENSC_C_TRANS_ENG_DLY_R2P ENSC_C_TRANS_FLW_RMP_DLY_R2P ENSC_C_TRANS_ENG_DLY_R2N ENSC_C_TRANS_FLW_RMP_DLY_R2N ENSC_C_TRANS_ENG_DLY_P2N ENSC_C_TRANS_ENG_DLY_N2P ENSC_C_TRANS_ENG_DLY_D2N ENSC_C_TRANS_FLW_RMP_DLY_D2N ENSC_C_TRANS_ENG_DLY_N2D ENSC_C_TRANS_FLW_RMP_DLY_N2D ENSC_C_TRANS_ENG_DLY_D2P ENSC_C_TRANS_FLW_RMP_DLY_D2P ENSC_C_TRANS_ENG_DLY_P2D ENSC_C_TRANS_FLW_RMP_DLY_P2D ENSC_C_TRANS_ENG_DLY_D2R ENSC_C_TRANS_FLW_RMP_DLY_D2R ENSC_C_TRANS_FLW_HLD_DUR_D2R ENSC_C_TRANS_FLW_RMP_THR_D2R ENSC_C_TRANS_ENG_DLY_R2D ENSC_C_TRANS_FLW_RMP_DLY_R2D ENSC_C_TRANS_FLW_HLD_DUR_R2D ENSC_C_TRANS_FLW_RMP_THR_R2D ENSC_C_TRANS_ENG_DLY_INGR_BIAS ENSC_C_TRANS_ENG_DLY_OUTGR_BIAS ENSC_C_TRANS_ENG_DLY_DR_BIAS ENSC_M_IDL_FLW_CONV_R ENSC_M_IDL_FLW_CONV_D ENSC_M_IDL_FLW_CONV_PN ENSC_M_IDL_FLW_CONV_VSPD_EN_THR ENSC_C_IDL_FLW_CONV_VSPD_DIS_HYS ENSC_C_IDL_FLW_CONV_VSPD_RMP_HYS ENSC_V_IDL_FLW_CONV_RMP_DN_STP ENSC_C_IDL_FLW_CONV_RMP_UP_STP ENSC_C_IDL_FLW_CONV_FAC ENSC_V_IDL_FLW_CONV_FIL ENSC_V_IDL_FLW_LNCH_DCY_FAC ENSC_V_IDL_FLW_LNCH_I_MAX ENSC_C_IDL_FLW_LNCH ENSC_V_IDL_FLW_LNCH ENSC_V_IDL_FLW_LNCH_DCY_THR ENSC_V_IDL_FLW_LNCH_DCY_FAC_HIDEV ENSC_V_IDL_FLW_LNCH_REC_THR ENSC_C_IDL_FLW_LNCH_ECT_FAC ENSC_V_AC_HL_OFFT_MIN ENSC_V_AC_HL_OFFT_MAX ENSC_V_AC_HL_KEYON_ECT_MIN ENSC_V_AC_HL_KEYON_IAT_MIN ENSC_V_AC_HL_IAT_MIN ENSC_V_AC_HL_MIN_AC_OFF_TIM ENSC_C_AC_FLW_LO_HL ENSC_C_AC_FLW_LO ENSC_C_AC_FLW_HI ENSC_C_AC_FLW_HI_HL ENSC_V_AC_FLW_DCY_FAC_HL ENSC_V_AC_FLW_DCY_FAC ENSC_V_AC_FLW_DCY_DLY ENSC_C_IDL_FLW_ST ENSC_V_IDL_FLW_HRST ENSC_C_IDL_FLW_ST_HLD_DUR ENSC_C_IDL_FLW_ST_DCY_DLY ENSC_V_IDL_FLW_ST_DCY_FAC ENSC_C_IDL_FLW_OR ENSC_V_BAT_VLT_FIL ENSC_V_IDL_FLW_BAT_EN_DLY ENSC_C_IDL_FLW_BAT ENSC_V_BAT_VLT_DFLT ENSC_V_IDL_FLW_FAN_LO ENSC_V_IDL_FLW_FAN_LO_DCY_FAC ENSC_V_IDL_FLW_FAN_LO_DCY_DLY ENSC_V_IDL_FLW_FAN_HI ENSC_V_IDL_FLW_FAN_HI_DCY_FAC ENSC_V_IDL_FLW_FAN_HI_DCY_DLY ENSC_C_IDL_FLW_PWM_FAN ENSC_V_IDL_FLW_ELOAD1 ENSC_V_IDL_FLW_ELOAD1_DCY_DLY ENSC_V_IDL_FLW_ELOAD1_DCY_FAC ENSC_V_IDL_FLW_ELOAD2 ENSC_V_IDL_FLW_ELOAD2_DCY_DLY ENSC_V_IDL_FLW_ELOAD2_DCY_FAC ENSC_C_IDL_FLW_PS_BAS ENSC_V_IDL_FLW_PS_BIAS_DR_AC ENSC_V_IDL_FLW_PS_BIAS_DR ENSC_V_IDL_FLW_PS_BIAS_PN_AC ENSC_V_IDL_FLW_PS_BIAS_PN ENSC_C_IDL_FLW_PS_ESPD_FAC ENSC_C_IDL_FLW_PS_TRANS ENSC_C_IDL_FLW_PS_TRANS_DUR ENSC_V_IDL_FLW_PS_TRANS_EN_DLY ENSC_V_IDL_FLW_PS_TRANS_DCY_DLY ENSC_V_IDL_FLW_PS_TRANS_DCY_FAC ENSC_C_IDL_FLW_PS ENSC_C_IDL_FLW_PS_BIAS_DELTP_R ENSC_C_IDL_FLW_PS_BIAS_DELTP ENSC_C_IDL_FLW_PS_DCY_STP ENSC_V_IDL_FLW_PSOFF ENSC_V_IDL_FLW_PSOFF_DLY ENSC_V_IDL_FLW_PSOFF_DUR ENSC_V_IDL_FLW_PSOFF_DCY_DLY ENSC_V_IDL_FLW_PSOFF_DCY_FAC ENSC_C_ANTISTL_EN_DEV_THR ENSC_V_ANTISTL_RUN_MIN ENSC_V_ANTISTL_VSPD_MAX ENSC_V_ANTISTL_VSPD_HYS ENSC_V_ANTISTL_IDL_SP_DELT_THR ENSC_V_ANTISTL_FLW_DR ENSC_V_ANTISTL_FLW_PN ENSC_V_ANTISTL_FLW_DCY_STP ENSC_V_ANTISTL_DIS_DEV_THR ENSC_V_NIDL_TRANS_TMP_CFG ENSC_C_NIDL_RMP_IN_DLY_R ENSC_C_NIDL_RMP_IN_DLY_N ENSC_C_NIDL_RMP_IN_DLY ENSC_V_NIDL_RMP_IN_DUR_R ENSC_V_NIDL_RMP_IN_DUR_N ENSC_V_NIDL_RMP_IN_DUR ENSC_C_NIDL_FLW_RMP_IN_R ENSC_C_NIDL_FLW_RMP_IN_N ENSC_C_NIDL_FLW_RMP_IN ENSC_V_NIDL_RMP_IN_DLY_THR ENSC_V_NIDL_RMP_IN_DUR_THR ENSC_C_NIDL_FLW ENSC_C_NIDL_RMP_OUT_DLY_R ENSC_C_NIDL_RMP_OUT_DLY_N ENSC_C_NIDL_RMP_OUT_DLY ENSC_V_NIDL_RMP_OUT_DUR_R ENSC_V_NIDL_RMP_OUT_DUR_N ENSC_V_NIDL_RMP_OUT_DUR ENSC_C_NIDL_FLW_RMP_OUT_R ENSC_C_NIDL_FLW_RMP_OUT_N ENSC_C_NIDL_FLW_RMP_OUT ENSC_V_NIDL_RMP_OUT_DLY_THR ENSC_C_IDL_FLW_CVT_BIAS_CFG ENSC_V_CRP_VSPD_MAX ENSC_C_IDL_FLW_CRP ENSC_C_IDL_FLW_CRP_FAC ENSC_V_IDL_FLW_CRP_RMP_EN ENSC_V_IDL_FLW_CRP_ZERO_DB ENSC_V_IDL_FLW_CRP_RST_EN ENSC_V_IDL_FLW_CRP_RMP_THR ENSC_V_IDL_FLW_CRP_RMP_STP_INC ENSC_V_IDL_FLW_CRP_RMP_STP_DEC ENSC_V_IDL_FLW_I_DFLT_D ENSC_V_IDL_FLW_I_DFLT_R ENSC_V_IDL_FLW_I_DFLT_AC_BIAS ENSC_V_IDL_ST_PD_EN ENSC_V_LD_CHG_PID_FAC_EN ENSC_V_LD_CHG_PID_FAC_RUN_MIN ENSC_V_AC_ON_PID_FAC_DUR ENSC_V_AC_OFF_PID_FAC_DUR ENSC_V_GR_SHFT_PID_FAC_DUR ENSC_C_LD_CHG_PID_FAC_PRI ENSC_C_GR_SHFT_FAC_NM_P ENSC_C_GR_SHFT_FAC_NM_I ENSC_C_GR_SHFT_FAC_NM_D ENSC_V_GR_SHFT_FAC_OR_P ENSC_V_GR_SHFT_FAC_OR_I ENSC_V_GR_SHFT_FAC_OR_D ENSC_V_AC_FAC_NM_P ENSC_V_AC_FAC_NM_I ENSC_V_AC_FAC_NM_D ENSC_V_AC_FAC_OR_P ENSC_V_AC_FAC_OR_I ENSC_V_AC_FAC_OR_D ENSC_V_LD_CHG_FAC_P_INC_STP ENSC_V_LD_CHG_FAC_P_DEC_STP ENSC_V_LD_CHG_FAC_I_INC_STP ENSC_V_LD_CHG_FAC_I_DEC_STP ENSC_V_LD_CHG_FAC_D_INC_STP ENSC_V_LD_CHG_FAC_D_DEC_STP ENSC_V_LNCH_I_OL_EN ENSC_V_LNCH_I_OL_ESPD_DB ENSC_V_I_RPM_DEV_FAC ENSC_C_I_GN_LNCH ENSC_V_NM_I_ESPD_DB ENSC_V_OR_I_ESPD_DB ENSC_C_I_GN_ANTISTL ENSC_V_LNCH_I_GN_EN ENSC_V_I_GN_ANTISTL_OR_IDL_EN ENSC_C_I_GN_PN ENSC_C_I_GN_R ENSC_C_I_GN_D ENSC_V_I_GN_OR_POS ENSC_V_I_GN_OR_NEG ENSC_C_ANTISTL_I_DEV_ESPD_THR ENSC_V_ANTISTL_I_DEV_PN ENSC_V_ANTISTL_I_DEV_D ENSC_V_ANTISTL_I_DEV_PN_DLY ENSC_V_ANTISTL_I_DEV_D_DLY ENSC_V_I_SUM_DEV_RST_FAC ENSC_V_I_SUM_RST_ESPD_FAC ENSC_V_I_DEV_RST_FAC_LO_ESPD ENSC_V_I_DEV_RST_FAC_HI_SUM ENSC_V_I_DEV_RST_FAC_DECLTCH ENSC_V_I_DEV_RST_FAC_DECLTCH_MT_N ENSC_V_I_SUM_RST_ESPD_FAC_DECLTCH ENSC_V_THRO_ERR_ESPD_DEV_DB ENSC_V_THRO_POS_ERR_MAX ENSC_V_THRO_NEG_ERR_MAX ENSC_V_I_SUM_DEV_THR_FIL ENSC_M_I_SUM_DEV_MIN ENSC_M_I_SUM_DEV_MAX ENSC_V_FLW_I_MIN_INIT_AC ENSC_V_FLW_I_MAX_INIT_AC ENSC_V_FLW_I_MIN_INIT ENSC_V_FLW_I_MAX_INIT ENSC_V_FLW_I_INIT_BIAS_AC ENSC_V_FLW_I_INIT_BIAS ENSC_V_STAB_IDL_ECT_MIN ENSC_V_STAB_IDL_TIM_THR ENSC_V_STAB_IDL_ESPD_DEV_FIL_THR ENSC_V_STAB_IDL_ESPD_DEV_THR ENSC_V_STAB_IDL_ESPD_CPS_THR ENSC_V_PS_HI_LD_THR ENSC_V_FST_ADP_STL_INIT_RUN_MIN ENSC_V_FST_ADP_STL_INIT_FAC ENSC_V_IDL_FLW_I_DFLT_N ENSC_V_P_ESPD_DB_ST_PD ENSC_V_P_ESPD_DB_NM_PN_POS ENSC_V_P_ESPD_DB_NM_D_POS ENSC_V_P_ESPD_DB_NM_PN_NEG ENSC_V_P_ESPD_DB_NM_D_NEG ENSC_V_P_ESPD_DB_OR_POS ENSC_V_P_ESPD_DB_OR_NEG ENSC_C_P_FAC_NM ENSC_C_P_FAC_OR_POS ENSC_C_P_FAC_OR_NEG ENSC_V_P_FAC_LNCH_PD_POS ENSC_V_P_FAC_LNCH_PD_NEG ENSC_V_FLW_P_MAX ENSC_V_FLW_P_MIN ENSC_C_FLW_P_ST_PD ENSC_C_FLW_P_LNCH ENSC_C_FLW_P_PN ENSC_C_FLW_P_DR_SHFT ENSC_C_FLW_P ENSC_M_FLW_P_OR ENSC_C_D_EIT_DB_ST_PD ENSC_C_D_EIT_DB_OR ENSC_C_D_EIT_DB_LNCH_PD ENSC_C_D_EIT_DB ENSC_C_D_EIT_DB_LDCHG ENSC_C_D_ESPD_DB_ST_PD ENSC_C_D_ESPD_DB_OR ENSC_C_D_ESPD_DB_LNCH_PD ENSC_C_D_ESPD_DB ENSC_C_FLW_D_ST_PD ENSC_C_FLW_D_OR ENSC_C_FLW_D ENSC_C_FLW_D_DR_SHFT ENSC_C_FLW_D_LNCH ENSC_C_D_FAC_OR ENSC_C_D_FAC ENSC_V_FLW_FAST_RMP_IN_STP ENSC_V_FLW_FAST_RMP_OUT_STP ENSC_V_FLW_SLOW_RMP_THR ENSC_V_FLW_SLOW_RMP_STP_INC ENSC_V_FLW_SLOW_RMP_STP_DEC ENSC_V_IDL_I_REF_TIM_THR ENSC_V_IDL_I_REF_LO ENSC_V_IDL_I_REF_HI /end DEF_CHARACTERISTIC
 /begin OUT_MEASUREMENT ensc_idl_flw ensc_idl_flw_cl ensc_idl_flw_ol ensc_idl_flw_i ensc_idl_flw_slow_raw ensc_idl_flw_slow ensc_idl_flw_fast ensc_idl_flw_p ensc_idl_flw_d ensc_idl_flw_wrm ensc_idl_flw_trans ensc_idl_flw_conv ensc_idl_flw_lnch ensc_idl_flw_lnch_i_ol ensc_idl_flw_ac ensc_idl_flw_or ensc_idl_flw_fan ensc_idl_flw_eld ensc_idl_flw_ps ensc_idl_flw_antistall ensc_idl_flw_bat ensc_idl_flw_crp ensc_idl_flw_nidl ensc_btm_cltch_release_1st ensc_idl_flw_wrm_pn ensc_idl_flw_wrm_r ensc_idl_flw_wrm_d ensc_idl_flw_wrm_pn_mx ensc_idl_flw_wrm_d_mx ensc_idl_flw_wrm_r_mx ensc_idl_flw_wrm_dcy_fac ensc_idl_flw_wrm_mt_dcy_fac ensc_idl_flw_wrm_mt_en ensc_idl_flw_wrm_mt ensc_en_gr_st_prev ensc_gr_shft_1st ensc_dr_shft_st ensc_dr_shft_flw_en ensc_trans_flw_rmp_dly ensc_trans_flw_rmp_tgt ensc_trans_flw_rmp_dur ensc_trans_flw_rmp_rate ensc_trans_flw_hld_dur ensc_trans_flw_hld ensc_trans_flw_rmp_thr ensc_trans_eng_dly_bias ensc_gr_shft_st ensc_idl_flw_conv_fac ensc_lnch_i_ol_dev ensc_idl_flw_lnch_ect_fac ensc_ac_flw_dcy_stat ensc_ac_hl_stat ensc_idl_flw_st_hld_stat ensc_idl_flw_fan_lo ensc_idl_flw_fan_hi ensc_idl_flw_eload1 ensc_idl_flw_eload2 ensc_antistl_actv ensc_antistl_vspd_thr ensc_idl_sp_chg_stat ensc_nidl_actv ensc_nidl_rmp_in ensc_nidl_rmp_out ensc_nidl_trans_stat ensc_nidl_dly_stat ensc_nidl_rmp_in_dly ensc_nidl_rmp_in_dur ensc_nidl_flw_rmp_in ensc_cvt_flw_en ensc_idl_flw_crp_hld ensc_idl_flw_crp_rmp_dis ensc_tq_req_pct_old ensc_idl_flw_crp_raw ensc_tq_crp_hld_thr ensc_idl_flw_adp_slw_nv_d ensc_idl_flw_adp_slw_nv_d_ac ensc_idl_flw_adp_slw_nv_r ensc_idl_flw_adp_slw_nv_r_ac ensc_idl_flw_adp_fst_nv_d ensc_idl_flw_adp_fst_nv_d_ac ensc_idl_flw_adp_fst_nv_r ensc_idl_flw_adp_fst_nv_r_ac ensc_idl_st_pd_en ensc_ld_chg_pid_rsn ensc_ld_chg_pid_pri ensc_ld_chg_fac_p ensc_ld_chg_fac_i ensc_ld_chg_fac_d ensc_i_dev_total ensc_i_dev_bas ensc_i_dev_dly_cnt ensc_antistl_i_dev_actv ensc_i_dev_sum_rst ensc_i_sum_dev_pn_ac ensc_i_sum_dev_pn ensc_i_sum_dev_d_ac ensc_i_sum_dev_d ensc_i_sum_dev_r_ac ensc_i_sum_dev_r ensc_i_sum_dev_rst_stat_ac ensc_i_sum_dev_rst_stat ensc_i_sum_dev_max ensc_idl_diag_stat ensc_idl_mod ensc_idl_mod_old ensc_i_sum_dev_thr_fil_stat ensc_i_sum_dev_min ensc_i_sum_dev_min_tgt ensc_i_sum_dev_max_tgt ensc_stab_idl_met_d_ac ensc_stab_idl_met_d ensc_stab_idl_met_r_ac ensc_stab_idl_met_r ensc_idl_flw_adp_fst_nv_pn_ac ensc_idl_flw_adp_fst_nv_pn ensc_idl_flw_adp_slw_nv_pn_ac ensc_idl_flw_adp_slw_nv_pn ensc_idl_flw_adp_fst_curr ensc_idl_flw_adp_slw_curr ensc_i_dev_adp_fst ensc_i_dev_wrm ensc_stab_idl_conds_met ensc_ps_hi_ld_stat ensc_idl_flw_p_fac ensc_idl_flw_d_fac ensc_idl_flw_fast_raw ensc_idl_st_trans_stat ensc_idl_flw_fast_rmp_stat ensc_idl_i_update_1st_stat ensc_idl_i_ref ensc_stab_idl_tmr /end OUT_MEASUREMENT
/end FUNCTION
/begin FUNCTION ensc_idle_torq "" /begin DEF_CHARACTERISTIC ENSC_V_IDL_FLW_TO_TQ_GAIN /end DEF_CHARACTERISTIC /begin OUT_MEASUREMENT ensc_idl_tq_slow ensc_idl_tq_fast /end OUT_MEASUREMENT /end FUNCTION
/begin FUNCTION ensc_axis ""
 /begin DEF_CHARACTERISTIC ENSC_X_VSPD_A ENSC_X_VSPD_B ENSC_X_ECT_A ENSC_X_ECT_C ENSC_X_ECT_B ENSC_X_TMP ENSC_X_ESPD ENSC_X_OIL_T ENSC_X_ESPD_SP ENSC_X_ESPD_DEV_A ENSC_X_FAC ENSC_X_PCT ENSC_X_ECT_F ENSC_X_VSPD_C ENSC_X_BAT_VLT ENSC_X_ESPD_A ENSC_X_PS_P ENSC_X_PS_DELTP ENSC_X_ESPD_SP_A ENSC_X_CRP_TQ ENSC_X_ESPD_DEV_B ENSC_X_ECT_D ENSC_X_ESPD_DEV_C ENSC_X_ECT_E ENSC_X_ESPD_DEV_D ENSC_X_ESPD_DEV_E ENSC_X_VSPD_D /end DEF_CHARACTERISTIC
 /begin OUT_MEASUREMENT /end OUT_MEASUREMENT
/end FUNCTION
/begin FUNCTION ensc "engine speed control"
 /begin SUB_FUNCTION ensc_espd_sp ensc_idle_conditions ensc_idle_state ensc_idle_flow ensc_idle_torq ensc_axis /end SUB_FUNCTION
/end FUNCTION
/begin FUNCTION charg "turbo charger control"
 /begin DEF_CHARACTERISTIC CHRG_C_WGPWM_FAC_CPA_BND CHRG_C_WGPWM_FAC_DLTP_BND CHRG_C_SURG_PV_MIN CHRG_V_SURG_EN CHRG_C_SURG_LN_HYS CHRG_C_CP_SP_DEC_RT_THRSH CHRG_V_RST_I CHRG_V_TPS_PQ_LMT_CP CHRG_V_WG_TO_AMP CHRG_V_SURG_PV_CNT CHRG_V_CP_BUF_CNT CHRG_V_SURG_PV_CFG CHRG_X_AMP_C CHRG_V_CPA_DLT_FIL CHRG_V_AMP_STD CHRG_V_CL_EN_BIAS CHRG_V_CP_THR CHRG_V_CPA_RT_I_EN_THR CHRG_C_SURG_LN CHRG_X_PQ_A CHRG_V_CP_I_RST_THR CHRG_V_WGPWM_FAC_CPA_HYS CHRG_V_WGPWM_FAC_DLTP_HYS CHRG_V_WGPWM_ADP_MAX_CPA CHRG_V_BUF_RT_USE CHRG_C_CP_SP_ACC_RT_THRSH CHRG_V_WGPWM_ADP_MAX_CPA_ERR CHRG_V_WGPWM_ADP_MAP_BIAS CHRG_V_WGPWM_ADP_MIN_ESPD CHRG_V_SURG_TPS_INC_RT CHRG_V_CP_SP_FILT CHRG_X_AMP_F CHRG_V_SURG_MIN_TPS CHRG_V_SURG_PVR_THR CHRG_V_WGPWM_MAX CHRG_V_WGPWM_MIN CHRG_V_WGPWM_FAC_ADP_STP CHRG_V_DEC_EXT_DLY CHRG_C_CP_SP_THRSH_LO CHRG_V_WGPWM_FAC_MAX CHRG_V_WGPWM_FAC_MIN CHRG_V_WGPWM_FAC_RMP_STP CHRG_V_SURG_MAX_TM CHRG_V_RCV_CLS_MIN CHRG_V_SP_DLY CHRG_X_AMP_E CHRG_V_WGPWM_ADP_DLY CHRG_V_SURG_MIN_VSPD CHRG_X_CPA_ERR_C CHRG_X_CPA_ERR_A CHRG_X_ESPD_B CHRG_X_FLW_A CHRG_V_RCV_OPN CHRG_X_AMP_D CHRG_X_ESPD_A CHRG_X_AMP_A CHRG_X_AMP_B CHRG_X_CPA_ERR_B CHRG_X_DLTP_A CHRG_X_DLTP_A CHRG_V_WG_CLS_INC_PWM CHRG_C_STD_FLW_FIL CHRG_X_MAF_PCT CHRG_X_STD_CFLW_MMV CHRG_X_INTCT_A CHRG_X_IAT_A CHRG_C_CP_SP_MAX_INC_STP CHRG_V_MX_CMPR_ERR_CP_SP_HYST CHRG_C_CP_SP_THRSH_HI CHRG_M_CP_SP_MAX CHRG_C_CP_SP_MAX_INC_EN_BIAS CHRG_M_WG_DPHR_DLTP_SP_BIAS CHRG_M_WG_DPHR_DLTP_SP_BS CHRG_V_MX_CMPR_ERR_CP_SP_THRSH CHRG_M_WGPWM CHRG_M_WGPWM_BIAS CHRG_C_CP_I_GN CHRG_C_CP_P_GN CHRG_M_DPHR_DLTP_SP_AMP_FAC CHRG_X_ESPD_C CHRG_V_WGPWM_CP_SP_THRSH CHRG_M_CMPR_PQ_SP_MAX_IAT_BIAS CHRG_M_CMPR_PQ_SP_MAX CHRG_M_PQ_SP_MAX_AMP_BIAS CHRG_M_PQ_SP_MAX_AMP_BIAS_M CHRG_M_MX_BSTP_SP_AMP_BIAS /end DEF_CHARACTERISTIC
 /begin OUT_MEASUREMENT chrg_surg_pv_en chrg_cp_en chrg_cp_hi chrg_cl_en chrg_i_rst_en chrg_wgpwm_fac_chng chrg_wgpwm_fac_adp_en chrg_wgpwm_fac_rmp chrg_surg_pv_rls_cnt chrg_cp_buff_idx chrg_std_cflw_mmv chrg_cpa_raw chrg_cpa_dlt_raw chrg_cpa_dlt_mmv chrg_cp_err chrg_cp_err_s chrg_cl_cor chrg_i_dlt chrg_i_h chrg_cp_sp_max_eng_ltd chrg_cp_sp_max_c_ltd chrg_map chrg_cp_sp_max_rt_ltd chrg_cp_sp_raw chrg_wg_dphr_dltp_sp chrg_wg_dphr_p_sp chrg_wg_dltp_sp chrg_wg_dltp_cl_sp chrg_wg_dltp_ol_sp chrg_wg_dltp_max chrg_surg_pv chrg_wgpwm_raw chrg_wgpwm_bias chrg_cmpr_pq_sp_max chrg_cmpr_pq_sp_max_amp_bias chrg_wgpwm_fac_tgt chrg_surg_en chrg_wgpwm_fac_cell chrg_wgpwm_fac_disp_idx chrg_cpa_inc_rt chrg_cp_sp chrg_cp_sp_lo chrg_i chrg_cp_sp_eng_max chrg_cp_sp_max chrg_p chrg_wgpwm chrg_wgpwm_fac chrg_wgpwm_fac_disp_val chrg_eng_load chrg_mx_bstp_sp_amp_bias chrg_wg_dphr_p_sp_cor /end OUT_MEASUREMENT
/end FUNCTION
/begin FUNCTION ente_fan "fan control"
 /begin DEF_CHARACTERISTIC ENTE_V_FAN_TYP ENTE_V_AC_LOAD_TYP ENTE_V_AC_PRES_HI ENTE_V_AC_PRES_MED ENTE_V_AC_PRES_LO ENTE_V_AC_P_HI_HYS ENTE_V_AC_P_MED_HYS ENTE_V_AC_P_LO_HYS ENTE_V_AC_T_HI ENTE_V_AC_T_MED ENTE_V_AC_T_LO ENTE_V_AC_T_HYS ENTE_V_VSPD_MED ENTE_V_VSPD_MED_HYS ENTE_V_VSPD_HI ENTE_V_VSPD_HI_HYS ENTE_V_ETHM_HI_THR ENTE_V_ETHM_HI_HYS ENTE_M_FAN_ON_LO_THR ENTE_M_FAN_ON_MED_THR ENTE_M_FAN_ON_HI_THR ENTE_V_FAN_ON_LO_HYS ENTE_V_FAN_ON_MED_HYS ENTE_V_FAN_ON_HI_HYS ENTE_V_FAN_OFF_MIN ENTE_V_FAN_ON_MIN ENTE_V_FAN_EN_RUN_MIN ENTE_V_FAN_REQ_ST_KP_MIN ENTE_V_FAN_SPD_TYP ENTE_V_FAN_ON_DLY ENTE_V_FAN_OFF_DLY ENTE_V_FAN_PWM_INC_STP ENTE_V_FAN_PWM_DEC_STP ENTE_V_FAN_PWM_VSPD_HI ENTE_C_PWM_HILD_ACON_V_LO ENTE_C_PWM_HILD_ACON_V_HI ENTE_C_PWM_MEDLD_ACON_V_LO ENTE_C_PWM_MEDLD_ACON_V_MED ENTE_C_PWM_MEDLD_ACON_V_HI ENTE_C_PWM_LOLD_ACON_V_LO ENTE_C_PWM_LOLD_ACON_V_MED ENTE_C_PWM_LOLD_ACON_V_HI ENTE_C_PWM_VLOLD_ACON ENTE_V_FAN_PWM_V_HI_T ENTE_V_FAN_PWM_V_MED_T ENTE_V_FAN_PWM_T_HYS ENTE_C_PWM_ACOFF ENTE_V_FAN_PWM_MIN ENTE_V_FAN_OFF_PWM ENTE_V_FAN_OFFR_EN_ECT ENTE_C_FAN_OFFR_EXT_ECT ENTE_V_FAN_OFFR_EN_AC_P ENTE_V_FAN_OFFR_EN_RUN_MIN ENTE_V_FAN_OFFR_AC_P_DUR ENTE_C_FAN_OFFR_ECT_LVL ENTE_V_FAN_OFFR_EXT_AC_P ENTE_V_FAN_OFFR_EXT_VLT ENTE_V_FAN_OFFR_AC_P_HI ENTE_V_FAN_OFFR_AC_P_LO ENTE_V_FAN_OFFR_ECT_HI ENTE_V_FAN_OFFR_ECT_LO ENTE_V_FAN_OFFR_HI_TYP ENTE_V_FAN_OFFR_MED_TYP ENTE_C_FAN_OFFR_PWM ENTE_V_FAN_HI_BY_ACON ENTE_X_ECT_A ENTE_X_OFFR_DUR /end DEF_CHARACTERISTIC
 /begin OUT_MEASUREMENT ente_fan_vspd_st ente_fan_ac_st ente_fan_ac_actv ente_fan_req_st ente_fan_ctrl_st ente_fan_req_pwm ente_fan_ctrl_chg_off_dly ente_fan_ctrl_chg_low_dly ente_fan_act_pwm ente_fan_offr_typ ente_fan_offr_actv ente_fan_offr_dur ente_fan_ctrl_chg_med_dly ente_fan_ctrl_chg_high_dly ente_fan_low_en_thr ente_fan_typ /end OUT_MEASUREMENT
/end FUNCTION
/begin RECORD_LAYOUT __UBYTE_S FNC_VALUES 1 UBYTE COLUMN_DIR DIRECT /end RECORD_LAYOUT
/begin RECORD_LAYOUT __UWORD_S FNC_VALUES 1 UWORD COLUMN_DIR DIRECT /end RECORD_LAYOUT
/begin RECORD_LAYOUT __SWORD_S FNC_VALUES 1 SWORD COLUMN_DIR DIRECT /end RECORD_LAYOUT
/begin RECORD_LAYOUT SSV__UWORD_S AXIS_PTS_X 1 UWORD INDEX_INCR DIRECT /end RECORD_LAYOUT
/begin RECORD_LAYOUT SSV__SWORD_S AXIS_PTS_X 1 SWORD INDEX_INCR DIRECT /end RECORD_LAYOUT
/end MODULE
/end PROJECT
