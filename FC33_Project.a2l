ASAP2_VERSION 1 60
/begin PROJECT FC33 ""
/begin HEADER "" VERSION "1.0" /end HEADER
/begin MODULE FC33 ""
/begin MOD_COMMON "" BYTE_ORDER MSB_FIRST ALIGNMENT_LONG 2 ALIGNMENT_WORD 1 /end MOD_COMMON
/begin MEASUREMENT fmsp_tf_comp "transient fuel compensation.fmsp_stk_fnl=fmsp_stk_cyl_cor+fmsp_tf_comp" SWORD u_gram_2 0 0 -1 0.999969482421875 ECU_ADDRESS 0x40003CF2 /end MEASUREMENT
/begin MEASUREMENT fmsp_tf_fac_neg "factor used to calculate fmsp_tf_comp when fmsp_tf_comp<0" UWORD u_fac_4 0 0 0.00 3.99993896484375 ECU_ADDRESS 0x400050DA FORMAT "%6.5" /end MEASUREMENT
/begin MEASUREMENT fmsp_tf_fac_pos "factor used to calculate fmsp_tf_comp when fmsp_tf_comp>0" UWORD u_fac_8 0 0 0.0 7.9998779296875 ECU_ADDRESS 0x4000DA4E FORMAT "%5.4" /end MEASUREMENT
/begin MEASUREMENT fmsp_stk_inj "stroke fuel quantity need to deliver by injector including fuel into cylinder and wall film" UWORD u_stk_flw 0 0 0.0 1.99996948242187 ECU_ADDRESS 0x4000DA4E FORMAT "%4.3" /end MEASUREMENT
/begin MEASUREMENT fmsp_wall_film_trm "wall film term used in transient fuel compensation" UWORD u_gram_1 0 0 0.0 0.9999847412109375 ARRAY_SIZE 4 ECU_ADDRESS 0x4000DA4E /end MEASUREMENT
/begin MEASUREMENT fmsp_wall_film_dcy_fac "decay factor of fmsp_wall_film_trm" UWORD u_fac_1 0 0 0.0 0.999984741210937 ECU_ADDRESS 0x4000DA4E /end MEASUREMENT
/begin MEASUREMENT fmsp_wall_film_fac "factor of fmsp_stk_inj to calculate fmsp_wall_film_trm" UWORD u_fac_1 0 0 0.0 0.999984741210937 ECU_ADDRESS 0x4000DA4E /end MEASUREMENT
/begin MEASUREMENT fmsp_cl_diff "close loop difference between current int term and average int term." SWORD u_fac_n2_p2 0 0 -2 1.99993896484375 ECU_ADDRESS 0x4000DA4E FORMAT "%5.4" /end MEASUREMENT
/begin MEASUREMENT fmsp_bs_delta_pos "base fuel delta is positive." UBYTE b_true 0 0 0.00 1.00 ECU_ADDRESS 0x400050DA FORMAT "%1.0" /end MEASUREMENT
/begin MEASUREMENT fmsp_trns_cor_fac "Transient fuel correction factor." SWORD u_fac_n1_p1 0 0 -1 0.999969482421875 ECU_ADDRESS 0x4000DA4E FORMAT "%5.4" /end MEASUREMENT
/begin MEASUREMENT fmsp_trns_red_term "Transient fuel correction reduction term." SWORD u_fac_n1_p1 0 0 -1 0.999969482421875 ECU_ADDRESS 0x4000DA4E FORMAT "%5.4" /end MEASUREMENT
/begin MEASUREMENT fmsp_trns_prop_term "Transient fuel correction p term." SWORD u_fac_n1_p1 0 0 -1 0.999969482421875 ECU_ADDRESS 0x4000DA4E FORMAT "%5.4" /end MEASUREMENT
/begin MEASUREMENT fmsp_trns_ampl_term "Transient fuel correction amplify term." SWORD u_fac_n1_p1 0 0 -1 0.999969482421875 ECU_ADDRESS 0x4000DA4E FORMAT "%5.4" /end MEASUREMENT
/begin MEASUREMENT fmsp_trns_mult "Final transient fuel mult." SWORD u_fac_n1_p1 0 0 -1 0.999969482421875 ECU_ADDRESS 0x40004EBC FORMAT "%5.4" /end MEASUREMENT
/begin MEASUREMENT ig_actv_iga "current active ignition advance" SWORD u_iga 0 0 -256.0 255.9921875 ECU_ADDRESS 0x4000DA4E FORMAT "%4.2" /end MEASUREMENT
/begin MEASUREMENT ig_bas_rtd_ref "base iga retard from MBT" SWORD u_iga 0 0 -256.0 255.9921875 ECU_ADDRESS 0x4000DA4E FORMAT "%4.2" /end MEASUREMENT
/begin MEASUREMENT ig_avg_rtd_ref "average iga retard from MBT" SWORD u_iga 0 0 -256.0 255.9921875 ECU_ADDRESS 0x4000DA4E FORMAT "%4.2" /end MEASUREMENT
/begin MEASUREMENT ig_iga_iat_bias "iat bias of base ignition angle" SWORD u_iga 0 0 -256.0 255.9921875 ECU_ADDRESS 0x4000DA4E FORMAT "%4.2" /end MEASUREMENT
/begin MEASUREMENT ig_iga_ect_bias "ect bias of base ignition angle" SWORD u_iga 0 0 -256.0 255.9921875 ECU_ADDRESS 0x4000DA4E FORMAT "%4.2" /end MEASUREMENT
/begin MEASUREMENT ig_iga_eff "ignition efficiency" UWORD u_pct 0 0 0 199.996948242187 ECU_ADDRESS 0x4000DA4E FORMAT "%4.1" /end MEASUREMENT
/begin MEASUREMENT ig_iga_ref "ref ignition angle" SWORD u_iga 0 0 -256.0 255.9921875 ECU_ADDRESS 0x4000DA4E FORMAT "%4.2" /end MEASUREMENT
/begin MEASUREMENT ig_iga_avg "average iga of all cylinder" SWORD u_iga 0 0 -256.0 255.9921875 ECU_ADDRESS 0x4000DA4E FORMAT "%4.2" /end MEASUREMENT
/begin MEASUREMENT ig_iga_gen " general iga before considering individual cylinder knock retard " SWORD u_iga 0 0 -256.0 255.9921875 ECU_ADDRESS 0x4000DA4E FORMAT "%4.2" /end MEASUREMENT
/begin MEASUREMENT ig_iga_fnl_cyl1 "final ignition angle of cylinder 1" SWORD u_iga 0 0 -256.0 255.9921875 ECU_ADDRESS 0x4000DA4E FORMAT "%4.2" /end MEASUREMENT
/begin MEASUREMENT ig_iga_fnl_cyl2 "final ignition angle of cylinder 2" SWORD u_iga 0 0 -256.0 255.9921875 ECU_ADDRESS 0x4000DA4E FORMAT "%4.2" SYMBOL_LINK "ig_iga_fnl_cyl2" 6 /end MEASUREMENT
/begin MEASUREMENT ig_iga_fnl_cyl3 "final ignition angle of cylinder 3" SWORD u_iga 0 0 -256.0 255.9921875 ECU_ADDRESS 0x4000DA4E FORMAT "%4.2" SYMBOL_LINK "ig_iga_fnl_cyl3" 2 /end MEASUREMENT
/begin MEASUREMENT ig_iga_fnl_cyl4 "final ignition angle of cylinder 4" SWORD u_iga 0 0 -256.0 255.9921875 ECU_ADDRESS 0x4000DA4E FORMAT "%4.2" SYMBOL_LINK "ig_iga_fnl_cyl4" 4 /end MEASUREMENT
/begin MEASUREMENT ig_iga_knck_cyl1 "ignition angle after knock retard of cylinder 1" SWORD u_iga 0 0 -256.0 255.9921875 ECU_ADDRESS 0x4000DA4E FORMAT "%4.2" /end MEASUREMENT
/begin MEASUREMENT ig_iga_knck_cyl2 "ignition angle after knock retard of cylinder 2" SWORD u_iga 0 0 -256.0 255.9921875 ECU_ADDRESS 0x4000DA4E FORMAT "%4.2" SYMBOL_LINK "ig_iga_knck_cyl2" 6 /end MEASUREMENT
/begin MEASUREMENT ig_iga_knck_cyl3 "ignition angle after knock retard of cylinder 3" SWORD u_iga 0 0 -256.0 255.9921875 ECU_ADDRESS 0x4000DA4E FORMAT "%4.2" SYMBOL_LINK "ig_iga_knck_cyl3" 2 /end MEASUREMENT
/begin MEASUREMENT ig_iga_knck_cyl4 "ignition angle after knock retard of cylinder 4" SWORD u_iga 0 0 -256.0 255.9921875 ECU_ADDRESS 0x4000DA4E FORMAT "%4.2" SYMBOL_LINK "ig_iga_knck_cyl4" 4 /end MEASUREMENT
/begin MEASUREMENT ig_iga_tq_bias "torque control bias term of iga" SWORD u_iga 0 0 -256.0 255.9921875 ECU_ADDRESS 0x4000DA4E FORMAT "%4.2" /end MEASUREMENT
/begin MEASUREMENT ig_powoff_stat "power off status used in iga determination" UBYTE u_powoff_state 0 0 0.00 3.00 ECU_ADDRESS 0x400050DA FORMAT "%1.0" /end MEASUREMENT
/begin MEASUREMENT ig_iga_antijerk "ignition angle after anti-jerk control" SWORD u_iga 0 0 -256.0 255.9921875 ECU_ADDRESS 0x4000DA4E FORMAT "%4.2" /end MEASUREMENT
/begin MEASUREMENT ig_iga_aj_rtd "iga retard of anti-jerk control" SWORD u_iga 0 0 -256.0 255.9921875 ECU_ADDRESS 0x4000DA4E FORMAT "%4.2" /end MEASUREMENT
/begin MEASUREMENT ig_iga_idl_cl_dly_stat "true means iga idle CL delay has been finished" UBYTE b_true 0 0 0.00 1.00 BIT_MASK 0x1 ECU_ADDRESS 0x4000440A FORMAT "%1.0" /end MEASUREMENT
/begin MEASUREMENT ig_coil_vlt "coil voltage used to calculate time dwell" UWORD u_volt_32 0 0 0 31.99951171875 ECU_ADDRESS 0x400050DA FORMAT "%4.2" /end MEASUREMENT
/begin MEASUREMENT ig_stat "ignition status Start or RUN" UBYTE u_state_eng 0 0 0.00 6.00 ECU_ADDRESS 0x400050DA FORMAT "%1.0" /end MEASUREMENT
/begin MEASUREMENT ig_td "final dwell time calculated" UWORD u_millisec 0 0 0.0 1023.984375 ECU_ADDRESS 0x4000DA4E /end MEASUREMENT
/begin MEASUREMENT ig_td_max "max dwell time allowed" UWORD u_millisec 0 0 0.0 1023.984375 ECU_ADDRESS 0x4000DA4E /end MEASUREMENT
/begin MEASUREMENT ig_td_min "min dwell time allowed" UWORD u_millisec 0 0 0.0 1023.984375 ECU_ADDRESS 0x4000DA4E /end MEASUREMENT
/begin MEASUREMENT ig_en "ignition outputs enable status" UBYTE b_true 0 0 0.00 1.00 BIT_MASK 0x1 ECU_ADDRESS 0x400050DA FORMAT "%1.0" /end MEASUREMENT
/begin MEASUREMENT ig_iga_start "ignition angle when engine state is start" SWORD u_iga 0 0 -256.0 255.9921875 ECU_ADDRESS 0x4000DA4E FORMAT "%4.2" /end MEASUREMENT
/begin MEASUREMENT ig_iga_mn "main ignition angle when engine state is run" SWORD u_iga 0 0 -256.0 255.9921875 ECU_ADDRESS 0x4000DA4E FORMAT "%4.2" /end MEASUREMENT
/begin MEASUREMENT ig_iga_egr_bias "EGR bias of ignition angle" SWORD u_iga 0 0 -256.0 255.9921875 ECU_ADDRESS 0x4000DA4E FORMAT "%4.2" /end MEASUREMENT
/begin MEASUREMENT ig_iga_pow_bias "Power bias of ignition angle" SWORD u_iga 0 0 -256.0 255.9921875 ECU_ADDRESS 0x4000DA4E FORMAT "%4.2" /end MEASUREMENT
/begin MEASUREMENT ig_iga_vvt_bias "VVT bias of ignition angle" SWORD u_iga 0 0 -256.0 255.9921875 ECU_ADDRESS 0x4000DA4E FORMAT "%4.2" /end MEASUREMENT
/begin MEASUREMENT ig_iga_mn_cor "corrected main ignition angle when engine state is run" SWORD u_iga 0 0 -256.0 255.9921875 ECU_ADDRESS 0x4000DA4E FORMAT "%4.2" /end MEASUREMENT
/begin MEASUREMENT ig_iga_rmp "ignition angle after ramp control of start to run" SWORD u_iga 0 0 -256.0 255.9921875 ECU_ADDRESS 0x4000DA4E FORMAT "%4.2" /end MEASUREMENT
/begin MEASUREMENT ig_iga_ref_raw "raw calibrated value of reference ignition angle" SWORD u_iga 0 0 -256.0 255.9921875 ECU_ADDRESS 0x4000DA4E FORMAT "%4.2" /end MEASUREMENT
/begin MEASUREMENT ig_iga_ref_bias "total bias of reference ignition angle" SWORD u_iga 0 0 -256.0 255.9921875 ECU_ADDRESS 0x4000DA4E FORMAT "%4.2" /end MEASUREMENT
/begin MEASUREMENT ig_max_rtd_ref "iga retard from REF at max IMEP" SWORD u_iga 0 0 -256.0 255.9921875 ECU_ADDRESS 0x4000DA4E FORMAT "%4.2" /end MEASUREMENT
/begin MEASUREMENT ig_act_rtd_ref "actual iga retard from REF" SWORD u_iga 0 0 -256.0 255.9921875 ECU_ADDRESS 0x4000DA4E FORMAT "%4.2" /end MEASUREMENT
/begin MEASUREMENT ig_iga_eff_max "max ignition angle efficiency calculated by ig_max_rtd_ref" UWORD u_pct 0 0 0 199.996948242187 ECU_ADDRESS 0x4000DA4E FORMAT "%4.1" /end MEASUREMENT
/begin MEASUREMENT ig_iga_eff_act "actual ignition angle efficiency calculated by ig_act_rtd_ref" UWORD u_pct 0 0 0 199.996948242187 ECU_ADDRESS 0x4000DA4E FORMAT "%4.1" /end MEASUREMENT
/begin MEASUREMENT ig_iga_eff_avg "ignition angle efficiency calculated by ig_avg_rtd_ref" UWORD u_pct 0 0 0 199.996948242187 ECU_ADDRESS 0x4000DA4E FORMAT "%4.1" /end MEASUREMENT
/begin MEASUREMENT ig_aj_rtd_actv "true means iga anti-jerk retard active" UBYTE b_true 0 0 0.00 1.00 BIT_MASK 0x1 ECU_ADDRESS 0x400050DA FORMAT "%1.0" /end MEASUREMENT
/begin MEASUREMENT ig_iga_tq_bias_fac "factor to calculate ig_iga_tq_bias" UWORD u_fac_1 0 0 0.0 0.999984741210937 ECU_ADDRESS 0x4000DA4E /end MEASUREMENT
/begin MEASUREMENT ig_iga_eff_fast "fast path ignition efficiency" UWORD u_pct 0 0 0 199.996948242187 ECU_ADDRESS 0x4000DA4E /end MEASUREMENT
/begin MEASUREMENT ig_iga_eff_min "ignition efficiency min limit." UWORD u_pct 0 0 0 199.996948242187 ECU_ADDRESS 0x4000DA4E /end MEASUREMENT
/begin MEASUREMENT trs_spd "trans input speed" UWORD u_espd 0 0 0 8191.875 ECU_ADDRESS 0x4000DA4E FORMAT "%6.2" /end MEASUREMENT
/begin MEASUREMENT trs_spd_rt "trans input speed vs engine speed ratio" UWORD u_fac_8 0 0 0 7.9998779296875 ECU_ADDRESS 0x4000DA4E FORMAT "%3.2" /end MEASUREMENT
/begin MEASUREMENT trs_veh_ng_actv "MT vehicle at neutral gear" UBYTE b_true 0 0 0.00 1.00 BIT_MASK 0x1 ECU_ADDRESS 0x400050DA FORMAT "%1.0" /end MEASUREMENT
/begin MEASUREMENT trs_veh_ng2drv_occur "MT vehicle neutral gear to drive gear occured" UBYTE b_true 0 0 0.00 1.00 BIT_MASK 0x1 ECU_ADDRESS 0x400050DA FORMAT "%1.0" /end MEASUREMENT
/begin MEASUREMENT trs_sprt_actv "ac system install" UBYTE b_true 0 0 0.00 1.00 BIT_MASK 0x1 ECU_ADDRESS 0x400050DA FORMAT "%1.0" /end MEASUREMENT
/begin MEASUREMENT trs_at_gr_st "AT gear state" UBYTE u_at_gr_typ 0 0 0 9 ECU_ADDRESS 0x4000DA4E FORMAT "%1.0" /end MEASUREMENT
/begin MEASUREMENT trs_gr_range "gear range" UBYTE u_gr_range 0 0 0 9 ECU_ADDRESS 0x4000DA4E FORMAT "%1.0" /end MEASUREMENT
/begin MEASUREMENT trs_at_in_gr "AT in gear" UBYTE b_true 0 0 0.00 1.00 BIT_MASK 0x1 ECU_ADDRESS 0x400050DA FORMAT "%1.0" /end MEASUREMENT
/begin MEASUREMENT trs_veh_in_gr "vehicle in gear" UBYTE b_true 0 0 0.00 1.00 BIT_MASK 0x1 ECU_ADDRESS 0x400050DA FORMAT "%1.0" /end MEASUREMENT
/begin MEASUREMENT trs_mt_gr_st "MT gear state" UBYTE u_cnts 0 0 0 6 ECU_ADDRESS 0x4000DA4E FORMAT "%1.0" /end MEASUREMENT
/begin MEASUREMENT trs_veh_gr_st "vehicle gear state" UBYTE u_at_gr_typ 0 0 0 9 ECU_ADDRESS 0x4000DA4E FORMAT "%1.0" /end MEASUREMENT
/begin MEASUREMENT trs_veh_gr_sp "vehicle gear state setpoint" UBYTE u_at_gr_typ 0 0 0 9 ECU_ADDRESS 0x4000DA4E FORMAT "%1.0" /end MEASUREMENT
/begin MEASUREMENT trs_top_cltch_on "top clutch switch on" UBYTE b_true 0 0 0.00 1.00 BIT_MASK 0x1 ECU_ADDRESS 0x400050DA FORMAT "%1.0" /end MEASUREMENT
/begin MEASUREMENT trs_btm_cltch_on "bottom clutch switch on" UBYTE b_true 0 0 0.00 1.00 BIT_MASK 0x1 ECU_ADDRESS 0x400050DA FORMAT "%1.0" /end MEASUREMENT
/begin MEASUREMENT trs_veh_strt_actv "vehicle start active" UBYTE b_true 0 0 0.00 1.00 BIT_MASK 0x1 ECU_ADDRESS 0x400050DA FORMAT "%1.0" /end MEASUREMENT
/begin MEASUREMENT trs_shft_actv "shift active" UBYTE b_true 0 0 0.00 1.00 BIT_MASK 0x1 ECU_ADDRESS 0x400050DA FORMAT "%1.0" /end MEASUREMENT
/begin MEASUREMENT pwsl_bat_t "battery temp" SWORD u_deg_C 0 0 -256 255.9921875 ECU_ADDRESS 0x4000DA4E /end MEASUREMENT
/begin MEASUREMENT pwsl_bat_soc "battery SOC" UWORD u_pct 0 0 0 199.996948242187 ECU_ADDRESS 0x4000DA4E FORMAT "%4.1" /end MEASUREMENT
/begin MEASUREMENT pwsl_vlt_sp_raw "voltage setpoint raw" UWORD u_volt_32 0 0 0.0 31.99951171875 ECU_ADDRESS 0x4000DA4E FORMAT "%4.2" /end MEASUREMENT
/begin MEASUREMENT pwsl_bat_curr "battery current" SLONG u_curr_amp 0 0 -2048 2047.9375 ECU_ADDRESS 0x4000DA4E FORMAT "%5.1" /end MEASUREMENT
/begin MEASUREMENT pwsl_soc_st "battery SOC state" UWORD u_soc_st 0 0 0 3 ECU_ADDRESS 0x4000DA4E FORMAT "%5.2" /end MEASUREMENT
/begin AXIS_PTS SYS_X_ESPD_A "engine speed breakpoint" 0x0002006C sys_eng_spd SSV__UWORD_S 0 u_espd 9 0 8191.875 FORMAT "%6.2" DEPOSIT ABSOLUTE SYMBOL_LINK "SYS_X_ESPD_A" 2 /end AXIS_PTS
/begin AXIS_PTS SYS_X_ECT_A "ect breakpoint" 0x0002006C sys_ect SSV__SWORD_S 0 u_deg_C 15 -256 255.9921875 DEPOSIT ABSOLUTE SYMBOL_LINK "SYS_X_ECT_A" 2 /end AXIS_PTS
/begin AXIS_PTS FMSP_X_ESPD "engine speed breakpoint" 0x0002006C sys_eng_spd SSV__UWORD_S 0 u_espd 8 0.000000 8191.875000 FORMAT "%6.2" DEPOSIT ABSOLUTE SYMBOL_LINK "FMSP_X_ESPD" 2 /end AXIS_PTS
/begin AXIS_PTS FMSP_X_ESPD_CL_IDL "engine speed breakpoint" 0x0002006C sys_eng_spd SSV__UWORD_S 0 u_espd 8 0.000000 8191.875000 FORMAT "%6.2" DEPOSIT ABSOLUTE SYMBOL_LINK "FMSP_X_ESPD_CL_IDL" 2 /end AXIS_PTS
/begin AXIS_PTS FMSP_X_ESPD_B "engine speed breakpoint" 0x0002006C sys_eng_spd SSV__UWORD_S 0 u_espd 9 0.000000 8191.875000 FORMAT "%6.2" DEPOSIT ABSOLUTE SYMBOL_LINK "FMSP_X_ESPD_B" 2 /end AXIS_PTS
/begin AXIS_PTS FMSP_X_STRK_AIR "stroke airflow breakpoint" 0x0002006C afm_stk_flw SSV__UWORD_S 0 u_stk_flw 8 0.000000 1.99996948242187 FORMAT "%6.2" DEPOSIT ABSOLUTE SYMBOL_LINK "FMSP_X_STRK_AIR" 2 /end AXIS_PTS
/begin AXIS_PTS FMSP_X_IDL_STRK_AIR "stroke airflow breakpoint" 0x0002006C afm_stk_flw SSV__UWORD_S 0 u_stk_flw 8 0.000000 1.99996948242187 FORMAT "%6.2" DEPOSIT ABSOLUTE SYMBOL_LINK "FMSP_X_IDL_STRK_AIR" 2 /end AXIS_PTS
/begin AXIS_PTS FMSP_X_ECT_A "ect breakpoint" 0x0002006C sys_ect SSV__SWORD_S 0 u_deg_C 5 -256.000000 255.9921875 FORMAT "%4.1" DEPOSIT ABSOLUTE SYMBOL_LINK "FMSP_X_ECT_A" 2 /end AXIS_PTS
/begin AXIS_PTS FMSP_X_TQ_PCT_A "torq percent breakpoint" 0x0002006C tq_tot_req_pct SSV__UWORD_S 0 u_pct 5 0 199.996948 FORMAT "%4.1" DEPOSIT ABSOLUTE SYMBOL_LINK "FMSP_X_TQ_PCT_A" 2 /end AXIS_PTS
/begin AXIS_PTS FMSP_X_ECT_B "ect breakpoint" 0x0002006C sys_ect SSV__SWORD_S 0 u_deg_C 17 -256.000000 255.9921875 FORMAT "%4.1" DEPOSIT ABSOLUTE /end AXIS_PTS
/begin AXIS_PTS FMSP_X_ECT_C "ect breakpoint" 0x0002006C sys_ect SSV__SWORD_S 0 u_deg_C 6 -256.000000 255.9921875 FORMAT "%4.1" DEPOSIT ABSOLUTE SYMBOL_LINK "FMSP_X_ECT_C" 2 /end AXIS_PTS
/begin AXIS_PTS FMSP_X_AMP_A "amp breakpoint" 0x0002006C sys_amp SSV__UWORD_S 0 u_kPa_0_256 6 0.000000 255.99609375 FORMAT "%4.1" DEPOSIT ABSOLUTE SYMBOL_LINK "FMSP_X_AMP_A" 2 /end AXIS_PTS
/begin AXIS_PTS FMSP_X_ECT_D "ect breakpoint" 0x0002006C sys_ect SSV__SWORD_S 0 u_deg_C 6 -256.000000 255.9921875 FORMAT "%4.1" DEPOSIT ABSOLUTE SYMBOL_LINK "FMSP_X_ECT_D" 2 /end AXIS_PTS
/begin AXIS_PTS FMSP_X_ECT_E "ect breakpoint" 0x0002006C sys_ect SSV__SWORD_S 0 u_deg_C 3 -256.000000 255.9921875 FORMAT "%4.1" DEPOSIT ABSOLUTE SYMBOL_LINK "FMSP_X_ECT_E" 2 /end AXIS_PTS
/begin AXIS_PTS FMSP_X_PORT_T_B "port temp breakpoint" 0x0002006C afm_intk_prt_t_c SSV__SWORD_S 0 u_deg_C 3 -256.000000 255.9921875 FORMAT "%4.1" DEPOSIT ABSOLUTE /end AXIS_PTS
/begin AXIS_PTS FMSP_X_STK_FLW_A "stroke flow breakpoint" 0x0002006C afm_stk_flw_pct SSV__UWORD_S 0 u_pct_8 5 0.000000 799.987793 FORMAT "%4.1" DEPOSIT ABSOLUTE /end AXIS_PTS
/begin AXIS_PTS FMSP_X_ECT_F "ect breakpoint" 0x0002006C sys_ect SSV__SWORD_S 0 u_deg_C 17 -256.000000 255.9921875 FORMAT "%4.1" DEPOSIT ABSOLUTE SYMBOL_LINK "FMSP_X_ECT_F" 2 /end AXIS_PTS
/begin AXIS_PTS FMSP_X_MAP_A "map breakpoint" 0x0002006C sys_map SSV__UWORD_S 0 u_kPa_0_256 17 0.000000 255.99609375 FORMAT "%4.1" DEPOSIT ABSOLUTE SYMBOL_LINK "FMSP_X_MAP_A" 2 /end AXIS_PTS
/begin AXIS_PTS FMSP_X_PORT_T_A "map breakpoint" 0x0002006C afm_intk_prt_t SSV__UWORD_S 0 u_deg_K 10 0.000000 2047.96875 FORMAT "%5.1" DEPOSIT ABSOLUTE SYMBOL_LINK "FMSP_X_PORT_T_A" 2 /end AXIS_PTS
/begin AXIS_PTS FMSP_X_ECT_G "ect breakpoint" 0x0002006C sys_ect SSV__SWORD_S 0 u_deg_C 17 -256 255.9921875 FORMAT "%4.1" DEPOSIT ABSOLUTE SYMBOL_LINK "FMSP_X_ECT_G" 2 /end AXIS_PTS
/begin AXIS_PTS FMSP_X_ECT_H "ect breakpoint" 0x0002006C sys_keyon_ect SSV__SWORD_S 0 u_deg_C 6 -256 255.9921875 FORMAT "%4.1" DEPOSIT ABSOLUTE SYMBOL_LINK "FMSP_X_ECT_H" 2 /end AXIS_PTS
/begin AXIS_PTS FMSP_X_ECT_K "ect breakpoint" 0x0002006C sys_ect SSV__SWORD_S 0 u_deg_C 4 -256 255.9921875 FORMAT "%4.1" DEPOSIT ABSOLUTE SYMBOL_LINK "FMSP_X_ECT_K" 2 /end AXIS_PTS
/begin AXIS_PTS FMSP_X_ECT_I "ect breakpoint" 0x0002006C sys_ect SSV__SWORD_S 0 u_deg_C 5 -256 255.9921875 FORMAT "%4.1" DEPOSIT ABSOLUTE SYMBOL_LINK "FMSP_X_ECT_I" 2 /end AXIS_PTS
/begin AXIS_PTS FMSP_X_ECT_J "ect breakpoint" 0x0002006C sys_ect SSV__SWORD_S 0 u_deg_C 7 -256 255.9921875 FORMAT "%4.1" DEPOSIT ABSOLUTE SYMBOL_LINK "FMSP_X_ECT_J" 2 /end AXIS_PTS
/begin AXIS_PTS FMSP_X_ESPD_C "engine speed breakpoint" 0x0002006C sys_eng_spd SSV__UWORD_S 0 u_espd 5 0.000000 8191.875000 FORMAT "%6.2" DEPOSIT ABSOLUTE SYMBOL_LINK "FMSP_X_ESPD_C" 2 /end AXIS_PTS
/begin AXIS_PTS FMSP_X_DO2_RT "engine speed breakpoint" 0x0002006C fmsp_do2_rt SSV__UWORD_S 0 u_fac_2 7 0.000000 1.99996948242187 FORMAT "%4.3" DEPOSIT ABSOLUTE SYMBOL_LINK "FMSP_X_DO2_RT" 2 /end AXIS_PTS
/begin AXIS_PTS FMSP_X_DO2_VLT "engine speed breakpoint" 0x0002006C sys_do2_vlt SSV__UWORD_S 0 u_volt_32 15 0 31.99951171875 FORMAT "%4.3" DEPOSIT ABSOLUTE SYMBOL_LINK "FMSP_X_DO2_VLT" 2 /end AXIS_PTS
/begin CHARACTERISTIC FMSP_V_TRANS_FUEL_EN "TRUE means enbale transient fuel control logic" VALUE 0x37118 __UBYTE_S 0 b_true 0 1 FORMAT "%1.0" /end CHARACTERISTIC
/begin CHARACTERISTIC FMSP_M_TF_WALL_FILM_FAC "factor of injected fuel into wall film term" MAP 0x39A2B __UWORD_S 0 u_fac_1 0 0.999984741210937 FORMAT "%6.5" SYMBOL_LINK "FMSP_M_TF_WALL_FILM_FAC" 4
 /begin AXIS_DESCR FIX_AXIS afm_intk_vlv_t u_deg_K_512 9 243 403 /begin FIX_AXIS_PAR_LIST 31104 33664 36224 38784 41344 43904 46464 49024 51584 /end FIX_AXIS_PAR_LIST /end AXIS_DESCR
 /begin AXIS_DESCR FIX_AXIS sys_map u_kPa_0_256 19 20 200
  /begin FIX_AXIS_PAR_LIST 5120 7680 10240 12800 15360 17920 20480 23040 25600 28160 30720 33280 35840 38400 40960 43520 46080 48640 51200 /end FIX_AXIS_PAR_LIST
 /end AXIS_DESCR
/end CHARACTERISTIC
/begin CHARACTERISTIC FMSP_M_TF_NEG_MAP_FAC "map factor used to calculate fmsp_tf_comp when fmsp_tf_comp<0" MAP 0x39A2B __UWORD_S 0 u_fac_4 0 3.99993896484375 FORMAT "%6.5" SYMBOL_LINK "FMSP_M_TF_NEG_MAP_FAC" 4
 /begin AXIS_DESCR FIX_AXIS afm_intk_vlv_t u_deg_K_512 9 243 403 /begin FIX_AXIS_PAR_LIST 31104 33664 36224 38784 41344 43904 46464 49024 51584 /end FIX_AXIS_PAR_LIST /end AXIS_DESCR
 /begin AXIS_DESCR FIX_AXIS sys_map u_kPa_0_256 19 20 200
  /begin FIX_AXIS_PAR_LIST 5120 7680 10240 12800 15360 17920 20480 23040 25600 28160 30720 33280 35840 38400 40960 43520 46080 48640 51200 /end FIX_AXIS_PAR_LIST
 /end AXIS_DESCR
/end CHARACTERISTIC
/begin CHARACTERISTIC FMSP_C_TF_POS_FLW_FAC "positive transient fuel airflow factor" CURVE 0x000200B0 __UWORD_S 0 u_fac_1 0 0.9999847412109375 FORMAT "%6.5" SYMBOL_LINK "FMSP_C_TF_POS_FLW_FAC" 2
 /begin AXIS_DESCR COM_AXIS afm_air_flw u_g_per_sec 6 0.000000 511.992188 AXIS_PTS_REF FMSP_X_AIRFLW_A /end AXIS_DESCR
/end CHARACTERISTIC
/begin AXIS_PTS FMSP_X_AIRFLW_A "axis of air airflow" 0x0002006C afm_air_flw SSV__UWORD_S 0 u_g_per_sec 6 0 511.9921875 DEPOSIT ABSOLUTE SYMBOL_LINK "FMSP_X_AIRFLW_A" 2 /end AXIS_PTS
/begin CHARACTERISTIC FMSP_M_TF_NEG_FLW_FAC "negtive transient fuel airflow factor" MAP 0x39A2B __UWORD_S 0 u_fac_4 0 3.99993896484375 FORMAT "%6.5" SYMBOL_LINK "FMSP_M_TF_NEG_FLW_FAC" 4
 /begin AXIS_DESCR FIX_AXIS afm_intk_vlv_t u_deg_K_512 9 243 403 /begin FIX_AXIS_PAR_LIST 31104 33664 36224 38784 41344 43904 46464 49024 51584 /end FIX_AXIS_PAR_LIST /end AXIS_DESCR
 /begin AXIS_DESCR COM_AXIS afm_air_flw u_g_per_sec 6 0.0 511.9921875 AXIS_PTS_REF FMSP_X_AIRFLW_B /end AXIS_DESCR
/end CHARACTERISTIC
/begin AXIS_PTS FMSP_X_AIRFLW_B "axis of air airflow" 0x0002006C afm_air_flw SSV__UWORD_S 0 u_g_per_sec 6 0 511.9921875 DEPOSIT ABSOLUTE SYMBOL_LINK "FMSP_X_AIRFLW_B" 2 /end AXIS_PTS
/begin CHARACTERISTIC FMSP_C_TF_POS_VLV_T_FAC "positive transient fuel intake valve temperature factor" CURVE 0x000200B0 __UWORD_S 0 u_fac_8 0 7.9998779296875 FORMAT "%6.5" SYMBOL_LINK "FMSP_C_TF_POS_VLV_T_FAC" 2
 /begin AXIS_DESCR FIX_AXIS afm_intk_vlv_t u_deg_K_512 17 233 425
  /begin FIX_AXIS_PAR_LIST 29824 31360 32896 34432 35968 37504 39040 40576 42112 43648 45184 46720 48256 49792 51328 52864 54400 /end FIX_AXIS_PAR_LIST
 /end AXIS_DESCR
/end CHARACTERISTIC
/begin CHARACTERISTIC FMSP_V_TF_POS_DCY_FAC_FIL "positive transient fuel delta decay factor filter initial value to 1 when fmsp_fuel_st==RUN" VALUE 0x0002038C __UWORD_S 0 u_filter 0 0.9999847412109375 FORMAT "%6.5" /end CHARACTERISTIC
/begin CHARACTERISTIC FMSP_C_TF_WALL_FILM_DCY_FAC "decay factor of wall film term" CURVE 0x000200B0 __UWORD_S 0 u_fac_1 0 0.999984741210937 FORMAT "%6.5" SYMBOL_LINK "FMSP_C_TF_WALL_FILM_DCY_FAC" 2
 /begin AXIS_DESCR FIX_AXIS afm_intk_vlv_t u_deg_K_512 9 243 403 /begin FIX_AXIS_PAR_LIST 31104 33664 36224 38784 41344 43904 46464 49024 51584 /end FIX_AXIS_PAR_LIST /end AXIS_DESCR
/end CHARACTERISTIC
/begin CHARACTERISTIC FMSP_V_PRE_PW_RT "The calibration value control the ratio of first nomal pulse in the final pulse width.Value To Calibrate Out: 1" VALUE 0x0002038C __UWORD_S 0 u_fac_1 0 0.999984741210937 /end CHARACTERISTIC
/begin CHARACTERISTIC FMSP_V_DUAL_PW_THR "This calibration when final bpw less than it  only one normal pulse used." VALUE 0x0002038C __UWORD_S 0 u_millisec 0 1023.984375 FORMAT "%5.1" /end CHARACTERISTIC
/begin AXIS_PTS FMSP_X_PUC_MAF_INT "Tunable breakpoint MAF int axis." 0x0002006C fmsp_puc_maf_int SSV__UWORD_S 0 u_gram_1024 6 0 1023.984375 FORMAT "%4.3" DEPOSIT ABSOLUTE SYMBOL_LINK "FMSP_X_PUC_MAF_INT" 2 /end AXIS_PTS
/begin CHARACTERISTIC FMSP_C_TRS_EN_REF_DLY "power manage on cylinder type B" CURVE 0x000200B0 __UWORD_S 0 u_cnts 0 65535 FORMAT "%5.0" SYMBOL_LINK "FMSP_C_TRS_EN_REF_DLY" 2
 /begin AXIS_DESCR FIX_AXIS sys_keyon_ect u_deg_C 17 -40 120
  /begin FIX_AXIS_PAR_LIST -5120 -3840 -2560 -1280 0 1280 2560 3840 5120 6400 7680 8960 10240 11520 12800 14080 15360 /end FIX_AXIS_PAR_LIST
 /end AXIS_DESCR
/end CHARACTERISTIC
/begin CHARACTERISTIC FMSP_V_TRS_FUEL_MIN "transient cyl fuel min" VALUE 0x0002038C __UWORD_S 0 u_gram_2 0 1.99996948242187 FORMAT "%4.3" /end CHARACTERISTIC
/begin CHARACTERISTIC FMSP_V_TRS_FROM_WALL_FAC "transient fuel from wall factor" VALUE 0x0002038C __UWORD_S 0 u_fac_2 0 1.99996948242187 FORMAT "%4.3" /end CHARACTERISTIC
/begin CHARACTERISTIC FMSP_M_TRNS_DB_POS "Transient fuel factor enable base fuel delta positive deadband." MAP 0x39A2B __SWORD_S 0 u_gram_n2_2 -2 1.99993896484375 SYMBOL_LINK "FMSP_M_TRNS_DB_POS" 4
 /begin AXIS_DESCR FIX_AXIS sys_eng_spd u_espd 9 0 6400 /begin FIX_AXIS_PAR_LIST 0 6400 12800 19200 25600 32000 38400 44800 51200 /end FIX_AXIS_PAR_LIST /end AXIS_DESCR
 /begin AXIS_DESCR FIX_AXIS sys_ect u_deg_C 7 -40 80 /begin FIX_AXIS_PAR_LIST -5120 -2560 0 2560 5120 7680 10240 /end FIX_AXIS_PAR_LIST /end AXIS_DESCR
/end CHARACTERISTIC
/begin CHARACTERISTIC FMSP_M_TRNS_DB_NEG "Transient fuel factor enable base fuel delta negative deadband." MAP 0x39A2B __SWORD_S 0 u_gram_n2_2 -2 1.99993896484375 SYMBOL_LINK "FMSP_M_TRNS_DB_NEG" 4
 /begin AXIS_DESCR FIX_AXIS sys_eng_spd u_espd 9 0 6400 /begin FIX_AXIS_PAR_LIST 0 6400 12800 19200 25600 32000 38400 44800 51200 /end FIX_AXIS_PAR_LIST /end AXIS_DESCR
 /begin AXIS_DESCR FIX_AXIS sys_ect u_deg_C 7 -40 80 /begin FIX_AXIS_PAR_LIST -5120 -2560 0 2560 5120 7680 10240 /end FIX_AXIS_PAR_LIST /end AXIS_DESCR
/end CHARACTERISTIC
/begin CHARACTERISTIC FMSP_V_TRNS_RT_THRSH "Transient fuel factor enable runtime threshold." VALUE 0x0002038C __UWORD_S 0 u_1s_tmr 0 65535 /end CHARACTERISTIC
/begin CHARACTERISTIC FMSP_C_RED_POS_FAC "Transient fuel factor reduction positive factor." CURVE 0x000200B0 __UWORD_S 0 u_fac_8 0 7.9998779296875 FORMAT "%6.5" SYMBOL_LINK "FMSP_C_RED_POS_FAC" 2
 /begin AXIS_DESCR FIX_AXIS sys_eng_spd u_espd 9 0 6400 /begin FIX_AXIS_PAR_LIST 0 6400 12800 19200 25600 32000 38400 44800 51200 /end FIX_AXIS_PAR_LIST /end AXIS_DESCR
/end CHARACTERISTIC
/begin CHARACTERISTIC FMSP_C_PROP_POS_FAC "Transient fuel factor proportional positive factor." CURVE 0x000200B0 __UWORD_S 0 u_fac_8 0 7.9998779296875 FORMAT "%6.5" SYMBOL_LINK "FMSP_C_PROP_POS_FAC" 2
 /begin AXIS_DESCR FIX_AXIS sys_eng_spd u_espd 9 0 6400 /begin FIX_AXIS_PAR_LIST 0 6400 12800 19200 25600 32000 38400 44800 51200 /end FIX_AXIS_PAR_LIST /end AXIS_DESCR
/end CHARACTERISTIC
/begin CHARACTERISTIC FMSP_C_AMPL_POS_FAC "Transient fuel factor amplify positive factor." CURVE 0x000200B0 __UWORD_S 0 u_fac_8 0 7.9998779296875 FORMAT "%6.5" SYMBOL_LINK "FMSP_C_AMPL_POS_FAC" 2
 /begin AXIS_DESCR FIX_AXIS sys_eng_spd u_espd 9 0 6400 /begin FIX_AXIS_PAR_LIST 0 6400 12800 19200 25600 32000 38400 44800 51200 /end FIX_AXIS_PAR_LIST /end AXIS_DESCR
/end CHARACTERISTIC
/begin CHARACTERISTIC FMSP_C_RED_NEG_FAC "Transient fuel factor reduction negative factor." CURVE 0x000200B0 __UWORD_S 0 u_fac_8 0 7.9998779296875 FORMAT "%6.5" SYMBOL_LINK "FMSP_C_RED_NEG_FAC" 2
 /begin AXIS_DESCR FIX_AXIS sys_eng_spd u_espd 9 0 6400 /begin FIX_AXIS_PAR_LIST 0 6400 12800 19200 25600 32000 38400 44800 51200 /end FIX_AXIS_PAR_LIST /end AXIS_DESCR
/end CHARACTERISTIC
/begin CHARACTERISTIC FMSP_C_PROP_NEG_FAC "Transient fuel factor proportional negative factor." CURVE 0x000200B0 __UWORD_S 0 u_fac_8 0 7.9998779296875 FORMAT "%6.5" SYMBOL_LINK "FMSP_C_PROP_NEG_FAC" 2
 /begin AXIS_DESCR FIX_AXIS sys_eng_spd u_espd 9 0 6400 /begin FIX_AXIS_PAR_LIST 0 6400 12800 19200 25600 32000 38400 44800 51200 /end FIX_AXIS_PAR_LIST /end AXIS_DESCR
/end CHARACTERISTIC
/begin CHARACTERISTIC FMSP_C_AMPL_NEG_FAC "Transient fuel factor amplify negative factor." CURVE 0x000200B0 __UWORD_S 0 u_fac_8 0 7.9998779296875 FORMAT "%6.5" SYMBOL_LINK "FMSP_C_AMPL_NEG_FAC" 2
 /begin AXIS_DESCR FIX_AXIS sys_eng_spd u_espd 9 0 6400 /begin FIX_AXIS_PAR_LIST 0 6400 12800 19200 25600 32000 38400 44800 51200 /end FIX_AXIS_PAR_LIST /end AXIS_DESCR
/end CHARACTERISTIC
/begin CHARACTERISTIC IG_M_TD_VLT_ECT_FAC "ignition voltage and coolant temperature factor of dwell time" MAP 0x00020320 __UWORD_S 0 u_fac_2 0 1.999969482421875 FORMAT "%4.3" SYMBOL_LINK "IG_M_TD_VLT_ECT_FAC" 4
 /begin AXIS_DESCR FIX_AXIS ig_coil_vlt u_volt_32 17 6 22
  /begin FIX_AXIS_PAR_LIST 12288 14336 16384 18432 20480 22528 24576 26624 28672 30720 32768 34816 36864 38912 40960 43008 45056 /end FIX_AXIS_PAR_LIST
 /end AXIS_DESCR
 /begin AXIS_DESCR FIX_AXIS sys_ect u_deg_C 17 -40 152
  /begin FIX_AXIS_PAR_LIST -5120 -3584 -2048 -512 1024 2560 4096 5632 7168 8704 10240 11776 13312 14848 16384 17920 19456 /end FIX_AXIS_PAR_LIST
 /end AXIS_DESCR
/end CHARACTERISTIC
/begin CHARACTERISTIC IG_C_TD_ST "Base start dwell time" CURVE 0x000200B0 __UWORD_S 0 u_millisec 0 1023.984375 SYMBOL_LINK "IG_C_TD_ST" 2
 /begin AXIS_DESCR FIX_AXIS ig_coil_vlt u_volt_32 17 6 22
  /begin FIX_AXIS_PAR_LIST 12288 14336 16384 18432 20480 22528 24576 26624 28672 30720 32768 34816 36864 38912 40960 43008 45056 /end FIX_AXIS_PAR_LIST
 /end AXIS_DESCR
/end CHARACTERISTIC
/begin CHARACTERISTIC IG_M_TD_RUN "Base run dwell time" MAP 0x00020320 __UWORD_S 0 u_millisec 0 1023.984375 SYMBOL_LINK "IG_M_TD_RUN" 4
 /begin AXIS_DESCR FIX_AXIS ig_coil_vlt u_volt_32 17 6 22
  /begin FIX_AXIS_PAR_LIST 12288 14336 16384 18432 20480 22528 24576 26624 28672 30720 32768 34816 36864 38912 40960 43008 45056 /end FIX_AXIS_PAR_LIST
 /end AXIS_DESCR
 /begin AXIS_DESCR FIX_AXIS sys_eng_spd u_espd 20 400 8000
  /begin FIX_AXIS_PAR_LIST 3200 6400 9600 12800 16000 19200 22400 25600 28800 32000 35200 38400 41600 44800 48000 51200 54400 57600 60800 64000 /end FIX_AXIS_PAR_LIST
 /end AXIS_DESCR
/end CHARACTERISTIC
/begin CHARACTERISTIC IG_M_EFF_LOSS_IGA "ignition efficency loss" MAP 0x00020320 __UBYTE_S 0 u_pct_b 0 100 FORMAT "%4.3" SYMBOL_LINK "IG_M_EFF_LOSS_IGA" 3
 /begin AXIS_DESCR COM_AXIS sys_eng_spd u_espd 6 0 8191.875 AXIS_PTS_REF IG_X_ESPD_A /end AXIS_DESCR
 /begin AXIS_DESCR COM_AXIS ig_bas_rtd_ref u_iga 11 -256 255.9921875 AXIS_PTS_REF IG_X_IGA_RTD /end AXIS_DESCR
/end CHARACTERISTIC
/begin AXIS_PTS IG_X_ESPD_A "engine speed breakpoint" 0x0002006C sys_eng_spd SSV__UWORD_S 0 u_espd 6 0 8191.875 FORMAT "%6.2" DEPOSIT ABSOLUTE SYMBOL_LINK "IG_X_ESPD_A" 2 /end AXIS_PTS
/begin AXIS_PTS IG_X_IGA_RTD "ignition retard breakpoint" 0x0002006C ig_bas_rtd_ref SSV__SWORD_S 0 u_iga 11 -256 255.9921875 FORMAT "%5.2" DEPOSIT ABSOLUTE SYMBOL_LINK "IG_X_IGA_RTD" 2 /end AXIS_PTS
/begin CHARACTERISTIC IG_M_IGA_ST "base ignition angle used when engine state is start" MAP 0x00020320 __SBYTE_S 0 u_iga_b -54 73.5 SYMBOL_LINK "IG_M_IGA_ST" 3
 /begin AXIS_DESCR COM_AXIS sys_ect u_deg_C 15 -256.000000 255.9921875 AXIS_PTS_REF SYS_X_ECT_A /end AXIS_DESCR
 /begin AXIS_DESCR COM_AXIS sys_eng_spd u_espd 9 0 8191.875 AXIS_PTS_REF SYS_X_ESPD_A /end AXIS_DESCR
/end CHARACTERISTIC
/begin CHARACTERISTIC IG_M_IGA_MN "main ignition angle used when engine state is RUN" MAP 0x00020320 __SBYTE_S 0 u_iga_b -54 73.5 SYMBOL_LINK "IG_M_IGA_MN" 3
 /begin AXIS_DESCR COM_AXIS sys_eng_spd u_espd 19 0.000000 8191.875000 AXIS_PTS_REF IG_X_ESPD_B /end AXIS_DESCR
 /begin AXIS_DESCR COM_AXIS tq_imep_ref u_kPa_0_4096 17 0.000000 4095.937500 AXIS_PTS_REF IG_X_IMEP_A /end AXIS_DESCR
/end CHARACTERISTIC
/begin CHARACTERISTIC IG_M_IGA_REF "ignition angle ref" MAP 0x00020320 __SBYTE_S 0 u_iga_b -54 73.5 SYMBOL_LINK "IG_M_IGA_REF" 3
 /begin AXIS_DESCR COM_AXIS sys_eng_spd u_espd 19 0.000000 8191.875000 AXIS_PTS_REF IG_X_ESPD_B /end AXIS_DESCR
 /begin AXIS_DESCR COM_AXIS tq_imep_ref u_kPa_0_4096 17 0.000000 4095.937500 AXIS_PTS_REF IG_X_IMEP_A /end AXIS_DESCR
/end CHARACTERISTIC
/begin CHARACTERISTIC IG_M_IGA_MN_LO "main ignition angle used when engine state is RUN" MAP 0x00020320 __SBYTE_S 0 u_iga_b -54 73.5 SYMBOL_LINK "IG_M_IGA_MN_LO" 3
 /begin AXIS_DESCR COM_AXIS sys_eng_spd u_espd 19 0.000000 8191.875000 AXIS_PTS_REF IG_X_ESPD_B /end AXIS_DESCR
 /begin AXIS_DESCR COM_AXIS tq_imep_ref u_kPa_0_4096 17 0.000000 4095.937500 AXIS_PTS_REF IG_X_IMEP_A /end AXIS_DESCR
/end CHARACTERISTIC
/begin AXIS_PTS IG_X_ESPD_B "engine speed breakpoint" 0x0002006C sys_eng_spd SSV__UWORD_S 0 u_espd 19 0 8191.875 FORMAT "%6.2" DEPOSIT ABSOLUTE SYMBOL_LINK "IG_X_ESPD_B" 2 /end AXIS_PTS
/begin AXIS_PTS IG_X_ESPD_C "engine speed breakpoint" 0x0002006C sys_eng_spd SSV__UWORD_S 0 u_espd 9 0 8191.875 FORMAT "%6.2" DEPOSIT ABSOLUTE SYMBOL_LINK "IG_X_ESPD_C" 2 /end AXIS_PTS
/begin AXIS_PTS IG_X_IMEP_A "imep breakpoint" 0x0002006C tq_imep_ref SSV__UWORD_S 0 u_kPa_0_4096 17 0.000000 4095.937500 DEPOSIT ABSOLUTE SYMBOL_LINK "IG_X_IMEP_A" 2 /end AXIS_PTS
/begin AXIS_PTS IG_X_IMEP_B "imep breakpoint" 0x0002006C tq_estd_imep_ref SSV__UWORD_S 0 u_kPa_0_4096 17 0.000000 4095.937500 DEPOSIT ABSOLUTE SYMBOL_LINK "IG_X_IMEP_B" 2 /end AXIS_PTS
/begin CHARACTERISTIC IG_M_IGA_IAT_BIAS "intake air temperature bias of base ignition angle when open throttle" MAP 0x00020320 __SBYTE_S 0 u_iga_n_b -64 63.5 SYMBOL_LINK "IG_M_IGA_IAT_BIAS" 3
 /begin AXIS_DESCR COM_AXIS sys_iat u_deg_C 11 -256.000000 255.9921875 AXIS_PTS_REF IG_X_IAT /end AXIS_DESCR
 /begin AXIS_DESCR COM_AXIS tq_imep_ref u_kPa_0_4096 17 0.000000 4095.937500 AXIS_PTS_REF IG_X_IMEP_A /end AXIS_DESCR
/end CHARACTERISTIC
/begin CHARACTERISTIC IG_M_IGA_IAT_IDL_BIAS "intake air temperature bias of base ignition angle when idle" MAP 0x00020320 __SBYTE_S 0 u_iga_n_b -64 63.5 SYMBOL_LINK "IG_M_IGA_IAT_IDL_BIAS" 3
 /begin AXIS_DESCR COM_AXIS sys_iat u_deg_C 11 -256.000000 255.9921875 AXIS_PTS_REF IG_X_IAT /end AXIS_DESCR
 /begin AXIS_DESCR COM_AXIS tq_imep_ref u_kPa_0_4096 17 0.000000 4095.937500 AXIS_PTS_REF IG_X_IMEP_A /end AXIS_DESCR
/end CHARACTERISTIC
/begin AXIS_PTS IG_X_IAT "iat breakpoint" 0x0002006C sys_iat SSV__SWORD_S 0 u_deg_C 11 -256.000000 255.9921875 DEPOSIT ABSOLUTE SYMBOL_LINK "IG_X_IAT" 2 /end AXIS_PTS
/begin CHARACTERISTIC IG_M_IGA_IAT_BIAS_ESPD_FAC "Engine speed factor of iat bias" MAP 0x00020320 __UWORD_S 0 u_fac_2 0 1.999969482421875 FORMAT "%3.1" SYMBOL_LINK "IG_M_IGA_IAT_BIAS_ESPD_FAC" 4
 /begin AXIS_DESCR COM_AXIS sys_eng_spd u_espd 19 0.000000 8191.875000 AXIS_PTS_REF IG_X_ESPD_B /end AXIS_DESCR
 /begin AXIS_DESCR COM_AXIS tq_imep_ref u_kPa_0_4096 17 0.000000 4095.937500 AXIS_PTS_REF IG_X_IMEP_A /end AXIS_DESCR
/end CHARACTERISTIC
/begin CHARACTERISTIC IG_M_IGA_ECT_BIAS "Engine coolant temperature bias of base ignition angle" MAP 0x00020320 __SBYTE_S 0 u_iga_n_b -64 63.5 SYMBOL_LINK "IG_M_IGA_ECT_BIAS" 3
 /begin AXIS_DESCR COM_AXIS sys_ect u_deg_C 15 -256.000000 255.9921875 AXIS_PTS_REF IG_X_ECT /end AXIS_DESCR
 /begin AXIS_DESCR COM_AXIS tq_imep_ref u_kPa_0_4096 17 0.000000 4095.937500 AXIS_PTS_REF IG_X_IMEP_A /end AXIS_DESCR
/end CHARACTERISTIC
/begin AXIS_PTS IG_X_ECT "ect breakpoint" 0x0002006C sys_ect SSV__SWORD_S 0 u_deg_C 15 -256.000000 255.9921875 DEPOSIT ABSOLUTE SYMBOL_LINK "IG_X_ECT" 2 /end AXIS_PTS
/begin CHARACTERISTIC IG_M_IGA_POW_BIAS "power bias of base ignition angle" MAP 0x00020320 __SBYTE_S 0 u_iga_n_b -64 63.5 SYMBOL_LINK "IG_M_IGA_POW_BIAS" 3
 /begin AXIS_DESCR COM_AXIS sys_eng_spd u_espd 19 0.000000 8191.875000 AXIS_PTS_REF IG_X_ESPD_B /end AXIS_DESCR
 /begin AXIS_DESCR COM_AXIS tq_imep_ref u_kPa_0_4096 17 0.000000 4095.937500 AXIS_PTS_REF IG_X_IMEP_A /end AXIS_DESCR
/end CHARACTERISTIC
/begin CHARACTERISTIC IG_V_IGA_POW_RAMP_STP "ramp step of power ignition angle bias" VALUE 0x0002038C __SWORD_S 0 u_iga -256 255.9921875 FORMAT "%4.2" /end CHARACTERISTIC
/begin CHARACTERISTIC IG_V_IGA_POW_RAMP_DLY "ramp delay of Power ignition angle bias" VALUE 0x0002038C __UWORD_S 0 u_2x_tmr 0 1023.984375 /end CHARACTERISTIC
/begin CHARACTERISTIC IG_M_IGA_EGR_BIAS "egr bias of base ignition angle" MAP 0x00020320 __SBYTE_S 0 u_iga_n_b -64 63.5 SYMBOL_LINK "IG_M_IGA_EGR_BIAS" 3
 /begin AXIS_DESCR COM_AXIS sys_eng_spd u_espd 9 0.000000 8191.875000 AXIS_PTS_REF IG_X_ESPD_C /end AXIS_DESCR
 /begin AXIS_DESCR FIX_AXIS afm_egr_pct u_pct 9 0 40 /begin FIX_AXIS_PAR_LIST 0 1638 3276 4915 6553 8192 9830 11468 13107 /end FIX_AXIS_PAR_LIST /end AXIS_DESCR
/end CHARACTERISTIC
/begin CHARACTERISTIC IG_M_IGA_VVT_BIAS "vvt bias of base ignition angle" MAP 0x00020320 __SBYTE_S 0 u_iga_n_b -64 63.5 SYMBOL_LINK "IG_M_IGA_VVT_BIAS" 3
 /begin AXIS_DESCR COM_AXIS sys_eng_spd u_espd 15 0.000000 8191.875000 AXIS_PTS_REF VVT_X_ESPD_A /end AXIS_DESCR
 /begin AXIS_DESCR COM_AXIS tq_estd_imep_ref u_kPa_0_4096 17 0.000000 4095.937500 AXIS_PTS_REF IG_X_IMEP_B /end AXIS_DESCR
/end CHARACTERISTIC
/begin CHARACTERISTIC IG_M_IGA_VVT_IDL_BIAS "vvt idle bias of base ignition angle" MAP 0x00020320 __SBYTE_S 0 u_iga_n_b -64 63.5 SYMBOL_LINK "IG_M_IGA_VVT_IDL_BIAS" 3
 /begin AXIS_DESCR FIX_AXIS vvt_b1_exh_sp u_iga 6 -50 0 /begin FIX_AXIS_PAR_LIST -6400 -5120 -3840 -2560 -1280 0 /end FIX_AXIS_PAR_LIST /end AXIS_DESCR
 /begin AXIS_DESCR FIX_AXIS vvt_b1_intk_sp u_iga 6 0 50 /begin FIX_AXIS_PAR_LIST 0 1280 2560 3840 5120 6400 /end FIX_AXIS_PAR_LIST /end AXIS_DESCR
/end CHARACTERISTIC
/begin CHARACTERISTIC IG_M_IGA_VVT_BIAS_FIL "vvt bias filter" MAP 0x00020320 __UWORD_S 0 u_filter 0 0.9999847412109375 FORMAT "%4.3" SYMBOL_LINK "IG_M_IGA_VVT_BIAS_FIL" 4
 /begin AXIS_DESCR FIX_AXIS vvt_exh_err_rt u_fac_n32_p32 11 -5 1 /begin FIX_AXIS_PAR_LIST -5120 -4096 -3072 -2048 -1024 0 204 409 614 819 1024 /end FIX_AXIS_PAR_LIST /end AXIS_DESCR
 /begin AXIS_DESCR FIX_AXIS vvt_intk_err_rt u_fac_n32_p32 11 -5 1 /begin FIX_AXIS_PAR_LIST -5120 -4096 -3072 -2048 -1024 0 204 409 614 819 1024 /end FIX_AXIS_PAR_LIST /end AXIS_DESCR
/end CHARACTERISTIC
/begin CHARACTERISTIC IG_V_IGA_MIN "min allowed ignition angle" VALUE 0x0002038C __SWORD_S 0 u_iga -256 255.9921875 FORMAT "%4.2" /end CHARACTERISTIC
/begin CHARACTERISTIC IG_V_IGA_MAX "max allowed ignition angle" VALUE 0x0002038C __SWORD_S 0 u_iga -256 255.9921875 FORMAT "%4.2" /end CHARACTERISTIC
/begin CHARACTERISTIC IG_V_IGA_LMT_CFG "True means limit max iga to ig_iga_ref" VALUE 0x37118 __UBYTE_S 0 b_true 0 1 FORMAT "%5.2" /end CHARACTERISTIC
/begin CHARACTERISTIC IG_V_IGA_POWOFF "Power off ignition angle" VALUE 0x0002038C __SWORD_S 0 u_iga -256 255.9921875 FORMAT "%4.2" /end CHARACTERISTIC
/begin CHARACTERISTIC IG_V_IGA_POWOFF_RMP_STP "ramp step of Power off ignition angle" VALUE 0x0002038C __SWORD_S 0 u_iga 0 255.9921875 FORMAT "%4.2" /end CHARACTERISTIC
/begin CHARACTERISTIC IG_C_IGA_KNCK_RTD_MAX "MAX allowed knock retard of ignition angle" CURVE 0x000200B0 __UBYTE_S 0 u_iga_b_64 0 63.75 SYMBOL_LINK "IG_C_IGA_KNCK_RTD_MAX" 2
 /begin AXIS_DESCR COM_AXIS sys_eng_spd u_espd 7 0.000000 8191.875000 FORMAT "%6.2" AXIS_PTS_REF IG_X_ESPD_D /end AXIS_DESCR
/end CHARACTERISTIC
/begin AXIS_PTS IG_X_ESPD_D "engine speed breakpoint" 0x0002006C sys_eng_spd SSV__UWORD_S 0 u_espd 7 0 8191.875 FORMAT "%6.2" DEPOSIT ABSOLUTE SYMBOL_LINK "IG_X_ESPD_D" 2 /end AXIS_PTS
/begin CHARACTERISTIC IG_C_IGA_IDL_CL_DLY "delay time since engine RUN to set ig_iga_idl_cl_dly_stat to true" CURVE 0x000200B0 __UWORD_S 0 u_2x_tmr 0.0 1023.984375 SYMBOL_LINK "IG_C_IGA_IDL_CL_DLY" 2
 /begin AXIS_DESCR COM_AXIS sys_keyon_ect u_deg_C 8 -256 255.9921875 AXIS_PTS_REF IG_X_ECT_A /end AXIS_DESCR
/end CHARACTERISTIC
/begin AXIS_PTS IG_X_ECT_A "" 0x0002006C sys_keyon_ect SSV__SWORD_S 0 u_deg_C 8 -256 255.9921875 DEPOSIT ABSOLUTE SYMBOL_LINK "IG_X_ECT_A" 2 /end AXIS_PTS
/begin CHARACTERISTIC IG_V_IDL_CL_ESPD_DEV_THR "espd deviation threshold above which will set ig_iga_idl_cl_dly_stat to true" VALUE 0x37FA6 __SWORD_S 0 u_espd -4096.0 4095.875 FORMAT "%6.2" /end CHARACTERISTIC
/begin CHARACTERISTIC IG_V_VLT_DEV_THR "If deviation between hw_mpr_vlt and hw_bat_vlt is bigger than threshold, hw_mpr_vlt will be used to calculate time dwell" VALUE 0x217E0 __UWORD_S 0 u_volt_32 0 31.99951171875 FORMAT "%4.2" /end CHARACTERISTIC
/begin CHARACTERISTIC IG_V_TD_INIT "Dwell Time used when initialization or dwell is not calculated" VALUE 0x0002038C __UWORD_S 0 u_millisec 0 1023.984375 /end CHARACTERISTIC
/begin CHARACTERISTIC IG_V_TD_ST_BIAS_MIN "Min start dwell bias subtracted to desired dwell time" VALUE 0x0002038C __UWORD_S 0 u_millisec 0 1023.984375 /end CHARACTERISTIC
/begin CHARACTERISTIC IG_V_TD_ST_BIAS_MAX "Max start dwell bias added to desired dwell time" VALUE 0x0002038C __UWORD_S 0 u_millisec 0 1023.984375 /end CHARACTERISTIC
/begin CHARACTERISTIC IG_V_TD_RUN_BIAS_MAX "Max RUN dwell bias added to desired dwell time" VALUE 0x0002038C __UWORD_S 0 u_millisec 0 1023.984375 /end CHARACTERISTIC
/begin CHARACTERISTIC IG_V_TD_RUN_BIAS_MIN "Min RUN dwell bias subtracted to desired dwell time" VALUE 0x0002038C __UWORD_S 0 u_millisec 0 1023.984375 /end CHARACTERISTIC
/begin CHARACTERISTIC IG_V_TD_OFF_TM_MIN "MIN time delayed before next dwell start, used to calculate dwell limit" VALUE 0x0002038C __UWORD_S 0 u_millisec 0 1023.984375 /end CHARACTERISTIC
/begin CHARACTERISTIC IG_V_TD_LMT_FAC "factor of segment to calculate dwell time limit.suggestion-half ignition:7;full ignition:14(4 cyl)." VALUE 0x0002038C __UWORD_S 0 u_cnts 0 65535 FORMAT "%5.0" /end CHARACTERISTIC
/begin CHARACTERISTIC IG_V_VLT_POW_OFF_THR "Low voltage threshold of power off" VALUE 0x217E0 __UWORD_S 0 u_volt_32 0 31.99951171875 FORMAT "%4.2" /end CHARACTERISTIC
/begin CHARACTERISTIC IG_V_TD_POW_OFF "dwell time used when power off" VALUE 0x0002038C __UWORD_S 0 u_millisec 0 1023.984375 /end CHARACTERISTIC
/begin CHARACTERISTIC IG_V_TD_MAX_INIT "Initial value of max dwell time" VALUE 0x0002038C __UWORD_S 0 u_millisec 0 1023.984375 /end CHARACTERISTIC
/begin CHARACTERISTIC IG_V_TD_MIN_INIT "Initial value of min dwell time" VALUE 0x0002038C __UWORD_S 0 u_millisec 0 1023.984375 /end CHARACTERISTIC
/begin CHARACTERISTIC IG_V_POW_OFF_SEG_THR "number of segments threshold above which power off finished" VALUE 0x0002038C __UBYTE_S 0 u_cnts 0 255 /end CHARACTERISTIC
/begin CHARACTERISTIC IG_V_TYP_CFG "ignition type configuration" VALUE 0x0002038C __UBYTE_S 0 u_ig_type 0 2 FORMAT "%5.2" /end CHARACTERISTIC
/begin CHARACTERISTIC IG_M_IGA_ST_HYB "base ignition angle used when engine state is start and hybrid is enable" MAP 0x00020320 __SBYTE_S 0 u_iga_b -54 73.5 SYMBOL_LINK "IG_M_IGA_ST_HYB" 3
 /begin AXIS_DESCR COM_AXIS sys_ect u_deg_C 15 -256.000000 255.9921875 AXIS_PTS_REF SYS_X_ECT_A /end AXIS_DESCR
 /begin AXIS_DESCR COM_AXIS sys_eng_spd u_espd 9 0 8191.875 AXIS_PTS_REF SYS_X_ESPD_A /end AXIS_DESCR
/end CHARACTERISTIC
/begin CHARACTERISTIC IG_V_ECT_BIAS_RMP_STP "ramp step per loop of IGA ECT bias term" VALUE 0x36F6C __UWORD_S 0 u_iga_128 0 127.998046875 /end CHARACTERISTIC
/begin CHARACTERISTIC IG_V_IGA_EGR_BIAS_FIL "filter coefficient of EGR ignition angle bias" VALUE 0x0002038C __UWORD_S 0 u_filter 0 0.9999847412109375 FORMAT "%6.5" /end CHARACTERISTIC
/begin CHARACTERISTIC IG_V_ST_RUN_RMP_DLY "delay time since engine run to enable start to run iga ramp control " VALUE 0x0002038C __UWORD_S 0 u_2x_tmr 0 1023.984375 /end CHARACTERISTIC
/begin CHARACTERISTIC IG_C_ST_RUN_RMP_STP_DEC "decrease step of start to run iga ramp" CURVE 0x000200B0 __UWORD_S 0 u_iga_128 0 127.998046875 SYMBOL_LINK "IG_C_ST_RUN_RMP_STP_DEC" 2
 /begin AXIS_DESCR COM_AXIS sys_ect u_deg_C 15 -256 255.9921875 AXIS_PTS_REF SYS_X_ECT_A /end AXIS_DESCR
/end CHARACTERISTIC
/begin CHARACTERISTIC IG_C_ST_RUN_RMP_STP_INC "increase step of start to run iga ramp" CURVE 0x000200B0 __UWORD_S 0 u_iga_128 0 127.998046875 SYMBOL_LINK "IG_C_ST_RUN_RMP_STP_INC" 2
 /begin AXIS_DESCR COM_AXIS sys_ect u_deg_C 15 -256 255.9921875 AXIS_PTS_REF SYS_X_ECT_A /end AXIS_DESCR
/end CHARACTERISTIC
/begin CHARACTERISTIC IG_V_ST_RUN_RMP_DLY_HYB "delay time since engine run to enable start to run iga ramp control when hybrid start" VALUE 0x0002038C __UWORD_S 0 u_2x_tmr 0 1023.984375 /end CHARACTERISTIC
/begin CHARACTERISTIC IG_C_ST_RUN_RMP_STP_DEC_HYB "decrease step of start to run iga ramp when hybrid start" CURVE 0x000200B0 __UWORD_S 0 u_iga_128 0 127.998046875 SYMBOL_LINK "IG_C_ST_RUN_RMP_STP_DEC_HYB" 2
 /begin AXIS_DESCR COM_AXIS sys_ect u_deg_C 15 -256 255.9921875 AXIS_PTS_REF SYS_X_ECT_A /end AXIS_DESCR
/end CHARACTERISTIC
/begin CHARACTERISTIC IG_C_ST_RUN_RMP_STP_INC_HYB "increase step of start to run iga ramp when hybrid start" CURVE 0x000200B0 __UWORD_S 0 u_iga_128 0 127.998046875 SYMBOL_LINK "IG_C_ST_RUN_RMP_STP_INC_HYB" 2
 /begin AXIS_DESCR COM_AXIS sys_ect u_deg_C 15 -256 255.9921875 AXIS_PTS_REF SYS_X_ECT_A /end AXIS_DESCR
/end CHARACTERISTIC
/begin CHARACTERISTIC IG_V_AJ_RTD_OLD_IMEP_CFG "number of loops to determinate old IMEP used to calculate IMEP deviation in AJ retard control" VALUE 0x0002038C __UBYTE_S 0 u_imep_old_loops 0 3 FORMAT "%5.2" /end CHARACTERISTIC
/begin CHARACTERISTIC IG_V_IGA_AJ_RTD_IMEP_THR "IMEP threshold below which to enable anti-jerk iga retard" VALUE 0x0002038C __UWORD_S 0 u_kPa_0_4096 0 4095.937500 /end CHARACTERISTIC
/begin CHARACTERISTIC IG_V_IGA_AJ_RTD_IMEP_DEV_THR "IMEP deviation threshold above which to enable anti-jerk iga retard" VALUE 0x0002038C __UWORD_S 0 u_kPa_0_4096 0 4095.937500 /end CHARACTERISTIC
/begin CHARACTERISTIC IG_V_IGA_AJ_RTD_ECT_THR "engine coolant threshold above which to enable anti-jerk iga retard" VALUE 0x0002038C __SWORD_S 0 u_iga -256 255.9921875 FORMAT "%4.2" /end CHARACTERISTIC
/begin CHARACTERISTIC IG_V_IGA_AJ_RTD_EN_DLY "delay time to enable AJ retard when tq_req_typ just change to DRVER_REQ or CRUZ_INC" VALUE 0x0002038C __UWORD_S 0 u_2x_tmr 0 1023.984375 /end CHARACTERISTIC
/begin CHARACTERISTIC IG_M_IGA_AJ_RTD "anti-jerk IGA retard" MAP 0x00020320 __UBYTE_S 0 u_iga_b_64 0 63.75 SYMBOL_LINK "IG_M_IGA_AJ_RTD" 3
 /begin AXIS_DESCR COM_AXIS sys_eng_spd u_espd 19 0.000000 8191.875000 AXIS_PTS_REF IG_X_ESPD_B /end AXIS_DESCR
 /begin AXIS_DESCR COM_AXIS ig_iga_avg u_iga 5 -256 255.9921875 AXIS_PTS_REF IG_X_IGA /end AXIS_DESCR
/end CHARACTERISTIC
/begin AXIS_PTS IG_X_IGA "ignition retard breakpoint" 0x0002006C ig_iga_avg SSV__SWORD_S 0 u_iga 5 -256 255.9921875 FORMAT "%5.2" DEPOSIT ABSOLUTE SYMBOL_LINK "IG_X_IGA" 2 /end AXIS_PTS
/begin CHARACTERISTIC IG_C_IGA_AJ_RTD_DUR "duration of anti-jerk IGA retard" CURVE 0x375CE __UWORD_S 0 u_2x_tmr 0 1023.984375 SYMBOL_LINK "IG_C_IGA_AJ_RTD_DUR" 2
 /begin AXIS_DESCR COM_AXIS sys_eng_spd u_espd 19 0.000000 8191.875000 AXIS_PTS_REF IG_X_ESPD_B /end AXIS_DESCR
/end CHARACTERISTIC
/begin CHARACTERISTIC IG_M_IGA_AJ_RTD_DCY_STP "decay step of anti-jerk IGA retard" MAP 0x00020320 __UWORD_S 0 u_iga_128 0 127.998046875 SYMBOL_LINK "IG_M_IGA_AJ_RTD_DCY_STP" 4
 /begin AXIS_DESCR COM_AXIS sys_eng_spd u_espd 19 0.000000 8191.875000 AXIS_PTS_REF IG_X_ESPD_B /end AXIS_DESCR
 /begin AXIS_DESCR COM_AXIS ig_iga_avg u_iga 5 -256 255.9921875 AXIS_PTS_REF IG_X_IGA /end AXIS_DESCR
/end CHARACTERISTIC
/begin CHARACTERISTIC IG_C_AJ_RTD_IAT_FAC "IAT factor of anti-jerk IGA retard" CURVE 0x000200B0 __UWORD_S 0 u_fac_2 0 1.999969482421875 FORMAT "%4.3" SYMBOL_LINK "IG_C_AJ_RTD_IAT_FAC" 2
 /begin AXIS_DESCR COM_AXIS NO_INPUT_QUANTITY u_deg_C 5 -256.000000 255.9921875 AXIS_PTS_REF IG_X_IAT_A /end AXIS_DESCR
/end CHARACTERISTIC
/begin AXIS_PTS IG_X_IAT_A "iat breakpoint" 0x0002006C sys_iat SSV__SWORD_S 0 u_deg_C 5 -256.000000 255.9921875 DEPOSIT ABSOLUTE SYMBOL_LINK "IG_X_IAT_A" 2 /end AXIS_PTS
/begin CHARACTERISTIC IG_V_IGA_MIN_HYB "min allowed ignition angle when hybrid start" VALUE 0x0002038C __SWORD_S 0 u_iga -256 255.9921875 FORMAT "%4.2" /end CHARACTERISTIC
/begin CHARACTERISTIC IG_V_TQ_BIAS_FAC_DCY_STP "decay step of ig_iga_tq_bias_fac" VALUE 0x0002038C __UWORD_S 0 u_fac_1 0 0.999984741210937 /end CHARACTERISTIC
/begin CHARACTERISTIC IG_M_IGA_OVRSHT "iga used to control engine speed overshoot after run" MAP 0x00020320 __SWORD_S 0 u_iga -256 255.9921875 FORMAT "%4.2" SYMBOL_LINK "IG_M_IGA_OVRSHT" 4
 /begin AXIS_DESCR COM_AXIS sys_keyon_ect u_deg_C 8 -256 255.9921875 AXIS_PTS_REF IG_X_ECT_A /end AXIS_DESCR
 /begin AXIS_DESCR FIX_AXIS sys_eng_spd u_espd 9 0 3200 /begin FIX_AXIS_PAR_LIST 0 3200 6400 9600 12800 16000 19200 22400 25600 /end FIX_AXIS_PAR_LIST /end AXIS_DESCR
/end CHARACTERISTIC
/begin CHARACTERISTIC IG_M_IGA_OVRSHT_HYB "iga used to control engine speed overshoot after run when Hybrid start" MAP 0x00020320 __SWORD_S 0 u_iga -256 255.9921875 FORMAT "%4.2" SYMBOL_LINK "IG_M_IGA_OVRSHT_HYB" 4
 /begin AXIS_DESCR COM_AXIS sys_keyon_ect u_deg_C 8 -256 255.9921875 AXIS_PTS_REF IG_X_ECT_A /end AXIS_DESCR
 /begin AXIS_DESCR FIX_AXIS sys_eng_spd u_espd 9 0 3200 /begin FIX_AXIS_PAR_LIST 0 3200 6400 9600 12800 16000 19200 22400 25600 /end FIX_AXIS_PAR_LIST /end AXIS_DESCR
/end CHARACTERISTIC
/begin CHARACTERISTIC IG_M_EFF_BS_MN "Min spark efficiency base." MAP 0x00020320 __UWORD_S 0 u_pct 0 199.996948242187 SYMBOL_LINK "IG_M_EFF_BS_MN" 4
 /begin AXIS_DESCR COM_AXIS sys_eng_spd u_espd 19 0 8191.875 AXIS_PTS_REF IG_X_ESPD_F /end AXIS_DESCR
 /begin AXIS_DESCR COM_AXIS tq_imep_ref u_kPa_0_4096 17 0.000000 4095.937500 AXIS_PTS_REF IG_X_IMEP_A /end AXIS_DESCR
/end CHARACTERISTIC
/begin AXIS_PTS IG_X_ESPD_F "engine speed breakpoint" 0x0002006C sys_eng_spd SSV__UWORD_S 0 u_espd 19 0 8191.875 FORMAT "%6.2" DEPOSIT ABSOLUTE SYMBOL_LINK "IG_X_ESPD_F" 2 /end AXIS_PTS
/begin CHARACTERISTIC IG_V_IGA_VGIS_BIAS_CFG "True means VGIS ignition angle bias is only applied in POW" VALUE 0x37118 __UBYTE_S 0 b_true 0 1 FORMAT "%5.2" /end CHARACTERISTIC
/begin CHARACTERISTIC IG_M_IGA_VGIS_BIAS "VGIS bias of ignition angle" MAP 0x00020320 __SBYTE_S 0 u_iga_n_b -64 63.5 SYMBOL_LINK "IG_M_IGA_VGIS_BIAS" 3
 /begin AXIS_DESCR COM_AXIS sys_eng_spd u_espd 19 0.000000 8191.875000 AXIS_PTS_REF IG_X_ESPD_B /end AXIS_DESCR
 /begin AXIS_DESCR COM_AXIS tq_imep_ref u_kPa_0_4096 17 0.000000 4095.937500 AXIS_PTS_REF IG_X_IMEP_A /end AXIS_DESCR
/end CHARACTERISTIC
/begin CHARACTERISTIC IG_V_IGA_VGIS_BIAS_HLD_DUR "VGIS iga bias hold duration when VGIS disabled" VALUE 0x0002038C __UWORD_S 0 u_2x_tmr 0 1023.984375 /end CHARACTERISTIC
/begin CHARACTERISTIC TRS_V_TRS_SPD_FIL "trans input speed filter" VALUE 0x0002038C __UWORD_S 0 u_filter 0 0.9999847412109375 FORMAT "%10.9" /end CHARACTERISTIC
/begin CHARACTERISTIC TRS_V_TRS_SPD_RT_FIL "trans input speed vs engine speed ratio filter" VALUE 0x0002038C __UWORD_S 0 u_filter 0 0.9999847412109375 FORMAT "%10.9" /end CHARACTERISTIC
/begin CHARACTERISTIC TRS_C_MT_SPD_RT_LO "speed ratio for gear calculation" CURVE 0x000200B0 __UWORD_S 0 u_fac_16384 0 16383.75 FORMAT "%7.2"
 /begin AXIS_DESCR FIX_AXIS NO_INPUT_QUANTITY u_cnts 6 0 5 /begin FIX_AXIS_PAR_LIST 0 1 2 3 4 5 /end FIX_AXIS_PAR_LIST /end AXIS_DESCR
/end CHARACTERISTIC
/begin CHARACTERISTIC TRS_C_MT_SPD_RT_HI "speed ratio for gear calculation" CURVE 0x000200B0 __UWORD_S 0 u_fac_16384 0 16383.75 FORMAT "%7.2"
 /begin AXIS_DESCR FIX_AXIS NO_INPUT_QUANTITY u_cnts 6 0 5 /begin FIX_AXIS_PAR_LIST 0 1 2 3 4 5 /end FIX_AXIS_PAR_LIST /end AXIS_DESCR
/end CHARACTERISTIC
/begin CHARACTERISTIC TRS_V_TIRE_R "tire radius" VALUE 0x0002038C __UWORD_S 0 u_meter_1 0 0.9999847412109375 FORMAT "%10.9" /end CHARACTERISTIC
/begin CHARACTERISTIC TRS_V_VEH_STRT_SRC "vehicle start state determine source" VALUE 0x0002038C __UBYTE_S 0 u_veh_st_src 0 4 FORMAT "%1.0" /end CHARACTERISTIC
/begin CHARACTERISTIC TRS_V_BTM_CLCH_STRT_EXT_DUR "bottom clutch on duration for vehicle start exit" VALUE 0x0002038C __UWORD_S 0 u_2x_tmr 0 1023.984375 /end CHARACTERISTIC
/begin CHARACTERISTIC TRS_V_TOP_CLCH_STRT_EXT_DUR "top clutch on duration for vehicle start exit" VALUE 0x0002038C __UWORD_S 0 u_2x_tmr 0 1023.984375 /end CHARACTERISTIC
/begin CHARACTERISTIC TRS_V_VEH_STRT_VSPD_BIAS "vehicle start enable vehicle speed bias" VALUE 0x0002038C __UWORD_S 0 u_vspd 0 511.9921875 FORMAT "%4.1" /end CHARACTERISTIC
/begin CHARACTERISTIC TRS_V_VEH_STRT_EN_VSPD "vehicle start enable vehicle speed" VALUE 0x0002038C __UWORD_S 0 u_vspd 0 511.9921875 FORMAT "%4.1" /end CHARACTERISTIC
/begin CHARACTERISTIC TRS_V_VEH_STRT_ECT_MIN "vehicle start enable ect min" VALUE 0x0002038C __SWORD_S 0 u_deg_C -256.000000 255.9921875 FORMAT "%5.1" /end CHARACTERISTIC
/begin CHARACTERISTIC TRS_V_VEH_STRT_RUN_MIN "vehicle start enable runtime min" VALUE 0x0002038C __UWORD_S 0 u_1s_tmr 0 65535 /end CHARACTERISTIC
/begin CHARACTERISTIC TRS_V_VEH_STRT_HLD_MIN "vehicle start hold time min" VALUE 0x0002038C __UWORD_S 0 u_2x_tmr 0 1023.984375 /end CHARACTERISTIC
/begin CHARACTERISTIC TRS_V_VEH_STRT_EXT_VSPD "vehicle start disable vehicle speed" VALUE 0x0002038C __UWORD_S 0 u_vspd 0 511.9921875 FORMAT "%4.1" /end CHARACTERISTIC
/begin CHARACTERISTIC TRS_V_VEH_STRT_EXT_TOP_CLTCH "vehicle start disable when top clutch active" VALUE 0x0002038C __UBYTE_S 0 b_true 0 1 FORMAT "%1.0" /end CHARACTERISTIC
/begin CHARACTERISTIC TRS_V_VEH_STRT_EN_BRK_OFF "vehicle start enable break off condition" VALUE 0x0002038C __UBYTE_S 0 b_true 0 1 FORMAT "%1.0" /end CHARACTERISTIC
/begin CHARACTERISTIC TRS_V_VEH_STRT_EN_PPS_MAX "vehicle start enable pedal position max" VALUE 0x0002038C __UWORD_S 0 u_pct 0 199.996948242187 FORMAT "%4.1" /end CHARACTERISTIC
/begin CHARACTERISTIC TRS_V_CLTCH_FCO_DPRS_MIN "clutch depressed duratiom min for clutch fuel cut off active" VALUE 0x0002038C __UWORD_S 0 u_2x_tmr 0 1023.984375 /end CHARACTERISTIC
/begin CHARACTERISTIC TRS_V_CLTCH_FCO_DPRS_MAX "clutch depressed duratiom max for clutch fuel cut off active" VALUE 0x0002038C __UWORD_S 0 u_2x_tmr 0 1023.984375 /end CHARACTERISTIC
/begin CHARACTERISTIC PWSL_V_RGLTR_DTY_MIN "regulator duty cycle min" VALUE 0x0002038C __UWORD_S 0 u_pct_1 0 99.9984741210937 FORMAT "%4.2" /end CHARACTERISTIC
/begin CHARACTERISTIC PWSL_V_RGLTR_DTY_MAX "regulator duty cycle max" VALUE 0x0002038C __UWORD_S 0 u_pct_1 0 99.9984741210937 FORMAT "%4.2" /end CHARACTERISTIC
/begin CHARACTERISTIC PWSL_V_BAT_SNSR_INST "battery sensor install" VALUE 0x0002038C __UBYTE_S 0 b_true 0 1 FORMAT "%1.0" /end CHARACTERISTIC
/begin CHARACTERISTIC PWSL_V_SNSR_SOC_DFLT "bat sensor SOC default" VALUE 0x0002038C __UWORD_S 0 u_pct 0 199.996948242187 FORMAT "%4.1" /end CHARACTERISTIC
/begin CHARACTERISTIC PWSL_V_SNSR_COMM_CFG "battery sensor install" VALUE 0x0002038C __UBYTE_S 0 u_bat_snsr_cfg 0 1 FORMAT "%1.0" /end CHARACTERISTIC
/begin CHARACTERISTIC PWSL_V_CTRL_DLY "power supply control delay" VALUE 0x0002038C __UWORD_S 0 u_2x_tmr 0 1023.984375 /end CHARACTERISTIC
/begin CHARACTERISTIC PWSL_V_SOC_SRC "SOC source config" VALUE 0x0002038C __UBYTE_S 0 u_soc_src 0 1 FORMAT "%1.0" /end CHARACTERISTIC
/begin CHARACTERISTIC PWSL_V_ALT_DTY_HI "Alternator duty cycle high thr" VALUE 0x0002038C __UWORD_S 0 u_pct_1 0 99.9984741210937 FORMAT "%4.2" /end CHARACTERISTIC
/begin CHARACTERISTIC PWSL_V_ALT_DTY_LO "Alternator duty cycle low thr" VALUE 0x0002038C __UWORD_S 0 u_pct_1 0 99.9984741210937 FORMAT "%4.2" /end CHARACTERISTIC
/begin CHARACTERISTIC PWSL_V_CT_NORM_SOC_LO "SOC low thr when control state is normal,cl and fault used by charging type determining" VALUE 0x0002038C __UWORD_S 0 u_pct 0 199.996948242187 FORMAT "%4.1" /end CHARACTERISTIC
/begin CHARACTERISTIC PWSL_V_CT_CHRG_SOC_LO "SOC low thr when control state is charge,discharg and rationality used by charging type determining" VALUE 0x0002038C __UWORD_S 0 u_pct 0 199.996948242187 FORMAT "%4.1" /end CHARACTERISTIC
/begin CHARACTERISTIC PWSL_V_CT_NORM_SOC_LO_HYS "SOC low hys when control state is normal,cl and fault used by charging type determining" VALUE 0x0002038C __UWORD_S 0 u_pct 0 199.996948242187 FORMAT "%4.1" /end CHARACTERISTIC
/begin CHARACTERISTIC PWSL_V_CT_CHRG_SOC_LO_HYS "SOC low hys when control state is charge,discharg and rationality used by charging type determining" VALUE 0x0002038C __UWORD_S 0 u_pct 0 199.996948242187 FORMAT "%4.1" /end CHARACTERISTIC
/begin CHARACTERISTIC PWSL_V_CT_NORM_VLT_LO "battery voltage low thr when control state is normal,cl and fault used by charging type determining" VALUE 0x0002038C __UWORD_S 0 u_volt_32 0 31.99951171875 FORMAT "%4.1" /end CHARACTERISTIC
/begin CHARACTERISTIC PWSL_V_CT_CHRG_VLT_LO "battery voltage low thr when control state is charge,discharg and rationality used by charging type determining" VALUE 0x0002038C __UWORD_S 0 u_volt_32 0 31.99951171875 FORMAT "%4.1" /end CHARACTERISTIC
/begin CHARACTERISTIC PWSL_V_CT_NORM_VLT_LO_HYS "battery voltage low hys when control state is normal,cl and fault used by charging type determining" VALUE 0x0002038C __UWORD_S 0 u_volt_32 0 31.99951171875 FORMAT "%4.1" /end CHARACTERISTIC
/begin CHARACTERISTIC PWSL_V_CT_CHRG_VLT_LO_HYS "battery voltage low hys when control state is charge,discharg and rationality used by charging type determining" VALUE 0x0002038C __UWORD_S 0 u_volt_32 0 31.99951171875 FORMAT "%4.1" /end CHARACTERISTIC
/begin CHARACTERISTIC PWSL_V_CT_NORM_BAT_T_LO "battery temp low thr when control state is normal,cl and fault used by charging type determining" VALUE 0x0002038C __SWORD_S 0 u_deg_C -256.000000 255.9921875 FORMAT "%5.1" /end CHARACTERISTIC
/begin CHARACTERISTIC PWSL_V_CT_CHRG_BAT_T_LO "battery temp low thr when control state is charge,discharg and rationality used by charging type determining" VALUE 0x0002038C __SWORD_S 0 u_deg_C -256.000000 255.9921875 FORMAT "%5.1" /end CHARACTERISTIC
/begin CHARACTERISTIC PWSL_V_CT_NORM_BAT_T_LO_HYS "battery temp low hys when control state is normal,cl and fault used by charging type determining" VALUE 0x0002038C __SWORD_S 0 u_deg_C -256.000000 255.9921875 FORMAT "%5.1" /end CHARACTERISTIC
/begin CHARACTERISTIC PWSL_V_CT_CHRG_BAT_T_LO_HYS "battery temp low hys when control state is charge,discharg and rationality used by charging type determining" VALUE 0x0002038C __SWORD_S 0 u_deg_C -256.000000 255.9921875 FORMAT "%5.1" /end CHARACTERISTIC
/begin CHARACTERISTIC PWSL_V_CT_SOC_HI "SOC hi thr used by charging type determining" VALUE 0x0002038C __UWORD_S 0 u_pct 0 199.996948242187 FORMAT "%4.1" /end CHARACTERISTIC
/begin CHARACTERISTIC PWSL_V_CT_SOC_HI_HYS "SOC hi hys used by charging type determining" VALUE 0x0002038C __UWORD_S 0 u_pct 0 199.996948242187 FORMAT "%4.1" /end CHARACTERISTIC
/begin CHARACTERISTIC PWSL_C_HI_SOC_VLT_SP "battery voltage setpoint at high SOC charge mode" CURVE 0x000200B0 __UWORD_S 0 u_volt_32 0 31.99951171875 FORMAT "%4.2" SYMBOL_LINK "PWSL_C_HI_SOC_VLT_SP" 2
 /begin AXIS_DESCR COM_AXIS pwsl_bat_t u_deg_C 9 -256.000000 255.9921875 AXIS_PTS_REF PWSL_X_BAT_T /end AXIS_DESCR
/end CHARACTERISTIC
/begin AXIS_PTS PWSL_X_BAT_T "battery temp breakpoint" 0x0002006C pwsl_bat_t SSV__SWORD_S 0 u_deg_C 9 -256.000000 255.9921875 FORMAT "%4.1" DEPOSIT ABSOLUTE SYMBOL_LINK "PWSL_X_BAT_T" 2 /end AXIS_PTS
/begin CHARACTERISTIC PWSL_V_MID_CHRG_HI_VSPD_THR "high charge voltage vehicle speed thr when mid soc type" VALUE 0x0002038C __UWORD_S 0 u_vspd 0 511.9921875 FORMAT "%4.1" /end CHARACTERISTIC
/begin CHARACTERISTIC PWSL_V_MID_CHRG_HI_DUR "high charge voltage duration at mid soc type" VALUE 0x0002038C __UWORD_S 0 u_2x_tmr 0 1023.984375 /end CHARACTERISTIC
/begin CHARACTERISTIC PWSL_V_MID_CHRG_LO_DUR "low charge voltage duration at mid soc type" VALUE 0x0002038C __UWORD_S 0 u_2x_tmr 0 1023.984375 /end CHARACTERISTIC
/begin CHARACTERISTIC PWSL_M_MID_CHRG_HI_VLT_SP "high charge voltage setpoint at mid soc type" MAP 0x00020320 __UWORD_S 0 u_volt_32 0 31.99951171875 FORMAT "%4.2" SYMBOL_LINK "PWSL_M_MID_CHRG_HI_VLT_SP" 4
 /begin AXIS_DESCR COM_AXIS pwsl_bat_t u_deg_C 9 -256.000000 255.9921875 AXIS_PTS_REF PWSL_X_BAT_T /end AXIS_DESCR
 /begin AXIS_DESCR FIX_AXIS pwsl_bat_soc u_pct 9 50 100 /begin FIX_AXIS_PAR_LIST 16384 26214 27852 29491 30146 30801 31457 32112 32768 /end FIX_AXIS_PAR_LIST /end AXIS_DESCR
/end CHARACTERISTIC
/begin CHARACTERISTIC PWSL_M_MID_CHRG_LO_VLT_SP "low charge voltage setpoint at mid soc type" MAP 0x00020320 __UWORD_S 0 u_volt_32 0 31.99951171875 FORMAT "%4.2" SYMBOL_LINK "PWSL_M_MID_CHRG_LO_VLT_SP" 4
 /begin AXIS_DESCR COM_AXIS pwsl_bat_t u_deg_C 9 -256.000000 255.9921875 AXIS_PTS_REF PWSL_X_BAT_T /end AXIS_DESCR
 /begin AXIS_DESCR FIX_AXIS pwsl_bat_soc u_pct 9 50 100 /begin FIX_AXIS_PAR_LIST 16384 26214 27852 29491 30146 30801 31457 32112 32768 /end FIX_AXIS_PAR_LIST /end AXIS_DESCR
/end CHARACTERISTIC
/begin CHARACTERISTIC PWSL_C_CRK2RUN_DLY "crank to run delay" CURVE 0x000200B0 __UWORD_S 0 u_2x_tmr 0 1023.984375 SYMBOL_LINK "PWSL_C_CRK2RUN_DLY" 2
 /begin AXIS_DESCR FIX_AXIS sys_ect u_deg_C 9 -40 120 /begin FIX_AXIS_PAR_LIST -5120 -2560 0 2560 5120 7680 10240 12800 15360 /end FIX_AXIS_PAR_LIST /end AXIS_DESCR
/end CHARACTERISTIC
/begin CHARACTERISTIC PWSL_V_ALT_PWM_INC_FIL "alternator PWM increase filter" VALUE 0x0002038C __UWORD_S 0 u_filter 0 0.9999847412109375 FORMAT "%10.9" /end CHARACTERISTIC
/begin CHARACTERISTIC PWSL_V_ALT_PWM_DEC_FIL "alternator PWM decrease filter" VALUE 0x0002038C __UWORD_S 0 u_filter 0 0.9999847412109375 FORMAT "%10.9" /end CHARACTERISTIC
/begin CHARACTERISTIC PWSL_C_FH_EXT_ALT_MAX "force high voltage mode exit enable alt load max" CURVE 0x000200B0 __UWORD_S 0 u_pct_1 0 99.9984741210937 FORMAT "%4.2" SYMBOL_LINK "PWSL_C_FH_EXT_ALT_MAX" 2
 /begin AXIS_DESCR FIX_AXIS sys_eng_spd u_deg_C 12 0.000000 8191.875000
  /begin FIX_AXIS_PAR_LIST 6400 9600 12800 16000 19200 22400 25600 28800 32000 35200 38400 41600 /end FIX_AXIS_PAR_LIST
 /end AXIS_DESCR
/end CHARACTERISTIC
/begin CHARACTERISTIC PWSL_M_FH_EXT_VLT_MIN "force high voltage mode exit enable bat voltage min" MAP 0x00020320 __UWORD_S 0 u_volt_32 0 31.99951171875 FORMAT "%4.2" SYMBOL_LINK "PWSL_M_FH_EXT_VLT_MIN" 4
 /begin AXIS_DESCR COM_AXIS pwsl_bat_t u_deg_C 9 -256.000000 255.9921875 AXIS_PTS_REF PWSL_X_BAT_T /end AXIS_DESCR
 /begin AXIS_DESCR FIX_AXIS pwsl_bat_soc u_pct 9 50 100 /begin FIX_AXIS_PAR_LIST 16384 26214 27852 29491 30146 30801 31457 32112 32768 /end FIX_AXIS_PAR_LIST /end AXIS_DESCR
/end CHARACTERISTIC
/begin CHARACTERISTIC PWSL_C_FH_EXT_CURR_MAX "force high voltage mode exit enable current max" CURVE 0x000200B0 __SWORD_S 0 u_curr_amp -2048 2047.9375 FORMAT "%5.1" SYMBOL_LINK "PWSL_C_FH_EXT_CURR_MAX" 2
 /begin AXIS_DESCR COM_AXIS pwsl_bat_t u_deg_C 9 -256.000000 255.9921875 AXIS_PTS_REF PWSL_X_BAT_T /end AXIS_DESCR
/end CHARACTERISTIC
/begin CHARACTERISTIC PWSL_V_FH_EXT_DLY "force high voltage mode exit enble delay" VALUE 0x0002038C __UWORD_S 0 u_2x_tmr 0 1023.984375 /end CHARACTERISTIC
/begin CHARACTERISTIC PWSL_V_FH_EXT_VSPD_MIN "force high voltage mode exit enble vehicle speed min" VALUE 0x0002038C __UWORD_S 0 u_vspd 0 511.9921875 FORMAT "%4.1" /end CHARACTERISTIC
/begin CHARACTERISTIC PWSL_V_FH_DUR_HI "force high voltage mode duration high" VALUE 0x0002038C __UWORD_S 0 u_1s_tmr 0 65535 /end CHARACTERISTIC
/begin CHARACTERISTIC PWSL_V_FH_DUR_LO "force high voltage mode duration low" VALUE 0x0002038C __UWORD_S 0 u_1s_tmr 0 65535 /end CHARACTERISTIC
/begin CHARACTERISTIC PWSL_V_FH_EXT_SOC_MIN "force high voltage mode low duration exit SOC min" VALUE 0x0002038C __UWORD_S 0 u_pct 0 199.996948242187 FORMAT "%4.1" /end CHARACTERISTIC
/begin CHARACTERISTIC PWSL_M_HI_LD_THR "high load mode airflow thr" MAP 0x00020320 __UWORD_S 0 u_pct_1 0 99.9984741210937 FORMAT "%4.2" SYMBOL_LINK "PWSL_M_HI_LD_THR" 4
 /begin AXIS_DESCR FIX_AXIS sys_eng_spd u_espd 17 0.000000 8191.875000
  /begin FIX_AXIS_PAR_LIST 0 3200 6400 9600 12800 16000 19200 22400 25600 28800 32000 35200 38400 41600 44800 48000 51200 /end FIX_AXIS_PAR_LIST
 /end AXIS_DESCR
 /begin AXIS_DESCR FIX_AXIS sys_amp u_kPa_0_256 7 45 105 /begin FIX_AXIS_PAR_LIST 11520 14080 16640 19200 21760 24320 26880 /end FIX_AXIS_PAR_LIST /end AXIS_DESCR
/end CHARACTERISTIC
/begin CHARACTERISTIC PWSL_V_HI_LD_THR_HYS "high load mode airflow hys" VALUE 0x0002038C __UWORD_S 0 u_pct_1 0 99.9984741210937 FORMAT "%4.2" /end CHARACTERISTIC
/begin CHARACTERISTIC PWSL_V_HI_LD_DUR_MIN "high load mode duration min" VALUE 0x0002038C __UWORD_S 0 u_2x_tmr 0 1023.984375 /end CHARACTERISTIC
/begin CHARACTERISTIC PWSL_V_FH_EN_AH_MIN "force high voltage mode enable amp-hour min" VALUE 0x0002038C __UWORD_S 0 u_amp_h 0 1023.984375 FORMAT "%5.1" /end CHARACTERISTIC
/begin CHARACTERISTIC PWSL_V_FH_EN_SOC_HI "force high voltage mode enable SOC high" VALUE 0x0002038C __UWORD_S 0 u_pct 0 199.996948242187 FORMAT "%4.2" /end CHARACTERISTIC
/begin CHARACTERISTIC PWSL_V_FH_EN_SOC_LO "force high voltage mode enable SOC low" VALUE 0x0002038C __UWORD_S 0 u_pct 0 199.996948242187 FORMAT "%4.2" /end CHARACTERISTIC
/begin CHARACTERISTIC PWSL_V_FH_EN_SOC_LO_CNTS "force high voltage mode enable SOC low counts" VALUE 0x0002038C __UWORD_S 0 u_cnts 0 65535 FORMAT "%5.0" /end CHARACTERISTIC
/begin CHARACTERISTIC PWSL_V_FH_EN_RUN_CNTS "force high voltage mode enable engine run counts" VALUE 0x0002038C __UWORD_S 0 u_cnts 0 65535 FORMAT "%5.0" /end CHARACTERISTIC
/begin CHARACTERISTIC PWSL_V_HI_TEMP_THR "high temp mode battery temp thr" VALUE 0x0002038C __SWORD_S 0 u_deg_C -256.000000 255.9921875 FORMAT "%5.1" /end CHARACTERISTIC
/begin CHARACTERISTIC PWSL_V_HI_TEMP_DLY "high temp mode enable delay" VALUE 0x0002038C __UWORD_S 0 u_2x_tmr 0 1023.984375 /end CHARACTERISTIC
/begin CHARACTERISTIC PWSL_C_CRK_VLT_SP "crank mode voltage setpoint" CURVE 0x000200B0 __UWORD_S 0 u_volt_32 0 31.99951171875 FORMAT "%4.2" SYMBOL_LINK "PWSL_C_CRK_VLT_SP" 2
 /begin AXIS_DESCR FIX_AXIS sys_ect u_deg_C 9 -40 120 /begin FIX_AXIS_PAR_LIST -5120 -2560 0 2560 5120 7680 10240 12800 15360 /end FIX_AXIS_PAR_LIST /end AXIS_DESCR
/end CHARACTERISTIC
/begin CHARACTERISTIC PWSL_V_AMP_LO "high altitude mode amp low thr" VALUE 0x0002038C __UWORD_S 0 u_kPa_0_256 0 255.99609375 /end CHARACTERISTIC
/begin CHARACTERISTIC PWSL_V_IAT_HI "high altitude mode IAT high thr" VALUE 0x0002038C __SWORD_S 0 u_deg_C -256.000000 255.9921875 /end CHARACTERISTIC
/begin CHARACTERISTIC PWSL_V_BAT_T_LO "low temp mode battery temp thr" VALUE 0x0002038C __SWORD_S 0 u_deg_C -256.000000 255.9921875 /end CHARACTERISTIC
/begin CHARACTERISTIC PWSL_V_BLWR_MD_EN "blower mode enable" VALUE 0x0002038C __UBYTE_S 0 b_true 0 1 FORMAT "%1.0" /end CHARACTERISTIC
/begin CHARACTERISTIC PWSL_V_LIGHT_MD_EN "head light mode enable" VALUE 0x0002038C __UBYTE_S 0 b_true 0 1 FORMAT "%1.0" /end CHARACTERISTIC
/begin CHARACTERISTIC PWSL_V_ECT_HI "fan high mode coolant temp thr" VALUE 0x0002038C __SWORD_S 0 u_deg_C -256.000000 255.9921875 /end CHARACTERISTIC
/begin CHARACTERISTIC PWSL_V_FAN_PWM_MIN "fan high mode PWM duty min" VALUE 0x0002038C __UWORD_S 0 u_pct 0 199.996948242187 FORMAT "%4.2" /end CHARACTERISTIC
/begin CHARACTERISTIC PWSL_V_HI_FAN_DLY "fan high mode enable delay" VALUE 0x0002038C __UWORD_S 0 u_2x_tmr 0 1023.984375 /end CHARACTERISTIC
/begin CHARACTERISTIC PWSL_V_PN_VSPD_MAX "PN mode vehicle speed max" VALUE 0x0002038C __UWORD_S 0 u_vspd 0 511.9921875 FORMAT "%4.1" /end CHARACTERISTIC
/begin CHARACTERISTIC PWSL_V_PN_DLY "PN mode enable delay" VALUE 0x0002038C __UWORD_S 0 u_2x_tmr 0 1023.984375 /end CHARACTERISTIC
/begin CHARACTERISTIC PWSL_C_FH_VLT_SP "battery voltage setpoint at force high voltage charge mode" CURVE 0x000200B0 __UWORD_S 0 u_volt_32 0 31.99951171875 FORMAT "%4.2" SYMBOL_LINK "PWSL_C_FH_VLT_SP" 2
 /begin AXIS_DESCR COM_AXIS pwsl_bat_t u_deg_C 9 -256.000000 255.9921875 AXIS_PTS_REF PWSL_X_BAT_T /end AXIS_DESCR
/end CHARACTERISTIC
/begin CHARACTERISTIC PWSL_V_FH_INC_MAX "force high voltage charge mode increase step max" VALUE 0x0002038C __UWORD_S 0 u_volt_32 0 31.99951171875 FORMAT "%4.2" /end CHARACTERISTIC
/begin CHARACTERISTIC PWSL_V_FH_DEC_MAX "force high voltage charge mode decrease step max" VALUE 0x0002038C __UWORD_S 0 u_volt_32 0 31.99951171875 FORMAT "%4.2" /end CHARACTERISTIC
/begin CHARACTERISTIC PWSL_V_RAT_VLT_SP "rationality mode voltage setpoint" VALUE 0x0002038C __UWORD_S 0 u_volt_32 0 31.99951171875 FORMAT "%4.2" /end CHARACTERISTIC
/begin CHARACTERISTIC PWSL_V_RAT_INC_MAX "rationality mode increase step max" VALUE 0x0002038C __UWORD_S 0 u_volt_32 0 31.99951171875 FORMAT "%4.2" /end CHARACTERISTIC
/begin CHARACTERISTIC PWSL_V_RAT_DEC_MAX "rationality mode decrease step max" VALUE 0x0002038C __UWORD_S 0 u_volt_32 0 31.99951171875 FORMAT "%4.2" /end CHARACTERISTIC
/begin CHARACTERISTIC PWSL_V_DCL_EN_VSPD_HI "decelerate mode enble vehicle speed high" VALUE 0x0002038C __UWORD_S 0 u_vspd 0 511.9921875 FORMAT "%4.1" /end CHARACTERISTIC
/begin CHARACTERISTIC PWSL_V_DCL_EN_VSPD_LO "decelerate mode enble vehicle speed low" VALUE 0x0002038C __UWORD_S 0 u_vspd 0 511.9921875 FORMAT "%4.1" /end CHARACTERISTIC
/begin CHARACTERISTIC PWSL_V_DCL_NRM_USE_PEDL "normal stage decelerate mode enable by pedal" VALUE 0x0002038C __UBYTE_S 0 b_true 0 1 FORMAT "%1.0" /end CHARACTERISTIC
/begin CHARACTERISTIC PWSL_V_DCL_ABNM_USE_PEDL "abnormal stage decelerate mode enable by pedal" VALUE 0x0002038C __UBYTE_S 0 b_true 0 1 FORMAT "%1.0" /end CHARACTERISTIC
/begin CHARACTERISTIC PWSL_M_DCL_NRM_PEDL_THR "normal stage decelerate mode pedal thr" MAP 0x00020320 __UWORD_S 0 u_pct 0 199.996948242187 SYMBOL_LINK "PWSL_M_DCL_NRM_PEDL_THR" 4
 /begin AXIS_DESCR FIX_AXIS trs_veh_gr_st u_pwsl_gr_typ 12 0 11 /begin FIX_AXIS_PAR_LIST 0 1 2 3 4 5 6 7 8 9 10 11 /end FIX_AXIS_PAR_LIST /end AXIS_DESCR
 /begin AXIS_DESCR FIX_AXIS sys_eng_spd u_espd 9 0 8191.875000 /begin FIX_AXIS_PAR_LIST 0 6400 12800 19200 25600 32000 38400 44800 51200 /end FIX_AXIS_PAR_LIST /end AXIS_DESCR
/end CHARACTERISTIC
/begin CHARACTERISTIC PWSL_M_DCL_ABNM_PEDL_THR "abnormal stage decelerate mode pedal thr" MAP 0x00020320 __UWORD_S 0 u_pct 0 199.996948242187 SYMBOL_LINK "PWSL_M_DCL_ABNM_PEDL_THR" 4
 /begin AXIS_DESCR FIX_AXIS trs_veh_gr_st u_pwsl_gr_typ 12 0 11 /begin FIX_AXIS_PAR_LIST 0 1 2 3 4 5 6 7 8 9 10 11 /end FIX_AXIS_PAR_LIST /end AXIS_DESCR
 /begin AXIS_DESCR FIX_AXIS sys_eng_spd u_espd 9 0 8191.875000 /begin FIX_AXIS_PAR_LIST 0 6400 12800 19200 25600 32000 38400 44800 51200 /end FIX_AXIS_PAR_LIST /end AXIS_DESCR
/end CHARACTERISTIC
/begin CHARACTERISTIC PWSL_V_DCL_DLY "decelerate mode enable delay" VALUE 0x0002038C __UWORD_S 0 u_2x_tmr 0 1023.984375 /end CHARACTERISTIC
/begin CHARACTERISTIC PWSL_V_DCL_DUR_MAX "decelerate mode duration max" VALUE 0x0002038C __UWORD_S 0 u_2x_tmr 0 1023.984375 /end CHARACTERISTIC
/begin CHARACTERISTIC PWSL_V_DCL_DEC_MAX "decelerate mode decrease step max" VALUE 0x0002038C __UWORD_S 0 u_volt_32 0 31.99951171875 FORMAT "%4.2" /end CHARACTERISTIC
/begin CHARACTERISTIC PWSL_V_DCL_INC_MAX "decelerate mode increase step max" VALUE 0x0002038C __UWORD_S 0 u_volt_32 0 31.99951171875 FORMAT "%4.2" /end CHARACTERISTIC
/begin CHARACTERISTIC PWSL_V_DCL_NRM_USE_BRK "normal stage decelerate mode enable by break" VALUE 0x0002038C __UBYTE_S 0 b_true 0 1 FORMAT "%1.0" /end CHARACTERISTIC
/begin CHARACTERISTIC PWSL_V_DCL_ABNM_USE_BRK "abnormal stage decelerate mode enable by break" VALUE 0x0002038C __UBYTE_S 0 b_true 0 1 FORMAT "%1.0" /end CHARACTERISTIC
/begin CHARACTERISTIC PWSL_M_DCL_VLT_SP "decelerate mode voltage setpoint" MAP 0x00020320 __UWORD_S 0 u_volt_32 0 31.99951171875 FORMAT "%4.2" SYMBOL_LINK "PWSL_M_DCL_VLT_SP" 4
 /begin AXIS_DESCR COM_AXIS pwsl_bat_t u_deg_C 9 -256.000000 255.9921875 AXIS_PTS_REF PWSL_X_BAT_T /end AXIS_DESCR
 /begin AXIS_DESCR FIX_AXIS pwsl_bat_soc u_pct 9 50 100 /begin FIX_AXIS_PAR_LIST 16384 26214 27852 29491 30146 30801 31457 32112 32768 /end FIX_AXIS_PAR_LIST /end AXIS_DESCR
/end CHARACTERISTIC
/begin CHARACTERISTIC PWSL_V_CHRG_INC_MAX "charge mode increase step max" VALUE 0x0002038C __UWORD_S 0 u_volt_32 0 31.99951171875 FORMAT "%4.2" /end CHARACTERISTIC
/begin CHARACTERISTIC PWSL_V_CHRG_DEC_MAX "charge mode decrease step max" VALUE 0x0002038C __UWORD_S 0 u_volt_32 0 31.99951171875 FORMAT "%4.2" /end CHARACTERISTIC
/begin CHARACTERISTIC PWSL_M_CHRG_VLT_SP "charge mode voltage setpoint" MAP 0x00020320 __UWORD_S 0 u_volt_32 0 31.99951171875 FORMAT "%4.2" SYMBOL_LINK "PWSL_M_CHRG_VLT_SP" 4
 /begin AXIS_DESCR COM_AXIS pwsl_bat_t u_deg_C 9 -256.000000 255.9921875 AXIS_PTS_REF PWSL_X_BAT_T /end AXIS_DESCR
 /begin AXIS_DESCR FIX_AXIS pwsl_bat_soc u_pct 9 50 100 /begin FIX_AXIS_PAR_LIST 16384 26214 27852 29491 30146 30801 31457 32112 32768 /end FIX_AXIS_PAR_LIST /end AXIS_DESCR
/end CHARACTERISTIC
/begin CHARACTERISTIC PWSL_V_ACL_TPS_MIN "accelerate mode tps min" VALUE 0x0002038C __UWORD_S 0 u_pct 0 199.996948242187 FORMAT "%4.2" /end CHARACTERISTIC
/begin CHARACTERISTIC PWSL_V_ACL_VSPD_MIN "accelerate mode enble vehicle speed min" VALUE 0x0002038C __UWORD_S 0 u_vspd 0 511.9921875 FORMAT "%4.1" /end CHARACTERISTIC
/begin CHARACTERISTIC PWSL_V_ACL_DUR_MAX "accelerate mode duration max" VALUE 0x0002038C __UWORD_S 0 u_2x_tmr 0 1023.984375 /end CHARACTERISTIC
/begin CHARACTERISTIC PWSL_V_ACL_INC_MAX "accelerate mode increase step max" VALUE 0x0002038C __UWORD_S 0 u_volt_32 0 31.99951171875 FORMAT "%4.2" /end CHARACTERISTIC
/begin CHARACTERISTIC PWSL_V_ACL_DEC_MAX "accelerate mode decrease step max" VALUE 0x0002038C __UWORD_S 0 u_volt_32 0 31.99951171875 FORMAT "%4.2" /end CHARACTERISTIC
/begin CHARACTERISTIC PWSL_M_ACL_VLT_SP "accelerate mode voltage setpoint" MAP 0x00020320 __UWORD_S 0 u_volt_32 0 31.99951171875 FORMAT "%4.2" SYMBOL_LINK "PWSL_M_ACL_VLT_SP" 4
 /begin AXIS_DESCR COM_AXIS pwsl_bat_t u_deg_C 9 -256.000000 255.9921875 AXIS_PTS_REF PWSL_X_BAT_T /end AXIS_DESCR
 /begin AXIS_DESCR FIX_AXIS pwsl_bat_soc u_pct 9 50 100 /begin FIX_AXIS_PAR_LIST 16384 26214 27852 29491 30146 30801 31457 32112 32768 /end FIX_AXIS_PAR_LIST /end AXIS_DESCR
/end CHARACTERISTIC
/begin CHARACTERISTIC PWSL_V_DCHRG_INC_MAX "discharge mode increase step max" VALUE 0x0002038C __UWORD_S 0 u_volt_32 0 31.99951171875 FORMAT "%4.2" /end CHARACTERISTIC
/begin CHARACTERISTIC PWSL_V_DCHRG_DEC_MAX "discharge mode decrease step max" VALUE 0x0002038C __UWORD_S 0 u_volt_32 0 31.99951171875 FORMAT "%4.2" /end CHARACTERISTIC
/begin CHARACTERISTIC PWSL_M_DCHRG_VLT_SP "discharge mode voltage setpoint" MAP 0x00020320 __UWORD_S 0 u_volt_32 0 31.99951171875 FORMAT "%4.2" SYMBOL_LINK "PWSL_M_DCHRG_VLT_SP" 4
 /begin AXIS_DESCR COM_AXIS pwsl_bat_t u_deg_C 9 -256.000000 255.9921875 AXIS_PTS_REF PWSL_X_BAT_T /end AXIS_DESCR
 /begin AXIS_DESCR FIX_AXIS pwsl_bat_soc u_pct 9 50 100 /begin FIX_AXIS_PAR_LIST 16384 26214 27852 29491 30146 30801 31457 32112 32768 /end FIX_AXIS_PAR_LIST /end AXIS_DESCR
/end CHARACTERISTIC
/begin CHARACTERISTIC PWSL_V_SOC_INC_MAX "SOC control mode increase step max" VALUE 0x0002038C __UWORD_S 0 u_volt_32 0 31.99951171875 FORMAT "%4.2" /end CHARACTERISTIC
/begin CHARACTERISTIC PWSL_V_SOC_DEC_MAX "SOC control mode decrease step max" VALUE 0x0002038C __UWORD_S 0 u_volt_32 0 31.99951171875 FORMAT "%4.2" /end CHARACTERISTIC
/begin CHARACTERISTIC PWSL_V_NRM_INC_MAX "normal control mode increase step max" VALUE 0x0002038C __UWORD_S 0 u_volt_32 0 31.99951171875 FORMAT "%4.2" /end CHARACTERISTIC
/begin CHARACTERISTIC PWSL_V_NRM_DEC_MAX "normal control mode decrease step max" VALUE 0x0002038C __UWORD_S 0 u_volt_32 0 31.99951171875 FORMAT "%4.2" /end CHARACTERISTIC
/begin CHARACTERISTIC PWSL_C_CURR_LMT_CTRL_DLY "current limit voltage setpoint control delay" CURVE 0x000200B0 __UWORD_S 0 u_2x_tmr 0 1023.984375 SYMBOL_LINK "PWSL_C_CURR_LMT_CTRL_DLY" 2
 /begin AXIS_DESCR FIX_AXIS sys_ect u_deg_C 9 -40 120 /begin FIX_AXIS_PAR_LIST -5120 -2560 0 2560 5120 7680 10240 12800 15360 /end FIX_AXIS_PAR_LIST /end AXIS_DESCR
/end CHARACTERISTIC
/begin CHARACTERISTIC PWSL_C_PN_SP_MIN_DLY "PN voltage setpoint limit delay" CURVE 0x000200B0 __UWORD_S 0 u_2x_tmr 0 1023.984375 SYMBOL_LINK "PWSL_C_PN_SP_MIN_DLY" 2
 /begin AXIS_DESCR FIX_AXIS sys_ect u_deg_C 9 -40 120 /begin FIX_AXIS_PAR_LIST -5120 -2560 0 2560 5120 7680 10240 12800 15360 /end FIX_AXIS_PAR_LIST /end AXIS_DESCR
/end CHARACTERISTIC
/begin CHARACTERISTIC PWSL_C_CURR_MAX "battery current max" CURVE 0x000200B0 __SWORD_S 0 u_curr_amp -2048 2047.9375 FORMAT "%6.2" SYMBOL_LINK "PWSL_C_CURR_MAX" 2
 /begin AXIS_DESCR COM_AXIS pwsl_bat_t u_deg_C 9 -256.000000 255.9921875 AXIS_PTS_REF PWSL_X_BAT_T /end AXIS_DESCR
/end CHARACTERISTIC
/begin CHARACTERISTIC PWSL_C_CURR_MIN "battery current min" CURVE 0x000200B0 __SWORD_S 0 u_curr_amp -2048 2047.9375 FORMAT "%6.2" SYMBOL_LINK "PWSL_C_CURR_MIN" 2
 /begin AXIS_DESCR COM_AXIS pwsl_bat_t u_deg_C 9 -256.000000 255.9921875 AXIS_PTS_REF PWSL_X_BAT_T /end AXIS_DESCR
/end CHARACTERISTIC
/begin CHARACTERISTIC PWSL_V_PN_SP_MIN "PN voltage setpoint min" VALUE 0x0002038C __UWORD_S 0 u_volt_32 0 31.99951171875 FORMAT "%4.2" /end CHARACTERISTIC
/begin CHARACTERISTIC PWSL_V_DR_SP_MIN "DR voltage setpoint min" VALUE 0x0002038C __UWORD_S 0 u_volt_32 0 31.99951171875 FORMAT "%4.2" /end CHARACTERISTIC
/begin CHARACTERISTIC PWSL_V_VLT_LMT_CHG_MAX "voltage setpoint limit change max" VALUE 0x0002038C __UWORD_S 0 u_volt_32 0 31.99951171875 FORMAT "%4.2" /end CHARACTERISTIC
/begin CHARACTERISTIC PWSL_V_CURR_HI_DLY "current high limit delay" VALUE 0x0002038C __UWORD_S 0 u_2x_tmr 0 1023.984375 /end CHARACTERISTIC
/begin CHARACTERISTIC PWSL_V_CURR_LO_DLY "current low limit delay" VALUE 0x0002038C __UWORD_S 0 u_2x_tmr 0 1023.984375 /end CHARACTERISTIC
/begin CHARACTERISTIC PWSL_V_VLT_SP_MAX "voltage setpoint max" VALUE 0x0002038C __UWORD_S 0 u_volt_32 0 31.99951171875 FORMAT "%4.2" /end CHARACTERISTIC
/begin CHARACTERISTIC PWSL_V_KEYON_RGLTR_DTY "keyon regulator duty cycle" VALUE 0x0002038C __UWORD_S 0 u_pct_1 0 99.9984741210937 FORMAT "%4.2" /end CHARACTERISTIC
/begin CHARACTERISTIC PWSL_C_DTY_BASE "regulator duty cycle base" CURVE 0x000200B0 __UWORD_S 0 u_pct_1 0 99.9984741210937 FORMAT "%4.2" SYMBOL_LINK "PWSL_C_DTY_BASE" 2
 /begin AXIS_DESCR COM_AXIS pwsl_vlt_sp_raw u_volt_32 11 0 31.99951171875 AXIS_PTS_REF PWSL_X_VLT_SP /end AXIS_DESCR
/end CHARACTERISTIC
/begin AXIS_PTS PWSL_X_VLT_SP "voltage setpoint breakpoint" 0x0002006C pwsl_vlt_sp_raw SSV__UWORD_S 0 u_volt_32 11 0 31.99951171875 FORMAT "%4.2" DEPOSIT ABSOLUTE SYMBOL_LINK "PWSL_X_VLT_SP" 2 /end AXIS_PTS
/begin CHARACTERISTIC PWSL_C_DTY_P "regulator duty cycle proportional term" CURVE 0x000200B0 __SWORD_S 0 u_pct_1 -50 49.9984741210937 FORMAT "%4.2" SYMBOL_LINK "PWSL_C_DTY_P" 2
 /begin AXIS_DESCR COM_AXIS NO_INPUT_QUANTITY u_volt_32 11 -16 15.99951171875 AXIS_PTS_REF PWSL_X_VLT_ERR /end AXIS_DESCR
/end CHARACTERISTIC
/begin AXIS_PTS PWSL_X_VLT_ERR "voltage setpoint error breakpoint" 0x0002006C NO_INPUT_QUANTITY SSV__SWORD_S 0 u_volt_32 11 -16 15.99951171875 FORMAT "%4.2" DEPOSIT ABSOLUTE SYMBOL_LINK "PWSL_X_VLT_ERR" 2 /end AXIS_PTS
/begin CHARACTERISTIC PWSL_V_DTY_I_GN "duty cycle int gain" VALUE 0x0002038C __UWORD_S 0 u_fac_2 0 1.999969482421875 FORMAT "%4.3" /end CHARACTERISTIC
/begin CHARACTERISTIC PWSL_V_DTY_I_MIN "duty cycle int min" VALUE 0x0002038C __SWORD_S 0 u_pct_1 -50 49.9984741210937 FORMAT "%4.2" /end CHARACTERISTIC
/begin CHARACTERISTIC PWSL_V_DTY_I_MAX "duty cycle int max" VALUE 0x0002038C __SWORD_S 0 u_pct_1 -50 49.9984741210937 FORMAT "%4.2" /end CHARACTERISTIC
/begin CHARACTERISTIC PWSL_V_DTY_DFLT "regulator duty cycle default" VALUE 0x0002038C __UWORD_S 0 u_pct_1 0 99.9984741210937 FORMAT "%4.2" /end CHARACTERISTIC
/begin CHARACTERISTIC PWSL_V_VLT_SP_DFLT "voltage setpoint default" VALUE 0x0002038C __UWORD_S 0 u_volt_32 0 31.99951171875 FORMAT "%4.2" /end CHARACTERISTIC
/begin CHARACTERISTIC PWSL_M_CHRG_EFF "charge efficiency" MAP 0x00020320 __UWORD_S 0 u_fac_2 0 1.999969482421875 FORMAT "%4.3" SYMBOL_LINK "PWSL_M_CHRG_EFF" 4
 /begin AXIS_DESCR COM_AXIS pwsl_bat_t u_deg_C 9 -256.000000 255.9921875 AXIS_PTS_REF PWSL_X_BAT_T /end AXIS_DESCR
 /begin AXIS_DESCR FIX_AXIS pwsl_bat_soc u_pct 11 50 100
  /begin FIX_AXIS_PAR_LIST 26214 26869 27525 28180 28835 29491 30146 30801 31457 32112 32768 /end FIX_AXIS_PAR_LIST
 /end AXIS_DESCR
/end CHARACTERISTIC
/begin CHARACTERISTIC PWSL_C_CHRG_EFF_FAC "charge efficiency factor" CURVE 0x000200B0 __UWORD_S 0 u_fac_2 0 1.999969482421875 FORMAT "%4.3" SYMBOL_LINK "PWSL_C_CHRG_EFF_FAC" 2
 /begin AXIS_DESCR COM_AXIS pwsl_bat_curr u_curr_amp 9 -2048 2047.9375 AXIS_PTS_REF PWSL_X_BAT_CURR /end AXIS_DESCR
/end CHARACTERISTIC
/begin AXIS_PTS PWSL_X_BAT_CURR "battery current breakpoint" 0x0002006C pwsl_bat_curr SSV__SWORD_S 0 u_curr_amp 9 -2048 2047.9375 FORMAT "%6.2" DEPOSIT ABSOLUTE SYMBOL_LINK "PWSL_X_BAT_CURR" 2 /end AXIS_PTS
/begin CHARACTERISTIC PWSL_V_MDL_SOC_MAX "model SOC max" VALUE 0x0002038C __UWORD_S 0 u_pct 0 199.996948242187 /end CHARACTERISTIC
/begin CHARACTERISTIC PWSL_V_MDL_SOC_MIN "model SOC min" VALUE 0x0002038C __UWORD_S 0 u_pct 0 199.996948242187 /end CHARACTERISTIC
/begin CHARACTERISTIC PWSL_M_BAT_CAP "battery capacity" MAP 0x00020320 __UWORD_S 0 u_amp_h_lo 0 127.998046875 SYMBOL_LINK "PWSL_M_BAT_CAP" 4
 /begin AXIS_DESCR COM_AXIS pwsl_bat_curr u_curr_amp 8 -2048.000000 2047.937500 AXIS_PTS_REF PWSL_X_BAT_CURR_B /end AXIS_DESCR
 /begin AXIS_DESCR COM_AXIS pwsl_bat_t u_deg_C 9 -256.000000 255.9921875 AXIS_PTS_REF PWSL_X_BAT_T /end AXIS_DESCR
/end CHARACTERISTIC
/begin AXIS_PTS PWSL_X_BAT_CURR_B "battery current breakpoint" 0x0002006C pwsl_bat_curr SSV__SWORD_S 0 u_curr_amp 8 -2048 2047.9375 FORMAT "%6.2" DEPOSIT ABSOLUTE SYMBOL_LINK "PWSL_X_BAT_CURR_B" 2 /end AXIS_PTS
/begin CHARACTERISTIC PWSL_V_CL_SOC_SP "close loop SOC setpoint" VALUE 0x0002038C __UWORD_S 0 u_pct 0 199.996948242187 /end CHARACTERISTIC
/begin CHARACTERISTIC PWSL_V_CL_SOC_DB "close loop SOC deadband" VALUE 0x0002038C __UWORD_S 0 u_pct 0 199.996948242187 /end CHARACTERISTIC
/begin CHARACTERISTIC PWSL_V_CL_SOC_I_GN "close loop SOC int gain" VALUE 0x0002038C __UWORD_S 0 u_fac_2 0 1.999969482421875 FORMAT "%4.3" /end CHARACTERISTIC
/begin CHARACTERISTIC PWSL_V_CL_SOC_I_MIN "close loop SOC int min" VALUE 0x0002038C __SWORD_S 0 u_volt_32 -16 15.99951171875 FORMAT "%4.2" /end CHARACTERISTIC
/begin CHARACTERISTIC PWSL_V_CL_SOC_I_MAX "close loop SOC int max" VALUE 0x0002038C __SWORD_S 0 u_volt_32 -16 15.99951171875 FORMAT "%4.2" /end CHARACTERISTIC
/begin CHARACTERISTIC PWSL_V_CHRG_EXT_SOC "charge control stage exit SOC min" VALUE 0x0002038C __UWORD_S 0 u_pct 0 199.996948242187 /end CHARACTERISTIC
/begin CHARACTERISTIC PWSL_M_CHRG_DUR_MAX "charge stage duration max" MAP 0x00020320 __UWORD_S 0 u_2x_tmr 0 1023.984375 SYMBOL_LINK "PWSL_M_CHRG_DUR_MAX" 4
 /begin AXIS_DESCR COM_AXIS pwsl_bat_t u_deg_C 9 -256.000000 255.9921875 AXIS_PTS_REF PWSL_X_BAT_T /end AXIS_DESCR
 /begin AXIS_DESCR FIX_AXIS pwsl_bat_soc u_pct 9 50 100 /begin FIX_AXIS_PAR_LIST 16384 26214 27852 29491 30146 30801 31457 32112 32768 /end FIX_AXIS_PAR_LIST /end AXIS_DESCR
/end CHARACTERISTIC
/begin CHARACTERISTIC PWSL_M_DISCHRG_DUR_MAX "discharge stage duration max" MAP 0x00020320 __UWORD_S 0 u_2x_tmr 0 1023.984375 SYMBOL_LINK "PWSL_M_DISCHRG_DUR_MAX" 4
 /begin AXIS_DESCR COM_AXIS pwsl_bat_t u_deg_C 9 -256.000000 255.9921875 AXIS_PTS_REF PWSL_X_BAT_T /end AXIS_DESCR
 /begin AXIS_DESCR FIX_AXIS sys_keyon_ect u_deg_C 9 -40 152 /begin FIX_AXIS_PAR_LIST -5120 -2048 1024 4096 7168 10240 13312 16384 19456 /end FIX_AXIS_PAR_LIST /end AXIS_DESCR
/end CHARACTERISTIC
/begin CHARACTERISTIC PWSL_V_DISCHRG_EXT_SOC "discharge control stage exit SOC max" VALUE 0x0002038C __UWORD_S 0 u_pct 0 199.996948242187 /end CHARACTERISTIC
/begin CHARACTERISTIC PWSL_C_DISCHRG_EXT_AH "discharge control stage exit discharge AMP_H thr" CURVE 0x000200B0 __SLONG_S 0 u_amp_h_l -128 127.999999940395355224609375 SYMBOL_LINK "PWSL_C_DISCHRG_EXT_AH" 4
 /begin AXIS_DESCR FIX_AXIS pwsl_bat_soc u_pct 9 50 100 /begin FIX_AXIS_PAR_LIST 16384 26214 27852 29491 30146 30801 31457 32112 32768 /end FIX_AXIS_PAR_LIST /end AXIS_DESCR
/end CHARACTERISTIC
/begin CHARACTERISTIC PWSL_V_DISCHRG_EXT_CURR "discharge control stage exit current max" VALUE 0x0002038C __SWORD_S 0 u_curr_amp -2048 2047.9375 /end CHARACTERISTIC
/begin CHARACTERISTIC PWSL_V_DISCHRG_EXT_RUN "discharge control stage exit run min" VALUE 0x0002038C __UWORD_S 0 u_16x_tmr 0 8191.875 /end CHARACTERISTIC
/begin CHARACTERISTIC PWSL_V_USE_CL_SOC "use close loop SOC control" VALUE 0x0002038C __UBYTE_S 0 b_true 0 1 FORMAT "%1.0" /end CHARACTERISTIC
/begin CHARACTERISTIC PWSL_V_MDL_SOC_INIT "modle SOC init" VALUE 0x0002038C __UWORD_S 0 u_pct 0 199.996948242187 /end CHARACTERISTIC
/begin CHARACTERISTIC PWSL_V_DFLT_DEC_MAX "default decrease step max" VALUE 0x0002038C __UWORD_S 0 u_volt_32 0 31.99951171875 FORMAT "%4.2" /end CHARACTERISTIC
/begin CHARACTERISTIC PWSL_V_DFLT_INC_MAX "default increase step max" VALUE 0x0002038C __UWORD_S 0 u_volt_32 0 31.99951171875 FORMAT "%4.2" /end CHARACTERISTIC
/begin CHARACTERISTIC PWSL_C_LO_SOC_VLT_SP "battery voltage setpoint at low SOC charge mode" CURVE 0x000200B0 __UWORD_S 0 u_volt_32 0 31.99951171875 FORMAT "%4.2" SYMBOL_LINK "PWSL_C_LO_SOC_VLT_SP" 2
 /begin AXIS_DESCR COM_AXIS pwsl_bat_t u_deg_C 9 -256.000000 255.9921875 AXIS_PTS_REF PWSL_X_BAT_T /end AXIS_DESCR
/end CHARACTERISTIC
/begin CHARACTERISTIC PWSL_C_CHRG_EXT_AH "charge control stage exit charge AMP_H thr" CURVE 0x000200B0 __SLONG_S 0 u_amp_h_l -128 127.999999940395355224609375 SYMBOL_LINK "PWSL_C_CHRG_EXT_AH" 4
 /begin AXIS_DESCR FIX_AXIS NO_INPUT_QUANTITY u_pct 9 50 100 /begin FIX_AXIS_PAR_LIST 16384 26214 27852 29491 30146 30801 31457 32112 32768 /end FIX_AXIS_PAR_LIST /end AXIS_DESCR
/end CHARACTERISTIC
/begin CHARACTERISTIC PWSL_C_DFLT_VLT_SP "battery voltage setpoint default" CURVE 0x000200B0 __UWORD_S 0 u_volt_32 0 31.99951171875 FORMAT "%4.2" SYMBOL_LINK "PWSL_C_DFLT_VLT_SP" 2
 /begin AXIS_DESCR COM_AXIS pwsl_bat_t u_deg_C 9 -256.000000 255.9921875 AXIS_PTS_REF PWSL_X_BAT_T /end AXIS_DESCR
/end CHARACTERISTIC
/begin CHARACTERISTIC PWSL_V_HI_TEMP_INC_MAX "high temp control mode increase step max" VALUE 0x0002038C __UWORD_S 0 u_volt_32 0 31.99951171875 FORMAT "%4.2" /end CHARACTERISTIC
/begin CHARACTERISTIC PWSL_V_HI_TEMP_DEC_MAX "high temp control mode decrease step max" VALUE 0x0002038C __UWORD_S 0 u_volt_32 0 31.99951171875 FORMAT "%4.2" /end CHARACTERISTIC
/begin CHARACTERISTIC PWSL_V_PN_INC_MAX "PN control mode increase step max" VALUE 0x0002038C __UWORD_S 0 u_volt_32 0 31.99951171875 FORMAT "%4.2" /end CHARACTERISTIC
/begin CHARACTERISTIC PWSL_V_PN_DEC_MAX "PN control mode decrease step max" VALUE 0x0002038C __UWORD_S 0 u_volt_32 0 31.99951171875 FORMAT "%4.2" /end CHARACTERISTIC
/begin CHARACTERISTIC PWSL_C_GEN_LD_RSP_DUR "generator load response duration from 0% to 100%" CURVE 0x000200B0 __UWORD_S 0 u_tmr_32 0 31.99951171875 FORMAT "%4.2" SYMBOL_LINK "PWSL_C_GEN_LD_RSP_DUR" 2
 /begin AXIS_DESCR FIX_AXIS sys_eng_spd u_espd 13 0 8191.875000
  /begin FIX_AXIS_PAR_LIST 0 3200 6400 9600 12800 16000 19200 22400 25600 32000 38400 44800 51200 /end FIX_AXIS_PAR_LIST
 /end AXIS_DESCR
/end CHARACTERISTIC
/begin CHARACTERISTIC PWSL_C_GEN_CURR_LMT "generator current limit" CURVE 0x000200B0 __UWORD_S 0 u_curr_amp_lo 0 127.998046875 SYMBOL_LINK "PWSL_C_GEN_CURR_LMT" 2
 /begin AXIS_DESCR FIX_AXIS sys_eng_spd u_espd 13 0 8191.875000
  /begin FIX_AXIS_PAR_LIST 0 3200 6400 9600 12800 16000 19200 22400 25600 32000 38400 44800 51200 /end FIX_AXIS_PAR_LIST
 /end AXIS_DESCR
/end CHARACTERISTIC
/begin CHARACTERISTIC PWSL_V_HYB_STP_VLT_MIN "hybrid stop enable voltage min" VALUE 0x0002038C __UWORD_S 0 u_volt_32 0 31.99951171875 FORMAT "%4.2" /end CHARACTERISTIC
/begin CHARACTERISTIC PWSL_V_HYB_STP_SOH_MIN "hybrid stop enable SOH min" VALUE 0x0002038C __UWORD_S 0 u_pct 0 199.996948242187 /end CHARACTERISTIC
/begin CHARACTERISTIC PWSL_C_HYB_STP_SOC_MIN "hybrid stop enable SOC min" CURVE 0x000200B0 __UWORD_S 0 u_pct 0 199.996948242187 SYMBOL_LINK "PWSL_C_HYB_STP_SOC_MIN" 2
 /begin AXIS_DESCR FIX_AXIS pwsl_soc_st u_soc_st 4 0 3 /begin FIX_AXIS_PAR_LIST 0 1 2 3 /end FIX_AXIS_PAR_LIST /end AXIS_DESCR
/end CHARACTERISTIC
/begin CHARACTERISTIC PWSL_C_HYB_STP_SOF_MIN "hybrid stop enable SOF min" CURVE 0x000200B0 __UWORD_S 0 u_volt_32 0 31.99951171875 FORMAT "%4.2" SYMBOL_LINK "PWSL_C_HYB_STP_SOF_MIN" 2
 /begin AXIS_DESCR FIX_AXIS pwsl_soc_st u_soc_st 4 0 3 /begin FIX_AXIS_PAR_LIST 0 1 2 3 /end FIX_AXIS_PAR_LIST /end AXIS_DESCR
/end CHARACTERISTIC
/begin CHARACTERISTIC PWSL_C_HYB_STRT_SOC_MIN "hybrid start enable SOC min" CURVE 0x000200B0 __UWORD_S 0 u_pct 0 199.996948242187 SYMBOL_LINK "PWSL_C_HYB_STRT_SOC_MIN" 2
 /begin AXIS_DESCR FIX_AXIS pwsl_soc_st u_soc_st 4 0 3 /begin FIX_AXIS_PAR_LIST 0 1 2 3 /end FIX_AXIS_PAR_LIST /end AXIS_DESCR
/end CHARACTERISTIC
/begin CHARACTERISTIC PWSL_C_HYB_STRT_SOF_MIN "hybrid stop enable SOF min" CURVE 0x000200B0 __UWORD_S 0 u_volt_32 0 31.99951171875 FORMAT "%4.2" SYMBOL_LINK "PWSL_C_HYB_STRT_SOF_MIN" 2
 /begin AXIS_DESCR FIX_AXIS pwsl_soc_st u_soc_st 4 0 3 /begin FIX_AXIS_PAR_LIST 0 1 2 3 /end FIX_AXIS_PAR_LIST /end AXIS_DESCR
/end CHARACTERISTIC
/begin CHARACTERISTIC PWSL_V_HYB_SNSR_REQ "hybrid request from battery sensor" VALUE 0x0002038C __UBYTE_S 0 b_true 0 1 FORMAT "%1.0" /end CHARACTERISTIC
/begin CHARACTERISTIC PWSL_V_HYB_STRT_SOH_MIN "hybrid start enable SOH min" VALUE 0x0002038C __UWORD_S 0 u_pct 0 199.996948242187 /end CHARACTERISTIC
/begin CHARACTERISTIC PWSL_V_HYB_STRT_SOC_DLT "hybrid start enable SOC delta" VALUE 0x0002038C __UWORD_S 0 u_pct 0 199.996948242187 /end CHARACTERISTIC
/begin CHARACTERISTIC PWSL_V_HYB_STRT_CURR_MAX "hybrid start enable request current max" VALUE 0x0002038C __SWORD_S 0 u_curr_amp -2048 2047.9375 /end CHARACTERISTIC
/begin CHARACTERISTIC PWSL_V_HYB_STRT_DLY "hybrid start enable delay" VALUE 0x0002038C __UWORD_S 0 u_2x_tmr 0 1023.984375 /end CHARACTERISTIC
/begin CHARACTERISTIC PWSL_V_HYB_STP_EN_DLY "hybrid stop enable delay" VALUE 0x0002038C __UWORD_S 0 u_2x_tmr 0 1023.984375 /end CHARACTERISTIC
/begin CHARACTERISTIC PWSL_V_HYB_STP_DIS_DLY "hybrid stop disable delay" VALUE 0x0002038C __UWORD_S 0 u_2x_tmr 0 1023.984375 /end CHARACTERISTIC
/begin CHARACTERISTIC PWSL_V_BAT_T_VLD_MAX "battery temp valid max" VALUE 0x0002038C __SWORD_S 0 u_deg_C -256 255.9921875 /end CHARACTERISTIC
/begin CHARACTERISTIC PWSL_V_BAT_T_VLD_MIN "battery temp valid min" VALUE 0x0002038C __SWORD_S 0 u_deg_C -256 255.9921875 /end CHARACTERISTIC
/begin AXIS_PTS VVT_X_ESPD_A "espd breakpoint" 0x0002006C sys_eng_spd SSV__UWORD_S 0 u_espd 15 0.000000 8191.875000 FORMAT "%5.1" DEPOSIT ABSOLUTE SYMBOL_LINK "VVT_X_ESPD_A" 2 /end AXIS_PTS
/begin COMPU_METHOD u_volt_32 "voltage" RAT_FUNC "%6.4" "V" COEFFS 0.0 1.0 0.000000 0.0 0.0 0.00048828125 /end COMPU_METHOD
/begin COMPU_METHOD u_kPa_0_256 "press" RAT_FUNC "%5.2" "kPa" COEFFS 0.0 1.0 0.000000 0.0 0.0 0.00390625 /end COMPU_METHOD
/begin COMPU_METHOD u_fac_16384 "factor" RAT_FUNC "%6.1" "fac" COEFFS 0.0 1.0 0.000000 0.0 0.0 0.25 /end COMPU_METHOD
/begin COMPU_METHOD u_fac_8 "factor" RAT_FUNC "%8.7" "fac" COEFFS 0.0 1.0 0.000000 0.0 0.0 0.0001220703125 /end COMPU_METHOD
/begin COMPU_METHOD u_fac_4 "factor" RAT_FUNC "%5.4" "fac" COEFFS 0.0 1.0 0.000000 0.0 0.0 0.00006103515625 /end COMPU_METHOD
/begin COMPU_METHOD u_fac_2 "factor" RAT_FUNC "%3.2" "fac" COEFFS 0.0 1.0 0.000000 0.0 0.0 0.000030517578125 /end COMPU_METHOD
/begin COMPU_METHOD u_fac_1 "factor" RAT_FUNC "%4.3" "fac" COEFFS 0.0 1.0 0.000000 0.0 0.0 0.0000152587890625 /end COMPU_METHOD
/begin COMPU_METHOD u_meter_1 "factor" RAT_FUNC "%4.3" "m" COEFFS 0.0 1.0 0.000000 0.0 0.0 0.0000152587890625 /end COMPU_METHOD
/begin COMPU_METHOD u_fac_n1_p1 "factor" RAT_FUNC "%3.2" "fac" COEFFS 0.0 1.0 0.000000 0.0 0.0 0.000030517578125 /end COMPU_METHOD
/begin COMPU_METHOD u_fac_n2_p2 "factor" RAT_FUNC "%3.2" "fac" COEFFS 0.0 1.0 0.000000 0.0 0.0 0.00006103515625 /end COMPU_METHOD
/begin COMPU_METHOD u_fac_n32_p32 "factor" RAT_FUNC "%4.2" "fac" COEFFS 0.0 1.0 0.000000 0.0 0.0 0.0009765625 /end COMPU_METHOD
/begin COMPU_METHOD u_deg_K_512 "degK" RAT_FUNC "%6.2" "K" COEFFS 0.0 1.0 0.0 0.0 0.0 0.0078125 /end COMPU_METHOD
/begin COMPU_METHOD u_deg_K "degK" RAT_FUNC "%6.2" "K" COEFFS 0.0 1.0 0.0 0.0 0.0 0.03125 /end COMPU_METHOD
/begin COMPU_METHOD u_deg_C "degC" RAT_FUNC "%5.2" "¡æ" COEFFS 0.0 1.0 0.0 0.0 0.0 0.0078125 /end COMPU_METHOD
/begin COMPU_METHOD u_filter "filter" RAT_FUNC "%11.10" "coef" COEFFS 0.0 1.0 0.0 0.0 0.0 0.0000152587890625 /end COMPU_METHOD
/begin COMPU_METHOD u_cnts "counts" RAT_FUNC "%3.0" "cnts" COEFFS 0.0 1.0 0.0 0.0 0.0 1.0 /end COMPU_METHOD
/begin COMPU_METHOD u_tmr_32 "32s timer" RAT_FUNC "%4.3" "s" COEFFS 0.0 1.0 0.0 0.0 0.0 0.00048828125 /end COMPU_METHOD
/begin COMPU_METHOD u_2x_tmr "15.6 timer" RAT_FUNC "%6.2" "s" COEFFS 0.0 1.0 0.0 0.0 0.0 0.015625 /end COMPU_METHOD
/begin COMPU_METHOD u_16x_tmr "125 timer" RAT_FUNC "%5.1" "s" COEFFS 0.0 1.0 0.0 0.0 0.0 0.125 /end COMPU_METHOD
/begin COMPU_METHOD u_1s_tmr "1 sec timer" RAT_FUNC "%5.0" "s" COEFFS 0.0 1.0 0.0 0.0 0.0 1.0 /end COMPU_METHOD
/begin COMPU_METHOD u_millisec "millisec" RAT_FUNC "%6.2" "ms" COEFFS 0.0 1.0 0.0 0.0 0.0 0.015625 /end COMPU_METHOD
/begin COMPU_METHOD b_true "" TAB_VERB "%6.3" "" COMPU_TAB_REF b_true /end COMPU_METHOD
/begin COMPU_VTAB b_true "" TAB_VERB 2 0 "FALSE" 1 "TRUE" /end COMPU_VTAB
/begin COMPU_METHOD u_state_eng "" TAB_VERB "%6.3" "" COMPU_TAB_REF u_state_eng /end COMPU_METHOD
/begin COMPU_VTAB u_state_eng "" TAB_VERB 7 0 "INIT" 1 "KEYON" 2 "START" 3 "RUN" 4 "STOP" 5 "POWOFF" 6 "SHUTDWN" /end COMPU_VTAB
/begin COMPU_METHOD u_espd "engine speed" RAT_FUNC "%5.2" "rpm" COEFFS 0.0 1.0 0.000000 0.0 0.0 0.125 /end COMPU_METHOD
/begin COMPU_METHOD u_vspd "vehicle speed" RAT_FUNC "%5.2" "kph" COEFFS 0.0 1.0 0.000000 0.0 0.0 0.0078125 /end COMPU_METHOD
/begin COMPU_METHOD u_pct "percentage" RAT_FUNC "%5.2" "%" COEFFS 0.0 1.0 0.000000 0.0 0.0 0.0030517578125 /end COMPU_METHOD
/begin COMPU_METHOD u_pct_1 "percentage" RAT_FUNC "%5.2" "%" COEFFS 0.0 1.0 0.000000 0.0 0.0 0.00152587890625 /end COMPU_METHOD
/begin COMPU_METHOD u_pct_8 "percentage" RAT_FUNC "%5.2" "%" COEFFS 0.0 1.0 0.000000 0.0 0.0 0.01220703125 /end COMPU_METHOD
/begin COMPU_METHOD u_pct_b "percentage" RAT_FUNC "%5.2" "%" COEFFS 0.0 1.0 0.000000 0.0 0.0 0.78125 /end COMPU_METHOD
/begin COMPU_METHOD u_stk_flw "stroke flow" RAT_FUNC "%5.4" "g/stk" COEFFS 0.0 1.0 0.000000 0.0 0.0 0.000030517578125 /end COMPU_METHOD
/begin COMPU_METHOD u_g_per_sec "g per second" RAT_FUNC "%5.2" "g/s" COEFFS 0.0 1.0 0.000000 0.0 0.0 0.0078125 /end COMPU_METHOD
/begin COMPU_METHOD u_kPa_0_4096 "IMEP" RAT_FUNC "%6.2" "kPa" COEFFS 0.0 1.0 0.000000 0.0 0.0 0.0625 /end COMPU_METHOD
/begin COMPU_METHOD u_iga "ignition angle" RAT_FUNC "%3.1" "Deg" COEFFS 0.0 1.0 0.000000 0.0 0.0 0.0078125 /end COMPU_METHOD
/begin COMPU_METHOD u_iga_b "ignition angle" RAT_FUNC "%3.1" "Deg" COEFFS 0.0 1.0 -10.000000 0.0 0.0 0.5 /end COMPU_METHOD
/begin COMPU_METHOD u_iga_n_b "ignition angle" RAT_FUNC "%3.1" "Deg" COEFFS 0.0 1.0 0.0 0.0 0.0 0.5 /end COMPU_METHOD
/begin COMPU_METHOD u_pw_s "millisec" RAT_FUNC "%6.2" "ms" COEFFS 0.0 1.0 0.0 0.0 0.0 0.015625 /end COMPU_METHOD
/begin COMPU_METHOD x_deg_C "degC" RAT_FUNC "%3.0" "¡æ" COEFFS 0.0 1.0 0.0 0.0 0.0 1.0 /end COMPU_METHOD
/begin COMPU_METHOD x_timer_sec "timer second" RAT_FUNC "%5.0" "s" COEFFS 0.0 1.0 0.0 0.0 0.0 1.0 /end COMPU_METHOD
/begin COMPU_METHOD u_at_gr_typ "" TAB_VERB "%5.0" "" COMPU_TAB_REF u_at_gr_typ /end COMPU_METHOD
/begin COMPU_VTAB u_at_gr_typ "" TAB_VERB 13 1 "1" 2 "2" 3 "3" 4 "4" 5 "5" 6 "6" 7 "7" 8 "8" 12 "D" 15 "P" 14 "R" 13 "N" 127 "UNKNOWN" /end COMPU_VTAB
/begin COMPU_METHOD u_gr_range "" TAB_VERB "%5.0" "" COMPU_TAB_REF u_gr_range /end COMPU_METHOD
/begin COMPU_VTAB u_gr_range "" TAB_VERB 10 0 "P" 1 "R" 2 "N" 3 "1" 4 "2" 5 "3" 6 "4" 7 "5" 8 "ILLEGAL" 9 "DRIVE" /end COMPU_VTAB
/begin COMPU_METHOD u_pwsl_gr_typ "" TAB_VERB "%5.0" "" COMPU_TAB_REF u_pwsl_gr_typ /end COMPU_METHOD
/begin COMPU_VTAB u_pwsl_gr_typ "" TAB_VERB 12 0 "1" 1 "2" 2 "3" 3 "4" 4 "5" 5 "6" 6 "7" 7 "8" 8 "D" 9 "PN" 10 "R" 11 "UNKNOWN" /end COMPU_VTAB
/begin COMPU_METHOD u_veh_st_src "" TAB_VERB "%5.0" "" COMPU_TAB_REF u_veh_st_src /end COMPU_METHOD
/begin COMPU_VTAB u_veh_st_src "" TAB_VERB 5 0 "PN" 1 "CLUTCH" 2 "PN_TOP_BTM_CLUTCH" 3 "BTM_CLUTCH" 4 "NONE" /end COMPU_VTAB
/begin COMPU_METHOD u_gram_1 "gram" RAT_FUNC "%6.5" "g" COEFFS 0.0 1.0 0.000000 0.0 0.0 0.0000152587890625 /end COMPU_METHOD
/begin COMPU_METHOD u_gram_2 "gram" RAT_FUNC "%6.5" "g" COEFFS 0.0 1.0 0.000000 0.0 0.0 0.000030517578125 /end COMPU_METHOD
/begin COMPU_METHOD u_gram_1024 "gram" RAT_FUNC "%5.2" "g" COEFFS 0.0 1.0 0.000000 0.0 0.0 0.015625 /end COMPU_METHOD
/begin COMPU_METHOD u_curr_amp "amp" RAT_FUNC "%5.2" "A" COEFFS 0.0 1.0 0.000000 0.0 0.0 0.0625 /end COMPU_METHOD
/begin COMPU_METHOD u_curr_amp_lo "amp" RAT_FUNC "%5.2" "A" COEFFS 0.0 1.0 0.000000 0.0 0.0 0.001953125 /end COMPU_METHOD
/begin COMPU_METHOD u_amp_h "amp_hour" RAT_FUNC "%5.2" "Ah" COEFFS 0.0 1.0 0.000000 0.0 0.0 0.015625 /end COMPU_METHOD
/begin COMPU_METHOD u_amp_h_lo "amp_hour" RAT_FUNC "%5.2" "Ah" COEFFS 0.0 1.0 0.000000 0.0 0.0 0.001953125 /end COMPU_METHOD
/begin COMPU_METHOD u_amp_h_l "amp_hour" RAT_FUNC "%5.2" "Ah" COEFFS 0.0 1.0 0.000000 0.0 0.0 0.000000059604644775390625 /end COMPU_METHOD
/begin COMPU_METHOD u_bat_snsr_cfg "" TAB_VERB "%6.3" "" COMPU_TAB_REF u_bat_snsr_cfg /end COMPU_METHOD
/begin COMPU_VTAB u_bat_snsr_cfg "" TAB_VERB 2 0 "LIN" 1 "CAN" /end COMPU_VTAB
/begin COMPU_METHOD u_soc_src "" TAB_VERB "%6.3" "" COMPU_TAB_REF u_soc_src /end COMPU_METHOD
/begin COMPU_VTAB u_soc_src "" TAB_VERB 2 0 "SENSOR" 1 "MODEL" /end COMPU_VTAB
/begin COMPU_METHOD u_powoff_state "" TAB_VERB "%6.3" "" COMPU_TAB_REF u_powoff_state /end COMPU_METHOD
/begin COMPU_VTAB u_powoff_state "" TAB_VERB 4 0 "NO" 1 "Undecided" 2 "InProgress" 3 "Finished" /end COMPU_VTAB
/begin COMPU_METHOD u_iga_b_64 "ignition angle" RAT_FUNC "%4.2" "Deg" COEFFS 0.0 1.0 0.000000 0.0 0.0 0.25 /end COMPU_METHOD
/begin COMPU_METHOD u_ig_type "" TAB_VERB "%6.3" "" COMPU_TAB_REF u_ig_type /end COMPU_METHOD
/begin COMPU_VTAB u_ig_type "" TAB_VERB 3 0 "WASTE to SEQ" 1 "WASTE" 2 "SEQ" /end COMPU_VTAB
/begin COMPU_METHOD u_iga_128 "ignition angle" RAT_FUNC "%4.2" "Deg" COEFFS 0.0 1.0 0.000000 0.0 0.0 0.001953125 /end COMPU_METHOD
/begin COMPU_METHOD u_imep_old_loops "" TAB_VERB "%6.3" "" COMPU_TAB_REF u_imep_old_loops /end COMPU_METHOD
/begin COMPU_VTAB u_imep_old_loops "" TAB_VERB 4 0 "1X_Loop" 1 "2X_Loop" 2 "3X_Loop" 3 "4X_Loop" /end COMPU_VTAB
/begin COMPU_METHOD u_soc_st "" TAB_VERB "%6.3" "" COMPU_TAB_REF u_soc_st /end COMPU_METHOD
/begin COMPU_VTAB u_soc_st "" TAB_VERB 4 0 "LOW_PRECISION" 1 "MED_PRECISION" 2 "HIGH_PRECISION" 3 "INVALID" /end COMPU_VTAB
/begin COMPU_METHOD u_gram_n2_2 "gram_per_cyl" RAT_FUNC "%5.4" "g/stk" COEFFS 0.0 1.0 0.000000 0.0 0.0 0.00006103515625 /end COMPU_METHOD
/begin FUNCTION fmsp_trs ""
 /begin DEF_CHARACTERISTIC FMSP_V_TRANS_FUEL_EN FMSP_M_TF_WALL_FILM_FAC FMSP_M_TF_NEG_MAP_FAC FMSP_V_PRE_PW_RT FMSP_V_DUAL_PW_THR FMSP_C_TRS_EN_REF_DLY FMSP_V_TRS_FUEL_MIN FMSP_V_TRS_FROM_WALL_FAC FMSP_C_TF_POS_FLW_FAC FMSP_X_AIRFLW_A FMSP_M_TF_NEG_FLW_FAC FMSP_X_AIRFLW_B FMSP_C_TF_POS_VLV_T_FAC FMSP_V_TF_POS_DCY_FAC_FIL FMSP_C_TF_WALL_FILM_DCY_FAC FMSP_M_TRNS_DB_POS FMSP_M_TRNS_DB_NEG FMSP_V_TRNS_RT_THRSH FMSP_C_RED_POS_FAC FMSP_C_PROP_POS_FAC FMSP_C_AMPL_POS_FAC FMSP_C_RED_NEG_FAC FMSP_C_PROP_NEG_FAC FMSP_C_AMPL_NEG_FAC /end DEF_CHARACTERISTIC
 /begin OUT_MEASUREMENT fmsp_tf_comp fmsp_tf_fac_neg fmsp_tf_fac_pos fmsp_stk_inj fmsp_wall_film_trm fmsp_wall_film_dcy_fac fmsp_wall_film_fac fmsp_cl_diff fmsp_bs_delta_pos fmsp_trns_cor_fac fmsp_trns_red_term fmsp_trns_prop_term fmsp_trns_ampl_term fmsp_trns_mult /end OUT_MEASUREMENT
/end FUNCTION
/begin FUNCTION fmsp_axis ""
 /begin DEF_CHARACTERISTIC FMSP_X_ECT_A FMSP_X_ESPD FMSP_X_STRK_AIR FMSP_X_IDL_STRK_AIR FMSP_X_ESPD_B FMSP_X_ESPD_CL_IDL FMSP_X_AMP_A FMSP_X_ECT_C FMSP_X_ECT_B FMSP_X_ECT_D FMSP_X_ECT_E FMSP_X_ECT_F FMSP_X_MAP_A FMSP_X_PORT_T_A FMSP_X_ECT_G FMSP_X_ECT_H FMSP_X_ECT_I FMSP_X_ECT_J FMSP_X_TQ_PCT_A FMSP_X_ECT_K FMSP_X_ESPD_C FMSP_X_DO2_RT FMSP_X_DO2_VLT FMSP_X_PUC_MAF_INT FMSP_X_PORT_T_B FMSP_X_STK_FLW_A /end DEF_CHARACTERISTIC
/end FUNCTION
/begin FUNCTION fmsp "" /begin SUB_FUNCTION fmsp_af fmsp_pw fmsp_trs fmsp_cl fmsp_cut fmsp_axis /end SUB_FUNCTION /end FUNCTION
/begin FUNCTION ig ""
 /begin DEF_CHARACTERISTIC IG_M_TD_VLT_ECT_FAC IG_M_EFF_LOSS_IGA IG_X_ESPD_A IG_X_IGA_RTD IG_C_TD_ST IG_M_TD_RUN IG_V_IGA_MIN IG_V_IGA_MAX IG_V_IGA_LMT_CFG IG_M_IGA_MN IG_M_IGA_MN_LO IG_M_IGA_REF IG_X_ESPD_B IG_X_IMEP_A IG_M_IGA_ST IG_V_IGA_POWOFF IG_V_IGA_POWOFF_RMP_STP IG_C_IGA_KNCK_RTD_MAX IG_M_IGA_IAT_BIAS IG_M_IGA_IAT_IDL_BIAS IG_X_IAT IG_M_IGA_IAT_BIAS_ESPD_FAC IG_X_ESPD_D IG_C_IGA_IDL_CL_DLY IG_X_ECT_A IG_V_IDL_CL_ESPD_DEV_THR IG_M_IGA_ECT_BIAS IG_X_ECT IG_M_IGA_POW_BIAS IG_V_IGA_POW_RAMP_STP IG_V_IGA_POW_RAMP_DLY IG_V_VLT_DEV_THR IG_V_TD_INIT IG_V_TD_ST_BIAS_MIN IG_M_IGA_EGR_BIAS IG_M_IGA_VVT_BIAS IG_X_ESPD_C IG_X_IMEP_B IG_M_IGA_VVT_IDL_BIAS IG_V_TD_ST_BIAS_MAX IG_V_TD_RUN_BIAS_MAX IG_V_TD_RUN_BIAS_MIN IG_M_IGA_VVT_BIAS_FIL IG_V_TD_OFF_TM_MIN IG_V_TD_LMT_FAC IG_V_VLT_POW_OFF_THR IG_V_TD_POW_OFF IG_V_TD_MAX_INIT IG_V_TD_MIN_INIT IG_V_POW_OFF_SEG_THR IG_V_TYP_CFG IG_M_IGA_ST_HYB IG_V_ECT_BIAS_RMP_STP IG_V_IGA_EGR_BIAS_FIL IG_V_ST_RUN_RMP_DLY IG_C_ST_RUN_RMP_STP_DEC IG_C_ST_RUN_RMP_STP_INC IG_V_ST_RUN_RMP_DLY_HYB IG_C_ST_RUN_RMP_STP_DEC_HYB IG_C_ST_RUN_RMP_STP_INC_HYB IG_V_AJ_RTD_OLD_IMEP_CFG IG_V_IGA_AJ_RTD_IMEP_THR IG_V_IGA_AJ_RTD_IMEP_DEV_THR IG_V_IGA_AJ_RTD_ECT_THR IG_V_IGA_AJ_RTD_EN_DLY IG_M_IGA_AJ_RTD IG_X_IGA IG_C_IGA_AJ_RTD_DUR IG_M_IGA_AJ_RTD_DCY_STP IG_C_AJ_RTD_IAT_FAC IG_V_IGA_MIN_HYB IG_X_IAT_A IG_V_TQ_BIAS_FAC_DCY_STP IG_M_IGA_OVRSHT IG_M_IGA_OVRSHT_HYB IG_M_EFF_BS_MN IG_X_ESPD_F IG_V_IGA_VGIS_BIAS_CFG IG_M_IGA_VGIS_BIAS IG_V_IGA_VGIS_BIAS_HLD_DUR /end DEF_CHARACTERISTIC
 /begin OUT_MEASUREMENT ig_actv_iga ig_bas_rtd_ref ig_avg_rtd_ref ig_iga_iat_bias ig_iga_ect_bias ig_iga_eff ig_iga_ref ig_iga_fnl_cyl1 ig_iga_fnl_cyl2 ig_iga_fnl_cyl3 ig_iga_fnl_cyl4 ig_iga_knck_cyl1 ig_iga_knck_cyl2 ig_iga_knck_cyl3 ig_iga_knck_cyl4 ig_iga_tq_bias ig_iga_avg ig_iga_gen ig_powoff_stat ig_iga_antijerk ig_iga_aj_rtd ig_iga_idl_cl_dly_stat ig_coil_vlt ig_stat ig_td ig_td_max ig_td_min ig_en ig_iga_start ig_iga_mn ig_iga_egr_bias ig_iga_pow_bias ig_iga_vvt_bias ig_iga_mn_cor ig_iga_rmp ig_iga_ref_raw ig_iga_ref_bias ig_max_rtd_ref ig_act_rtd_ref ig_iga_eff_max ig_iga_eff_act ig_iga_eff_avg ig_aj_rtd_actv ig_iga_tq_bias_fac ig_iga_eff_fast ig_iga_eff_min /end OUT_MEASUREMENT
/end FUNCTION
/begin FUNCTION trs ""
 /begin DEF_CHARACTERISTIC TRS_V_TRS_SPD_FIL TRS_V_TRS_SPD_RT_FIL TRS_C_MT_SPD_RT_LO TRS_C_MT_SPD_RT_HI TRS_V_TIRE_R TRS_V_VEH_STRT_SRC TRS_V_BTM_CLCH_STRT_EXT_DUR TRS_V_TOP_CLCH_STRT_EXT_DUR TRS_V_VEH_STRT_VSPD_BIAS TRS_V_VEH_STRT_ECT_MIN TRS_V_VEH_STRT_EN_VSPD TRS_V_VEH_STRT_RUN_MIN TRS_V_VEH_STRT_HLD_MIN TRS_V_VEH_STRT_EXT_VSPD TRS_V_VEH_STRT_EXT_TOP_CLTCH TRS_V_VEH_STRT_EN_BRK_OFF TRS_V_VEH_STRT_EN_PPS_MAX TRS_V_CLTCH_FCO_DPRS_MIN TRS_V_CLTCH_FCO_DPRS_MAX /end DEF_CHARACTERISTIC
 /begin OUT_MEASUREMENT trs_spd trs_spd_rt trs_veh_ng_actv trs_veh_ng2drv_occur trs_sprt_actv trs_at_in_gr trs_mt_gr_st trs_at_gr_st trs_veh_gr_st trs_veh_in_gr trs_veh_gr_sp trs_top_cltch_on trs_btm_cltch_on trs_veh_strt_actv trs_shft_actv trs_gr_range /end OUT_MEASUREMENT
/end FUNCTION
/begin FUNCTION pwsl "power supply"
 /begin DEF_CHARACTERISTIC PWSL_V_RGLTR_DTY_MIN PWSL_V_RGLTR_DTY_MAX PWSL_V_BAT_SNSR_INST PWSL_V_SNSR_SOC_DFLT PWSL_V_SNSR_COMM_CFG PWSL_V_CTRL_DLY PWSL_V_SOC_SRC PWSL_V_ALT_DTY_HI PWSL_V_ALT_DTY_LO PWSL_V_CT_NORM_SOC_LO PWSL_V_CT_CHRG_SOC_LO PWSL_V_CT_NORM_SOC_LO_HYS PWSL_V_CT_CHRG_SOC_LO_HYS PWSL_V_CT_NORM_VLT_LO PWSL_V_CT_CHRG_VLT_LO PWSL_V_CT_NORM_VLT_LO_HYS PWSL_V_CT_CHRG_VLT_LO_HYS PWSL_V_CT_NORM_BAT_T_LO PWSL_V_CT_CHRG_BAT_T_LO PWSL_V_CT_NORM_BAT_T_LO_HYS PWSL_V_CT_CHRG_BAT_T_LO_HYS PWSL_V_CT_SOC_HI PWSL_V_CT_SOC_HI_HYS PWSL_C_HI_SOC_VLT_SP PWSL_X_BAT_T PWSL_V_MID_CHRG_HI_VSPD_THR PWSL_V_MID_CHRG_HI_DUR PWSL_V_MID_CHRG_LO_DUR PWSL_M_MID_CHRG_HI_VLT_SP PWSL_M_MID_CHRG_LO_VLT_SP PWSL_C_CRK2RUN_DLY PWSL_V_ALT_PWM_INC_FIL PWSL_V_ALT_PWM_DEC_FIL PWSL_C_FH_EXT_ALT_MAX PWSL_M_FH_EXT_VLT_MIN PWSL_C_FH_EXT_CURR_MAX PWSL_V_FH_EXT_DLY PWSL_V_FH_EXT_VSPD_MIN PWSL_V_FH_DUR_HI PWSL_V_FH_DUR_LO PWSL_V_FH_EXT_SOC_MIN PWSL_M_HI_LD_THR PWSL_V_HI_LD_THR_HYS PWSL_V_HI_LD_DUR_MIN PWSL_V_FH_EN_AH_MIN PWSL_V_FH_EN_SOC_HI PWSL_V_FH_EN_SOC_LO PWSL_V_FH_EN_SOC_LO_CNTS PWSL_V_FH_EN_RUN_CNTS PWSL_V_HI_TEMP_THR PWSL_V_HI_TEMP_DLY PWSL_C_CRK_VLT_SP PWSL_V_AMP_LO PWSL_V_IAT_HI PWSL_V_BAT_T_LO PWSL_V_BLWR_MD_EN PWSL_V_LIGHT_MD_EN PWSL_V_ECT_HI PWSL_V_FAN_PWM_MIN PWSL_V_HI_FAN_DLY PWSL_V_PN_VSPD_MAX PWSL_V_PN_DLY PWSL_C_FH_VLT_SP PWSL_V_FH_INC_MAX PWSL_V_FH_DEC_MAX PWSL_V_RAT_VLT_SP PWSL_V_RAT_INC_MAX PWSL_V_RAT_DEC_MAX PWSL_V_DCL_EN_VSPD_HI PWSL_V_DCL_EN_VSPD_LO PWSL_V_DCL_NRM_USE_PEDL PWSL_V_DCL_ABNM_USE_PEDL PWSL_M_DCL_NRM_PEDL_THR PWSL_M_DCL_ABNM_PEDL_THR PWSL_V_DCL_DLY PWSL_V_DCL_DUR_MAX PWSL_V_DCL_DEC_MAX PWSL_V_DCL_INC_MAX PWSL_V_DCL_NRM_USE_BRK PWSL_V_DCL_ABNM_USE_BRK PWSL_M_DCL_VLT_SP PWSL_V_CHRG_INC_MAX PWSL_V_CHRG_DEC_MAX PWSL_M_CHRG_VLT_SP PWSL_V_ACL_TPS_MIN PWSL_V_ACL_VSPD_MIN PWSL_V_ACL_DUR_MAX PWSL_V_ACL_INC_MAX PWSL_V_ACL_DEC_MAX PWSL_M_ACL_VLT_SP PWSL_V_DCHRG_INC_MAX PWSL_V_DCHRG_DEC_MAX PWSL_M_DCHRG_VLT_SP PWSL_V_SOC_INC_MAX PWSL_V_SOC_DEC_MAX PWSL_V_NRM_INC_MAX PWSL_V_NRM_DEC_MAX PWSL_C_CURR_LMT_CTRL_DLY PWSL_C_PN_SP_MIN_DLY PWSL_C_CURR_MAX PWSL_C_CURR_MIN PWSL_V_PN_SP_MIN PWSL_V_DR_SP_MIN PWSL_V_VLT_LMT_CHG_MAX PWSL_V_CURR_HI_DLY PWSL_V_CURR_LO_DLY PWSL_V_VLT_SP_MAX PWSL_V_KEYON_RGLTR_DTY PWSL_C_DTY_BASE PWSL_X_VLT_SP PWSL_C_DTY_P PWSL_X_VLT_ERR PWSL_V_DTY_I_GN PWSL_V_DTY_I_MIN PWSL_V_DTY_I_MAX PWSL_V_DTY_DFLT PWSL_V_VLT_SP_DFLT PWSL_M_CHRG_EFF PWSL_C_CHRG_EFF_FAC PWSL_X_BAT_CURR PWSL_V_MDL_SOC_MAX PWSL_V_MDL_SOC_MIN PWSL_M_BAT_CAP PWSL_X_BAT_CURR_B PWSL_V_CL_SOC_SP PWSL_V_CL_SOC_DB PWSL_V_CL_SOC_I_GN PWSL_V_CL_SOC_I_MIN PWSL_V_CL_SOC_I_MAX PWSL_V_CHRG_EXT_SOC PWSL_M_CHRG_DUR_MAX PWSL_M_DISCHRG_DUR_MAX PWSL_V_DISCHRG_EXT_SOC PWSL_C_DISCHRG_EXT_AH PWSL_V_DISCHRG_EXT_CURR PWSL_V_DISCHRG_EXT_RUN PWSL_V_USE_CL_SOC PWSL_V_MDL_SOC_INIT PWSL_V_DFLT_DEC_MAX PWSL_V_DFLT_INC_MAX PWSL_C_LO_SOC_VLT_SP PWSL_C_CHRG_EXT_AH PWSL_C_DFLT_VLT_SP PWSL_V_HI_TEMP_INC_MAX PWSL_V_HI_TEMP_DEC_MAX PWSL_V_PN_INC_MAX PWSL_V_PN_DEC_MAX PWSL_C_GEN_LD_RSP_DUR PWSL_C_GEN_CURR_LMT PWSL_V_HYB_STP_VLT_MIN PWSL_V_HYB_STP_SOH_MIN PWSL_C_HYB_STP_SOC_MIN PWSL_C_HYB_STP_SOF_MIN PWSL_C_HYB_STRT_SOC_MIN PWSL_C_HYB_STRT_SOF_MIN PWSL_V_HYB_SNSR_REQ PWSL_V_HYB_STRT_SOH_MIN PWSL_V_HYB_STRT_SOC_DLT PWSL_V_HYB_STRT_CURR_MAX PWSL_V_HYB_STRT_DLY PWSL_V_HYB_STP_EN_DLY PWSL_V_HYB_STP_DIS_DLY PWSL_V_BAT_T_VLD_MAX PWSL_V_BAT_T_VLD_MIN /end DEF_CHARACTERISTIC
 /begin OUT_MEASUREMENT pwsl_bat_t pwsl_bat_soc pwsl_vlt_sp_raw pwsl_bat_curr pwsl_soc_st /end OUT_MEASUREMENT
/end FUNCTION
/begin RECORD_LAYOUT __UBYTE_S FNC_VALUES 1 UBYTE COLUMN_DIR DIRECT /end RECORD_LAYOUT
/begin RECORD_LAYOUT __UWORD_S FNC_VALUES 1 UWORD COLUMN_DIR DIRECT /end RECORD_LAYOUT
/begin RECORD_LAYOUT __SBYTE_S FNC_VALUES 1 SBYTE COLUMN_DIR DIRECT /end RECORD_LAYOUT
/begin RECORD_LAYOUT __SWORD_S FNC_VALUES 1 SWORD COLUMN_DIR DIRECT /end RECORD_LAYOUT
/begin RECORD_LAYOUT __SLONG_S FNC_VALUES 1 SLONG COLUMN_DIR DIRECT /end RECORD_LAYOUT
/begin RECORD_LAYOUT SSV__UWORD_S AXIS_PTS_X 1 UWORD INDEX_INCR DIRECT /end RECORD_LAYOUT
/begin RECORD_LAYOUT SSV__SWORD_S AXIS_PTS_X 1 SWORD INDEX_INCR DIRECT /end RECORD_LAYOUT
/end MODULE
/end PROJECT
