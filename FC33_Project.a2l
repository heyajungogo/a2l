ASAP2_VERSION 1 60
/begin PROJECT FC33 ""
/begin HEADER "" VERSION "1.0" /end HEADER
/begin MODULE FC33 ""
/begin MOD_COMMON "" BYTE_ORDER MSB_FIRST ALIGNMENT_LONG 2 ALIGNMENT_WORD 1 /end MOD_COMMON
/begin MEASUREMENT tq_fc_en "torque fuel cut off enable" UBYTE b_true 0 0 0.00 1.00 BIT_MASK 0x20 ECU_ADDRESS 0x400050DA FORMAT "%1.0" /end MEASUREMENT
/begin MEASUREMENT tq_imep_ref "imep at ref ignition angle" UWORD u_kPa_0_4096 0 0 0.0 4095.9375 ECU_ADDRESS 0x4000DA4E /end MEASUREMENT
/begin MEASUREMENT tq_imep_act "actual imep" UWORD u_kPa_0_4096 0 0 0.0 4095.9375 ECU_ADDRESS 0x4000DA4E /end MEASUREMENT
/begin MEASUREMENT tq_imep_base "base imep" UWORD u_kPa_0_4096 0 0 0.0 4095.9375 ECU_ADDRESS 0x4000DA4E /end MEASUREMENT
/begin MEASUREMENT tq_imep_sp "imep setpoint" UWORD u_kPa_0_4096 0 0 0.0 4095.9375 ECU_ADDRESS 0x4000DA4E /end MEASUREMENT
/begin MEASUREMENT tq_tot_req_pct "total requested torque percent" UWORD u_pct 0 0 0.0 199.996948242187 ECU_ADDRESS 0x4000DA4E /end MEASUREMENT
/begin MEASUREMENT tq_vr_pps "virtual pps percent include cruise" UWORD u_pct 0 0 0.0 199.996948242187 ECU_ADDRESS 0x4000DA4E /end MEASUREMENT
/begin MEASUREMENT tq_them_eff_sp "them eeficiency setpoint" UWORD u_pct_1 0 0 0.0 99.9984741210937 ECU_ADDRESS 0x4000DA4E FORMAT "%4.2" /end MEASUREMENT
/begin MEASUREMENT tq_exh_to_intk_p_dlt "delta equal exh manifold press sub intk manifold press" UWORD u_kPa_256n_256p 0 0 -256 255.9921875 ECU_ADDRESS 0x4000DA4E /end MEASUREMENT
/begin MEASUREMENT tq_estd_imep_ref "estimated imep at ref ignition angle" UWORD u_kPa_0_4096 0 0 0.0 4095.9375 ECU_ADDRESS 0x4000DA4E /end MEASUREMENT
/begin MEASUREMENT tq_clch_torq "clutch torque" SWORD u_nm_s 0 0 -2048 2047.9375 ECU_ADDRESS 0x4000DA4E /end MEASUREMENT
/begin MEASUREMENT tq_ind_torq "indicated torque" SWORD u_nm_s 0 0 -2048 2047.9375 ECU_ADDRESS 0x4000DA4E /end MEASUREMENT
/begin MEASUREMENT tq_aux_torq "indicated torque" SWORD u_nm_s 0 0 -2048 2047.9375 ECU_ADDRESS 0x4000DA4E /end MEASUREMENT
/begin MEASUREMENT tq_ps_torq "indicated torque" SWORD u_nm_s 0 0 -2048 2047.9375 ECU_ADDRESS 0x4000DA4E /end MEASUREMENT
/begin MEASUREMENT tq_req_typ "imep at ref ignition angle" UBYTE u_tq_req_typ 0 0 0 20 ECU_ADDRESS 0x4000DA4E FORMAT "%6.2" /end MEASUREMENT
/begin MEASUREMENT tq_veh_gr_st "gear state" UBYTE u_tq_gr_typ 0 0 0 12 ECU_ADDRESS 0x4000DA4E FORMAT "%1.0" /end MEASUREMENT
/begin MEASUREMENT tq_calc_rpm "Calculated engine speed by vehicle speed,tire radius and gear ratio." UWORD u_espd 0 0 0 8191.875 ECU_ADDRESS 0x40004EBC FORMAT "%6.2" /end MEASUREMENT
/begin MEASUREMENT tq_calc_rpm_chng_rt "Calculated engine speed change rate.Unit:rpm per second." SWORD u_espd_acl_hi 0 0 -256 255.9921875 ECU_ADDRESS 0x40004EBC FORMAT "%6.2" /end MEASUREMENT
/begin MEASUREMENT tq_clch_slp_rt "Clutch slip ratio when calculated engine speed less than actual engine speed." UWORD u_fac_2 0 0 0 1.999969482421875 ECU_ADDRESS 0x40004EBC FORMAT "%5.4" /end MEASUREMENT
/begin MEASUREMENT tq_exh_press "Modeled exhaust pressure for torque module." UWORD u_kPa_0_512 0 0 0.0 511.9921875 ECU_ADDRESS 0x4000DA4E /end MEASUREMENT
/begin MEASUREMENT tq_map "MAP updated every seg for torque module." UWORD u_kPa_0_256 0 0 0 255.99609375 ECU_ADDRESS 0x400050DA /end MEASUREMENT
/begin MEASUREMENT tq_pump_mep_thrt "Mean effective pressure in pumping loss due to throttle." UWORD u_kPa_512n_512p 0 0 -512 511.984375 ECU_ADDRESS 0x400050DA /end MEASUREMENT
/begin MEASUREMENT tq_pump_mep_vlv "Mean effective pressure in pumping loss due to valve." UWORD u_kPa_512n_512p 0 0 -512 511.984375 ECU_ADDRESS 0x400050DA /end MEASUREMENT
/begin MEASUREMENT tq_pump_mep "Mean effective pressure in pumping loss." UWORD u_kPa_512n_512p 0 0 -512 511.984375 ECU_ADDRESS 0x400050DA /end MEASUREMENT
/begin MEASUREMENT tq_mep2tq_fac "IMEP to torque factor.IMEP *this factor = torque." UWORD u_fac_16 0 0 0 15.999755859375 ECU_ADDRESS 0x400050DA FORMAT "%5.2" /end MEASUREMENT
/begin MEASUREMENT tq_pump "Pumping friction torque at current condition." SWORD u_tq 0 0 -2048 2047.9375 ECU_ADDRESS 0x400050DA /end MEASUREMENT
/begin MEASUREMENT tq_pump_espd_sp "Pumping friction torque at engine speed setpoint." SWORD u_tq 0 0 -2048 2047.9375 ECU_ADDRESS 0x400050DA /end MEASUREMENT
/begin MEASUREMENT tq_pump_wot "Pumping friction torque at wot condition." SWORD u_tq 0 0 -2048 2047.9375 ECU_ADDRESS 0x400050DA /end MEASUREMENT
/begin MEASUREMENT tq_pump_mx "Max pumping friction torque." SWORD u_tq 0 0 -2048 2047.9375 ECU_ADDRESS 0x400050DA /end MEASUREMENT
/begin MEASUREMENT tq_rub_bs "Base rubbing friction torque at current condition." SWORD u_tq 0 0 -2048 2047.9375 ECU_ADDRESS 0x400050DA /end MEASUREMENT
/begin MEASUREMENT tq_fric_loss "Rubbing friction torque loss." SWORD u_tq 0 0 -2048 2047.9375 ECU_ADDRESS 0x400050DA /end MEASUREMENT
/begin MEASUREMENT tq_rub_espd_sp "Base rubbing friction torque at engine speed setpoint." SWORD u_tq 0 0 -2048 2047.9375 ECU_ADDRESS 0x400050DA /end MEASUREMENT
/begin MEASUREMENT tq_rub_ect_bias "Base rubbing friction torque coolant temperature bias at current condition." SWORD u_tq 0 0 -2048 2047.9375 ECU_ADDRESS 0x400050DA /end MEASUREMENT
/begin MEASUREMENT tq_rub_ect_bias_espd_sp "Base rubbing friction torque coolant temperature bias at engine speed setpoint." SWORD u_tq 0 0 -2048 2047.9375 ECU_ADDRESS 0x400050DA /end MEASUREMENT
/begin MEASUREMENT tq_fric "Pumping and rubbing friction torque at current condition." SWORD u_tq 0 0 -2048 2047.9375 ECU_ADDRESS 0x400050DA /end MEASUREMENT
/begin MEASUREMENT tq_fric_mx "Max pumping and rubbing friction torque." SWORD u_tq 0 0 -2048 2047.9375 ECU_ADDRESS 0x400050DA /end MEASUREMENT
/begin MEASUREMENT tq_fric_wot "Pumping and rubbing friction torque at wot condition." SWORD u_tq 0 0 -2048 2047.9375 ECU_ADDRESS 0x400050DA /end MEASUREMENT
/begin MEASUREMENT tq_fric_espd_sp "Pumping and rubbing friction torque at engine speed setpoint." SWORD u_tq 0 0 -2048 2047.9375 ECU_ADDRESS 0x400050DA /end MEASUREMENT
/begin MEASUREMENT tq_clch_torq_mn "Min clutch torque." SWORD u_tq 0 0 -2048 2047.9375 ECU_ADDRESS 0x400050DA /end MEASUREMENT
/begin MEASUREMENT tq_them_eff_fac "Thermo efficiency factor by AFR." UWORD u_fac_2 0 0 0 1.999969482421875 ECU_ADDRESS 0x400050DA FORMAT "%5.4" /end MEASUREMENT
/begin MEASUREMENT tq_flyw_torq_mbt_mx "MBT max flywheel torque limit." SWORD u_tq 0 0 -2048 2047.9375 ECU_ADDRESS 0x400050DA /end MEASUREMENT
/begin MEASUREMENT tq_flyw_torq_mx_chrg_amp_fac "Max flywheel torque ambient pressure factor for turbo application." UWORD u_fac_1 0 0 0 0.9999847412109375 ECU_ADDRESS 0x400050DA FORMAT "%5.4" /end MEASUREMENT
/begin MEASUREMENT tq_throt_mdl_t "Modeled throttle temperature for torque module." SWORD u_deg_C 0 0 -256 255.9921875 ECU_ADDRESS 0x400050DA /end MEASUREMENT
/begin MEASUREMENT tq_lmt_rsn "Torque limited reason." UBYTE u_lmt_rsn 0 0 0 255.9921875 ECU_ADDRESS 0x400050DA FORMAT "%1.0" /end MEASUREMENT
/begin MEASUREMENT tq_ind_torq_mbt_mx_raw "Raw MBT indicate torque max." SWORD u_tq 0 0 -2048 2047.9375 ECU_ADDRESS 0x400050DA /end MEASUREMENT
/begin MEASUREMENT tq_trns_fric_torq "Transmission friction torque,including torque converter load and transmission oil pump load." SWORD u_tq 0 0 -2048 2047.9375 ECU_ADDRESS 0x400050DA /end MEASUREMENT
/begin MEASUREMENT tq_idl_torq "Idle torque." SWORD u_tq 0 0 -2048 2047.9375 ECU_ADDRESS 0x400050DA /end MEASUREMENT
/begin MEASUREMENT tq_mx_flyw_torq_exh_t_tm "A timer when exhaust over temperature." UWORD u_2x_tmr 0 0 0 1023.984375 ECU_ADDRESS 0x400050DA /end MEASUREMENT
/begin MEASUREMENT tq_mx_flyw_torq_exh_t_rmp_tm "A timer when tq_mx_flyw_torq_exh_t_tm exceed a cal threshold." UWORD u_2x_tmr 0 0 0 1023.984375 ECU_ADDRESS 0x400050DA /end MEASUREMENT
/begin MEASUREMENT tq_ind_torq_mbt_mx "MBT indicate torque max." SWORD u_tq 0 0 -2048 2047.9375 ECU_ADDRESS 0x400050DA /end MEASUREMENT
/begin MEASUREMENT tq_est_tq_vld "valid status of torq estimate" UBYTE u_tq_valid 0 0 0 3 ECU_ADDRESS 0x400052D4 FORMAT "%1.0" /end MEASUREMENT
/begin MEASUREMENT tq_lmt_flt_actv "true means fault that cause torq limiting active" UBYTE b_true 0 0 0.00 1.00 BIT_MASK 0x1 ECU_ADDRESS 0x4000DA4E FORMAT "%4.2" /end MEASUREMENT
/begin MEASUREMENT tq_eco_stat "torq control ECO mode status" UBYTE u_tq_eco_stat 0 0 0 11 ECU_ADDRESS 0x400052D4 FORMAT "%1.0" /end MEASUREMENT
/begin MEASUREMENT tq_sprt_mode_actv "true means torq control sport mode active" UBYTE b_true 0 0 0.00 1.00 BIT_MASK 0x1 ECU_ADDRESS 0x4000DA4E FORMAT "%4.2" /end MEASUREMENT
/begin MEASUREMENT tq_flyw_torq_raw_sp "Raw flywheel torque setpoint include clutch torque setpoint and idle torque setpoint." SWORD u_tq 0 0 -2048 2047.9375 ECU_ADDRESS 0x400050DA /end MEASUREMENT
/begin MEASUREMENT tq_iga_fac "ignition factor used to calculate ig_iga_tq_bias" UWORD u_fac_2 0 0 0 1.999969482421875 ECU_ADDRESS 0x4000DA4E FORMAT "%4.3" /end MEASUREMENT
/begin MEASUREMENT tq_alt_torq "Alternator torque." SWORD u_tq 0 0 -2048 2047.9375 ECU_ADDRESS 0x400050DA /end MEASUREMENT
/begin MEASUREMENT tq_pps_fac "Accelerate pedal position factor." UWORD u_fac_16 0 0 0.0 15.999756 ECU_ADDRESS 0x4000DA4E /end MEASUREMENT
/begin MEASUREMENT tq_pps_raw "Pedal postion after factor modified but without all-terrain modify." UWORD u_pct 0 0 0.0 199.996948242187 ECU_ADDRESS 0x4000DA4E /end MEASUREMENT
/begin MEASUREMENT tq_pps "Modified pedal position value." UWORD u_pct_r 0 0 0.0 127.998046875 ECU_ADDRESS 0x4000DA4E /end MEASUREMENT
/begin MEASUREMENT tq_clch_torq_rmp_fn "Clutch torque ramp finished." UBYTE b_true 0 0 0.00 1.00 BIT_MASK 0x1 ECU_ADDRESS 0x400050DA FORMAT "%1.0" /end MEASUREMENT
/begin MEASUREMENT tq_clch_torq_rmp_fn_sprt "Clutch torque ramp finished in sport mode." UBYTE b_true 0 0 0.00 1.00 BIT_MASK 0x1 ECU_ADDRESS 0x400050DA FORMAT "%1.0" /end MEASUREMENT
/begin MEASUREMENT tq_clch_torq_rmp_fn_eco "Clutch torque ramp finished in ECO mode." UBYTE b_true 0 0 0.00 1.00 BIT_MASK 0x1 ECU_ADDRESS 0x400050DA FORMAT "%1.0" /end MEASUREMENT
/begin MEASUREMENT tq_clch_torq_pct_sp_raw "Clutch torque setpoint percent raw value after ramp when driver mode transition." UWORD u_pct 0 0 0.0 199.996948242187 ECU_ADDRESS 0x4000DA4E /end MEASUREMENT
/begin MEASUREMENT tq_clch_torq_pct_sp_mx "Clutch torque setpoint percent max limit." UWORD u_pct_r 0 0 0.0 127.998046875 ECU_ADDRESS 0x4000DA4E /end MEASUREMENT
/begin MEASUREMENT tq_clch_torq_sp "Clutch torque setpoint from pedal." SWORD u_tq 0 0 -2048 2047.9375 ECU_ADDRESS 0x400050DA /end MEASUREMENT
/begin MEASUREMENT tq_air_ms_sp "Air mass setpoint from torque." UWORD u_mg_4096 0 0 0 4095.9375 ECU_ADDRESS 0x4000DA4E /end MEASUREMENT
/begin MEASUREMENT tq_imep_rt "imep ratio from fast imep setpoint to actual slow imep." UWORD u_fac_2 0 0 0.0 1.999969482421875 ECU_ADDRESS 0x4000DA4E FORMAT "%4.3" /end MEASUREMENT
/begin MEASUREMENT tq_imep_fst_sp "Fast imep setpoint." UWORD u_kPa_0_4096 0 0 0.0 4095.9375 ECU_ADDRESS 0x4000DA4E /end MEASUREMENT
/begin MEASUREMENT tq_fuel_rt "fuel ratio." UWORD u_fac_2 0 0 0.0 1.999969482421875 ECU_ADDRESS 0x4000DA4E FORMAT "%4.3" /end MEASUREMENT
/begin MEASUREMENT tq_ctrl_mod "Torque control mode." UBYTE u_tq_mod 0 0 0 2 ECU_ADDRESS 0x4000DA4E FORMAT "%1.0" /end MEASUREMENT
/begin MEASUREMENT tq_sp2act_fm_rt "fuel mass setpoint / actual fuel mass." UWORD u_fac_16 0 0 0.0 15.999756 ECU_ADDRESS 0x4000DA4E /end MEASUREMENT
/begin MEASUREMENT tq_ctrl_mod_fac "Control mode factor." UWORD u_fac_16 0 0 0.0 15.999756 ECU_ADDRESS 0x4000DA4E /end MEASUREMENT
/begin MEASUREMENT tq_ctrl_mod_trn_fac "Control mode transition factor." UWORD u_fac_1 0 0 0.0 0.9999847412109375 ECU_ADDRESS 0x4000DA4E FORMAT "%5.4" /end MEASUREMENT
/begin MEASUREMENT tq_vsg_vspd_lmt "Final vehicle speed limit by vehicle speed governor." UWORD u_vspd 0 0 0.0 511.9921875 ECU_ADDRESS 0x4000DA4E /end MEASUREMENT
/begin MEASUREMENT tq_vsg_int "Integral part of the Vehicle Speed Governor closed loop control." SWORD u_tq 0 0 -2048 2047.9375 ECU_ADDRESS 0x400050DA /end MEASUREMENT
/begin MEASUREMENT tq_vsg_actv "Vehicle speed governor is active when vehicle speed has exceeded the max value." UBYTE b_true 0 0 0.00 1.00 BIT_MASK 0x1 ECU_ADDRESS 0x4000DA4E FORMAT "%4.2" /end MEASUREMENT
/begin MEASUREMENT tq_vsg_prop "Proportional part of the Vehicle Speed Governor closed loop control." SWORD u_tq 0 0 -2048 2047.9375 ECU_ADDRESS 0x400050DA /end MEASUREMENT
/begin MEASUREMENT tq_vsg_torq_sp "Engine torque setpoint from the vehicle speed governor function.Limits the maximum torque to protect the vehicle from excessive speed." SWORD u_tq 0 0 -2048 2047.9375 ECU_ADDRESS 0x400050DA /end MEASUREMENT
/begin MEASUREMENT tq_vsg_vspd_dlt "Vehicle Speed Governor delta = cruise filtered speed - vehicle speed governor max limit." SWORD u_vspd_err 0 0 -512 511.984375 ECU_ADDRESS 0x400050DA /end MEASUREMENT
/begin MEASUREMENT tq_poc_enbl "POC enabled status bit Inertia Control" UBYTE b_true 0 0 0 1 BIT_MASK 0x80 ECU_ADDRESS 0x400050DA FORMAT "%1.0" SYMBOL_LINK "tq_poc_ctrl" 0 /end MEASUREMENT
/begin MEASUREMENT tq_poc_ctrl_enbl "POC control enabled status bit Inertia Control" UBYTE b_true 0 0 0 1 BIT_MASK 0x40 ECU_ADDRESS 0x400050DA FORMAT "%1.0" SYMBOL_LINK "tq_poc_ctrl" 0 /end MEASUREMENT
/begin MEASUREMENT tq_poc_ctrl_met "POC control condition met status bit Inertia Control" UBYTE b_true 0 0 0 1 BIT_MASK 0x20 ECU_ADDRESS 0x400050DA FORMAT "%1.0" SYMBOL_LINK "tq_poc_ctrl" 0 /end MEASUREMENT
/begin AXIS_PTS ENSC_X_PS_P "" 0x65E4A sys_ps_p SSV__UWORD_S 0 u_kPa_0_32768 5 0 32767.5 DEPOSIT ABSOLUTE SYMBOL_LINK "ENSC_X_PS_P" 2 /end AXIS_PTS
/begin CHARACTERISTIC TQ_C_THEM_EFF_AF_FAC "AFR factor of ignition efficency" CURVE 0x000200B0 __UWORD_S 0 u_fac_2 0 1.999969482421875 FORMAT "%4.3" SYMBOL_LINK "TQ_C_THEM_EFF_AF_FAC" 2
 /begin AXIS_DESCR COM_AXIS fmsp_af_sp u_afr 20 0 31.99951171875 AXIS_PTS_REF TQ_X_AFR /end AXIS_DESCR
/end CHARACTERISTIC
/begin AXIS_PTS TQ_X_AFR "airfuel ratio breakpoint" 0x0002006C fmsp_af_sp SSV__UWORD_S 0 u_afr 20 0 31.99951171875 DEPOSIT ABSOLUTE SYMBOL_LINK "TQ_X_AFR" 2 /end AXIS_PTS
/begin CHARACTERISTIC TQ_M_THEM_EFF_STOCH "them efficiency at lambda 1" MAP 0x00020320 __UWORD_S 0 u_pct_1 0 99.9984741210937 FORMAT "%4.2" SYMBOL_LINK "TQ_M_THEM_EFF_STOCH" 4
 /begin AXIS_DESCR COM_AXIS sys_eng_spd u_espd 15 0.000000 8191.875000 AXIS_PTS_REF TQ_X_ESPD_A /end AXIS_DESCR
 /begin AXIS_DESCR COM_AXIS afm_stk_flw_pct u_pct_8 12 0.000000 799.987793 AXIS_PTS_REF TQ_X_STRK_FLW_A /end AXIS_DESCR
/end CHARACTERISTIC
/begin AXIS_PTS TQ_X_ESPD_A "engine speed breakpoint" 0x0002006C sys_eng_spd SSV__UWORD_S 0 u_espd 15 0.000000 8191.875000 FORMAT "%5.1" DEPOSIT ABSOLUTE SYMBOL_LINK "TQ_X_ESPD_A" 2 /end AXIS_PTS
/begin AXIS_PTS TQ_X_STRK_FLW_A "stroke flow percent breakpoint" 0x0002006C afm_stk_flw_pct SSV__UWORD_S 0 u_pct_8 12 0.000000 799.987793 DEPOSIT ABSOLUTE SYMBOL_LINK "TQ_X_STRK_FLW_A" 2 /end AXIS_PTS
/begin CHARACTERISTIC TQ_M_FRIC_LOSS "friction torque losses" MAP 0x00020320 __SWORD_S 0 u_tq -2048 2047.9375 FORMAT "%5.2" SYMBOL_LINK "TQ_M_FRIC_LOSS" 4
 /begin AXIS_DESCR COM_AXIS sys_eng_spd u_espd 9 0.000000 8191.875000 AXIS_PTS_REF TQ_X_ESPD_B /end AXIS_DESCR
 /begin AXIS_DESCR COM_AXIS tq_imep_ref u_kPa_0_4096 17 0.000000 4095.937500 AXIS_PTS_REF TQ_X_IMEP_REF /end AXIS_DESCR
/end CHARACTERISTIC
/begin CHARACTERISTIC TQ_M_FRIC_LOSS_ECT_BIAS "ect bias of friction torque losses" MAP 0x00020320 __SWORD_S 0 u_tq -2048 2047.9375 FORMAT "%5.2" SYMBOL_LINK "TQ_M_FRIC_LOSS_ECT_BIAS" 4
 /begin AXIS_DESCR COM_AXIS sys_eng_spd u_espd 9 0.000000 8191.875000 AXIS_PTS_REF TQ_X_ESPD_B /end AXIS_DESCR
 /begin AXIS_DESCR FIX_AXIS sys_ect u_deg_C 15 -40 128
  /begin FIX_AXIS_PAR_LIST -5120 -3584 -2048 -512 1024 2560 4096 5632 7168 8704 10240 11776 13312 14848 16384 /end FIX_AXIS_PAR_LIST
 /end AXIS_DESCR
/end CHARACTERISTIC
/begin AXIS_PTS TQ_X_ESPD_B "engine speed breakpoint" 0x0002006C sys_eng_spd SSV__UWORD_S 0 u_espd 9 0.000000 8191.875000 FORMAT "%5.1" DEPOSIT ABSOLUTE SYMBOL_LINK "TQ_X_ESPD_B" 2 /end AXIS_PTS
/begin AXIS_PTS TQ_X_ESPD_C "engine speed breakpoint" 0x0002006C sys_eng_spd SSV__UWORD_S 0 u_espd 21 0.000000 8191.875000 FORMAT "%5.1" DEPOSIT ABSOLUTE SYMBOL_LINK "TQ_X_ESPD_C" 2 /end AXIS_PTS
/begin AXIS_PTS TQ_X_IMEP_REF "ref imep breakpoint" 0x0002006C tq_imep_ref SSV__UWORD_S 0 u_kPa_0_4096 17 0.000000 4095.937500 FORMAT "%5.1" DEPOSIT ABSOLUTE SYMBOL_LINK "TQ_X_IMEP_REF" 2 /end AXIS_PTS
/begin CHARACTERISTIC TQ_C_PMP_MEP_THRO "pumping mean effective pressure from throttle" CURVE 0x000200B0 __SWORD_S 0 u_kPa_512n_512p -512 511.984375 FORMAT "%4.1" SYMBOL_LINK "TQ_C_PMP_MEP_THRO" 2
 /begin AXIS_DESCR FIX_AXIS tq_exh_to_intk_p_dlt u_kPa_256n_256p 11 0 100 /begin FIX_AXIS_PAR_LIST 0 1280 2560 3840 5120 6400 7680 8960 10240 11520 12800 /end FIX_AXIS_PAR_LIST /end AXIS_DESCR
/end CHARACTERISTIC
/begin CHARACTERISTIC TQ_M_PMP_MEP_VALV "pumping mean effective pressure from valve" MAP 0x00020320 __SWORD_S 0 u_kPa_512n_512p -512 511.984375 FORMAT "%4.1" SYMBOL_LINK "TQ_M_PMP_MEP_VALV" 4
 /begin AXIS_DESCR FIX_AXIS afm_stk_flw_pct u_pct_8 13 0 120
  /begin FIX_AXIS_PAR_LIST 0 819 1638 2457 3276 4096 4915 5734 6553 7372 8192 9011 9830 /end FIX_AXIS_PAR_LIST
 /end AXIS_DESCR
 /begin AXIS_DESCR COM_AXIS sys_eng_spd u_espd 21 0.000000 8191.875000 AXIS_PTS_REF TQ_X_ESPD_C /end AXIS_DESCR
/end CHARACTERISTIC
/begin CHARACTERISTIC TQ_V_HT_VALUE "ramp interval of FLE ignition angle bias " VALUE 0x0002038C __UWORD_S 0 u_ht_value 0 63.9990234375 /end CHARACTERISTIC
/begin CHARACTERISTIC TQ_M_ALT_TORQ "alternator torque" MAP 0x00020320 __UWORD_S 0 u_nm 0 1023.984375 SYMBOL_LINK "TQ_M_ALT_TORQ" 4
 /begin AXIS_DESCR FIX_AXIS sys_alt_pwm u_pct_1 8 0 99.9984741210937 /begin FIX_AXIS_PAR_LIST 0 19660 26214 32768 39321 45875 52428 65535 /end FIX_AXIS_PAR_LIST /end AXIS_DESCR
 /begin AXIS_DESCR COM_AXIS sys_eng_spd u_espd 8 0.000000 8191.875000 AXIS_PTS_REF TQ_X_ESPD_D /end AXIS_DESCR
/end CHARACTERISTIC
/begin AXIS_PTS TQ_X_ESPD_D "engine speed breakpoint" 0x0002006C sys_eng_spd SSV__UWORD_S 0 u_espd 8 0.000000 8191.875000 FORMAT "%5.1" DEPOSIT ABSOLUTE SYMBOL_LINK "TQ_X_ESPD_D" 2 /end AXIS_PTS
/begin CHARACTERISTIC TQ_M_ALT_TORQ_BAT_FAC "alternator torque battery volt factor" MAP 0x00020320 __UWORD_S 0 u_fac_2 0 1.999969482421875 FORMAT "%4.3" SYMBOL_LINK "TQ_M_ALT_TORQ_BAT_FAC" 4
 /begin AXIS_DESCR COM_AXIS hw_bat_vlt u_volt_32 6 0.000000 31.99951171875 AXIS_PTS_REF TQ_X_BAT_VLT_A /end AXIS_DESCR
 /begin AXIS_DESCR COM_AXIS sys_eng_spd u_espd 8 0.000000 8191.875000 AXIS_PTS_REF TQ_X_ESPD_D /end AXIS_DESCR
/end CHARACTERISTIC
/begin AXIS_PTS TQ_X_BAT_VLT_A "voltage breakpoint" 0x0002006C hw_bat_vlt SSV__UWORD_S 0 u_volt_32 6 0.000000 31.99951171875 FORMAT "%3.1" DEPOSIT ABSOLUTE SYMBOL_LINK "TQ_X_BAT_VLT_A" 2 /end AXIS_PTS
/begin CHARACTERISTIC TQ_C_PCT_TORQ_MAX "max torque for torque percent calculation" CURVE 0x000200B0 __SWORD_S 0 u_nm_s -2048 2047.9375 FORMAT "%6.1" SYMBOL_LINK "TQ_C_PCT_TORQ_MAX" 2
 /begin AXIS_DESCR COM_AXIS sys_eng_spd u_espd 17 0 8191.875000 AXIS_PTS_REF TQ_X_ESPD_E /end AXIS_DESCR
/end CHARACTERISTIC
/begin AXIS_PTS TQ_X_ESPD_E "engine speed breakpoint" 0x0002006C sys_eng_spd SSV__UWORD_S 0 u_espd 17 0.000000 8191.875000 FORMAT "%5.1" DEPOSIT ABSOLUTE SYMBOL_LINK "TQ_X_ESPD_E" 2 /end AXIS_PTS
/begin CHARACTERISTIC TQ_M_FLYW_TORQ_MX_CHRG_AMP_FAC "Max flywheel torque ambient pressure factor for turbo application." MAP 0x00020320 __UWORD_S 0 u_fac_1 0 0.9999847412109375 SYMBOL_LINK "TQ_M_FLYW_TORQ_MX_CHRG_AMP_FAC" 4
 /begin AXIS_DESCR COM_AXIS sys_amp u_kPa_0_256 5 0.000000 255.99609375 AXIS_PTS_REF TQ_X_AMP_A /end AXIS_DESCR
 /begin AXIS_DESCR COM_AXIS sys_eng_spd u_espd 7 0.000000 8191.875000 AXIS_PTS_REF TQ_X_ESPD_F /end AXIS_DESCR
/end CHARACTERISTIC
/begin AXIS_PTS TQ_X_AMP_A "Ambient breakpoint" 0x0002006C sys_amp SSV__UWORD_S 0 u_kPa_0_256 5 0.000000 255.99609375 FORMAT "%4.1" DEPOSIT ABSOLUTE SYMBOL_LINK "TQ_X_AMP_A" 2 /end AXIS_PTS
/begin AXIS_PTS TQ_X_ESPD_F "engine speed breakpoint" 0x0002006C sys_eng_spd SSV__UWORD_S 0 u_espd 7 0.000000 8191.875000 FORMAT "%5.1" DEPOSIT ABSOLUTE SYMBOL_LINK "TQ_X_ESPD_F" 2 /end AXIS_PTS
/begin CHARACTERISTIC TQ_C_FLYW_TORQ_MBT_MX_PROT_OB "Maximum Flywheel Torque at MBT and stoich A/F vs. engine speed under standard conditions,use when protection due to over boost." CURVE 0x000200B0 __SWORD_S 0 u_tq -2048 2047.9375 FORMAT "%5.2" SYMBOL_LINK "TQ_C_FLYW_TORQ_MBT_MX_PROT_OB" 2
 /begin AXIS_DESCR COM_AXIS sys_eng_spd u_espd 13 0 8191.875000 AXIS_PTS_REF TQ_X_ESPD_G /end AXIS_DESCR
/end CHARACTERISTIC
/begin AXIS_PTS TQ_X_ESPD_G "engine speed breakpoint" 0x0002006C sys_eng_spd SSV__UWORD_S 0 u_espd 13 0.000000 8191.875000 FORMAT "%5.1" DEPOSIT ABSOLUTE SYMBOL_LINK "TQ_X_ESPD_G" 2 /end AXIS_PTS
/begin CHARACTERISTIC TQ_C_FLYW_TORQ_MBT_MX_PROT_KN "Maximum Flywheel Torque at MBT and stoich A/F vs. engine speed under standard conditions,use when protection due to super knock many times." CURVE 0x000200B0 __SWORD_S 0 u_tq -2048 2047.9375 FORMAT "%5.2" SYMBOL_LINK "TQ_C_FLYW_TORQ_MBT_MX_PROT_KN" 2
 /begin AXIS_DESCR COM_AXIS sys_eng_spd u_espd 13 0 8191.875000 AXIS_PTS_REF TQ_X_ESPD_G /end AXIS_DESCR
/end CHARACTERISTIC
/begin CHARACTERISTIC TQ_V_THROT_MDL_T_FLT "Modeled throttle temperature filter for torque module." VALUE 0x0002038C __UWORD_S 0 u_filter 0 0.9999847412109375 FORMAT "%10.9" /end CHARACTERISTIC
/begin CHARACTERISTIC TQ_C_FLYW_TORQ_MBT_MX_PROT_ICP "Maximum Flywheel Torque at MBT and stoich A/F vs. engine speed under standard conditions,use when protection due to intercooler pump." CURVE 0x000200B0 __SWORD_S 0 u_tq -2048 2047.9375 FORMAT "%5.2" SYMBOL_LINK "TQ_C_FLYW_TORQ_MBT_MX_PROT_ICP" 2
 /begin AXIS_DESCR COM_AXIS sys_eng_spd u_espd 13 0 8191.875000 AXIS_PTS_REF TQ_X_ESPD_G /end AXIS_DESCR
/end CHARACTERISTIC
/begin CHARACTERISTIC TQ_C_FLYW_TORQ_MBT_MX_PROT_CAM_BKP "Maximum Flywheel Torque at MBT and stoich A/F vs. engine speed under standard conditions,use when protection due to CAM backup active." CURVE 0x000200B0 __SWORD_S 0 u_tq -2048 2047.9375 FORMAT "%5.2" SYMBOL_LINK "TQ_C_FLYW_TORQ_MBT_MX_PROT_CAM_BKP" 2
 /begin AXIS_DESCR COM_AXIS sys_eng_spd u_espd 13 0 8191.875000 AXIS_PTS_REF TQ_X_ESPD_G /end AXIS_DESCR
/end CHARACTERISTIC
/begin CHARACTERISTIC TQ_V_MX_FLYW_TORQ_EXH_T_ENBL_THRSH "tq_mx_flyw_torq_exh_t_tm starts to increment when exhaust temperature over this cal." VALUE 0x0002038C __UWORD_S 0 u_deg_K 0 2047.96875 FORMAT "%5.1" /end CHARACTERISTIC
/begin CHARACTERISTIC TQ_V_MX_FLYW_TORQ_EXH_T_DSBL_THRSH "tq_mx_flyw_torq_exh_t_tm resets to 0 when exhaust temperature below this cal." VALUE 0x0002038C __UWORD_S 0 u_deg_K 0 2047.96875 FORMAT "%5.1" /end CHARACTERISTIC
/begin CHARACTERISTIC TQ_V_MX_FLYW_TORQ_EXH_T_TMR_THRSH "Time threshold to apply exhaust temperature max flywheel torque." VALUE 0x0002038C __UWORD_S 0 u_2x_tmr 0 1023.984375 /end CHARACTERISTIC
/begin CHARACTERISTIC TQ_M_MX_FLYW_TORQ_EXH_T "Max flywheel torque limiitation when exhaust over temperature." MAP 0x00020320 __SWORD_S 0 u_tq -2048 2047.9375 FORMAT "%5.2" SYMBOL_LINK "TQ_M_MX_FLYW_TORQ_EXH_T" 4
 /begin AXIS_DESCR COM_AXIS fmsp_af_sp u_afr 7 0 31.99951171875 AXIS_PTS_REF TQ_X_AFR_A /end AXIS_DESCR
 /begin AXIS_DESCR COM_AXIS afm_exh_prt_t u_deg_K 7 0.0 2047.96875 AXIS_PTS_REF TQ_X_EXH_T_A /end AXIS_DESCR
/end CHARACTERISTIC
/begin AXIS_PTS TQ_X_AFR_A "" 0x0002006C fmsp_af_sp SSV__UWORD_S 0 u_afr 7 0.000000 31.99951171875 FORMAT "%5.2" DEPOSIT ABSOLUTE SYMBOL_LINK "TQ_X_AFR_A" 2 /end AXIS_PTS
/begin AXIS_PTS TQ_X_EXH_T_A "" 0x0002006C afm_exh_prt_t SSV__UWORD_S 0 u_deg_K 7 0.000000 2047.96875 FORMAT "%5.1" DEPOSIT ABSOLUTE SYMBOL_LINK "TQ_X_EXH_T_A" 2 /end AXIS_PTS
/begin CHARACTERISTIC TQ_V_GR_SRC_CAN "TRUE means torq gear state source is CAN" VALUE 0x0002038C __UBYTE_S 0 b_true 0 1 FORMAT "%1.0" /end CHARACTERISTIC
/begin CHARACTERISTIC TQ_V_ECO_ECT_THR "min engine coolant threshold to enable torq ECO mode" VALUE 0x0002038C __SWORD_S 0 u_deg_C -256 255.9921875 FORMAT "%4.2" /end CHARACTERISTIC
/begin CHARACTERISTIC TQ_V_ECO_ECT_THR_HYS "min engine coolant threshold to enable torq ECO mode" VALUE 0x0002038C __SWORD_S 0 u_deg_C -256 255.9921875 FORMAT "%4.2" /end CHARACTERISTIC
/begin CHARACTERISTIC TQ_V_ECO_RUN_MIN "min engine runtime threshold to enable torq ECO mode" VALUE 0x232DC __UBYTE_S 0 u_1s_tmr 0 255 /end CHARACTERISTIC
/begin CHARACTERISTIC TQ_V_ECO_PPS_MAX_DUR "hold duration of knock transient state after transient conditions not meet" VALUE 0x0002038C __UWORD_S 0 u_2x_tmr 0 1023.984375 /end CHARACTERISTIC
/begin CHARACTERISTIC TQ_V_ECO_PPS_MAX "pedal position threshold above which Torq ECO mode will be disabled" VALUE 0x2DD38 __UWORD_S 0 u_pct 0 199.996948 FORMAT "%6.3" /end CHARACTERISTIC
/begin CHARACTERISTIC TQ_V_ECO_DIS_TIM_MIN "once ECO mode is disabled, ECO mode will keep at disable status for at least this time" VALUE 0x0002038C __UWORD_S 0 u_2x_tmr 0 1023.984375 /end CHARACTERISTIC
/begin AXIS_PTS TQ_X_TPO_ESPD "engine speed breakpoint" 0x0002006C sys_eng_spd SSV__UWORD_S 0 u_espd 11 0.000000 8191.875000 FORMAT "%5.1" DEPOSIT ABSOLUTE SYMBOL_LINK "TQ_X_TPO_ESPD" 2 /end AXIS_PTS
/begin AXIS_PTS TQ_X_CLTCH_TORQ "clutch torque breakpoint" 0x0002006C tq_cltch_torq_raw_sp_filt SSV__SWORD_S 0 u_tq 11 -2048 2047.9375 DEPOSIT ABSOLUTE SYMBOL_LINK "TQ_X_CLTCH_TORQ" 2 /end AXIS_PTS
/begin AXIS_PTS TQ_X_PPS_FILT "virtual pedal position breakpoint" 0x0002006C tq_vr_pps SSV__UWORD_S 0 u_pct 5 0 199.996948242187 DEPOSIT ABSOLUTE SYMBOL_LINK "TQ_X_PPS_FILT" 2 /end AXIS_PTS
/begin AXIS_PTS TQ_X_PPS_DLT "virtual pedal position breakpoint" 0x0002006C tq_vr_pps_dlt SSV__UWORD_S 0 u_pct 5 0 199.996948242187 DEPOSIT ABSOLUTE SYMBOL_LINK "TQ_X_PPS_DLT" 2 /end AXIS_PTS
/begin AXIS_PTS TQ_X_TPI_DSBL_ADC "Ambient air density correction breakpoint" 0x0002006C NO_INPUT_QUANTITY SSV__UWORD_S 0 u_fac_8 7 0.000000 7.9998779296875 FORMAT "%5.4" DEPOSIT ABSOLUTE SYMBOL_LINK "TQ_X_TPI_DSBL_ADC" 2 /end AXIS_PTS
/begin AXIS_PTS TQ_X_TPI_DSBL_IAT "Intake air temperature correction breakpoint" 0x0002006C sys_iat SSV__SWORD_S 0 u_deg_C 7 -256 255.9921875 DEPOSIT ABSOLUTE SYMBOL_LINK "TQ_X_TPI_DSBL_IAT" 2 /end AXIS_PTS
/begin AXIS_PTS TQ_X_TPI_ESPD "Tip in enable torque engine speed breakpoint" 0x0002006C sys_eng_spd SSV__UWORD_S 0 u_espd 7 0 8191.875000 FORMAT "%5.1" DEPOSIT ABSOLUTE SYMBOL_LINK "TQ_X_TPI_ESPD" 2 /end AXIS_PTS
/begin AXIS_PTS TQ_X_TPI_RMP_STP "Tip in ramp step breakpoint" 0x0002006C tq_flyw_torq_raw_sp SSV__SWORD_S 0 u_tq 11 -2048 2047.9375 FORMAT "%5.2" DEPOSIT ABSOLUTE SYMBOL_LINK "TQ_X_TPI_RMP_STP" 2 /end AXIS_PTS
/begin CHARACTERISTIC TQ_M_ALL_TERN_PPS "For all-terrain vehicle,modified pedal position." MAP 0x00020320 __UWORD_S 0 u_pct_r 0 127.998046875
 /begin AXIS_DESCR FIX_AXIS NO_INPUT_QUANTITY u_all_terrain_mod 4 0 3 /begin FIX_AXIS_PAR_LIST 0 1 2 3 /end FIX_AXIS_PAR_LIST /end AXIS_DESCR
 /begin AXIS_DESCR FIX_AXIS tq_pps_raw u_pct_r 22 0 100
  /begin FIX_AXIS_PAR_LIST 0 1280 2560 5120 7680 10240 12800 15360 17920 20480 23040 25600 28160 30720 33280 35840 38400 40960 43520 46080 48640 51200 /end FIX_AXIS_PAR_LIST
 /end AXIS_DESCR
/end CHARACTERISTIC
/begin AXIS_PTS TQ_X_PPS "Pedal position breakpoint." 0x0002006C tq_pps SSV__UWORD_S 0 u_pct_r 21 0 127.998046875 DEPOSIT ABSOLUTE SYMBOL_LINK "TQ_X_PPS" 2 /end AXIS_PTS
/begin CHARACTERISTIC TQ_M_PED2TQ_PCT "Pedal position to torque percent." MAP 0x00020320 __UWORD_S 0 u_pct 0 199.996948242187 SYMBOL_LINK "TQ_M_PED2TQ_PCT" 4
 /begin AXIS_DESCR COM_AXIS sys_eng_spd u_espd 17 0 8191.875 AXIS_PTS_REF TQ_X_ESPD_E /end AXIS_DESCR
 /begin AXIS_DESCR COM_AXIS tq_pps u_pct_r 21 0 127.998046875 AXIS_PTS_REF TQ_X_PPS /end AXIS_DESCR
/end CHARACTERISTIC
/begin CHARACTERISTIC TQ_M_PED2TQ_PCT_ECO "Pedal position to torque percent in ECO mode." MAP 0x00020320 __UWORD_S 0 u_pct 0 199.996948242187 SYMBOL_LINK "TQ_M_PED2TQ_PCT_ECO" 4
 /begin AXIS_DESCR COM_AXIS sys_eng_spd u_espd 17 0 8191.875 AXIS_PTS_REF TQ_X_ESPD_E /end AXIS_DESCR
 /begin AXIS_DESCR COM_AXIS tq_pps u_pct_r 21 0 127.998046875 AXIS_PTS_REF TQ_X_PPS /end AXIS_DESCR
/end CHARACTERISTIC
/begin CHARACTERISTIC TQ_M_PED2TQ_PCT_SPRT "Pedal position to torque percent in sport mode." MAP 0x00020320 __UWORD_S 0 u_pct 0 199.996948242187 SYMBOL_LINK "TQ_M_PED2TQ_PCT_SPRT" 4
 /begin AXIS_DESCR COM_AXIS sys_eng_spd u_espd 17 0 8191.875 AXIS_PTS_REF TQ_X_ESPD_E /end AXIS_DESCR
 /begin AXIS_DESCR COM_AXIS tq_pps u_pct_r 21 0 127.998046875 AXIS_PTS_REF TQ_X_PPS /end AXIS_DESCR
/end CHARACTERISTIC
/begin CHARACTERISTIC TQ_M_CLCH_TQ_SP_RMP_STP "Clutch torque setpoint from pedal ramp step.Only active after ECO mode,sport mode and normal mode transition." MAP 0x00020320 __UWORD_S 0 u_pct 0 199.996948242187
 /begin AXIS_DESCR FIX_AXIS NO_INPUT_QUANTITY u_rmp_dir 2 0 1 /begin FIX_AXIS_PAR_LIST 0 1 /end FIX_AXIS_PAR_LIST /end AXIS_DESCR
 /begin AXIS_DESCR FIX_AXIS NO_INPUT_QUANTITY u_rmp_mod 3 0 2 /begin FIX_AXIS_PAR_LIST 0 1 2 /end FIX_AXIS_PAR_LIST /end AXIS_DESCR
/end CHARACTERISTIC
/begin AXIS_PTS TQ_X_ADD_ESPD_DEV_A "" 0x291C4 ensc_espd_dev SSV__SWORD_S 0 u_espd 19 -4096 4095.875 FORMAT "%6.2" DEPOSIT ABSOLUTE SYMBOL_LINK "TQ_X_ADD_ESPD_DEV_A" 2 /end AXIS_PTS
/begin AXIS_PTS TQ_X_ADD_RATIO "" 0x0002006C NO_INPUT_QUANTITY SSV__SWORD_S 0 u_fac_n4_p4 11 -4.000000 3.9998779296875 FORMAT "%5.4" DEPOSIT ABSOLUTE SYMBOL_LINK "TQ_X_ADD_RATIO" 2 /end AXIS_PTS
/begin CHARACTERISTIC TQ_C_IDL_FLW_TQ_GAIN_MX_STR "Idle flow to torque scaler max limit when engine starting." CURVE 0x000200B0 __UWORD_S 0 u_fac_4 0 3.99993896484375 FORMAT "%6.5" SYMBOL_LINK "TQ_C_IDL_FLW_TQ_GAIN_MX_STR" 2
 /begin AXIS_DESCR FIX_AXIS sys_ect u_deg_C 13 -256 255
  /begin FIX_AXIS_PAR_LIST -5120 -3584 -2048 -512 1024 2560 4096 5632 7168 8704 10240 11776 13312 /end FIX_AXIS_PAR_LIST
 /end AXIS_DESCR
/end CHARACTERISTIC
/begin CHARACTERISTIC TQ_V_IDL_FLW_TQ_GAIN_MX "Idle flow to torque scaler max limit." VALUE 0x0002038C __UWORD_S 0 u_fac_4 0 3.99993896484375 FORMAT "%6.5" /end CHARACTERISTIC
/begin CHARACTERISTIC TQ_M_TRN_PMP_PN "Transmission pump torque in PN gear." MAP 0x00020320 __SWORD_S 0 u_tq -2048 2047.9375 FORMAT "%5.2" SYMBOL_LINK "TQ_M_TRN_PMP_PN" 4
 /begin AXIS_DESCR COM_AXIS sys_eng_spd u_espd 11 0 8191.875 AXIS_PTS_REF TQ_X_ESPD_H /end AXIS_DESCR
 /begin AXIS_DESCR FIX_AXIS sys_trs_oil_t u_deg_C 15 -256 255
  /begin FIX_AXIS_PAR_LIST -5120 -3584 -2048 -512 1024 2560 4096 5632 7168 8704 10240 11776 13312 14848 16384 /end FIX_AXIS_PAR_LIST
 /end AXIS_DESCR
/end CHARACTERISTIC
/begin AXIS_PTS TQ_X_ESPD_H "engine speed breakpoint" 0x0002006C sys_eng_spd SSV__UWORD_S 0 u_espd 11 0.000000 8191.875000 FORMAT "%5.1" DEPOSIT ABSOLUTE SYMBOL_LINK "TQ_X_ESPD_H" 2 /end AXIS_PTS
/begin CHARACTERISTIC TQ_M_TRN_PMP_D "Transmission pump torque in Drive gear." MAP 0x00020320 __SWORD_S 0 u_tq -2048 2047.9375 FORMAT "%5.2" SYMBOL_LINK "TQ_M_TRN_PMP_D" 4
 /begin AXIS_DESCR COM_AXIS sys_eng_spd u_espd 11 0 8191.875 AXIS_PTS_REF TQ_X_ESPD_H /end AXIS_DESCR
 /begin AXIS_DESCR FIX_AXIS sys_trs_oil_t u_deg_C 15 -256 255
  /begin FIX_AXIS_PAR_LIST -5120 -3584 -2048 -512 1024 2560 4096 5632 7168 8704 10240 11776 13312 14848 16384 /end FIX_AXIS_PAR_LIST
 /end AXIS_DESCR
/end CHARACTERISTIC
/begin CHARACTERISTIC TQ_M_TRN_PMP_R "Transmission pump torque in Reverse gear." MAP 0x00020320 __SWORD_S 0 u_tq -2048 2047.9375 FORMAT "%5.2" SYMBOL_LINK "TQ_M_TRN_PMP_R" 4
 /begin AXIS_DESCR COM_AXIS sys_eng_spd u_espd 11 0 8191.875 AXIS_PTS_REF TQ_X_ESPD_H /end AXIS_DESCR
 /begin AXIS_DESCR FIX_AXIS sys_trs_oil_t u_deg_C 15 -256 255
  /begin FIX_AXIS_PAR_LIST -5120 -3584 -2048 -512 1024 2560 4096 5632 7168 8704 10240 11776 13312 14848 16384 /end FIX_AXIS_PAR_LIST
 /end AXIS_DESCR
/end CHARACTERISTIC
/begin CHARACTERISTIC TQ_V_CTRL_MOD "Torque control mode selection." VALUE 0x0002038C __UBYTE_S 0 u_tq_mod 0 2 FORMAT "%1.0" /end CHARACTERISTIC
/begin CHARACTERISTIC TQ_V_EXT_ESPD_MX "External engine speed control max engine speed limit." VALUE 0x0002038C __UWORD_S 0 u_espd 0 8191.875 FORMAT "%5.1" /end CHARACTERISTIC
/begin CHARACTERISTIC TQ_V_EXT_ESPD_MN "External engine speed control min engine speed limit." VALUE 0x0002038C __UWORD_S 0 u_espd 0 8191.875 FORMAT "%5.1" /end CHARACTERISTIC
/begin CHARACTERISTIC TQ_V_EXT_ESPD_ENBL_PRN "External engine speed control is enabled in P/R/N gear." VALUE 0x0002038C __UBYTE_S 0 b_true 0 1 FORMAT "%1.0" /end CHARACTERISTIC
/begin CHARACTERISTIC TQ_V_EXT_ESPD_ENBL_TOOTH_LRN "External engine speed control is enabled before tooth learn finished." VALUE 0x0002038C __UBYTE_S 0 b_true 0 1 FORMAT "%1.0" /end CHARACTERISTIC
/begin CHARACTERISTIC TQ_V_EXT_ESPD_INT_TORQ_LMT "Integrated torque error limit when external engine speed control enabled." VALUE 0x0002038C __UWORD_S 0 u_tq_sec 0 1023.984375 /end CHARACTERISTIC
/begin CHARACTERISTIC TQ_V_EXT_ESPD_INT_TORQ_LMT_BRK "Integrated torque error limit when external engine speed control enabled and brake pedal depressed." VALUE 0x0002038C __UWORD_S 0 u_tq_sec 0 1023.984375 /end CHARACTERISTIC
/begin CHARACTERISTIC TQ_V_RT_EXT_ESPD_INC "Runtime low limit for enable external engine speed increase request." VALUE 0x0002038C __UWORD_S 0 u_1x_tmr 0 511.9921875 FORMAT "%4.1" /end CHARACTERISTIC
/begin CHARACTERISTIC TQ_V_ECT_EXT_ESPD_INC "Coolant temperature high limit for enable external engine speed increase request." VALUE 0x0002038C __SWORD_S 0 u_deg_C -256 255.9921875 FORMAT "%4.2" /end CHARACTERISTIC
/begin CHARACTERISTIC TQ_C_RT_EXT_ESPD_DEC "Runtime low limit for enable external engine speed decrease request." CURVE 0x000200B0 __UWORD_S 0 u_1x_tmr 0 511.9921875 FORMAT "%4.1" SYMBOL_LINK "TQ_C_RT_EXT_ESPD_DEC" 2
 /begin AXIS_DESCR FIX_AXIS sys_ect u_deg_C 9 -40.0 120 /begin FIX_AXIS_PAR_LIST -5120 -2560 0 2560 5120 7680 10240 12800 15360 /end FIX_AXIS_PAR_LIST /end AXIS_DESCR
/end CHARACTERISTIC
/begin CHARACTERISTIC TQ_V_PPS_EXT_ESPD_DEC "Integrated pedal position high limit for enable external engine speed decrease request." VALUE 0x0002038C __UWORD_S 0 u_pct_sec 0 511.9921875 /end CHARACTERISTIC
/begin CHARACTERISTIC TQ_V_VSPD_EXT_ESPD_LNCH "External engine speed control launch shift mode max vehicle speed limit." VALUE 0x0002038C __UWORD_S 0 u_vspd 0 511.9921875 FORMAT "%5.1" /end CHARACTERISTIC
/begin AXIS_PTS TQ_X_ESPD_I "engine speed breakpoint" 0x0002006C sys_eng_spd SSV__UWORD_S 0 u_espd 5 0.000000 8191.875000 FORMAT "%5.1" DEPOSIT ABSOLUTE SYMBOL_LINK "TQ_X_ESPD_I" 2 /end AXIS_PTS
/begin AXIS_PTS TQ_X_ESPD_DLT "engine speed delta breakpoint" 0x0002006C NO_INPUT_QUANTITY SSV__SWORD_S 0 u_espd 8 -4096 4095.875000 FORMAT "%5.1" DEPOSIT ABSOLUTE SYMBOL_LINK "TQ_X_ESPD_DLT" 2 /end AXIS_PTS
/begin AXIS_PTS TQ_X_ESPD_RT "engine speed ratio breakpoint" 0x0002006C NO_INPUT_QUANTITY SSV__SWORD_S 0 u_pct_s 11 -200 199.993896484375 DEPOSIT ABSOLUTE SYMBOL_LINK "TQ_X_ESPD_RT" 2 /end AXIS_PTS
/begin CHARACTERISTIC TQ_C_EXT_ESPD_TORQ_FAC "External engine speed request base torque factor." CURVE 0x000200B0 __UWORD_S 0 u_fac_128 0 127.998046875 FORMAT "%5.3" SYMBOL_LINK "TQ_C_EXT_ESPD_TORQ_FAC" 2
 /begin AXIS_DESCR COM_AXIS NO_INPUT_QUANTITY u_pct_s 11 -200 199.993896484375 AXIS_PTS_REF TQ_X_ESPD_RT /end AXIS_DESCR
/end CHARACTERISTIC
/begin CHARACTERISTIC TQ_V_ROT_J "Engine crank rotational inertia in rad.kg.m2 (2 * pi *J [kg.m2]ï¼‰used to calculate the rotational inertia torque of the engine." VALUE 0x0002038C __UWORD_S 0 u_fac_2 0 1.999969482421875 FORMAT "%4.3" /end CHARACTERISTIC
/begin AXIS_PTS TQ_X_VSPD "Vehicle speed breakpoint" 0x0002006C sys_veh_spd SSV__UWORD_S 0 u_vspd 8 0 511.9921875 DEPOSIT ABSOLUTE SYMBOL_LINK "TQ_X_VSPD" 2 /end AXIS_PTS
/begin AXIS_PTS TQ_X_PPS_B "pedal position breakpoint" 0x0002006C NO_INPUT_QUANTITY SSV__UWORD_S 0 u_pct 8 0 199.996948 DEPOSIT ABSOLUTE SYMBOL_LINK "TQ_X_PPS_B" 2 /end AXIS_PTS
/begin AXIS_PTS TQ_X_OIL_TEMP "Oil temperature breakpoint" 0x0002006C sys_trs_oil_t SSV__SWORD_S 0 u_deg_C 6 -256 255.9921875 DEPOSIT ABSOLUTE SYMBOL_LINK "TQ_X_OIL_TEMP" 2 /end AXIS_PTS
/begin CHARACTERISTIC TQ_M_EXT_ESPD_VSPD_FAC "External engine speed control vehicle speed factor." MAP 0x00020320 __UWORD_S 0 u_fac_2 0 1.999969482421875 FORMAT "%4.3" SYMBOL_LINK "TQ_M_EXT_ESPD_VSPD_FAC" 4
 /begin AXIS_DESCR COM_AXIS NO_INPUT_QUANTITY u_pct 8 0 199.996948 AXIS_PTS_REF TQ_X_PPS_B /end AXIS_DESCR
 /begin AXIS_DESCR COM_AXIS sys_veh_spd u_vspd 8 0 511.9921875 AXIS_PTS_REF TQ_X_VSPD /end AXIS_DESCR
/end CHARACTERISTIC
/begin CHARACTERISTIC TQ_M_EXT_ESPD_OILT_FAC "External engine speed control oil temperature factor." MAP 0x00020320 __UWORD_S 0 u_fac_2 0 1.999969482421875 FORMAT "%4.3" SYMBOL_LINK "TQ_M_EXT_ESPD_OILT_FAC" 4
 /begin AXIS_DESCR COM_AXIS sys_trs_oil_t u_deg_C 6 -256 255.9921875 AXIS_PTS_REF TQ_X_OIL_TEMP /end AXIS_DESCR
 /begin AXIS_DESCR COM_AXIS sys_veh_spd u_vspd 8 0 511.9921875 AXIS_PTS_REF TQ_X_VSPD /end AXIS_DESCR
/end CHARACTERISTIC
/begin CHARACTERISTIC TQ_M_EXT_ESPD_TORQ_OFST "External engine speed control base flywheel torque offset." MAP 0x00020320 __SWORD_S 0 u_tq -2048 2047.9375 FORMAT "%5.2" SYMBOL_LINK "TQ_M_EXT_ESPD_TORQ_OFST" 4
 /begin AXIS_DESCR FIX_AXIS tq_veh_gr_st u_tq_gr_typ 11 0 10 /begin FIX_AXIS_PAR_LIST 0 1 2 3 4 5 6 7 8 9 10 /end FIX_AXIS_PAR_LIST /end AXIS_DESCR
 /begin AXIS_DESCR COM_AXIS NO_INPUT_QUANTITY u_pct_s 11 -200 199.993896484375 AXIS_PTS_REF TQ_X_ESPD_RT /end AXIS_DESCR
/end CHARACTERISTIC
/begin CHARACTERISTIC TQ_V_EXT_ESPD_CHNG_THRSH "External engine speed control speed change rate threshold,change rate beyond this cal,the base torque determined by internal flywheel torque and clutch load torque with a weight." VALUE 0x0002038C __SWORD_S 0 u_espd_n4096_p4096 -4096 4095.875 /end CHARACTERISTIC
/begin AXIS_PTS TQ_X_ESPD_RT_B "engine speed ratio breakpoint" 0x0002006C NO_INPUT_QUANTITY SSV__SWORD_S 0 u_pct_s 11 -200 199.993896484375 DEPOSIT ABSOLUTE SYMBOL_LINK "TQ_X_ESPD_RT_B" 2 /end AXIS_PTS
/begin CHARACTERISTIC TQ_C_EXT_ESPD_TORQ_SP_WGHT "Internal torque setpoint weight." CURVE 0x000200B0 __UWORD_S 0 u_fac_1 0 0.999984741210937 SYMBOL_LINK "TQ_C_EXT_ESPD_TORQ_SP_WGHT" 2
 /begin AXIS_DESCR COM_AXIS NO_INPUT_QUANTITY u_pct_s 11 -200 199.993896484375 AXIS_PTS_REF TQ_X_ESPD_RT_B /end AXIS_DESCR
/end CHARACTERISTIC
/begin CHARACTERISTIC TQ_M_EXT_ESPD_TORQ_PWRON_DS "External engine speed control base torque when pedal depressed and down shifting." MAP 0x00020320 __SWORD_S 0 u_tq -2048 2047.9375 FORMAT "%5.2" SYMBOL_LINK "TQ_M_EXT_ESPD_TORQ_PWRON_DS" 4
 /begin AXIS_DESCR FIX_AXIS tq_veh_gr_st_sp u_tq_gr_typ 11 0 10 /begin FIX_AXIS_PAR_LIST 0 1 2 3 4 5 6 7 8 9 10 /end FIX_AXIS_PAR_LIST /end AXIS_DESCR
 /begin AXIS_DESCR COM_AXIS NO_INPUT_QUANTITY u_pct 8 0 199.996948 AXIS_PTS_REF TQ_X_PPS_B /end AXIS_DESCR
/end CHARACTERISTIC
/begin CHARACTERISTIC TQ_M_EXT_ESPD_PROP "Proportional torque term for RPM control based on the target RPM error." MAP 0x00020320 __SWORD_S 0 u_tq -2048 2047.9375 FORMAT "%5.2" SYMBOL_LINK "TQ_M_EXT_ESPD_PROP" 4
 /begin AXIS_DESCR COM_AXIS NO_INPUT_QUANTITY u_espd 8 -4096 4095.875 AXIS_PTS_REF TQ_X_ESPD_DLT /end AXIS_DESCR
 /begin AXIS_DESCR COM_AXIS sys_eng_spd u_espd 5 0 8191.875 AXIS_PTS_REF TQ_X_ESPD_I /end AXIS_DESCR
/end CHARACTERISTIC
/begin CHARACTERISTIC TQ_M_EXT_ESPD_DERV "Derivative gain used to determine the RPM control torque based on the derivative of the target RPM error." MAP 0x00020320 __SWORD_S 0 u_tq_per_rpm -8 7.999755859375 SYMBOL_LINK "TQ_M_EXT_ESPD_DERV" 4
 /begin AXIS_DESCR COM_AXIS NO_INPUT_QUANTITY u_espd 8 -4096 4095.875 AXIS_PTS_REF TQ_X_ESPD_DLT /end AXIS_DESCR
 /begin AXIS_DESCR COM_AXIS sys_eng_spd u_espd 5 0 8191.875 AXIS_PTS_REF TQ_X_ESPD_I /end AXIS_DESCR
/end CHARACTERISTIC
/begin CHARACTERISTIC TQ_M_EXT_ESPD_INT "Integral gain used to determine the RPM control torque based on the target RPM error. " MAP 0x00020320 __SWORD_S 0 u_tq_per_rpm -8 7.999755859375 SYMBOL_LINK "TQ_M_EXT_ESPD_INT" 4
 /begin AXIS_DESCR COM_AXIS NO_INPUT_QUANTITY u_espd 8 -4096 4095.875 AXIS_PTS_REF TQ_X_ESPD_DLT /end AXIS_DESCR
 /begin AXIS_DESCR COM_AXIS sys_eng_spd u_espd 5 0 8191.875 AXIS_PTS_REF TQ_X_ESPD_I /end AXIS_DESCR
/end CHARACTERISTIC
/begin CHARACTERISTIC TQ_V_EXT_ESPD_INT_DB "When the difference between the engine speed and the target RPM is less than this value, the integral portion of the RPM control torque determination will be held." VALUE 0x0002038C __SWORD_S 0 u_espd_n4096_p4096 -4096 4095.875 /end CHARACTERISTIC
/begin CHARACTERISTIC TQ_C_EXT_ESPD_TORQ_LMT_RMP_LNCH "External engine speed control torque setpoint limit ramp out in launch mode." CURVE 0x000200B0 __SWORD_S 0 u_tq -2048 2047.9375 FORMAT "%5.2" SYMBOL_LINK "TQ_C_EXT_ESPD_TORQ_LMT_RMP_LNCH" 2
 /begin AXIS_DESCR COM_AXIS NO_INPUT_QUANTITY u_pct 8 0 199.996948 AXIS_PTS_REF TQ_X_PPS_B /end AXIS_DESCR
/end CHARACTERISTIC
/begin CHARACTERISTIC TQ_C_EXT_ESPD_TORQ_LMT_RMP "External engine speed control torque setpoint limit ramp out." CURVE 0x000200B0 __SWORD_S 0 u_tq -2048 2047.9375 FORMAT "%5.2" SYMBOL_LINK "TQ_C_EXT_ESPD_TORQ_LMT_RMP" 2
 /begin AXIS_DESCR COM_AXIS NO_INPUT_QUANTITY u_pct 8 0 199.996948 AXIS_PTS_REF TQ_X_PPS_B /end AXIS_DESCR
/end CHARACTERISTIC
/begin CHARACTERISTIC TQ_V_EXT_ESPD_TORQ_LMT_RMP_IN "External engine speed control torque setpoint limit ramp in." VALUE 0x0002038C __SWORD_S 0 u_tq -2048 2047.9375 FORMAT "%5.2" /end CHARACTERISTIC
/begin CHARACTERISTIC TQ_V_EXT_ESPD_TORQ_DEC_RMP_OUT "External engine speed control torque setpoint decrease ramp out." VALUE 0x0002038C __SWORD_S 0 u_tq -2048 2047.9375 FORMAT "%5.2" /end CHARACTERISTIC
/begin CHARACTERISTIC TQ_V_EXT_ESPD_TORQ_DEC_RMP_IN "External engine speed control torque setpoint decrease ramp in." VALUE 0x0002038C __SWORD_S 0 u_tq -2048 2047.9375 FORMAT "%5.2" /end CHARACTERISTIC
/begin CHARACTERISTIC TQ_V_EXT_ESPD_TORQ_INC_RMP_OUT "External engine speed control torque setpoint increase ramp out." VALUE 0x0002038C __SWORD_S 0 u_tq -2048 2047.9375 FORMAT "%5.2" /end CHARACTERISTIC
/begin CHARACTERISTIC TQ_V_EXT_ESPD_TORQ_INC_RMP_IN "External engine speed control torque setpoint increase ramp in." VALUE 0x0002038C __SWORD_S 0 u_tq -2048 2047.9375 FORMAT "%5.2" /end CHARACTERISTIC
/begin AXIS_PTS TQ_X_ECT "engine coolant temperature breakpoint." 0x0002006C NO_INPUT_QUANTITY SSV__SWORD_S 0 u_deg_C 7 -256 255.9921875 DEPOSIT ABSOLUTE SYMBOL_LINK "TQ_X_ECT" 2 /end AXIS_PTS
/begin AXIS_PTS TQ_X_IMEP_RT "IMEP ratio breakpoint." 0x0002006C tq_imep_rt SSV__UWORD_S 0 u_fac_2 7 0 1.999969482421875 FORMAT "%4.3" DEPOSIT ABSOLUTE SYMBOL_LINK "TQ_X_IMEP_RT" 2 /end AXIS_PTS
/begin CHARACTERISTIC TQ_M_IDL_FST_OFST_FAC_PD "Idle torque fast offset factor when in PD idle control." MAP 0x00020320 __UWORD_S 0 u_fac_8 0 7.9998779296875 FORMAT "%3.2" SYMBOL_LINK "TQ_M_IDL_FST_OFST_FAC_PD" 4
 /begin AXIS_DESCR COM_AXIS ensc_espd_dev u_espd_n4096_p4096 19 -4096 4095.875 AXIS_PTS_REF TQ_X_ADD_ESPD_DEV_A /end AXIS_DESCR
 /begin AXIS_DESCR COM_AXIS tq_imep_rt u_fac_2 7 0 1.999969482421875 AXIS_PTS_REF TQ_X_IMEP_RT /end AXIS_DESCR
/end CHARACTERISTIC
/begin CHARACTERISTIC TQ_M_IDL_FST_OFST_FAC "Idle torque fast offset factor when in PID idle control." MAP 0x00020320 __UWORD_S 0 u_fac_8 0 7.9998779296875 FORMAT "%3.2" SYMBOL_LINK "TQ_M_IDL_FST_OFST_FAC" 4
 /begin AXIS_DESCR COM_AXIS sys_ect u_deg_C 7 -256 255.9921875 AXIS_PTS_REF TQ_X_ECT /end AXIS_DESCR
 /begin AXIS_DESCR COM_AXIS NO_INPUT_QUANTITY u_fac_n4_p4 11 -4.000000 3.9998779296875 AXIS_PTS_REF TQ_X_ADD_RATIO /end AXIS_DESCR
/end CHARACTERISTIC
/begin CHARACTERISTIC TQ_C_IDL_FST_OFST_ESPD_DLT_FAC "Idle torque fast offset engine speed delta factor when in PID idle control." CURVE 0x000200B0 __UWORD_S 0 u_fac_1 0 0.999984741210937 SYMBOL_LINK "TQ_C_IDL_FST_OFST_ESPD_DLT_FAC" 2
 /begin AXIS_DESCR COM_AXIS ensc_espd_dev u_espd_n4096_p4096 19 -4096 4095.875 AXIS_PTS_REF TQ_X_ADD_ESPD_DEV_A /end AXIS_DESCR
/end CHARACTERISTIC
/begin CHARACTERISTIC TQ_V_RFST_PPS_THRSH "Ramp fast control mode pedal position threshold." VALUE 0x0002038C __UWORD_S 0 u_pct_r 0 127.998046875 /end CHARACTERISTIC
/begin CHARACTERISTIC TQ_V_RFST_OL "Ramp fast control mode enable in idle open loop mode." VALUE 0x2886C __UBYTE_S 0 b_true 0 1 FORMAT "%1.0" /end CHARACTERISTIC
/begin CHARACTERISTIC TQ_V_PUC_TORQ_CTRL "Torque control in PUC." VALUE 0x2886C __UBYTE_S 0 b_true 0 1 FORMAT "%1.0" /end CHARACTERISTIC
/begin CHARACTERISTIC TQ_V_INRT_PUC_TORQ_CTRL "Enable the consideration of inertia torque when Torque based PUC active." VALUE 0x2886C __UBYTE_S 0 b_true 0 1 FORMAT "%1.0" /end CHARACTERISTIC
/begin CHARACTERISTIC TQ_C_PUC_ENTRY_STP "PUC enter step based on gear." CURVE 0x000200B0 __SWORD_S 0 u_tq_1024 -1024 1023.96875 FORMAT "%6.2"
 /begin AXIS_DESCR FIX_AXIS tq_veh_gr_st_sp u_tq_gr_typ 11 0 10 /begin FIX_AXIS_PAR_LIST 0 1 2 3 4 5 6 7 8 9 10 /end FIX_AXIS_PAR_LIST /end AXIS_DESCR
/end CHARACTERISTIC
/begin CHARACTERISTIC TQ_V_PUC_ENTRY_MN_TORQ_OFST "PUC enter min torque from min flywheel torque offset." VALUE 0x0002038C __SWORD_S 0 u_tq_1024 -1024 1023.96875 FORMAT "%6.2" /end CHARACTERISTIC
/begin CHARACTERISTIC TQ_V_STOMP_PPS_THRSH "Stomp pedal threshold for exit PUC." VALUE 0x0002038C __UWORD_S 0 u_pct 0 199.996948 FORMAT "%4.1" /end CHARACTERISTIC
/begin CHARACTERISTIC TQ_C_PUC_EXIT_DLY "Exit delay time that the current PUC fast torq will be held for exit ramping occurs based on state PUC exit mode." CURVE 0x000200B0 __UWORD_S 0 u_2x_tmr 0 1023.984375
 /begin AXIS_DESCR FIX_AXIS NO_INPUT_QUANTITY u_PUC_exit_dly_mod 5 0 4 /begin FIX_AXIS_PAR_LIST 0 1 2 3 4 /end FIX_AXIS_PAR_LIST /end AXIS_DESCR
/end CHARACTERISTIC
/begin CHARACTERISTIC TQ_C_PUC_EXIT_MN_TORQ_OFST "PUC exit min torque from min flywheel torque offset." CURVE 0x000200B0 __SWORD_S 0 u_tq_1024 -1024 1023.96875 FORMAT "%6.2"
 /begin AXIS_DESCR FIX_AXIS NO_INPUT_QUANTITY u_PUC_exit_dly_mod 5 0 4 /begin FIX_AXIS_PAR_LIST 0 1 2 3 4 /end FIX_AXIS_PAR_LIST /end AXIS_DESCR
/end CHARACTERISTIC
/begin AXIS_PTS TQ_X_ESPD_DLT_RT "Engine speed change rate breakpoint." 0x0002006C sys_espd_acl SSV__SWORD_S 0 u_espd_acl 7 -4096 4095.875 FORMAT "%6.2" DEPOSIT ABSOLUTE SYMBOL_LINK "TQ_X_ESPD_DLT_RT" 2 /end AXIS_PTS
/begin CHARACTERISTIC TQ_C_PUC_EXIT_STP_FAC "Torque based PUC used. PUC torque exit ramp factor based on engine speed changed rate." CURVE 0x000200B0 __UWORD_S 0 u_fac_32 0 31.99951171875 FORMAT "%5.3" SYMBOL_LINK "TQ_C_PUC_EXIT_STP_FAC" 2
 /begin AXIS_DESCR COM_AXIS sys_espd_acl u_espd_acl 7 -4096 4095.875 AXIS_PTS_REF TQ_X_ESPD_DLT_RT /end AXIS_DESCR
/end CHARACTERISTIC
/begin CHARACTERISTIC TQ_V_PUC_EXIT_STP_IDL "PUC exit step when exit mode is race idle." VALUE 0x0002038C __SWORD_S 0 u_tq_1024 -1024 1023.96875 FORMAT "%6.2" /end CHARACTERISTIC
/begin CHARACTERISTIC TQ_V_PUC_EXIT_STP_DECLTCH "PUC exit step when exit mode is declutch." VALUE 0x0002038C __SWORD_S 0 u_tq_1024 -1024 1023.96875 FORMAT "%6.2" /end CHARACTERISTIC
/begin CHARACTERISTIC TQ_M_PUC_EXIT_STP "PUC exit step based on gear and exit mode." MAP 0x00020320 __SWORD_S 0 u_tq_1024 -1024 1023.96875 FORMAT "%6.2"
 /begin AXIS_DESCR FIX_AXIS NO_INPUT_QUANTITY u_PUC_exit_gear 4 0 3 /begin FIX_AXIS_PAR_LIST 0 1 2 3 /end FIX_AXIS_PAR_LIST /end AXIS_DESCR
 /begin AXIS_DESCR FIX_AXIS NO_INPUT_QUANTITY u_PUC_exit_mod 3 0 2 /begin FIX_AXIS_PAR_LIST 0 1 2 /end FIX_AXIS_PAR_LIST /end AXIS_DESCR
/end CHARACTERISTIC
/begin CHARACTERISTIC TQ_M_PUC_EXIT_STP_BRK_OFST "PUC exit step offset when brake is depressed." VALUE 0x0002038C __SWORD_S 0 u_tq_1024 -1024 1023.96875 FORMAT "%6.2" /end CHARACTERISTIC
/begin CHARACTERISTIC TQ_V_PUC_EXIT_STP_FAC_SPRT "Torque based PUC used. PUC torque exit ramp factor when sport mode active." VALUE 0x0002038C __UWORD_S 0 u_fac_32 0 31.99951171875 FORMAT "%4.2" /end CHARACTERISTIC
/begin AXIS_PTS TQ_X_PUC_EXIT_TM "PUC exit active breakpoint." 0x0002006C NO_INPUT_QUANTITY SSV__UWORD_S 0 u_2x_tmr 10 0 1023.984375 DEPOSIT ABSOLUTE SYMBOL_LINK "TQ_X_PUC_EXIT_TM" 2 /end AXIS_PTS
/begin CHARACTERISTIC TQ_M_PUC_EXIT_STP_FAC_TM "Torque based PUC used. PUC torque exit ramp factor based on PUC exit active duration." MAP 0x00020320 __UWORD_S 0 u_fac_1 0 0.999984741210937
 /begin AXIS_DESCR FIX_AXIS NO_INPUT_QUANTITY u_PUC_exit_gear 4 0 3 /begin FIX_AXIS_PAR_LIST 0 1 2 3 /end FIX_AXIS_PAR_LIST /end AXIS_DESCR
 /begin AXIS_DESCR COM_AXIS NO_INPUT_QUANTITY u_2x_tmr 10 0 1023.984375 AXIS_PTS_REF TQ_X_PUC_EXIT_TM /end AXIS_DESCR
/end CHARACTERISTIC
/begin CHARACTERISTIC TQ_V_PUC_EXIT_ESPD_DLT_THRSH "Enable PUC exit engine speed delta threshold." VALUE 0x0002038C __SWORD_S 0 u_espd_n4096_p4096 -4096 4095.875 /end CHARACTERISTIC
/begin CHARACTERISTIC TQ_V_PUC_EXIT_ESPD_DLT_RT_THRSH "Enable PUC exit engine speed delta rate threshold." VALUE 0x0002038C __SWORD_S 0 u_espd_n4096_p4096 -4096 4095.875 /end CHARACTERISTIC
/begin CHARACTERISTIC TQ_V_PUC_EXIT_END_IDL "PUC ramp exit end when idle is active." VALUE 0x2886C __UBYTE_S 0 b_true 0 1 FORMAT "%1.0" /end CHARACTERISTIC
/begin CHARACTERISTIC TQ_V_TCS_INC_FAC "Traction Control System increase request factor." VALUE 0x0002038C __UWORD_S 0 u_fac_2 0 1.999969482421875 FORMAT "%4.3" /end CHARACTERISTIC
/begin CHARACTERISTIC TQ_V_TCS_INC_OFST "Traction Control System increase request offset." VALUE 0x0002038C __SWORD_S 0 u_tq -2048 2047.9375 FORMAT "%5.2" /end CHARACTERISTIC
/begin CHARACTERISTIC TQ_V_TCS_INC_FLYW_TYP "Traction Control System increase request torque is flywheel torque,else is indicate torque. True:Flywheel torque;False:Indicate torque." VALUE 0x2886C __UBYTE_S 0 b_true 0 1 FORMAT "%1.0" /end CHARACTERISTIC
/begin CHARACTERISTIC TQ_V_TCS_LMT_FAC "Traction Control System limit request factor." VALUE 0x0002038C __UWORD_S 0 u_fac_2 0 1.999969482421875 FORMAT "%4.3" /end CHARACTERISTIC
/begin CHARACTERISTIC TQ_V_TCS_LMT_OFST "Traction Control System limit request offset." VALUE 0x0002038C __SWORD_S 0 u_tq -2048 2047.9375 FORMAT "%5.2" /end CHARACTERISTIC
/begin CHARACTERISTIC TQ_V_TCS_LMT_FLYW_TYP "Traction Control System limit request torque is flywheel torque,else is indicate torque. True:Flywheel torque;False:Indicate torque." VALUE 0x2886C __UBYTE_S 0 b_true 0 1 FORMAT "%1.0" /end CHARACTERISTIC
/begin CHARACTERISTIC TQ_V_TCS_DEC_FAC "Traction Control System decrease request factor." VALUE 0x0002038C __UWORD_S 0 u_fac_2 0 1.999969482421875 FORMAT "%4.3" /end CHARACTERISTIC
/begin CHARACTERISTIC TQ_V_TCS_DEC_OFST "Traction Control System decrease request offset." VALUE 0x0002038C __SWORD_S 0 u_tq -2048 2047.9375 FORMAT "%5.2" /end CHARACTERISTIC
/begin CHARACTERISTIC TQ_V_TCS_DEC_FLYW_TYP "Traction Control System decrease request torque is flywheel torque,else is indicate torque. True:Flywheel torque;False:Indicate torque." VALUE 0x2886C __UBYTE_S 0 b_true 0 1 FORMAT "%1.0" /end CHARACTERISTIC
/begin AXIS_PTS TQ_X_TORQ_DLT "Torque delta breakpoint." 0x0002006C NO_INPUT_QUANTITY SSV__SWORD_S 0 u_tq 5 -2048 2047.9375 FORMAT "%5.2" DEPOSIT ABSOLUTE SYMBOL_LINK "TQ_X_TORQ_DLT" 2 /end AXIS_PTS
/begin CHARACTERISTIC TQ_C_ADD_INC_TORQ "The difference between actual fast torque and torque setpoint should be compensated by additional torque,this cal get additional torque increase value." CURVE 0x000200B0 __UBYTE_S 0 u_tq_b 0 127.5 SYMBOL_LINK "TQ_C_ADD_INC_TORQ" 2
 /begin AXIS_DESCR COM_AXIS NO_INPUT_QUANTITY u_tq 5 -2048 2047.9375 AXIS_PTS_REF TQ_X_TORQ_DLT /end AXIS_DESCR
/end CHARACTERISTIC
/begin CHARACTERISTIC TQ_V_TEST_INC_ENBL "Test increase torque enable." VALUE 0x0002038C __UBYTE_S 0 b_true 0 1 FORMAT "%1.0" BIT_MASK 0x80 SYMBOL_LINK "TQ_V_TEST" 0 /end CHARACTERISTIC
/begin CHARACTERISTIC TQ_V_TEST_INC_TORQ_SP "Test increase torque setpoint." VALUE 0x0002038C __SWORD_S 0 u_tq -2048 2047.9375 FORMAT "%5.2" /end CHARACTERISTIC
/begin CHARACTERISTIC TQ_V_DRVBL_ENBL_DLY "Delay after which drivability modifiers are re-enabled after they have been disabled through torque intervention." VALUE 0x2976E __UWORD_S 0 u_2x_tmr 0 1023.984375 /end CHARACTERISTIC
/begin CHARACTERISTIC TQ_V_TEST_LMT_ENBL "Test limit torque enable." VALUE 0x0002038C __UBYTE_S 0 b_true 0 1 FORMAT "%1.0" BIT_MASK 0x20 SYMBOL_LINK "TQ_V_TEST" 0 /end CHARACTERISTIC
/begin CHARACTERISTIC TQ_V_TEST_LMT_TORQ_SP "Test limit torque setpoint." VALUE 0x0002038C __SWORD_S 0 u_tq -2048 2047.9375 FORMAT "%5.2" /end CHARACTERISTIC
/begin CHARACTERISTIC TQ_V_DEC_FOFF_PPS_THRSH "When torque source indicates TCM torque decrease active,if pedal larger than this threshold,decide whether use torque fuel cut off based on TQ_V_DEC_FOFF_ENBL, otherwise disable fuel cut off." VALUE 0x0002038C __UWORD_S 0 u_pct 0 199.996948 FORMAT "%4.1" /end CHARACTERISTIC
/begin CHARACTERISTIC TQ_V_DEC_FOFF_ECT_THRSH "When torque source indicates TCM torque decrease active,if coolant temperature larger than this threshold,decide whether use torque fuel cut off based on TQ_V_DEC_FOFF_ENBL, otherwise disable fuel cut off." VALUE 0x0002038C __SWORD_S 0 u_deg_C -256 255.9921875 FORMAT "%4.2" /end CHARACTERISTIC
/begin CHARACTERISTIC TQ_V_DEC_FOFF_ENBL "Allow fuel cut off when a torque decrease request is made by the TCM." VALUE 0x2886C __UBYTE_S 0 b_true 0 1 FORMAT "%1.0" /end CHARACTERISTIC
/begin CHARACTERISTIC TQ_V_EXT_ESPD_FOFF_ENBL "If TRUE, engine speed control for torque decrease requests will be achieved by Fuel Cut Off if necessary." VALUE 0x2886C __UBYTE_S 0 b_true 0 1 FORMAT "%1.0" /end CHARACTERISTIC
/begin CHARACTERISTIC TQ_V_TEST_DEC_ENBL "Test decrease torque enable." VALUE 0x0002038C __UBYTE_S 0 b_true 0 1 FORMAT "%1.0" BIT_MASK 0x40 SYMBOL_LINK "TQ_V_TEST" 0 /end CHARACTERISTIC
/begin CHARACTERISTIC TQ_V_TEST_FOFF_ENBL "Test torque fuel cut off enable." VALUE 0x0002038C __UBYTE_S 0 b_true 0 1 FORMAT "%1.0" BIT_MASK 0x04 SYMBOL_LINK "TQ_V_TEST" 0 /end CHARACTERISTIC
/begin CHARACTERISTIC TQ_V_TEST_DEC_TORQ_SP "Test decrease torque setpoint." VALUE 0x0002038C __SWORD_S 0 u_tq -2048 2047.9375 FORMAT "%5.2" /end CHARACTERISTIC
/begin CHARACTERISTIC TQ_C_LIMP_TORQ "Limp home torque setpoint when ETC limit performance mode active." CURVE 0x000200B0 __UBYTE_S 0 u_tq_b_256 0 255 FORMAT "%5.2" SYMBOL_LINK "TQ_C_LIMP_TORQ" 2
 /begin AXIS_DESCR FIX_AXIS sys_eng_spd u_espd 17 0 8191.875
  /begin FIX_AXIS_PAR_LIST 0 3200 6400 9600 12800 16000 19200 22400 25600 28800 32000 35200 38400 41600 44800 48000 51200 /end FIX_AXIS_PAR_LIST
 /end AXIS_DESCR
/end CHARACTERISTIC
/begin CHARACTERISTIC TQ_V_LIMP_RMP_TM "Time to ramp from normal mode torque to limited performance mode torque." VALUE 0x2976E __UWORD_S 0 u_2x_tmr 0 1023.984375 /end CHARACTERISTIC
/begin CHARACTERISTIC TQ_C_PWRM_TORQ "Power management torque setpoint when ETC power management mode active." CURVE 0x000200B0 __UBYTE_S 0 u_tq_b_256 0 255 FORMAT "%5.2" SYMBOL_LINK "TQ_C_PWRM_TORQ" 2
 /begin AXIS_DESCR FIX_AXIS sys_eng_spd u_espd 17 0 8191.875
  /begin FIX_AXIS_PAR_LIST 0 3200 6400 9600 12800 16000 19200 22400 25600 28800 32000 35200 38400 41600 44800 48000 51200 /end FIX_AXIS_PAR_LIST
 /end AXIS_DESCR
/end CHARACTERISTIC
/begin CHARACTERISTIC TQ_V_PWRM_RMP_TM "Time to ramp from normal mode torque to power management mode torque." VALUE 0x2976E __UWORD_S 0 u_2x_tmr 0 1023.984375 /end CHARACTERISTIC
/begin CHARACTERISTIC TQ_V_CLTCH_FCO_UP_EXIT_ESPD "Used to decide whether automatically calculate the clutch fuel cut off exit engine speed threshold enable." VALUE 0x2886C __UBYTE_S 0 b_true 0 1 FORMAT "%1.0" /end CHARACTERISTIC
/begin CHARACTERISTIC TQ_M_GR_RT "Clutch slip final gear ratio." MAP 0x00020320 __UWORD_S 0 u_fac_32 0 31.99951171875 FORMAT "%4.2"
 /begin AXIS_DESCR FIX_AXIS NO_INPUT_QUANTITY u_gearbox_type 3 0 2 /begin FIX_AXIS_PAR_LIST 0 1 2 /end FIX_AXIS_PAR_LIST /end AXIS_DESCR
 /begin AXIS_DESCR FIX_AXIS NO_INPUT_QUANTITY u_tq_gr_typ 11 0 10 /begin FIX_AXIS_PAR_LIST 0 1 2 3 4 5 6 7 8 9 10 /end FIX_AXIS_PAR_LIST /end AXIS_DESCR
/end CHARACTERISTIC
/begin CHARACTERISTIC TQ_M_CLTCH_FCO_MN_ESPD "Clutch fuel cut off min engine speed." MAP 0x00020320 __UBYTE_S 0 u_espd_b_4096 0 4080 FORMAT "%4.0" SYMBOL_LINK "TQ_M_CLTCH_FCO_MN_ESPD" 3
 /begin AXIS_DESCR FIX_AXIS NO_INPUT_QUANTITY u_tq_gr_typ 11 0 10 /begin FIX_AXIS_PAR_LIST 0 1 2 3 4 5 6 7 8 9 10 /end FIX_AXIS_PAR_LIST /end AXIS_DESCR
 /begin AXIS_DESCR FIX_AXIS sys_ect u_deg_C 7 -256 255.9921875 /begin FIX_AXIS_PAR_LIST -5120 -2560 0 2560 5120 7680 10240 /end FIX_AXIS_PAR_LIST /end AXIS_DESCR
/end CHARACTERISTIC
/begin CHARACTERISTIC TQ_V_CLTCH_FCO_MN_ESPD_HYS "Clutch fuel cut off min engine speed hysteresis." VALUE 0x0002038C __UWORD_S 0 u_espd 0 8191.875 FORMAT "%5.1" /end CHARACTERISTIC
/begin CHARACTERISTIC TQ_V_CLTCH_TYP "Clutch type for torque clutch fuel cut off use." VALUE 0x0002038C __UBYTE_S 0 u_tq_clutch_type 0 3 FORMAT "%1.0" /end CHARACTERISTIC
/begin CHARACTERISTIC TQ_V_CLTCH_FCO_MN_VSPD "Clutch fuel cut off min vehicle speed." VALUE 0x0002038C __UWORD_S 0 u_vspd 0 511.9921875 FORMAT "%5.1" /end CHARACTERISTIC
/begin CHARACTERISTIC TQ_V_CLTCH_FCO_MX_PPS "Clutch fuel cut off max pedal position." VALUE 0x0002038C __UWORD_S 0 u_pct_r 0 127.998046875 /end CHARACTERISTIC
/begin CHARACTERISTIC TQ_V_CLTCH_FCO_CAT_HT_DSBL "True:Disable clutch fuel cut off during catalyst heating;False:Allow clutch fuel cut off during catalyst heating." VALUE 0x2886C __UBYTE_S 0 b_true 0 1 FORMAT "%1.0" /end CHARACTERISTIC
/begin CHARACTERISTIC TQ_V_CLTCH_FCO_TPO_ESPD "Max engine speed to enable half clutch tip out,for clutch fuel cut off." VALUE 0x0002038C __UWORD_S 0 u_espd 0 8191.875 FORMAT "%5.1" /end CHARACTERISTIC
/begin CHARACTERISTIC TQ_V_CLTCH_FCO_TPO_ESPD_HYS "Max engine speed hysteresis to enable half clutch tip out,for clutch fuel cut off." VALUE 0x0002038C __UWORD_S 0 u_espd 0 8191.875 FORMAT "%5.1" /end CHARACTERISTIC
/begin CHARACTERISTIC TQ_V_CLTCH_FCO_TPO_VSPD "Max vehicle speed to enable half clutch tip out,for clutch fuel cut off." VALUE 0x0002038C __UWORD_S 0 u_vspd 0 511.9921875 FORMAT "%5.1" /end CHARACTERISTIC
/begin CHARACTERISTIC TQ_V_CLTCH_FCO_TPO_VSPD_HYS "Max vehicle speed hysteresis to enable half clutch tip out,for clutch fuel cut off." VALUE 0x0002038C __UWORD_S 0 u_vspd 0 511.9921875 FORMAT "%5.1" /end CHARACTERISTIC
/begin CHARACTERISTIC TQ_V_CLTCH_FCO_ENBL "True:Use Fuel Cut Off during Clutch fuel cut off.False:Use Spark Retard only during clutch fuel cut off." VALUE 0x2886C __UBYTE_S 0 b_true 0 1 FORMAT "%1.0" /end CHARACTERISTIC
/begin AXIS_PTS TQ_X_ESPD_J "engine speed breakpoint" 0x0002006C sys_eng_spd SSV__UWORD_S 0 u_espd 15 0.000000 8191.875000 FORMAT "%5.1" DEPOSIT ABSOLUTE SYMBOL_LINK "TQ_X_ESPD_J" 2 /end AXIS_PTS
/begin CHARACTERISTIC TQ_C_CLTCH_FCO_EXIT_ESPD_FILT "Clutch fuel cut off exit filter based on engine speed." CURVE 0x000200B0 __UWORD_S 0 u_fac_1 0 0.999984741210937 SYMBOL_LINK "TQ_C_CLTCH_FCO_EXIT_ESPD_FILT" 2
 /begin AXIS_DESCR COM_AXIS sys_eng_spd u_espd 15 0 8191.875 AXIS_PTS_REF TQ_X_ESPD_J /end AXIS_DESCR
/end CHARACTERISTIC
/begin AXIS_PTS TQ_X_CLTCH_FCO_TM "clutch fuel cut off time breakpoint" 0x0002006C NO_INPUT_QUANTITY SSV__UWORD_S 0 u_2x_tmr 11 0.000000 1023.984375 DEPOSIT ABSOLUTE SYMBOL_LINK "TQ_X_CLTCH_FCO_TM" 2 /end AXIS_PTS
/begin CHARACTERISTIC TQ_C_CLTCH_FCO_EXIT_TM_FILT "Clutch fuel cut off exit filter based on fuel cut off duration." CURVE 0x000200B0 __UWORD_S 0 u_fac_1 0 0.999984741210937 SYMBOL_LINK "TQ_C_CLTCH_FCO_EXIT_TM_FILT" 2
 /begin AXIS_DESCR COM_AXIS NO_INPUT_QUANTITY u_2x_tmr 11 0.000000 1023.984375 AXIS_PTS_REF TQ_X_CLTCH_FCO_TM /end AXIS_DESCR
/end CHARACTERISTIC
/begin CHARACTERISTIC TQ_V_CLTCH_FCO_MN_TORQ "Torque calibration use to override fast torque setpoint when fuel cut off due to de-clutch action is active. " VALUE 0x0002038C __SWORD_S 0 u_tq -2048 2047.9375 FORMAT "%5.2" /end CHARACTERISTIC
/begin CHARACTERISTIC TQ_V_TPO_CTRL_MOD "True:Fast lead control during tip out decay.False:Slow lead control during tip out decay." VALUE 0x2886C __UBYTE_S 0 b_true 0 1 FORMAT "%1.0" /end CHARACTERISTIC
/begin CHARACTERISTIC TQ_V_TPO_IGA_RTD_ENBL "Enables sprk control (Retard) during slow lead control tip out(torq decrease)." VALUE 0x2886C __UBYTE_S 0 b_true 0 1 FORMAT "%1.0" /end CHARACTERISTIC
/begin CHARACTERISTIC TQ_V_TPO_FCO_MN_ESPD "Min engine speed to allow fast tip out torque control fuel cut off." VALUE 0x0002038C __UWORD_S 0 u_espd 0 8191.875 FORMAT "%5.1" /end CHARACTERISTIC
/begin CHARACTERISTIC TQ_V_TPO_FCO_MN_ECT "Min engine coolant temperature to allow fast tip out torque control fuel cut off." VALUE 0x0002038C __SWORD_S 0 u_deg_C -256 255.9921875 FORMAT "%4.2" /end CHARACTERISTIC
/begin CHARACTERISTIC TQ_V_SURG_FCO_ENBL "Fuel cut off is allowed when anti surge is active." VALUE 0x2886C __UBYTE_S 0 b_true 0 1 FORMAT "%1.0" /end CHARACTERISTIC
/begin CHARACTERISTIC TQ_V_SURG_INIT_TM "Initialization time for antisurge torque lower limitation when antisurge condition is met." VALUE 0x2976E __UWORD_S 0 u_2x_tmr 0 1023.984375 /end CHARACTERISTIC
/begin AXIS_PTS TQ_X_PQ "pressure quotient breakpoint" 0x0002006C NO_INPUT_QUANTITY SSV__UWORD_S 0 u_fac_8 20 0.000000 7.9998779296875 FORMAT "%3.2" DEPOSIT ABSOLUTE SYMBOL_LINK "TQ_X_PQ" 2 /end AXIS_PTS
/begin CHARACTERISTIC TQ_M_SURG_MX_SLW_TORQ "The slow torque will be limited no less than this table if turbo anti surge control is enabled." MAP 0x00020320 __SBYTE_S 0 u_tq_b_512n_512p -512 508 SYMBOL_LINK "TQ_M_SURG_MX_SLW_TORQ" 3
 /begin AXIS_DESCR COM_AXIS NO_INPUT_QUANTITY u_espd 17 0 8191.875 AXIS_PTS_REF TQ_X_ESPD_E /end AXIS_DESCR
 /begin AXIS_DESCR COM_AXIS afm_bstp2amp_rt u_fac_8 20 0.000000 7.9998779296875 AXIS_PTS_REF TQ_X_PQ /end AXIS_DESCR
/end CHARACTERISTIC
/begin AXIS_PTS TQ_X_IAT "Intake air temperature breakpoint" 0x0002006C sys_iat SSV__SWORD_S 0 u_deg_C 11 -256 255.9921875 FORMAT "%4.2" DEPOSIT ABSOLUTE SYMBOL_LINK "TQ_X_IAT" 2 /end AXIS_PTS
/begin CHARACTERISTIC TQ_M_SURG_IAT_TORQ_FAC "Factor for slow torque limitation when  turbo anti-surge function is enabled. " MAP 0x00020320 __UBYTE_S 0 u_fac_2_b 0 1.9921875 FORMAT "%4.3" SYMBOL_LINK "TQ_M_SURG_IAT_TORQ_FAC" 3
 /begin AXIS_DESCR COM_AXIS NO_INPUT_QUANTITY u_espd 17 0 8191.875 AXIS_PTS_REF TQ_X_ESPD_E /end AXIS_DESCR
 /begin AXIS_DESCR COM_AXIS sys_iat u_deg_C 11 -256 255.9921875 AXIS_PTS_REF TQ_X_IAT /end AXIS_DESCR
/end CHARACTERISTIC
/begin AXIS_PTS TQ_X_AMP_B "Ambient pressure breakpoint" 0x0002006C sys_amp SSV__UWORD_S 0 u_kPa_0_256 7 0 255.996094 DEPOSIT ABSOLUTE SYMBOL_LINK "TQ_X_AMP_B" 2 /end AXIS_PTS
/begin CHARACTERISTIC TQ_M_SURG_AMP_TORQ_FAC "Factor for slow torque limitation when  turbo anti-surge function is enabled. " MAP 0x00020320 __UBYTE_S 0 u_fac_2_b 0 1.9921875 FORMAT "%4.3" SYMBOL_LINK "TQ_M_SURG_AMP_TORQ_FAC" 3
 /begin AXIS_DESCR COM_AXIS NO_INPUT_QUANTITY u_espd 17 0 8191.875 AXIS_PTS_REF TQ_X_ESPD_E /end AXIS_DESCR
 /begin AXIS_DESCR COM_AXIS sys_amp u_kPa_0_256 7 0 255.996094 AXIS_PTS_REF TQ_X_AMP_B /end AXIS_DESCR
/end CHARACTERISTIC
/begin AXIS_PTS TQ_X_DCY_TM "Anti surge decay time breakpoint" 0x0002006C NO_INPUT_QUANTITY SSV__UWORD_S 0 u_2x_tmr 11 0 1023.984375 DEPOSIT ABSOLUTE SYMBOL_LINK "TQ_X_DCY_TM" 2 /end AXIS_PTS
/begin CHARACTERISTIC TQ_C_SURG_DCY_FAC "Decay factor for slow torque limitation when turbo anti-surge function is enabled." CURVE 0x000200B0 __UBYTE_S 0 u_fac_2_b 0 1.9921875 FORMAT "%4.3" SYMBOL_LINK "TQ_C_SURG_DCY_FAC" 2
 /begin AXIS_DESCR COM_AXIS NO_INPUT_QUANTITY u_2x_tmr 11 0.000000 1023.984375 AXIS_PTS_REF TQ_X_DCY_TM /end AXIS_DESCR
/end CHARACTERISTIC
/begin CHARACTERISTIC TQ_C_RMP_FST_TM "Ramp fast lead active duration after TCU/ABS torque increase mode." CURVE 0x000200B0 __UWORD_S 0 u_2x_tmr 0 1023.984375 SYMBOL_LINK "TQ_C_RMP_FST_TM" 2
 /begin AXIS_DESCR FIX_AXIS sys_eng_spd u_espd 5 0.000000 8191.875 /begin FIX_AXIS_PAR_LIST 8000 16000 24000 32000 40000 /end FIX_AXIS_PAR_LIST /end AXIS_DESCR
/end CHARACTERISTIC
/begin CHARACTERISTIC TQ_V_TEST_CTRL_MOD "Test torque control mode." VALUE 0x0002038C __UBYTE_S 0 u_tq_test_ctrl_mod 0 3 FORMAT "%1.0" BIT_MASK 0x03 SYMBOL_LINK "TQ_V_TEST" 0 /end CHARACTERISTIC
/begin AXIS_PTS TQ_X_ESPD_K "engine speed breakpoint" 0x0002006C sys_eng_spd SSV__UWORD_S 0 u_espd 19 0.000000 8191.875000 FORMAT "%5.1" DEPOSIT ABSOLUTE SYMBOL_LINK "TQ_X_ESPD_K" 2 /end AXIS_PTS
/begin CHARACTERISTIC TQ_C_MX_IMEP "Maximum allowed desired average cylinder pressure used to limit pressure in the combustion chamber to protect engine components." CURVE 0x000200B0 __UWORD_S 0 u_kPa_0_4096 0 4095.937500 FORMAT "%5.2" SYMBOL_LINK "TQ_C_MX_IMEP" 2
 /begin AXIS_DESCR COM_AXIS sys_eng_spd u_espd 19 0.000000 8191.875 AXIS_PTS_REF TQ_X_ESPD_K /end AXIS_DESCR
/end CHARACTERISTIC
/begin CHARACTERISTIC TQ_V_LO_IMEP_VSPD_THRSH "Vehicle speed limit below which minimum desired IMEP is 0." VALUE 0x0002038C __UWORD_S 0 u_vspd 0 511.9921875 FORMAT "%5.1" /end CHARACTERISTIC
/begin CHARACTERISTIC TQ_C_LO_IMEP_PUC "Min IMEP setpoint to min limit MAP for low fuel consumption and proper combustion quality.Used only in PUC but not in low speed condition." CURVE 0x000200B0 __UWORD_S 0 u_kPa_0_4096 0 4095.937500 FORMAT "%5.2" SYMBOL_LINK "TQ_C_LO_IMEP_PUC" 2
 /begin AXIS_DESCR FIX_AXIS sys_eng_spd u_espd 9 0.000000 8191.875 /begin FIX_AXIS_PAR_LIST 0 6400 12800 19200 25600 32000 38400 44800 51200 /end FIX_AXIS_PAR_LIST /end AXIS_DESCR
/end CHARACTERISTIC
/begin CHARACTERISTIC TQ_C_LO_IMEP "Min IMEP setpoint to min limit MAP for low fuel consumption and proper combustion quality.Used only NOT in PUC." CURVE 0x000200B0 __UWORD_S 0 u_kPa_0_4096 0 4095.937500 FORMAT "%5.2" SYMBOL_LINK "TQ_C_LO_IMEP" 2
 /begin AXIS_DESCR FIX_AXIS sys_eng_spd u_espd 9 0.000000 8191.875 /begin FIX_AXIS_PAR_LIST 0 6400 12800 19200 25600 32000 38400 44800 51200 /end FIX_AXIS_PAR_LIST /end AXIS_DESCR
/end CHARACTERISTIC
/begin AXIS_PTS TQ_X_AMP_C "Ambient pressure breakpoint" 0x0002006C sys_amp SSV__UWORD_S 0 u_kPa_0_256 7 0 255.996094 DEPOSIT ABSOLUTE SYMBOL_LINK "TQ_X_AMP_C" 2 /end AXIS_PTS
/begin CHARACTERISTIC TQ_C_LO_IMEP_FAC "Min IMEP setpoint to min limit factor." CURVE 0x000200B0 __UWORD_S 0 u_fac_2 0 1.9921875 FORMAT "%4.3" SYMBOL_LINK "TQ_C_LO_IMEP_FAC" 2
 /begin AXIS_DESCR COM_AXIS sys_amp u_kPa_0_256 7 0.000000 255.996094 AXIS_PTS_REF TQ_X_AMP_C /end AXIS_DESCR
/end CHARACTERISTIC
/begin CHARACTERISTIC TQ_V_LO_IMEP_STP_PUC "Step limit(kPa/loop) applied to minimum desired IMEP when entering PUC." VALUE 0x0002038C __UWORD_S 0 u_kPa_0_4096 0 4095.9375 /end CHARACTERISTIC
/begin CHARACTERISTIC TQ_V_LO_IMEP_HYST "Positive hysteresis on the minimum desired IMEP.The desired IMEP must rise above the hysteresis in order to disable the minimum limiting." VALUE 0x0002038C __UWORD_S 0 u_kPa_0_4096 0 4095.9375 /end CHARACTERISTIC
/begin AXIS_PTS TQ_X_REF_TORQ "referenced torque breakpoint" 0x0002006C tq_cltch_sp_pct SSV__UWORD_S 0 u_pct 21 0 199.996948 DEPOSIT ABSOLUTE SYMBOL_LINK "TQ_X_REF_TORQ" 2 /end AXIS_PTS
/begin CHARACTERISTIC TQ_M_R_PED2TQ_PCT "Reverse pedal to torque table." MAP 0x00020320 __UWORD_S 0 u_pct 0 199.996948 SYMBOL_LINK "TQ_M_R_PED2TQ_PCT" 4
 /begin AXIS_DESCR COM_AXIS sys_eng_spd u_espd 17 0 8191.875 AXIS_PTS_REF TQ_X_ESPD_E /end AXIS_DESCR
 /begin AXIS_DESCR COM_AXIS tq_cltch_sp_pct u_pct 21 0 199.996948 AXIS_PTS_REF TQ_X_REF_TORQ /end AXIS_DESCR
/end CHARACTERISTIC
/begin AXIS_PTS TQ_X_TORQ_RT "Torque ratio breakpoint" 0x0002006C tq_imep_rt SSV__UWORD_S 0 u_fac_2 7 0 1.9921875 FORMAT "%4.3" DEPOSIT ABSOLUTE SYMBOL_LINK "TQ_X_TORQ_RT" 2 /end AXIS_PTS
/begin AXIS_PTS TQ_X_ESPD_DLT_B "engine speed delta breakpoint" 0x0002006C NO_INPUT_QUANTITY SSV__SWORD_S 0 u_espd 7 -4096 4095.875000 FORMAT "%5.1" DEPOSIT ABSOLUTE SYMBOL_LINK "TQ_X_ESPD_DLT_B" 2 /end AXIS_PTS
/begin CHARACTERISTIC TQ_M_IDL_FST_OFST_PD_FAC "Before fast idle offset torque added into fast path, it would be modified by this table." MAP 0x00020320 __UWORD_S 0 u_fac_16 0 15.999756 SYMBOL_LINK "TQ_M_IDL_FST_OFST_PD_FAC" 4
 /begin AXIS_DESCR COM_AXIS NO_INPUT_QUANTITY u_espd 7 -4096 4095.875000 AXIS_PTS_REF TQ_X_ESPD_DLT_B /end AXIS_DESCR
 /begin AXIS_DESCR COM_AXIS tq_imep_rt u_fac_2 7 0 1.9921875 AXIS_PTS_REF TQ_X_TORQ_RT /end AXIS_DESCR
/end CHARACTERISTIC
/begin CHARACTERISTIC TQ_V_CTRL_MOD_RMP_S2F_STP "Ramp step per loop to transition from slow to fast lead control mode." VALUE 0x0002038C __UWORD_S 0 u_fac_1 0 0.999984741210937 /end CHARACTERISTIC
/begin CHARACTERISTIC TQ_V_CTRL_MOD_RMP_F2S_STP "Ramp step per loop to transition from fast to slow lead control mode." VALUE 0x0002038C __UWORD_S 0 u_fac_1 0 0.999984741210937 /end CHARACTERISTIC
/begin AXIS_PTS TQ_X_PPS_C "pedal position breakpoint" 0x0002006C NO_INPUT_QUANTITY SSV__UWORD_S 0 u_pct 11 0 199.996948 DEPOSIT ABSOLUTE SYMBOL_LINK "TQ_X_PPS_C" 2 /end AXIS_PTS
/begin AXIS_PTS TQ_X_ESPD_L "engine speed breakpoint" 0x0002006C sys_eng_spd SSV__UWORD_S 0 u_espd 13 0.000000 8191.875000 FORMAT "%5.1" DEPOSIT ABSOLUTE SYMBOL_LINK "TQ_X_ESPD_L" 2 /end AXIS_PTS
/begin CHARACTERISTIC TQ_M_MN_IMEP_FCO_DEC "This calibration define the min actual slow IMEP  threshold to enable the determination of always using max spark retard to response TCM torque decrease request." MAP 0x00020320 __UWORD_S 0 u_kPa_0_4096 0 4095.9375 SYMBOL_LINK "TQ_M_MN_IMEP_FCO_DEC" 4
 /begin AXIS_DESCR COM_AXIS NO_INPUT_QUANTITY u_pct 11 0 199.996948 AXIS_PTS_REF TQ_X_PPS_C /end AXIS_DESCR
 /begin AXIS_DESCR COM_AXIS sys_eng_spd u_espd 13 0 8191.875 AXIS_PTS_REF TQ_X_ESPD_L /end AXIS_DESCR
/end CHARACTERISTIC
/begin CHARACTERISTIC TQ_V_POC_ENBL_PUC "Used to enable the consideration of POC torque when Torque based PUC active." VALUE 0x0002038C __UBYTE_S 0 b_true 0 1 FORMAT "%1.0" /end CHARACTERISTIC
/begin CHARACTERISTIC TQ_C_F_RT_OFF_CYL_PUC "Torque based PUC used. Ratio Fast/Slow IMEP threshold below which an additional cylinder is shut off." CURVE 0x000200B0 __UWORD_S 0 u_fac_2 0 1.999969482421875 FORMAT "%4.3"
 /begin AXIS_DESCR FIX_AXIS NO_INPUT_QUANTITY u_cnts 4 1 4 /begin FIX_AXIS_PAR_LIST 1 2 3 4 /end FIX_AXIS_PAR_LIST /end AXIS_DESCR
/end CHARACTERISTIC
/begin CHARACTERISTIC TQ_C_F_RT_ON_CYL_PUC "Torque based PUC used. Ratio Fast/Slow IMEP threshold below which an additional cylinder is switched on." CURVE 0x000200B0 __UWORD_S 0 u_fac_2 0 1.999969482421875 FORMAT "%4.3"
 /begin AXIS_DESCR FIX_AXIS NO_INPUT_QUANTITY u_cnts 4 1 4 /begin FIX_AXIS_PAR_LIST 1 2 3 4 /end FIX_AXIS_PAR_LIST /end AXIS_DESCR
/end CHARACTERISTIC
/begin CHARACTERISTIC TQ_C_F_RT_OFF_CYL "Ratio Fast/Slow IMEP threshold below which an additional cylinder is shut off." CURVE 0x000200B0 __UWORD_S 0 u_fac_2 0 1.999969482421875 FORMAT "%4.3"
 /begin AXIS_DESCR FIX_AXIS NO_INPUT_QUANTITY u_cnts 4 1 4 /begin FIX_AXIS_PAR_LIST 1 2 3 4 /end FIX_AXIS_PAR_LIST /end AXIS_DESCR
/end CHARACTERISTIC
/begin CHARACTERISTIC TQ_C_F_RT_ON_CYL "Ratio Fast/Slow IMEP threshold below which an additional cylinder is switched on." CURVE 0x000200B0 __UWORD_S 0 u_fac_2 0 1.999969482421875 FORMAT "%4.3"
 /begin AXIS_DESCR FIX_AXIS NO_INPUT_QUANTITY u_cnts 4 1 4 /begin FIX_AXIS_PAR_LIST 1 2 3 4 /end FIX_AXIS_PAR_LIST /end AXIS_DESCR
/end CHARACTERISTIC
/begin CHARACTERISTIC TQ_V_CRK_IG_RTD "When true uses spark advance table lookup and reverse calculates actual and desired spark efficiency." VALUE 0x0002038C __UBYTE_S 0 b_true 0 1 FORMAT "%1.0" /end CHARACTERISTIC
/begin CHARACTERISTIC TQ_M_1STFLR_IG_EFF "First_Fire_to_Run flare ignition efficiency from MBT." MAP 0x00020320 __UWORD_S 0 u_fac_2 0 1.999969482421875 FORMAT "%4.3" SYMBOL_LINK "TQ_M_1STFLR_IG_EFF" 4
 /begin AXIS_DESCR FIX_AXIS sys_eng_spd u_espd 11 0 8191.875 /begin FIX_AXIS_PAR_LIST 0 1600 3200 4800 6400 8000 9600 11200 12800 14400 16000 /end FIX_AXIS_PAR_LIST /end AXIS_DESCR
 /begin AXIS_DESCR FIX_AXIS sys_ect u_deg_C 15 -256 255.9921875
  /begin FIX_AXIS_PAR_LIST -5120 -3584 -2048 -512 1024 2560 4096 5632 7168 8704 10240 11776 13312 14848 16384 /end FIX_AXIS_PAR_LIST
 /end AXIS_DESCR
/end CHARACTERISTIC
/begin CHARACTERISTIC TQ_M_FLR_IG_EFF "Run flare ignition efficiency from MBT." MAP 0x00020320 __UWORD_S 0 u_fac_2 0 1.999969482421875 FORMAT "%4.3" SYMBOL_LINK "TQ_M_FLR_IG_EFF" 4
 /begin AXIS_DESCR FIX_AXIS sys_eng_spd u_espd 11 0 8191.875 /begin FIX_AXIS_PAR_LIST 0 1600 3200 4800 6400 8000 9600 11200 12800 14400 16000 /end FIX_AXIS_PAR_LIST /end AXIS_DESCR
 /begin AXIS_DESCR FIX_AXIS sys_ect u_deg_C 15 -256 255.9921875
  /begin FIX_AXIS_PAR_LIST -5120 -3584 -2048 -512 1024 2560 4096 5632 7168 8704 10240 11776 13312 14848 16384 /end FIX_AXIS_PAR_LIST
 /end AXIS_DESCR
/end CHARACTERISTIC
/begin CHARACTERISTIC TQ_V_IG_RT_CLTCH_FCO "The spark ratio when clutch fuel cut off active and fuel cut off enabled for clutch fuel cut off." VALUE 0x0002038C __UWORD_S 0 u_fac_2 0 1.999969482421875 FORMAT "%4.3" /end CHARACTERISTIC
/begin CHARACTERISTIC TQ_V_IG_RT_ENBL_PUC "Ignition ratio used when PUC." VALUE 0x0002038C __UBYTE_S 0 b_true 0 1 FORMAT "%1.0" /end CHARACTERISTIC
/begin CHARACTERISTIC TQ_M_IG_RT_PUC "Ignition ratio when PUC." MAP 0x00020320 __UWORD_S 0 u_fac_2 0 1.999969482421875 FORMAT "%4.3" SYMBOL_LINK "TQ_M_IG_RT_PUC" 4
 /begin AXIS_DESCR FIX_AXIS NO_INPUT_QUANTITY u_ac_st 2 0 1 /begin FIX_AXIS_PAR_LIST 0 1 /end FIX_AXIS_PAR_LIST /end AXIS_DESCR
 /begin AXIS_DESCR FIX_AXIS tq_fuel_rt u_fac_2 5 0 1.999969482421875 /begin FIX_AXIS_PAR_LIST 0 8192 16384 24576 32768 /end FIX_AXIS_PAR_LIST /end AXIS_DESCR
/end CHARACTERISTIC
/begin CHARACTERISTIC TQ_V_ADD_OFF_PPS_VSPD_THRSH "Vehicle speed threshold below at which the closed pedal additional torque can be initiated." VALUE 0x0002038C __UWORD_S 0 u_vspd 0 511.9921875 /end CHARACTERISTIC
/begin CHARACTERISTIC TQ_V_ADD_OFF_PPS_MAP_THRSH "Normalized MAP threshold below at which the closed pedal additional torque can be initiated." VALUE 0x0002038C __UWORD_S 0 u_kPa_0_256 0 255.99609375 FORMAT "%4.1" /end CHARACTERISTIC
/begin AXIS_PTS TQ_X_ECT_B "engine coolant temperature breakpoint." 0x0002006C sys_ect SSV__SWORD_S 0 u_deg_C 5 -256 255.9921875 DEPOSIT ABSOLUTE SYMBOL_LINK "TQ_X_ECT_B" 2 /end AXIS_PTS
/begin CHARACTERISTIC TQ_C_ADD_OFF_PPS_TM_THRSH "Engine run time threshold beyond at which the closed pedal additional torque can be initiated." CURVE 0x000200B0 __UBYTE_S 0 u_cnts 0 255 SYMBOL_LINK "TQ_C_ADD_OFF_PPS_TM_THRSH" 2
 /begin AXIS_DESCR COM_AXIS sys_ect u_deg_C 5 -256 255.9921875 AXIS_PTS_REF TQ_X_ECT_B /end AXIS_DESCR
/end CHARACTERISTIC
/begin CHARACTERISTIC TQ_V_ADD_AT_TM "Time that initial Auto transmission compensation is applied to the idle additional torque" VALUE 0x0002038C __UWORD_S 0 u_2x_tmr 0.0 1023.984375 /end CHARACTERISTIC
/begin CHARACTERISTIC TQ_V_ADD_AT_IDL_WRM "Control additional in idle when Auto Transmission is in gear (steady state) and Light-Off active." VALUE 0x0002038C __SWORD_S 0 u_tq_1024 -1024 1023.96875 FORMAT "%6.2" /end CHARACTERISTIC
/begin CHARACTERISTIC TQ_V_ADD_AT_IDL "Control additional in idle when Auto Transmission is in gear (steady state)." VALUE 0x0002038C __SWORD_S 0 u_tq_1024 -1024 1023.96875 FORMAT "%6.2" /end CHARACTERISTIC
/begin CHARACTERISTIC TQ_V_ADD_AT_IDL_IN "Additional control reserve in idle when Auto Transmission is initially shifted into gear (dynamic)." VALUE 0x0002038C __SWORD_S 0 u_tq_1024 -1024 1023.96875 FORMAT "%6.2" /end CHARACTERISTIC
/begin CHARACTERISTIC TQ_V_ADD_AT_IDL_OUT "Additional control reserve in idle when Auto Transmission is initially shifted outo gear (dynamic)." VALUE 0x0002038C __SWORD_S 0 u_tq_1024 -1024 1023.96875 FORMAT "%6.2" /end CHARACTERISTIC
/begin AXIS_PTS TQ_X_TQ_DLT "Torque delta breakpoint" 0x0002006C NO_INPUT_QUANTITY SSV__SWORD_S 0 u_tq 9 -2048 2047.9375 FORMAT "%6.2" DEPOSIT ABSOLUTE SYMBOL_LINK "TQ_X_TQ_DLT" 2 /end AXIS_PTS
/begin AXIS_PTS TQ_X_TQ "Torque breakpoint" 0x0002006C NO_INPUT_QUANTITY SSV__SWORD_S 0 u_tq 7 -2048 2047.9375 FORMAT "%6.2" DEPOSIT ABSOLUTE SYMBOL_LINK "TQ_X_TQ" 2 /end AXIS_PTS
/begin CHARACTERISTIC TQ_M_ADD_CRP "AMT,DCT,CVT creeping additional torque." MAP 0x00020320 __UBYTE_S 0 u_tq_b 0 127.5 SYMBOL_LINK "TQ_M_ADD_CRP" 3
 /begin AXIS_DESCR COM_AXIS NO_INPUT_QUANTITY u_tq 7 -2048 2047.9375 AXIS_PTS_REF TQ_X_TQ /end AXIS_DESCR
 /begin AXIS_DESCR COM_AXIS NO_INPUT_QUANTITY u_tq 9 -2048 2047.9375 AXIS_PTS_REF TQ_X_TQ_DLT /end AXIS_DESCR
/end CHARACTERISTIC
/begin CHARACTERISTIC TQ_V_ADD_CRP_RMP_THRSH "Additional torque ramping lower absolute threshold for creeping, below which,creeping reserve torque changes will take place immediately.." VALUE 0x0002038C __SWORD_S 0 u_tq_1024 -1024 1023.96875 FORMAT "%6.2" /end CHARACTERISTIC
/begin CHARACTERISTIC TQ_V_ADD_CRP_RMP_INC "Additional torque increase ramp step when creeping." VALUE 0x0002038C __SWORD_S 0 u_tq_1024 -1024 1023.96875 FORMAT "%6.2" /end CHARACTERISTIC
/begin CHARACTERISTIC TQ_V_ADD_CRP_RMP_DEC "Additional torque decrease ramp step when creeping." VALUE 0x0002038C __SWORD_S 0 u_tq_1024 -1024 1023.96875 FORMAT "%6.2" /end CHARACTERISTIC
/begin CHARACTERISTIC TQ_M_ADD_WRM "Additional torque when warm up in idle open loop." MAP 0x00020320 __UBYTE_S 0 u_tq_b_256 0 255 FORMAT "%3.0" SYMBOL_LINK "TQ_M_ADD_WRM" 3
 /begin AXIS_DESCR COM_AXIS tq_imep_ref u_kPa_0_4096 17 0.000000 4095.937500 AXIS_PTS_REF TQ_X_IMEP_REF /end AXIS_DESCR
 /begin AXIS_DESCR COM_AXIS sys_eng_spd u_espd 20 0.000000 8191.875000 AXIS_PTS_REF TQ_X_ESPD_M /end AXIS_DESCR
/end CHARACTERISTIC
/begin AXIS_PTS TQ_X_ESPD_M "engine speed breakpoint" 0x0002006C sys_eng_spd SSV__UWORD_S 0 u_espd 20 0.000000 8191.875000 FORMAT "%5.1" DEPOSIT ABSOLUTE SYMBOL_LINK "TQ_X_ESPD_M" 2 /end AXIS_PTS
/begin CHARACTERISTIC TQ_M_ADD_PFST_ECT_FAC "When positive PD idle offset,additional torque should be modified by this factor." MAP 0x00020320 __UWORD_S 0 u_fac_8 0 7.9998779296875 FORMAT "%3.2" SYMBOL_LINK "TQ_M_ADD_PFST_ECT_FAC" 4
 /begin AXIS_DESCR COM_AXIS sys_ect u_deg_C 7 -256 255.9921875 AXIS_PTS_REF TQ_X_ECT /end AXIS_DESCR
 /begin AXIS_DESCR COM_AXIS NO_INPUT_QUANTITY u_fac_n4_p4 11 -4.000000 3.9998779296875 AXIS_PTS_REF TQ_X_ADD_RATIO /end AXIS_DESCR
/end CHARACTERISTIC
/begin CHARACTERISTIC TQ_C_ADD_PFST_ESPD_FAC "When positive PD idle offset,additional torque should be modified by this factor." CURVE 0x000200B0 __UBYTE_S 0 u_fac_2_b 0 1.9921875 FORMAT "%4.3" SYMBOL_LINK "TQ_C_ADD_PFST_ESPD_FAC" 2
 /begin AXIS_DESCR COM_AXIS ensc_espd_dev u_espd_n4096_p4096 19 -4096 4095.875 AXIS_PTS_REF TQ_X_ADD_ESPD_DEV_A /end AXIS_DESCR
/end CHARACTERISTIC
/begin CHARACTERISTIC TQ_V_ADD_RMP_MX "Maximum Idle Offset Torque included in the Raw additional torque used to ramp the total desired torque." VALUE 0x0002038C __SWORD_S 0 u_tq_1024 -1024 1023.96875 FORMAT "%6.2" /end CHARACTERISTIC
/begin CHARACTERISTIC TQ_V_ADD_LNCH_MN "Minimum additional torque setpoint in launch condition." VALUE 0x0002038C __SWORD_S 0 u_tq_1024 -1024 1023.96875 FORMAT "%6.2" /end CHARACTERISTIC
/begin CHARACTERISTIC TQ_V_ADD_MX_MRG "Max available additional torque margin." VALUE 0x0002038C __SWORD_S 0 u_tq_1024 -1024 1023.96875 FORMAT "%6.2" /end CHARACTERISTIC
/begin CHARACTERISTIC TQ_V_POC_AT_TRNS "If False, the engagement status of transmission won't be concerned during POC.If True, POC will be disabled while TCC is not locked and clutch status is not closed for non-MT vehicles." VALUE 0x2886C __UBYTE_S 0 b_true 0 1 FORMAT "%1.0" /end CHARACTERISTIC
/begin CHARACTERISTIC TQ_V_POC_HCLTCH_MN_TORQ "Min actual slow flywheel torque threshold to enable half clutch POC." VALUE 0x0002038C __SWORD_S 0 u_tq -2048 2047.9375 FORMAT "%5.2" /end CHARACTERISTIC
/begin CHARACTERISTIC TQ_V_POC_HCLTCH_MN_PPS "Min pedal position threshold to enable half clutch POC." VALUE 0x0002038C __UWORD_S 0 u_pct 0 199.996948 FORMAT "%4.1" /end CHARACTERISTIC
/begin CHARACTERISTIC TQ_V_POC_HCLTCH_INRT "Indicates thatinertia torque has Zero-Cross." VALUE 0x0002038C __SWORD_S 0 u_tq -2048 2047.9375 FORMAT "%5.2" /end CHARACTERISTIC
/begin CHARACTERISTIC TQ_V_POC_MN_VSPD "POC enable when vehicle speed beyond this threshold." VALUE 0x0002038C __UWORD_S 0 u_vspd 0 511.9921875 /end CHARACTERISTIC
/begin CHARACTERISTIC TQ_V_POC_TM "Disable POC if engine runtime is less than this threshold." VALUE 0x0002038C __UWORD_S 0 u_cnts 0 65535 FORMAT "%5.0" /end CHARACTERISTIC
/begin CHARACTERISTIC TQ_V_POC_ECT "Disable POC if coolant temperature is below or equal to this value." VALUE 0x0002038C __SWORD_S 0 u_deg_C -256 255.9921875 /end CHARACTERISTIC
/begin CHARACTERISTIC TQ_V_POC_ESPD_MN "Disable POC below this engine speed." VALUE 0x0002038C __UWORD_S 0 u_espd 0.0 8191.875 FORMAT "%6.2" /end CHARACTERISTIC
/begin CHARACTERISTIC TQ_V_POC_ESPD_MX "Disable POC above this engine speed." VALUE 0x0002038C __UWORD_S 0 u_espd 0.0 8191.875 FORMAT "%6.2" /end CHARACTERISTIC
/begin CHARACTERISTIC TQ_V_POC_INH_PUC "Disable POC when PUC active." VALUE 0x2886C __UBYTE_S 0 b_true 0 1 FORMAT "%1.0" /end CHARACTERISTIC
/begin CHARACTERISTIC TQ_V_POC_THRO_LO "This calibration determines the low maximum throttle position to enable POC control for TIP IN." VALUE 0x0002038C __UWORD_S 0 u_pct 0 199.996948 FORMAT "%4.1" /end CHARACTERISTIC
/begin CHARACTERISTIC TQ_V_POC_THRO_HI "This calibration determines the high maximum throttle position to enable POC control for TIP IN." VALUE 0x0002038C __UWORD_S 0 u_pct 0 199.996948 FORMAT "%4.1" /end CHARACTERISTIC
/begin CHARACTERISTIC TQ_V_POC_TPI_THRO_THRSH "This calibration determines the lower threshold of delta throttle position for trigger of POC control for TIP IN." VALUE 0x0002038C __UWORD_S 0 u_pct 0 199.996948 FORMAT "%4.1" /end CHARACTERISTIC
/begin CHARACTERISTIC TQ_V_POC_PN_DSBL "True:disable POC in neutral or park." VALUE 0x2886C __UBYTE_S 0 b_true 0 1 FORMAT "%1.0" /end CHARACTERISTIC
/begin CHARACTERISTIC TQ_V_POC_CVT_TC "True:CVT with Torque converter;False:CVT with clutch.Only used to POC calculation." VALUE 0x2886C __UBYTE_S 0 b_true 0 1 FORMAT "%1.0" /end CHARACTERISTIC
/begin CHARACTERISTIC TQ_V_POC_ESPD_DLT "Enable POC if the delta between Actual engine speed and estimated engine speed is greater than this value." VALUE 0x0002038C __UWORD_S 0 u_espd 0.0 8191.875 FORMAT "%6.2" /end CHARACTERISTIC
/begin CHARACTERISTIC TQ_C_POC_MN_DB "Enable POC if the calculated absolute POC-Torque is greater than this value. The input of the table is the calculated differential optimised engine speed signal averaging index based on the powertrain resonance frequency ." CURVE 0x000200B0 __SWORD_S 0 u_tq -2048 2047.9375 FORMAT "%5.2"
 /begin AXIS_DESCR FIX_AXIS NO_INPUT_QUANTITY u_cnts 4 1 4 /begin FIX_AXIS_PAR_LIST 1 2 3 4 /end FIX_AXIS_PAR_LIST /end AXIS_DESCR
/end CHARACTERISTIC
/begin CHARACTERISTIC TQ_V_POC_MN_DB_FAC "Factor applied to TQ_C_POC_MN_DB to define the disable deadband. The POC control is disable if the delta inertia torque stay below this threshold for some time." VALUE 0x0002038C __UWORD_S 0 u_fac_1 0 0.999984741210937 /end CHARACTERISTIC
/begin CHARACTERISTIC TQ_V_POC_RST_P_ESPD "Reset POC p term min transmission calculated engine speed threshold." VALUE 0x0002038C __UWORD_S 0 u_espd 0.0 8191.875 FORMAT "%6.2" /end CHARACTERISTIC
/begin CHARACTERISTIC TQ_M_POC_FAC_G1 "Gear 1 POC factor." MAP 0x00020320 __UWORD_S 0 u_fac_2 0.0 1.999969482421875 FORMAT "%6.5" SYMBOL_LINK "TQ_M_POC_FAC_G1" 4
 /begin AXIS_DESCR FIX_AXIS sys_eng_spd u_espd 17 0 8191.875
  /begin FIX_AXIS_PAR_LIST 0 3200 6400 9600 12800 16000 19200 22400 25600 28800 32000 35200 38400 41600 44800 48000 51200 /end FIX_AXIS_PAR_LIST
 /end AXIS_DESCR
 /begin AXIS_DESCR COM_AXIS tq_imep_ref u_kPa_0_4096 17 0.000000 4095.937500 AXIS_PTS_REF TQ_X_IMEP_REF /end AXIS_DESCR
/end CHARACTERISTIC
/begin CHARACTERISTIC TQ_M_POC_FAC_G2 "Gear 2 POC factor." MAP 0x00020320 __UWORD_S 0 u_fac_2 0.0 1.999969482421875 FORMAT "%6.5" SYMBOL_LINK "TQ_M_POC_FAC_G2" 4
 /begin AXIS_DESCR FIX_AXIS sys_eng_spd u_espd 17 0 8191.875
  /begin FIX_AXIS_PAR_LIST 0 3200 6400 9600 12800 16000 19200 22400 25600 28800 32000 35200 38400 41600 44800 48000 51200 /end FIX_AXIS_PAR_LIST
 /end AXIS_DESCR
 /begin AXIS_DESCR COM_AXIS tq_imep_ref u_kPa_0_4096 17 0.000000 4095.937500 AXIS_PTS_REF TQ_X_IMEP_REF /end AXIS_DESCR
/end CHARACTERISTIC
/begin CHARACTERISTIC TQ_M_POC_FAC_G3 "Gear 3 POC factor." MAP 0x00020320 __UWORD_S 0 u_fac_2 0.0 1.999969482421875 FORMAT "%6.5" SYMBOL_LINK "TQ_M_POC_FAC_G3" 4
 /begin AXIS_DESCR FIX_AXIS sys_eng_spd u_espd 17 0 8191.875
  /begin FIX_AXIS_PAR_LIST 0 3200 6400 9600 12800 16000 19200 22400 25600 28800 32000 35200 38400 41600 44800 48000 51200 /end FIX_AXIS_PAR_LIST
 /end AXIS_DESCR
 /begin AXIS_DESCR COM_AXIS tq_imep_ref u_kPa_0_4096 17 0.000000 4095.937500 AXIS_PTS_REF TQ_X_IMEP_REF /end AXIS_DESCR
/end CHARACTERISTIC
/begin CHARACTERISTIC TQ_M_POC_FAC_G4 "Gear 4 POC factor." MAP 0x00020320 __UWORD_S 0 u_fac_2 0.0 1.999969482421875 FORMAT "%6.5" SYMBOL_LINK "TQ_M_POC_FAC_G4" 4
 /begin AXIS_DESCR FIX_AXIS sys_eng_spd u_espd 17 0 8191.875
  /begin FIX_AXIS_PAR_LIST 0 3200 6400 9600 12800 16000 19200 22400 25600 28800 32000 35200 38400 41600 44800 48000 51200 /end FIX_AXIS_PAR_LIST
 /end AXIS_DESCR
 /begin AXIS_DESCR COM_AXIS tq_imep_ref u_kPa_0_4096 17 0.000000 4095.937500 AXIS_PTS_REF TQ_X_IMEP_REF /end AXIS_DESCR
/end CHARACTERISTIC
/begin CHARACTERISTIC TQ_M_POC_FAC_G5 "Gear 5 POC factor." MAP 0x00020320 __UWORD_S 0 u_fac_2 0.0 1.999969482421875 FORMAT "%6.5" SYMBOL_LINK "TQ_M_POC_FAC_G5" 4
 /begin AXIS_DESCR FIX_AXIS sys_eng_spd u_espd 17 0 8191.875
  /begin FIX_AXIS_PAR_LIST 0 3200 6400 9600 12800 16000 19200 22400 25600 28800 32000 35200 38400 41600 44800 48000 51200 /end FIX_AXIS_PAR_LIST
 /end AXIS_DESCR
 /begin AXIS_DESCR COM_AXIS tq_imep_ref u_kPa_0_4096 17 0.000000 4095.937500 AXIS_PTS_REF TQ_X_IMEP_REF /end AXIS_DESCR
/end CHARACTERISTIC
/begin CHARACTERISTIC TQ_M_POC_FAC_G6 "Gear 6 POC factor." MAP 0x00020320 __UWORD_S 0 u_fac_2 0.0 1.999969482421875 FORMAT "%6.5" SYMBOL_LINK "TQ_M_POC_FAC_G6" 4
 /begin AXIS_DESCR FIX_AXIS sys_eng_spd u_espd 17 0 8191.875
  /begin FIX_AXIS_PAR_LIST 0 3200 6400 9600 12800 16000 19200 22400 25600 28800 32000 35200 38400 41600 44800 48000 51200 /end FIX_AXIS_PAR_LIST
 /end AXIS_DESCR
 /begin AXIS_DESCR COM_AXIS tq_imep_ref u_kPa_0_4096 17 0.000000 4095.937500 AXIS_PTS_REF TQ_X_IMEP_REF /end AXIS_DESCR
/end CHARACTERISTIC
/begin CHARACTERISTIC TQ_M_POC_FAC_G7 "Gear 7 POC factor." MAP 0x00020320 __UWORD_S 0 u_fac_2 0.0 1.999969482421875 FORMAT "%6.5" SYMBOL_LINK "TQ_M_POC_FAC_G7" 4
 /begin AXIS_DESCR FIX_AXIS sys_eng_spd u_espd 17 0 8191.875
  /begin FIX_AXIS_PAR_LIST 0 3200 6400 9600 12800 16000 19200 22400 25600 28800 32000 35200 38400 41600 44800 48000 51200 /end FIX_AXIS_PAR_LIST
 /end AXIS_DESCR
 /begin AXIS_DESCR COM_AXIS tq_imep_ref u_kPa_0_4096 17 0.000000 4095.937500 AXIS_PTS_REF TQ_X_IMEP_REF /end AXIS_DESCR
/end CHARACTERISTIC
/begin CHARACTERISTIC TQ_M_POC_FAC_G8 "Gear 8 POC factor." MAP 0x00020320 __UWORD_S 0 u_fac_2 0.0 1.999969482421875 FORMAT "%6.5" SYMBOL_LINK "TQ_M_POC_FAC_G8" 4
 /begin AXIS_DESCR FIX_AXIS sys_eng_spd u_espd 17 0 8191.875
  /begin FIX_AXIS_PAR_LIST 0 3200 6400 9600 12800 16000 19200 22400 25600 28800 32000 35200 38400 41600 44800 48000 51200 /end FIX_AXIS_PAR_LIST
 /end AXIS_DESCR
 /begin AXIS_DESCR COM_AXIS tq_imep_ref u_kPa_0_4096 17 0.000000 4095.937500 AXIS_PTS_REF TQ_X_IMEP_REF /end AXIS_DESCR
/end CHARACTERISTIC
/begin CHARACTERISTIC TQ_M_POC_FAC_U "Gear information is Unknown POC factor." MAP 0x00020320 __UWORD_S 0 u_fac_2 0.0 1.999969482421875 FORMAT "%6.5" SYMBOL_LINK "TQ_M_POC_FAC_U" 4
 /begin AXIS_DESCR FIX_AXIS sys_eng_spd u_espd 17 0 8191.875
  /begin FIX_AXIS_PAR_LIST 0 3200 6400 9600 12800 16000 19200 22400 25600 28800 32000 35200 38400 41600 44800 48000 51200 /end FIX_AXIS_PAR_LIST
 /end AXIS_DESCR
 /begin AXIS_DESCR COM_AXIS tq_imep_ref u_kPa_0_4096 17 0.000000 4095.937500 AXIS_PTS_REF TQ_X_IMEP_REF /end AXIS_DESCR
/end CHARACTERISTIC
/begin CHARACTERISTIC TQ_M_POC_FAC_PN "Gear PN POC factor." MAP 0x00020320 __UWORD_S 0 u_fac_2 0.0 1.999969482421875 FORMAT "%6.5" SYMBOL_LINK "TQ_M_POC_FAC_PN" 4
 /begin AXIS_DESCR FIX_AXIS sys_eng_spd u_espd 17 0 8191.875
  /begin FIX_AXIS_PAR_LIST 0 3200 6400 9600 12800 16000 19200 22400 25600 28800 32000 35200 38400 41600 44800 48000 51200 /end FIX_AXIS_PAR_LIST
 /end AXIS_DESCR
 /begin AXIS_DESCR COM_AXIS tq_imep_ref u_kPa_0_4096 17 0.000000 4095.937500 AXIS_PTS_REF TQ_X_IMEP_REF /end AXIS_DESCR
/end CHARACTERISTIC
/begin CHARACTERISTIC TQ_M_POC_FAC_R "Gear R POC factor." MAP 0x00020320 __UWORD_S 0 u_fac_2 0.0 1.999969482421875 FORMAT "%6.5" SYMBOL_LINK "TQ_M_POC_FAC_R" 4
 /begin AXIS_DESCR FIX_AXIS sys_eng_spd u_espd 17 0 8191.875
  /begin FIX_AXIS_PAR_LIST 0 3200 6400 9600 12800 16000 19200 22400 25600 28800 32000 35200 38400 41600 44800 48000 51200 /end FIX_AXIS_PAR_LIST
 /end AXIS_DESCR
 /begin AXIS_DESCR COM_AXIS tq_imep_ref u_kPa_0_4096 17 0.000000 4095.937500 AXIS_PTS_REF TQ_X_IMEP_REF /end AXIS_DESCR
/end CHARACTERISTIC
/begin AXIS_PTS TQ_X_POC_ESPD_DLT "engine speed delta breakpoint." 0x0002006C NO_INPUT_QUANTITY SSV__SWORD_S 0 u_espd_n4096_p4096 17 -4096 4095.875 FORMAT "%5.1" DEPOSIT ABSOLUTE SYMBOL_LINK "TQ_X_POC_ESPD_DLT" 2 /end AXIS_PTS
/begin CHARACTERISTIC TQ_M_POC_ESPD_TPI_FAC "The POC proportional part gain table for Tip-in." MAP 0x00020320 __UWORD_S 0 u_nm_per_rpm 0.0 127.998046875 SYMBOL_LINK "TQ_M_POC_ESPD_TPI_FAC" 4
 /begin AXIS_DESCR FIX_AXIS NO_INPUT_QUANTITY u_poc_gr 4 0 3 /begin FIX_AXIS_PAR_LIST 0 1 2 3 /end FIX_AXIS_PAR_LIST /end AXIS_DESCR
 /begin AXIS_DESCR COM_AXIS NO_INPUT_QUANTITY u_espd_n4096_p4096 17 -4096 4095.875 AXIS_PTS_REF TQ_X_POC_ESPD_DLT /end AXIS_DESCR
/end CHARACTERISTIC
/begin CHARACTERISTIC TQ_M_POC_ESPD_TPO_FAC "The POC proportional part gain table for Tip-out." MAP 0x00020320 __UWORD_S 0 u_nm_per_rpm 0.0 127.998046875 SYMBOL_LINK "TQ_M_POC_ESPD_TPO_FAC" 4
 /begin AXIS_DESCR FIX_AXIS NO_INPUT_QUANTITY u_poc_gr 4 0 3 /begin FIX_AXIS_PAR_LIST 0 1 2 3 /end FIX_AXIS_PAR_LIST /end AXIS_DESCR
 /begin AXIS_DESCR COM_AXIS NO_INPUT_QUANTITY u_espd_n4096_p4096 17 -4096 4095.875 AXIS_PTS_REF TQ_X_POC_ESPD_DLT /end AXIS_DESCR
/end CHARACTERISTIC
/begin CHARACTERISTIC TQ_M_POC_TORQ_THRSH "The POC control enable threshold compared to inertia torque." MAP 0x00020320 __SWORD_S 0 u_tq -2048 2047.9375 FORMAT "%5.2"
 /begin AXIS_DESCR FIX_AXIS tq_veh_gr_st u_tq_gr_typ 11 0 10 /begin FIX_AXIS_PAR_LIST 0 1 2 3 4 5 6 7 8 9 10 /end FIX_AXIS_PAR_LIST /end AXIS_DESCR
 /begin AXIS_DESCR COM_AXIS sys_eng_spd u_espd 13 0 8191.875 AXIS_PTS_REF TQ_X_ESPD_L /end AXIS_DESCR
/end CHARACTERISTIC
/begin CHARACTERISTIC TQ_V_POC_TORQ_HYS "The POC control enable threshold hysteresis compared to inertia torque." VALUE 0x0002038C __SWORD_S 0 u_tq -2048 2047.9375 FORMAT "%5.2" /end CHARACTERISTIC
/begin CHARACTERISTIC TQ_V_POC_ESPD_TOOTH_COR "Engine speed threshold above which the tooth error correction can be applied to the TORQ POC reference." VALUE 0x0002038C __UWORD_S 0 u_espd 0.0 8191.875 FORMAT "%5.1" /end CHARACTERISTIC
/begin CHARACTERISTIC TQ_C_TRNS_FREQ "Transmission oscillation frequency for each gear state." CURVE 0x000200B0 __UWORD_S 0 u_hz 0 15.999755859375 FORMAT "%5.2"
 /begin AXIS_DESCR FIX_AXIS tq_veh_gr_st u_tq_gr_typ 11 0 10 /begin FIX_AXIS_PAR_LIST 0 1 2 3 4 5 6 7 8 9 10 /end FIX_AXIS_PAR_LIST /end AXIS_DESCR
/end CHARACTERISTIC
/begin CHARACTERISTIC TQ_V_POC_FILT_B1 "POC filter B1." VALUE 0x0002038C __UWORD_S 0 u_fac_2 0 1.99996948242187 FORMAT "%4.3" /end CHARACTERISTIC
/begin CHARACTERISTIC TQ_V_POC_FILT_B2 "POC filter B2." VALUE 0x0002038C __UWORD_S 0 u_fac_2 0 1.99996948242187 FORMAT "%4.3" /end CHARACTERISTIC
/begin CHARACTERISTIC TQ_V_POC_FILT_A2 "POC filter A2." VALUE 0x0002038C __SWORD_S 0 u_fac_n2_p2 -2 1.99993896484375 FORMAT "%4.3" /end CHARACTERISTIC
/begin CHARACTERISTIC TQ_V_POC_FILT_A3 "POC filter A3." VALUE 0x0002038C __SWORD_S 0 u_fac_n2_p2 -2 1.99993896484375 FORMAT "%4.3" /end CHARACTERISTIC
/begin CHARACTERISTIC TQ_V_ILD_GAIN_FILT_ENBL "Option to filter idle gain with gain in limit range." VALUE 0x0002038C __UBYTE_S 0 b_true 0 1 FORMAT "%1.0" /end CHARACTERISTIC
/begin CHARACTERISTIC TQ_V_ILD_GAIN_FILT "Idle gain filter." VALUE 0x0002038C __UWORD_S 0 u_fac_1 0 0.999984741210937 /end CHARACTERISTIC
/begin CHARACTERISTIC TQ_V_OR_IDL_LMT "Use overrun idle gain to limit idle torque during overrun idle closed loop mode." VALUE 0x0002038C __UBYTE_S 0 b_true 0 1 FORMAT "%1.0" /end CHARACTERISTIC
/begin AXIS_PTS TQ_X_IDL_GAIN "Idle gain breakpoint." 0x0002006C NO_INPUT_QUANTITY SSV__UWORD_S 0 u_fac_4 17 0 3.99993896484375 FORMAT "%6.5" DEPOSIT ABSOLUTE SYMBOL_LINK "TQ_X_IDL_GAIN" 2 /end AXIS_PTS
/begin CHARACTERISTIC TQ_C_OR_IDL_GAIN "Value of the idle flow torque RPM gain when overrun idle enabled." CURVE 0x000200B0 __UWORD_S 0 u_fac_4 0 3.99993896484375 FORMAT "%6.5" SYMBOL_LINK "TQ_C_OR_IDL_GAIN" 2
 /begin AXIS_DESCR COM_AXIS NO_INPUT_QUANTITY u_fac_4 17 0 3.99993896484375 AXIS_PTS_REF TQ_X_IDL_GAIN /end AXIS_DESCR
/end CHARACTERISTIC
/begin AXIS_PTS TQ_X_ESPD_TC_TORQ "Engine speed breakpoint." 0x0002006C NO_INPUT_QUANTITY SSV__UWORD_S 0 u_espd 8 0 8191.875 FORMAT "%5.1" DEPOSIT ABSOLUTE SYMBOL_LINK "TQ_X_ESPD_TC_TORQ" 2 /end AXIS_PTS
/begin CHARACTERISTIC TQ_C_TC_TORQ "Load torque compensation for torque converter when the engine speed is increased from base idle speed in gear." CURVE 0x000200B0 __SWORD_S 0 u_tq -2048 2047.9375 FORMAT "%5.2" SYMBOL_LINK "TQ_C_TC_TORQ" 2
 /begin AXIS_DESCR COM_AXIS NO_INPUT_QUANTITY u_espd 8 0 8191.875 AXIS_PTS_REF TQ_X_ESPD_TC_TORQ /end AXIS_DESCR
/end CHARACTERISTIC
/begin AXIS_PTS TQ_X_PPS_D "Pedal position breakpoint." 0x0002006C NO_INPUT_QUANTITY SSV__UWORD_S 0 u_pct 16 0 199.996948 FORMAT "%4.1" DEPOSIT ABSOLUTE SYMBOL_LINK "TQ_X_PPS_D" 2 /end AXIS_PTS
/begin CHARACTERISTIC TQ_M_ECO_TORQ_SP_FAC "Modifier applied to relative driver torque setpoint when ECO mode is active." MAP 0x00020320 __UWORD_S 0 u_fac_2 0 1.99996948242187 FORMAT "%4.3"
 /begin AXIS_DESCR FIX_AXIS tq_veh_gr_st u_tq_gr_typ 8 0 7 /begin FIX_AXIS_PAR_LIST 0 1 2 3 4 5 6 7 /end FIX_AXIS_PAR_LIST /end AXIS_DESCR
 /begin AXIS_DESCR COM_AXIS NO_INPUT_QUANTITY u_pct 16 0 199.996948 AXIS_PTS_REF TQ_X_PPS_D /end AXIS_DESCR
/end CHARACTERISTIC
/begin CHARACTERISTIC TQ_V_ECO_VSPD_LMT_RMP_OUT_STP "ECO vehicle speed limiter will be ramped out following deactivation of ECO mode." VALUE 0x0002038C __UWORD_S 0 u_vspd 0 511.992188 FORMAT "%4.1" /end CHARACTERISTIC
/begin CHARACTERISTIC TQ_V_ECO_TORQ_RMP_ENBL "When TRUE, the driver torque setpoint ECO modifier will be ramped when transition in and out of ECO mode.else it will not be ramped." VALUE 0x0002038C __UBYTE_S 0 b_true 0 1 FORMAT "%1.0" /end CHARACTERISTIC
/begin CHARACTERISTIC TQ_V_ECO_RMP_OUT_FAC "Factor multiplied by the pedal position delta." VALUE 0x0002038C __UWORD_S 0 u_fac_2 0 1.999969482421875 FORMAT "%4.3" /end CHARACTERISTIC
/begin CHARACTERISTIC TQ_C_TPO_LO_ECO_FAC "Factor applied to the lower tip out torque when ECO mode is active." CURVE 0x000200B0 __UWORD_S 0 u_fac_2 0 1.999969482421875 FORMAT "%4.3"
 /begin AXIS_DESCR FIX_AXIS tq_veh_gr_st u_tq_gr_typ 8 0 7 /begin FIX_AXIS_PAR_LIST 0 1 2 3 4 5 6 7 /end FIX_AXIS_PAR_LIST /end AXIS_DESCR
/end CHARACTERISTIC
/begin CHARACTERISTIC TQ_C_TPO_HI_ECO_FAC "Factor applied to the high limit tip out torque when ECO mode is active." CURVE 0x000200B0 __UWORD_S 0 u_fac_2 0 1.999969482421875 FORMAT "%4.3"
 /begin AXIS_DESCR FIX_AXIS tq_veh_gr_st u_tq_gr_typ 8 0 7 /begin FIX_AXIS_PAR_LIST 0 1 2 3 4 5 6 7 /end FIX_AXIS_PAR_LIST /end AXIS_DESCR
/end CHARACTERISTIC
/begin CHARACTERISTIC TQ_V_IMEP_MN_ECO_PUC_FAC "Factor applied to the Minimum IMEP setpoint limitation when ECO mode is active during PUC." VALUE 0x0002038C __UWORD_S 0 u_fac_2 0 1.999969482421875 FORMAT "%4.3" /end CHARACTERISTIC
/begin CHARACTERISTIC TQ_V_IMEP_MN_ECO_FAC "Factor applied to the Minimum IMEP setpoint limitation when ECO mode is active." VALUE 0x0002038C __UWORD_S 0 u_fac_2 0 1.999969482421875 FORMAT "%4.3" /end CHARACTERISTIC
/begin CHARACTERISTIC TQ_C_TPI_DSBL_FAC_ECO "Factor applied to the tip-in-bump disable torque threshold when ECO mode is active." CURVE 0x000200B0 __UWORD_S 0 u_fac_2 0 1.999969482421875 FORMAT "%4.3"
 /begin AXIS_DESCR FIX_AXIS tq_veh_gr_st u_tq_gr_typ 8 0 7 /begin FIX_AXIS_PAR_LIST 0 1 2 3 4 5 6 7 /end FIX_AXIS_PAR_LIST /end AXIS_DESCR
/end CHARACTERISTIC
/begin CHARACTERISTIC TQ_C_TPI_ENBL_FAC_ECO "Factor applied to the tip-in-bump enable torque threshold when ECO mode is active." CURVE 0x000200B0 __UWORD_S 0 u_fac_2 0 1.999969482421875 FORMAT "%4.3"
 /begin AXIS_DESCR FIX_AXIS tq_veh_gr_st u_tq_gr_typ 8 0 7 /begin FIX_AXIS_PAR_LIST 0 1 2 3 4 5 6 7 /end FIX_AXIS_PAR_LIST /end AXIS_DESCR
/end CHARACTERISTIC
/begin CHARACTERISTIC TQ_C_TPI_FILTER_FAC_ECO "Factor applied to the tip-in-bump filter coefficient when ECO mode is active." CURVE 0x000200B0 __UWORD_S 0 u_fac_2 0 1.999969482421875 FORMAT "%4.3"
 /begin AXIS_DESCR FIX_AXIS tq_veh_gr_st u_tq_gr_typ 8 0 7 /begin FIX_AXIS_PAR_LIST 0 1 2 3 4 5 6 7 /end FIX_AXIS_PAR_LIST /end AXIS_DESCR
/end CHARACTERISTIC
/begin CHARACTERISTIC TQ_C_TPI_RMP_STP_FAC_ECO "Factor applied to the tip-in-bump ramp step when ECO mode is active." CURVE 0x000200B0 __UWORD_S 0 u_fac_2 0 1.999969482421875 FORMAT "%4.3"
 /begin AXIS_DESCR FIX_AXIS tq_veh_gr_st u_tq_gr_typ 8 0 7 /begin FIX_AXIS_PAR_LIST 0 1 2 3 4 5 6 7 /end FIX_AXIS_PAR_LIST /end AXIS_DESCR
/end CHARACTERISTIC
/begin CHARACTERISTIC TQ_V_TPI_PDSBL_FAC_ECO "Factor applied to the tip-in-bump post-disable torque threshold when ECO mode is active." VALUE 0x0002038C __UWORD_S 0 u_fac_2 0 1.999969482421875 FORMAT "%4.3" /end CHARACTERISTIC
/begin CHARACTERISTIC TQ_V_ECO_VSPD_LMT "Vehicle speed limit when ECO mode is active." VALUE 0x0002038C __UWORD_S 0 u_vspd 0 511.992188 FORMAT "%4.1" /end CHARACTERISTIC
/begin CHARACTERISTIC TQ_V_ECO_VSPD_LMT_RMP_IN_STP "ECO vehicle speed limiter will be ramped in following activation of ECO mode." VALUE 0x0002038C __UWORD_S 0 u_vspd 0 511.992188 FORMAT "%4.1" /end CHARACTERISTIC
/begin CHARACTERISTIC TQ_V_ECO_RMP_IN_FAC "Factor multiplied by the pedal position delta." VALUE 0x0002038C __UWORD_S 0 u_fac_2 0 1.999969482421875 FORMAT "%4.3" /end CHARACTERISTIC
/begin CHARACTERISTIC TQ_V_ALT_STR_RT_THRSH "Alternator startup mode finish runtime threshold." VALUE 0x0002038C __UWORD_S 0 u_cnts 0 65535 FORMAT "%5.0" /end CHARACTERISTIC
/begin CHARACTERISTIC TQ_V_ALT_RMP_DLY_ESPD "Alternator load ramp delay start when engine speed reach this threshold." VALUE 0x0002038C __UWORD_S 0 u_espd 0.0 8191.875 FORMAT "%5.1" /end CHARACTERISTIC
/begin CHARACTERISTIC TQ_V_ALT_RMP_DLY "Alternator load ramp delay time." VALUE 0x0002038C __UWORD_S 0 u_2x_tmr 0 1023.984375 /end CHARACTERISTIC
/begin CHARACTERISTIC TQ_C_ALT_VLT_FAC "Alternator charge level factor applied to load compensation versus battery voltage at start up ramp control." CURVE 0x000200B0 __UWORD_S 0 u_fac_2 0 1.999969482421875 FORMAT "%4.3" SYMBOL_LINK "TQ_C_ALT_VLT_FAC" 2
 /begin AXIS_DESCR FIX_AXIS hw_bat_vlt u_volt_32 17 8 16
  /begin FIX_AXIS_PAR_LIST 16384 17408 18432 19456 20480 21504 22528 23552 24576 25600 26624 27648 28672 29696 30720 31744 32768 /end FIX_AXIS_PAR_LIST
 /end AXIS_DESCR
/end CHARACTERISTIC
/begin CHARACTERISTIC TQ_C_ALT_ECT_OFST "Alternator Charge level offset by engine coolant temperature." CURVE 0x000200B0 __UWORD_S 0 u_nm 0 1023.984375 SYMBOL_LINK "TQ_C_ALT_ECT_OFST" 2
 /begin AXIS_DESCR FIX_AXIS sys_ect u_deg_C 13 -40 104
  /begin FIX_AXIS_PAR_LIST -5120 -3584 -2048 -512 1024 2560 4096 5632 7168 8704 10240 11776 13312 /end FIX_AXIS_PAR_LIST
 /end AXIS_DESCR
/end CHARACTERISTIC
/begin CHARACTERISTIC TQ_V_PS_CFG "Power steering load is from CAN.True:from CAN.False:No PS input." VALUE 0x0002038C __UBYTE_S 0 b_true 0 1 FORMAT "%1.0" /end CHARACTERISTIC
/begin CHARACTERISTIC TQ_C_ALT_PS_LD "Alternator load from power steering load." CURVE 0x000200B0 __UWORD_S 0 u_nm 0 1023.984375 SYMBOL_LINK "TQ_C_ALT_PS_LD" 2
 /begin AXIS_DESCR FIX_AXIS NO_INPUT_QUANTITY u_amp 11 0 100
  /begin FIX_AXIS_PAR_LIST 0 5120 10240 15360 20480 25600 30720 35840 40960 46080 51200 /end FIX_AXIS_PAR_LIST
 /end AXIS_DESCR
/end CHARACTERISTIC
/begin CHARACTERISTIC TQ_V_BEAM_CFG "Beam load configuration." VALUE 0x0002038C __UBYTE_S 0 u_load_cfg 0 2 FORMAT "%1.0" /end CHARACTERISTIC
/begin CHARACTERISTIC TQ_V_ALT_BEAM_LD "Alternator load from beam load." VALUE 0x0002038C __UWORD_S 0 u_nm 0 1023.984375 /end CHARACTERISTIC
/begin CHARACTERISTIC TQ_V_DEFRST_CFG "Defroster load configuration." VALUE 0x0002038C __UBYTE_S 0 u_load_cfg 0 2 FORMAT "%1.0" /end CHARACTERISTIC
/begin CHARACTERISTIC TQ_V_ALT_DEFRST_LD "Alternator load from defroster load." VALUE 0x0002038C __UWORD_S 0 u_nm 0 1023.984375 /end CHARACTERISTIC
/begin CHARACTERISTIC TQ_V_ALT_ELD1 "Alternator load from E load 1." VALUE 0x0002038C __UWORD_S 0 u_nm 0 1023.984375 /end CHARACTERISTIC
/begin CHARACTERISTIC TQ_V_ALT_ELD2 "Alternator load from E load 2." VALUE 0x0002038C __UWORD_S 0 u_nm 0 1023.984375 /end CHARACTERISTIC
/begin CHARACTERISTIC TQ_V_ALT_RMP_STR_INC "Increasing alternator load ramp rate during startup to compensate for the increase charge requirement of the battery after crank." VALUE 0x0002038C __ULONG_S 0 u_nm_l 0 1023.9999997615814208984375 /end CHARACTERISTIC
/begin CHARACTERISTIC TQ_V_ALT_RMP_INC "Increasing alternator load ramp rate to compensate for the increase charge requirement of the battery after crank." VALUE 0x0002038C __ULONG_S 0 u_nm_l 0 1023.9999997615814208984375 /end CHARACTERISTIC
/begin CHARACTERISTIC TQ_V_ALT_RMP_ESPD_THRSH "Engine speed above which the alternator Load Ramp Control is disabled when increasing and in normal mode." VALUE 0x0002038C __UWORD_S 0 u_espd 0.0 8191.875 FORMAT "%5.1" /end CHARACTERISTIC
/begin CHARACTERISTIC TQ_V_ALT_RMP_STR_DEC "Decreasing alternator load ramp rate during startup to compensate for the increase charge requirement of the battery after crank." VALUE 0x0002038C __ULONG_S 0 u_nm_l 0 1023.9999997615814208984375 /end CHARACTERISTIC
/begin CHARACTERISTIC TQ_V_ALT_RMP_DEC "Decreasing alternator load ramp rate to compensate for the increase charge requirement of the battery after crank." VALUE 0x0002038C __ULONG_S 0 u_nm_l 0 1023.9999997615814208984375 /end CHARACTERISTIC
/begin CHARACTERISTIC TQ_V_AC_CFG "AC load configuration." VALUE 0x0002038C __UBYTE_S 0 u_ac_cfg 0 3 FORMAT "%1.0" /end CHARACTERISTIC
/begin CHARACTERISTIC TQ_V_AC_FRIC_RMP "A/C friction torque ramp down value." VALUE 0x0002038C __SWORD_S 0 u_tq -2048 2047.9375 FORMAT "%5.2" /end CHARACTERISTIC
/begin CHARACTERISTIC TQ_V_AC_DFLT_TORQ "Maximum torque default if there for non AC applications." VALUE 0x0002038C __SWORD_S 0 u_tq -2048 2047.9375 FORMAT "%5.2" /end CHARACTERISTIC
/begin CHARACTERISTIC TQ_M_AC_INIT_LD "A/C initial load." MAP 0x00020320 __UWORD_S 0 u_kw 0 1023.984375
 /begin AXIS_DESCR FIX_AXIS NO_INPUT_QUANTITY u_ac_cfg 2 0 1 /begin FIX_AXIS_PAR_LIST 0 1 /end FIX_AXIS_PAR_LIST /end AXIS_DESCR
 /begin AXIS_DESCR FIX_AXIS NO_INPUT_QUANTITY u_ac_idx 17 0 16 /begin FIX_AXIS_PAR_LIST 0 1 2 3 4 5 6 7 8 9 10 11 12 13 14 15 16 /end FIX_AXIS_PAR_LIST /end AXIS_DESCR
/end CHARACTERISTIC
/begin CHARACTERISTIC TQ_M_AC_INIT_DEC_FAC "A/C initial load decay factor." MAP 0x00020320 __UWORD_S 0 u_fac_1 0 0.999984741210937
 /begin AXIS_DESCR FIX_AXIS NO_INPUT_QUANTITY u_ac_cfg 2 0 1 /begin FIX_AXIS_PAR_LIST 0 1 /end FIX_AXIS_PAR_LIST /end AXIS_DESCR
 /begin AXIS_DESCR FIX_AXIS NO_INPUT_QUANTITY u_ac_idx 17 0 16 /begin FIX_AXIS_PAR_LIST 0 1 2 3 4 5 6 7 8 9 10 11 12 13 14 15 16 /end FIX_AXIS_PAR_LIST /end AXIS_DESCR
/end CHARACTERISTIC
/begin CHARACTERISTIC TQ_C_AC_PWR "The power load compensation for AC compressor in a standard AC configuration as a function of KPA (for pressure sensor type) or ambient air temperature." CURVE 0x000200B0 __UWORD_S 0 u_kw 0 1023.984375 SYMBOL_LINK "TQ_C_AC_PWR" 2
 /begin AXIS_DESCR FIX_AXIS NO_INPUT_QUANTITY u_ac_idx 17 0 16 /begin FIX_AXIS_PAR_LIST 0 1 2 3 4 5 6 7 8 9 10 11 12 13 14 15 16 /end FIX_AXIS_PAR_LIST /end AXIS_DESCR
/end CHARACTERISTIC
/begin CHARACTERISTIC TQ_C_AC_POS_DLT_P "Delta positive pressure between actual AC pressure and init AC pressure above which the delay timer is applied before AC compensation start." CURVE 0x000200B0 __SWORD_S 0 u_kPa_4096n_4096p -4096 4095.875 FORMAT "%6.2" SYMBOL_LINK "TQ_C_AC_POS_DLT_P" 2
 /begin AXIS_DESCR FIX_AXIS NO_INPUT_QUANTITY u_kPa_4096n_4096p 7 0 3000 /begin FIX_AXIS_PAR_LIST 0 4000 8000 12000 16000 20000 24000 /end FIX_AXIS_PAR_LIST /end AXIS_DESCR
/end CHARACTERISTIC
/begin CHARACTERISTIC TQ_C_AC_POS_DLY "ECC compensation delay for positive delta pressure. Time after which the AC compensation starts." CURVE 0x000200B0 __UWORD_S 0 u_2x_tmr 0 1023.984375 SYMBOL_LINK "TQ_C_AC_POS_DLY" 2
 /begin AXIS_DESCR FIX_AXIS NO_INPUT_QUANTITY u_kPa_4096n_4096p 7 0 3000 /begin FIX_AXIS_PAR_LIST 0 4000 8000 12000 16000 20000 24000 /end FIX_AXIS_PAR_LIST /end AXIS_DESCR
/end CHARACTERISTIC
/begin CHARACTERISTIC TQ_C_AC_NEG_DLT_P "Delta negative pressure between actual AC pressure and init AC pressure above which the delay timer is applied before AC compensation start." CURVE 0x000200B0 __SWORD_S 0 u_kPa_4096n_4096p -4096 4095.875 FORMAT "%6.2" SYMBOL_LINK "TQ_C_AC_NEG_DLT_P" 2
 /begin AXIS_DESCR FIX_AXIS NO_INPUT_QUANTITY u_kPa_4096n_4096p 7 0 3000 /begin FIX_AXIS_PAR_LIST 0 4000 8000 12000 16000 20000 24000 /end FIX_AXIS_PAR_LIST /end AXIS_DESCR
/end CHARACTERISTIC
/begin CHARACTERISTIC TQ_C_AC_NEG_DLY "ECC compensation delay for negative delta pressure. Time after which the AC compensation starts." CURVE 0x000200B0 __UWORD_S 0 u_2x_tmr 0 1023.984375 SYMBOL_LINK "TQ_C_AC_NEG_DLY" 2
 /begin AXIS_DESCR FIX_AXIS NO_INPUT_QUANTITY u_kPa_4096n_4096p 7 0 3000 /begin FIX_AXIS_PAR_LIST 0 4000 8000 12000 16000 20000 24000 /end FIX_AXIS_PAR_LIST /end AXIS_DESCR
/end CHARACTERISTIC
/begin CHARACTERISTIC TQ_C_PS_INIT_STRT_TORQ "Initial start up power steering torque." CURVE 0x000200B0 __SWORD_S 0 u_tq_256 -128 127.998046875 FORMAT "%5.2" SYMBOL_LINK "TQ_C_PS_INIT_STRT_TORQ" 2
 /begin AXIS_DESCR COM_AXIS NO_INPUT_QUANTITY u_deg_C 7 -256 255.9921875 AXIS_PTS_REF TQ_X_ECT_C /end AXIS_DESCR
/end CHARACTERISTIC
/begin AXIS_PTS TQ_X_ECT_C "engine start coolant temperature breakpoint." 0x0002006C sys_keyon_ect SSV__SWORD_S 0 u_deg_C 7 -256 255.9921875 DEPOSIT ABSOLUTE SYMBOL_LINK "TQ_X_ECT_C" 2 /end AXIS_PTS
/begin AXIS_PTS TQ_X_OFF_DUR "engine off duration." 0x0002006C offt_off_dur_nv SSV__UWORD_S 0 u_min 7 0 65535 DEPOSIT ABSOLUTE SYMBOL_LINK "TQ_X_OFF_DUR" 2 /end AXIS_PTS
/begin CHARACTERISTIC TQ_C_PS_OFF_DUR_FAC "Torque offset that is applied to the initial start up power steering torque." CURVE 0x000200B0 __UWORD_S 0 u_fac_1 0 0.999984741210937 SYMBOL_LINK "TQ_C_PS_OFF_DUR_FAC" 2
 /begin AXIS_DESCR COM_AXIS NO_INPUT_QUANTITY u_min 7 0 65535 AXIS_PTS_REF TQ_X_OFF_DUR /end AXIS_DESCR
/end CHARACTERISTIC
/begin CHARACTERISTIC TQ_C_PS_DCY_FAC "Decay factor that is applied to the initial start up power steering torque." CURVE 0x000200B0 __UWORD_S 0 u_fac_1 0 0.999984741210937 SYMBOL_LINK "TQ_C_PS_DCY_FAC" 2
 /begin AXIS_DESCR COM_AXIS NO_INPUT_QUANTITY u_deg_C 7 -256 255.9921875 AXIS_PTS_REF TQ_X_ECT_C /end AXIS_DESCR
/end CHARACTERISTIC
/begin CHARACTERISTIC TQ_V_DTORQ_LMT_PPS "Minimum PPS for which the relative driver clutch torque will be limited when brake pedal is applied." VALUE 0x0002038C __UWORD_S 0 u_pct_r 0 127.998046875 /end CHARACTERISTIC
/begin CHARACTERISTIC TQ_V_DTORQ_LMT_MX_DLT_PPS "When the difference in PPS over 8 main time loops exceeds this value, the driver clutch torque setpoint limitation will not be applied." VALUE 0x0002038C __UWORD_S 0 u_pct 0 199.996948 FORMAT "%4.1" /end CHARACTERISTIC
/begin AXIS_PTS TQ_X_VSPD_B "Vehicle speed breakpoint" 0x0002006C sys_veh_spd SSV__UWORD_S 0 u_vspd 5 0 511.9921875 DEPOSIT ABSOLUTE SYMBOL_LINK "TQ_X_VSPD_B" 2 /end AXIS_PTS
/begin AXIS_PTS TQ_X_TMR "Timer breakpoint" 0x0002006C NO_INPUT_QUANTITY SSV__UWORD_S 0 u_2x_tmr 7 0 1023.984375 FORMAT "%8.4" DEPOSIT ABSOLUTE SYMBOL_LINK "TQ_X_TMR" 2 /end AXIS_PTS
/begin CHARACTERISTIC TQ_M_DTORQ_LMT_BRK "Maximum accepted value of the relative driver clutch torque when brakes are applied while PPS is greater than TQ_V_DTORQ_LMT_PPS." MAP 0x00020320 __UBYTE_S 0 u_tq_b 0 127.5 SYMBOL_LINK "TQ_M_DTORQ_LMT_BRK" 3
 /begin AXIS_DESCR COM_AXIS NO_INPUT_QUANTITY u_2x_tmr 7 0 1023.984375 AXIS_PTS_REF TQ_X_TMR /end AXIS_DESCR
 /begin AXIS_DESCR COM_AXIS sys_veh_spd u_vspd 5 0 511.9921875 AXIS_PTS_REF TQ_X_VSPD_B /end AXIS_DESCR
/end CHARACTERISTIC
/begin CHARACTERISTIC TQ_M_DTORQ_LMT_PPS "Maximum accepted value of the relative driver clutch torque when PPS are applied while PPS is greater than TQ_V_DTORQ_LMT_PPS." MAP 0x00020320 __UBYTE_S 0 u_tq_b 0 127.5 SYMBOL_LINK "TQ_M_DTORQ_LMT_PPS" 3
 /begin AXIS_DESCR COM_AXIS NO_INPUT_QUANTITY u_2x_tmr 7 0 1023.984375 AXIS_PTS_REF TQ_X_TMR /end AXIS_DESCR
 /begin AXIS_DESCR COM_AXIS sys_veh_spd u_vspd 5 0 511.9921875 AXIS_PTS_REF TQ_X_VSPD_B /end AXIS_DESCR
/end CHARACTERISTIC
/begin CHARACTERISTIC TQ_V_DTORQ_LMT_RMP "Increasing step size of limited relative driver clutch torque when the brakes are no longer applied or the pedal is released." VALUE 0x0002038C __UWORD_S 0 u_pct_r 0 127.998046875 /end CHARACTERISTIC
/begin AXIS_PTS TQ_X_ESPD_N "Engine speed breakpoint." 0x0002006C NO_INPUT_QUANTITY SSV__UWORD_S 0 u_espd 7 0 8191.875 FORMAT "%5.1" DEPOSIT ABSOLUTE SYMBOL_LINK "TQ_X_ESPD_N" 2 /end AXIS_PTS
/begin AXIS_PTS TQ_X_ECT_D "engine start coolant temperature breakpoint." 0x0002006C sys_ect SSV__SWORD_S 0 u_deg_C 9 -256 255.9921875 DEPOSIT ABSOLUTE SYMBOL_LINK "TQ_X_ECT_D" 2 /end AXIS_PTS
/begin CHARACTERISTIC TQ_M_SLW_MN_LMT_TCM "Minimum limit for the slow torque value from TCM." MAP 0x00020320 __SWORD_S 0 u_tq -2048 2047.9375 FORMAT "%5.2" SYMBOL_LINK "TQ_M_SLW_MN_LMT_TCM" 4
 /begin AXIS_DESCR COM_AXIS NO_INPUT_QUANTITY u_espd 7 0 8191.875 AXIS_PTS_REF TQ_X_ESPD_N /end AXIS_DESCR
 /begin AXIS_DESCR COM_AXIS sys_ect u_deg_C 9 -256 255.9921875 AXIS_PTS_REF TQ_X_ECT_D /end AXIS_DESCR
/end CHARACTERISTIC
/begin CHARACTERISTIC TQ_M_FST_MN_LMT_TCM "Minimum limit for the fast torque value from TCM." MAP 0x00020320 __SWORD_S 0 u_tq -2048 2047.9375 FORMAT "%5.2" SYMBOL_LINK "TQ_M_FST_MN_LMT_TCM" 4
 /begin AXIS_DESCR COM_AXIS NO_INPUT_QUANTITY u_espd 7 0 8191.875 AXIS_PTS_REF TQ_X_ESPD_N /end AXIS_DESCR
 /begin AXIS_DESCR COM_AXIS sys_ect u_deg_C 9 -256 255.9921875 AXIS_PTS_REF TQ_X_ECT_D /end AXIS_DESCR
/end CHARACTERISTIC
/begin CHARACTERISTIC TQ_M_INC_MX_LMT_TCM "Max limit value for increase torque from TCM." MAP 0x00020320 __SWORD_S 0 u_tq -2048 2047.9375 FORMAT "%5.2" SYMBOL_LINK "TQ_M_INC_MX_LMT_TCM" 4
 /begin AXIS_DESCR COM_AXIS NO_INPUT_QUANTITY u_espd 7 0 8191.875 AXIS_PTS_REF TQ_X_ESPD_N /end AXIS_DESCR
 /begin AXIS_DESCR COM_AXIS sys_ect u_deg_C 9 -256 255.9921875 AXIS_PTS_REF TQ_X_ECT_D /end AXIS_DESCR
/end CHARACTERISTIC
/begin CHARACTERISTIC TQ_M_SLW_MN_LMT_TCS "Minimum limit for the slow torque value from TCS." MAP 0x00020320 __SWORD_S 0 u_tq -2048 2047.9375 FORMAT "%5.2" SYMBOL_LINK "TQ_M_SLW_MN_LMT_TCS" 4
 /begin AXIS_DESCR COM_AXIS NO_INPUT_QUANTITY u_espd 7 0 8191.875 AXIS_PTS_REF TQ_X_ESPD_N /end AXIS_DESCR
 /begin AXIS_DESCR COM_AXIS sys_ect u_deg_C 9 -256 255.9921875 AXIS_PTS_REF TQ_X_ECT_D /end AXIS_DESCR
/end CHARACTERISTIC
/begin CHARACTERISTIC TQ_M_FST_MN_LMT_TCS "Minimum limit for the fast torque value from TCS." MAP 0x00020320 __SWORD_S 0 u_tq -2048 2047.9375 FORMAT "%5.2" SYMBOL_LINK "TQ_M_FST_MN_LMT_TCS" 4
 /begin AXIS_DESCR COM_AXIS NO_INPUT_QUANTITY u_espd 7 0 8191.875 AXIS_PTS_REF TQ_X_ESPD_N /end AXIS_DESCR
 /begin AXIS_DESCR COM_AXIS sys_ect u_deg_C 9 -256 255.9921875 AXIS_PTS_REF TQ_X_ECT_D /end AXIS_DESCR
/end CHARACTERISTIC
/begin CHARACTERISTIC TQ_M_INC_MX_LMT_TCS "Max limit value for increase torque from TCS." MAP 0x00020320 __SWORD_S 0 u_tq -2048 2047.9375 FORMAT "%5.2" SYMBOL_LINK "TQ_M_INC_MX_LMT_TCS" 4
 /begin AXIS_DESCR COM_AXIS NO_INPUT_QUANTITY u_espd 7 0 8191.875 AXIS_PTS_REF TQ_X_ESPD_N /end AXIS_DESCR
 /begin AXIS_DESCR COM_AXIS sys_ect u_deg_C 9 -256 255.9921875 AXIS_PTS_REF TQ_X_ECT_D /end AXIS_DESCR
/end CHARACTERISTIC
/begin CHARACTERISTIC TQ_C_MX_IND_TORQ_AMP_FAC "Ambient pressure compensation factor for the maximum indicated engine torque." CURVE 0x000200B0 __UWORD_S 0 u_fac_4 0 3.99993896484375 FORMAT "%6.5" SYMBOL_LINK "TQ_C_MX_IND_TORQ_AMP_FAC" 2
 /begin AXIS_DESCR FIX_AXIS sys_amp u_kPa_0_256 7 70 110 /begin FIX_AXIS_PAR_LIST 17920 20480 23040 24576 25088 25600 28160 /end FIX_AXIS_PAR_LIST /end AXIS_DESCR
/end CHARACTERISTIC
/begin CHARACTERISTIC TQ_V_F_RT_DLT_LMT "Fuel ratio delta limit threshold for filter." VALUE 0x0002038C __UWORD_S 0 u_fac_16 0.0 15.999756 FORMAT "%4.2" /end CHARACTERISTIC
/begin CHARACTERISTIC TQ_V_F_RT_MX "Maximum limit authority for fuel mass ratio." VALUE 0x0002038C __UWORD_S 0 u_fac_16 0.0 15.999756 FORMAT "%4.2" /end CHARACTERISTIC
/begin CHARACTERISTIC TQ_V_F_RT_MN "Minimum limit authority for fuel mass ratio." VALUE 0x0002038C __UWORD_S 0 u_fac_16 0.0 15.999756 FORMAT "%4.2" /end CHARACTERISTIC
/begin CHARACTERISTIC TQ_V_F_RT_FILT "Fuel ratio filter." VALUE 0x0002038C __UWORD_S 0 u_fac_1 0 0.999984741210937 /end CHARACTERISTIC
/begin CHARACTERISTIC TQ_V_PUC_ENTR_DLY "Delay time before PUC fast enter torque is allowed." VALUE 0x0002038C __UWORD_S 0 u_2x_tmr 0 1023.984375 /end CHARACTERISTIC
/begin CHARACTERISTIC TQ_C_IND_TORQ_MN "Minimum indicated torque at which engine can maintain inertia." CURVE 0x000200B0 __SWORD_S 0 u_tq -2048 2047.9375 FORMAT "%5.2" SYMBOL_LINK "TQ_C_IND_TORQ_MN" 2
 /begin AXIS_DESCR FIX_AXIS sys_eng_spd u_espd 9 0 6400 /begin FIX_AXIS_PAR_LIST 0 6400 12800 19200 25600 32000 38400 44800 51200 /end FIX_AXIS_PAR_LIST /end AXIS_DESCR
/end CHARACTERISTIC
/begin CHARACTERISTIC TQ_V_F_RT_MX_TRNS "Maximum limit authority for fuel mass ratio when load transition is active." VALUE 0x0002038C __UWORD_S 0 u_fac_16 0.0 15.999756 FORMAT "%4.2" /end CHARACTERISTIC
/begin CHARACTERISTIC TQ_V_F_RT_MN_TRNS "Minimum limit authority for fuel mass ratio when load transition is active." VALUE 0x0002038C __UWORD_S 0 u_fac_16 0.0 15.999756 FORMAT "%4.2" /end CHARACTERISTIC
/begin CHARACTERISTIC TQ_V_TRNS_RT_IDL "Using transition fuel ratio when at idle." VALUE 0x0002038C __UBYTE_S 0 b_true 0 1 FORMAT "%1.0" /end CHARACTERISTIC
/begin CHARACTERISTIC TQ_V_TRNS_RT_ESPD_POS_DB "Engine speed error larger than this positive deadband will use transition fuel ratio lmit." VALUE 0x0002038C __SWORD_S 0 u_espd -4096.0 4095.875 FORMAT "%4.1" /end CHARACTERISTIC
/begin CHARACTERISTIC TQ_V_TRNS_RT_ESPD_NEG_DB "Engine speed error less than this negative deadband will use transition fuel ratio lmit." VALUE 0x0002038C __SWORD_S 0 u_espd -4096.0 4095.875 FORMAT "%4.1" /end CHARACTERISTIC
/begin CHARACTERISTIC TQ_V_TRNS_RT_ECT_MN "When engine run time exceeds limit,transition fuel ratio limit is used if ECT is less than this cal." VALUE 0x0002038C __SWORD_S 0 u_deg_C -256 255.9921875 /end CHARACTERISTIC
/begin CHARACTERISTIC TQ_C_TRNS_RT_RTM "If engine runtime less than this limit,transition fuel ratio limit is used." CURVE 0x000200B0 __UBYTE_S 0 u_1s_tmr 0 255 FORMAT "%3.0" SYMBOL_LINK "TQ_C_TRNS_RT_RTM" 2
 /begin AXIS_DESCR FIX_AXIS sys_ect u_deg_C 17 -40 120
  /begin FIX_AXIS_PAR_LIST -5120 -3840 -2560 -1280 0 1280 2560 3840 5120 6400 7680 8960 10240 11520 12800 14080 15360 /end FIX_AXIS_PAR_LIST
 /end AXIS_DESCR
/end CHARACTERISTIC
/begin CHARACTERISTIC TQ_V_LNCH_FLYW_TORQ_MX "Launch flywheel torque max limit." VALUE 0x0002038C __SWORD_S 0 u_tq -2048 2047.9375 FORMAT "%5.2" /end CHARACTERISTIC
/begin CHARACTERISTIC TQ_V_LNCH_FLYW_TORQ_MN "Launch flywheel torque min limit." VALUE 0x0002038C __SWORD_S 0 u_tq -2048 2047.9375 FORMAT "%5.2" /end CHARACTERISTIC
/begin CHARACTERISTIC TQ_V_LNCH_INIT_PPS_THRSH "Launch initial will be diasbled when PPS above this threshold." VALUE 0x0002038C __UWORD_S 0 u_pct 0.0 199.996948 /end CHARACTERISTIC
/begin CHARACTERISTIC TQ_V_CRU_VSPD_DLT_MX "If actual vehicle speed and cruise target speed error not below this calibration, cruise or ACC base enable criteria are not met." VALUE 0x0002038C __SWORD_S 0 u_vspd -256 255.992188 FORMAT "%4.1" /end CHARACTERISTIC
/begin CHARACTERISTIC TQ_V_FST2SLW_UNLMT_POC "Not limit fast torque to slow torque when POC met." VALUE 0x0002038C __UBYTE_S 0 b_true 0 1 FORMAT "%1.0" /end CHARACTERISTIC
/begin CHARACTERISTIC TQ_V_ACT_TORQ_NON_POC "Actual torque transmit on CAN not included POC torque." VALUE 0x0002038C __UBYTE_S 0 b_true 0 1 FORMAT "%1.0" /end CHARACTERISTIC
/begin CHARACTERISTIC TQ_C_ADD_TORQ_PS_R "Additional torque applied in reverse gear when Power Steering is cramped with a pressure sensor." CURVE 0x000200B0 __SWORD_S 0 u_tq_256 -128 127.998046875 FORMAT "%5.2" SYMBOL_LINK "TQ_C_ADD_TORQ_PS_R" 2
 /begin AXIS_DESCR COM_AXIS NO_INPUT_QUANTITY u_kPa_0_32768 5 0 32767.5 AXIS_PTS_REF ENSC_X_PS_P /end AXIS_DESCR
/end CHARACTERISTIC
/begin CHARACTERISTIC TQ_C_ALT_PWM_FAN "PWM fan load for alternator." CURVE 0x000200B0 __UWORD_S 0 u_nm 0 1023.984375 SYMBOL_LINK "TQ_C_ALT_PWM_FAN" 2
 /begin AXIS_DESCR FIX_AXIS NO_INPUT_QUANTITY u_pct 6 0 100 /begin FIX_AXIS_PAR_LIST 0 6553.6 13107.2 19660.8 26214.4 32768 /end FIX_AXIS_PAR_LIST /end AXIS_DESCR
/end CHARACTERISTIC
/begin CHARACTERISTIC TQ_M_ALT_FAN "Discrete fan load for alternator." MAP 0x00020320 __UWORD_S 0 u_nm 0 1023.984375
 /begin AXIS_DESCR FIX_AXIS NO_INPUT_QUANTITY b_true 2 0 1 /begin FIX_AXIS_PAR_LIST 0 1 /end FIX_AXIS_PAR_LIST /end AXIS_DESCR
 /begin AXIS_DESCR FIX_AXIS NO_INPUT_QUANTITY b_true 2 0 1 /begin FIX_AXIS_PAR_LIST 0 1 /end FIX_AXIS_PAR_LIST /end AXIS_DESCR
/end CHARACTERISTIC
/begin CHARACTERISTIC TQ_V_BLW_CFG "Blower load configuration." VALUE 0x0002038C __UBYTE_S 0 u_load_cfg 0 2 FORMAT "%1.0" /end CHARACTERISTIC
/begin CHARACTERISTIC TQ_C_RBLW_LD "Rear blower load." CURVE 0x000200B0 __UWORD_S 0 u_nm 0 1023.984375
 /begin AXIS_DESCR FIX_AXIS NO_INPUT_QUANTITY u_blower_lvl 5 0 4 /begin FIX_AXIS_PAR_LIST 0 1 2 3 4 /end FIX_AXIS_PAR_LIST /end AXIS_DESCR
/end CHARACTERISTIC
/begin CHARACTERISTIC TQ_C_FBLW_LD "Front blower load." CURVE 0x000200B0 __UWORD_S 0 u_nm 0 1023.984375
 /begin AXIS_DESCR FIX_AXIS NO_INPUT_QUANTITY u_blower_lvl 5 0 4 /begin FIX_AXIS_PAR_LIST 0 1 2 3 4 /end FIX_AXIS_PAR_LIST /end AXIS_DESCR
/end CHARACTERISTIC
/begin CHARACTERISTIC TQ_C_BRK_PPS_FAC "PPS factor when brake pedal is depressed." CURVE 0x000200B0 __UWORD_S 0 u_fac_2 0 1.999969482421875 FORMAT "%4.3" SYMBOL_LINK "TQ_C_BRK_PPS_FAC" 2
 /begin AXIS_DESCR COM_AXIS NO_INPUT_QUANTITY u_2x_tmr 5 0 1023.984375 AXIS_PTS_REF TQ_X_TMR_B /end AXIS_DESCR
/end CHARACTERISTIC
/begin AXIS_PTS TQ_X_TMR_B "Timer breakpoint" 0x0002006C NO_INPUT_QUANTITY SSV__UWORD_S 0 u_2x_tmr 5 0 1023.984375 FORMAT "%8.4" DEPOSIT ABSOLUTE SYMBOL_LINK "TQ_X_TMR_B" 2 /end AXIS_PTS
/begin CHARACTERISTIC TQ_C_PED_MOD_RMP "Linear Pedal progression ramp rate." CURVE 0x000200B0 __UWORD_S 0 u_fac_2 0 1.999969482421875 FORMAT "%4.3"
 /begin AXIS_DESCR FIX_AXIS NO_INPUT_QUANTITY u_ped_mod 5 0 4 /begin FIX_AXIS_PAR_LIST 0 1 2 3 4 /end FIX_AXIS_PAR_LIST /end AXIS_DESCR
/end CHARACTERISTIC
/begin CHARACTERISTIC TQ_V_MN_PPS_BRK_MOD "Brake applied driver pedal factor will not be applied if PPS is less than this limit." VALUE 0x0002038C __UWORD_S 0 u_pct_r 0 127.998046875 /end CHARACTERISTIC
/begin CHARACTERISTIC TQ_V_VPPS_CRU_FILT "Filter of internal virtual effective pedal position while cruise control is the internal torque control source." VALUE 0x0002038C __UWORD_S 0 u_fac_1 0 0.999984741210937 /end CHARACTERISTIC
/begin CHARACTERISTIC TQ_C_MX_IND_TORQ_ESPD_FAC "Max indicated torque limit factor by engine speed." CURVE 0x000200B0 __UBYTE_S 0 u_fac_4_b 0 3.984375 SYMBOL_LINK "TQ_C_MX_IND_TORQ_ESPD_FAC" 2
 /begin AXIS_DESCR FIX_AXIS NO_INPUT_QUANTITY u_espd 5 400 1200 /begin FIX_AXIS_PAR_LIST 3200 4800 6400 8000 9600 /end FIX_AXIS_PAR_LIST /end AXIS_DESCR
/end CHARACTERISTIC
/begin CHARACTERISTIC TQ_V_TC_FILT_DLY_TPO "When tip out torque convertor load should be filted after this delay time." VALUE 0x0002038C __UWORD_S 0 u_2x_tmr 0.0 1023.984375 /end CHARACTERISTIC
/begin CHARACTERISTIC TQ_V_TC_FILT_DLY_SHFT "When shifting in gear,torque convertor load should be filted after this delay time." VALUE 0x0002038C __UWORD_S 0 u_2x_tmr 0.0 1023.984375 /end CHARACTERISTIC
/begin CHARACTERISTIC TQ_V_IMEP_INC_FILT "Filter of IMEP setpoint when IMEP is increasing." VALUE 0x0002038C __UWORD_S 0 u_fac_1 0 0.999984741210937 /end CHARACTERISTIC
/begin CHARACTERISTIC TQ_V_IMEP_DEC_FILT "Filter of IMEP setpoint when IMEP is decreasing." VALUE 0x0002038C __UWORD_S 0 u_fac_1 0 0.999984741210937 /end CHARACTERISTIC
/begin CHARACTERISTIC TQ_C_IMEP_DLT_FILT "IMEP delta filter." CURVE 0x000200B0 __UWORD_S 0 u_fac_1 0 0.999984741210937 SYMBOL_LINK "TQ_C_IMEP_DLT_FILT" 2
 /begin AXIS_DESCR COM_AXIS NO_INPUT_QUANTITY u_kPa_0_4096 7 0 4095.9375 AXIS_PTS_REF TQ_X_IMEP /end AXIS_DESCR
/end CHARACTERISTIC
/begin AXIS_PTS TQ_X_IMEP "IMEP breakpoint." 0x0002006C NO_INPUT_QUANTITY SSV__UWORD_S 0 u_kPa_0_4096 7 0 4095.9375 FORMAT "%5.1" DEPOSIT ABSOLUTE SYMBOL_LINK "TQ_X_IMEP" 2 /end AXIS_PTS
/begin CHARACTERISTIC TQ_V_MX_FLYW_TORQ_RMP_TM "Time to ramp in from normal maximum flywheel torque to exhaust temperature maximum flywheel torque." VALUE 0x0002038C __UWORD_S 0 u_2x_tmr 0.0 1023.984375 /end CHARACTERISTIC
/begin CHARACTERISTIC TQ_M_MX_FLYW_TORQ_PROT "Max Flywheel Torque limitation when engine temperature is too high." MAP 0x00020320 __SWORD_S 0 u_tq -2048 2047.9375 SYMBOL_LINK "TQ_M_MX_FLYW_TORQ_PROT" 4
 /begin AXIS_DESCR COM_AXIS NO_INPUT_QUANTITY u_espd 7 0 8191.875 AXIS_PTS_REF TQ_X_ESPD_O /end AXIS_DESCR
 /begin AXIS_DESCR COM_AXIS NO_INPUT_QUANTITY u_deg_C 7 -256 255.9921875 AXIS_PTS_REF TQ_X_TEMP /end AXIS_DESCR
/end CHARACTERISTIC
/begin AXIS_PTS TQ_X_ESPD_O "Engine speed breakpoint." 0x0002006C NO_INPUT_QUANTITY SSV__UWORD_S 0 u_espd 7 0 8191.875 FORMAT "%5.1" DEPOSIT ABSOLUTE SYMBOL_LINK "TQ_X_ESPD_O" 2 /end AXIS_PTS
/begin AXIS_PTS TQ_X_TEMP "Engine temperature breakpoint." 0x0002006C NO_INPUT_QUANTITY SSV__SWORD_S 0 u_deg_C 7 -256 255.9921875 DEPOSIT ABSOLUTE SYMBOL_LINK "TQ_X_TEMP" 2 /end AXIS_PTS
/begin CHARACTERISTIC TQ_V_MX_FLYW_TORQ_BTM "Maximum flywheel torque limit cannot be less than this calibration." VALUE 0x0002038C __SWORD_S 0 u_tq -2048 2047.9375 FORMAT "%5.2" /end CHARACTERISTIC
/begin CHARACTERISTIC TQ_V_TC_INC_RMP "Torque converter load increase ramp step." VALUE 0x0002038C __SWORD_S 0 u_tq -2048 2047.9375 FORMAT "%5.2" /end CHARACTERISTIC
/begin CHARACTERISTIC TQ_V_TC_DEC_RMP "Torque converter load decrease ramp step." VALUE 0x0002038C __SWORD_S 0 u_tq -2048 2047.9375 FORMAT "%5.2" /end CHARACTERISTIC
/begin CHARACTERISTIC TQ_M_ADD_TC_FAC "Additional torque factor by torque converter load." MAP 0x00020320 __UBYTE_S 0 u_fac_2_b 0 1.9921875 FORMAT "%5.4" SYMBOL_LINK "TQ_M_ADD_TC_FAC" 3
 /begin AXIS_DESCR COM_AXIS NO_INPUT_QUANTITY u_vspd 5 0 511.992188 AXIS_PTS_REF TQ_X_VSPD_C /end AXIS_DESCR
 /begin AXIS_DESCR COM_AXIS NO_INPUT_QUANTITY u_pct 5 0 199.996895 AXIS_PTS_REF TQ_X_PPS_E /end AXIS_DESCR
/end CHARACTERISTIC
/begin AXIS_PTS TQ_X_VSPD_C "Vehicle speed breakpoint." 0x0002006C NO_INPUT_QUANTITY SSV__UWORD_S 0 u_vspd 5 0 511.992188 FORMAT "%4.1" DEPOSIT ABSOLUTE SYMBOL_LINK "TQ_X_VSPD_C" 2 /end AXIS_PTS
/begin AXIS_PTS TQ_X_PPS_E "Pedal position breakpoint." 0x0002006C NO_INPUT_QUANTITY SSV__UWORD_S 0 u_pct 5 0 199.996895 DEPOSIT ABSOLUTE SYMBOL_LINK "TQ_X_PPS_E" 2 /end AXIS_PTS
/begin CHARACTERISTIC TQ_C_TC_DLY "When engine run time below this cal,the transmission shaft speed using idle setpoint instead of TC speed to calculate TC load." CURVE 0x000200B0 __UWORD_S 0 u_1x_tmr 0 511.9921875 FORMAT "%5.2" SYMBOL_LINK "TQ_C_TC_DLY" 2
 /begin AXIS_DESCR COM_AXIS NO_INPUT_QUANTITY u_deg_C 10 -256 255.9921875 AXIS_PTS_REF TQ_X_OIL_TEMP_B /end AXIS_DESCR
/end CHARACTERISTIC
/begin AXIS_PTS TQ_X_OIL_TEMP_B "Engine temperature breakpoint." 0x0002006C NO_INPUT_QUANTITY SSV__SWORD_S 0 u_deg_C 10 -256 255.9921875 DEPOSIT ABSOLUTE SYMBOL_LINK "TQ_X_OIL_TEMP_B" 2 /end AXIS_PTS
/begin CHARACTERISTIC TQ_V_TRNS_PUMP_FILT "Transmission pump torque loss filter." VALUE 0x0002038C __UWORD_S 0 u_fac_1 0 0.999984741210937 /end CHARACTERISTIC
/begin CHARACTERISTIC TQ_M_TC_LD "Torque converter load." MAP 0x00020320 __SWORD_S 0 u_tq -2048 2047.9375 SYMBOL_LINK "TQ_M_TC_LD" 4
 /begin AXIS_DESCR COM_AXIS NO_INPUT_QUANTITY u_fac_2 15 0 1.999969482421875 AXIS_PTS_REF TQ_X_RT /end AXIS_DESCR
 /begin AXIS_DESCR COM_AXIS NO_INPUT_QUANTITY u_espd 10 0 8191.875 AXIS_PTS_REF TQ_X_ESPD_P /end AXIS_DESCR
/end CHARACTERISTIC
/begin AXIS_PTS TQ_X_RT "Ratio breakpoint." 0x0002006C NO_INPUT_QUANTITY SSV__UWORD_S 0 u_fac_2 15 0 1.999969482421875 FORMAT "%5.4" DEPOSIT ABSOLUTE SYMBOL_LINK "TQ_X_RT" 2 /end AXIS_PTS
/begin AXIS_PTS TQ_X_ESPD_P "Engine speed breakpoint." 0x0002006C NO_INPUT_QUANTITY SSV__UWORD_S 0 u_espd 10 0 8191.875 FORMAT "%5.1" DEPOSIT ABSOLUTE SYMBOL_LINK "TQ_X_ESPD_P" 2 /end AXIS_PTS
/begin CHARACTERISTIC TQ_C_TC_TEMP_FAC "Torque converter load oil temperature factor." CURVE 0x000200B0 __UBYTE_S 0 u_fac_2_b 0 1.9921875 FORMAT "%5.4" SYMBOL_LINK "TQ_C_TC_TEMP_FAC" 2
 /begin AXIS_DESCR COM_AXIS NO_INPUT_QUANTITY u_deg_C 11 -256 255.9921875 AXIS_PTS_REF TQ_X_OIL_TEMP_C /end AXIS_DESCR
/end CHARACTERISTIC
/begin AXIS_PTS TQ_X_OIL_TEMP_C "Oil temperature breakpoint." 0x0002006C NO_INPUT_QUANTITY SSV__SWORD_S 0 u_deg_C 11 -256 255.9921875 DEPOSIT ABSOLUTE SYMBOL_LINK "TQ_X_OIL_TEMP_C" 2 /end AXIS_PTS
/begin CHARACTERISTIC TQ_C_TC_ESPD_FAC "Torque converter load engine speed ratio factor." CURVE 0x000200B0 __UBYTE_S 0 u_fac_2_b 0 1.9921875 FORMAT "%5.4" SYMBOL_LINK "TQ_C_TC_ESPD_FAC" 2
 /begin AXIS_DESCR COM_AXIS NO_INPUT_QUANTITY u_fac_16 15 0 15.999756 AXIS_PTS_REF TQ_X_RT_B /end AXIS_DESCR
/end CHARACTERISTIC
/begin AXIS_PTS TQ_X_RT_B "Ratio breakpoint." 0x0002006C NO_INPUT_QUANTITY SSV__UWORD_S 0 u_fac_16 15 0 15.999756 DEPOSIT ABSOLUTE SYMBOL_LINK "TQ_X_RT_B" 2 /end AXIS_PTS
/begin CHARACTERISTIC TQ_C_ADD_MX_TORQ_TC "Max additional torque for torque converter load." CURVE 0x000200B0 __SWORD_S 0 u_tq -2048 2047.9375 SYMBOL_LINK "TQ_C_ADD_MX_TORQ_TC" 2
 /begin AXIS_DESCR FIX_AXIS NO_INPUT_QUANTITY u_espd 8 700 1200 /begin FIX_AXIS_PAR_LIST 5600 6000 6400 6800 7200 8000 8800 9600 /end FIX_AXIS_PAR_LIST /end AXIS_DESCR
/end CHARACTERISTIC
/begin CHARACTERISTIC TQ_V_TC_MDL_ENBL "Torque convertor model used to calculate TC load." VALUE 0x2886C __UBYTE_S 0 b_true 0 1 FORMAT "%1.0" /end CHARACTERISTIC
/begin CHARACTERISTIC TQ_V_ESG_OVR_HYS "Engine speed less than long term limit for some time then use overrun engine speed limit." VALUE 0x0002038C __UWORD_S 0 u_espd 0.0 8191.875 FORMAT "%5.1" /end CHARACTERISTIC
/begin CHARACTERISTIC TQ_V_ESG_ESPD_LMT_GR_L "The long-term maximum engine speed permitted while in gear." VALUE 0x0002038C __UWORD_S 0 u_espd 0.0 8191.875 FORMAT "%5.1" /end CHARACTERISTIC
/begin CHARACTERISTIC TQ_V_ESG_OVR_TM "If engine speed is less than long term in gear limit - hysteresis for this time,the limit will use in gear limit(not using long term)." VALUE 0x0002038C __UWORD_S 0 u_1s_tmr 0.0 65535 /end CHARACTERISTIC
/begin CHARACTERISTIC TQ_V_ESG_ESPD_LMT_GR "The maximum engine speed permitted while in gear." VALUE 0x0002038C __UWORD_S 0 u_espd 0.0 8191.875 FORMAT "%5.1" /end CHARACTERISTIC
/begin CHARACTERISTIC TQ_V_ESG_LMT_TM_L "If engine speed is greater than long term in gear limit for some tim,the in-gear limit will no greater than long term in gear limit." VALUE 0x0002038C __UWORD_S 0 u_1s_tmr 0.0 65535 /end CHARACTERISTIC
/begin CHARACTERISTIC TQ_V_ESG_ESPD_LMT_OIL "Engine speed limit when oil temperature is high." VALUE 0x0002038C __UWORD_S 0 u_espd 0.0 8191.875 FORMAT "%5.1" /end CHARACTERISTIC
/begin CHARACTERISTIC TQ_V_ESG_ESPD_DCY "Engine speed limit decay step in one 125ms loop." VALUE 0x0002038C __UWORD_S 0 u_espd 0.0 8191.875 FORMAT "%5.1" /end CHARACTERISTIC
/begin CHARACTERISTIC TQ_V_ESG_ESPD_LMT_VSPD_ENBL "When vehicle speed above this threshold,engine speed limit use in gear limit value even it is not in gear." VALUE 0x0002038C __UWORD_S 0 u_vspd 0 511.9921875 /end CHARACTERISTIC
/begin CHARACTERISTIC TQ_V_ESG_ESPD_RMP_TM_THRSH "After governor active for this duration then engine speed limit ramp to long term limit value." VALUE 0x0002038C __UWORD_S 0 u_1s_tmr 0.0 65535 /end CHARACTERISTIC
/begin CHARACTERISTIC TQ_V_ESG_ESPD_N_L "Engine speed limit in neutral gear in long term when vehicle speed is low." VALUE 0x0002038C __UWORD_S 0 u_espd 0.0 8191.875 FORMAT "%5.1" /end CHARACTERISTIC
/begin CHARACTERISTIC TQ_V_ESG_ESPD_N_L_OFST "Engine speed limit in neutral gear in long term offset." VALUE 0x0002038C __UWORD_S 0 u_espd 0.0 8191.875 FORMAT "%5.1" /end CHARACTERISTIC
/begin CHARACTERISTIC TQ_V_ESG_ESPD_N "Engine speed limit in neutral gear in short term when vehicle speed is low." VALUE 0x0002038C __UWORD_S 0 u_espd 0.0 8191.875 FORMAT "%5.1" /end CHARACTERISTIC
/begin CHARACTERISTIC TQ_C_ESG_PRE_LD "Torque needed to maintain the maximum engine speed calibration a flat road." CURVE 0x000200B0 __UWORD_S 0 u_tq -2048 2047.9375
 /begin AXIS_DESCR FIX_AXIS tq_veh_gr_st u_tq_gr_typ 11 0 10 /begin FIX_AXIS_PAR_LIST 0 1 2 3 4 5 6 7 8 9 10 /end FIX_AXIS_PAR_LIST /end AXIS_DESCR
/end CHARACTERISTIC
/begin CHARACTERISTIC TQ_V_ESG_FAC "Engine speed governor factor." VALUE 0x0002038C __UWORD_S 0 u_fac_2 0 1.99996948242187 FORMAT "%4.3" /end CHARACTERISTIC
/begin CHARACTERISTIC TQ_V_ESG_FAC_MN "Engine Speed Governor factor min limit." VALUE 0x0002038C __UWORD_S 0 u_fac_2 0 1.99996948242187 FORMAT "%4.3" /end CHARACTERISTIC
/begin CHARACTERISTIC TQ_V_ESG_INT_FAC "Engine Speed Governor integral factor." VALUE 0x0002038C __UWORD_S 0 u_fac_8 0 7.9998779296875 FORMAT "%4.3" /end CHARACTERISTIC
/begin CHARACTERISTIC TQ_V_ESG_PROP_FAC "Engine Speed Governor proportional factor." VALUE 0x0002038C __UWORD_S 0 u_fac_8 0 7.9998779296875 FORMAT "%4.3" /end CHARACTERISTIC
/begin CHARACTERISTIC TQ_V_ESG_PROP_MN "Engine Speed Governor torque proportional term min limit." VALUE 0x0002038C __SWORD_S 0 u_tq -2048 2047.9375 FORMAT "%5.2" /end CHARACTERISTIC
/begin CHARACTERISTIC TQ_V_ESG_PROP_MX "Engine Speed Governor torque proportional term max limit." VALUE 0x0002038C __SWORD_S 0 u_tq -2048 2047.9375 FORMAT "%5.2" /end CHARACTERISTIC
/begin CHARACTERISTIC TQ_V_ESG_DERV_FAC "Engine Speed Governor derivative factor." VALUE 0x0002038C __UWORD_S 0 u_fac_8 0 7.9998779296875 FORMAT "%4.3" /end CHARACTERISTIC
/begin CHARACTERISTIC TQ_V_ESG_FILT_DSBL "Engine speed governor torque setpoint filter disable when engine speed error less than this cal." VALUE 0x0002038C __UWORD_S 0 u_espd 0.0 8191.875 FORMAT "%5.1" /end CHARACTERISTIC
/begin CHARACTERISTIC TQ_V_ESG_TORQ_FILT_PN "Engine speed governor torque setpoint filter in PN gear." VALUE 0x0002038C __UWORD_S 0 u_fac_1 0 0.999984741210937 /end CHARACTERISTIC
/begin CHARACTERISTIC TQ_V_ESG_TORQ_FILT "Engine speed governor torque setpoint filter in gear." VALUE 0x0002038C __UWORD_S 0 u_fac_1 0 0.999984741210937 /end CHARACTERISTIC
/begin CHARACTERISTIC TQ_C_VSG_MX "Vehicle speed limit above which torque governor will actively limit torque to vehicle speed as a function of gear state." CURVE 0x35EEA __UWORD_S 0 u_vspd 0 511.992188 FORMAT "%4.1"
 /begin AXIS_DESCR FIX_AXIS NO_INPUT_QUANTITY u_fwd_gear 8 0 7 /begin FIX_AXIS_PAR_LIST 0 1 2 3 4 5 6 7 /end FIX_AXIS_PAR_LIST /end AXIS_DESCR
/end CHARACTERISTIC
/begin CHARACTERISTIC TQ_V_VSG_MX_FILT "Vehicle speed governor max value filter." VALUE 0x0002038C __UWORD_S 0 u_fac_1 0 0.999984741210937 /end CHARACTERISTIC
/begin CHARACTERISTIC TQ_V_VSG_MN "Minimum allowable governing vehicle speed limit." VALUE 0x0002038C __UWORD_S 0 u_vspd 0 511.9921875 FORMAT "%4.1" /end CHARACTERISTIC
/begin CHARACTERISTIC TQ_C_VSG_PROP_FAC "Vehicle Speed Governor proportional factor." CURVE 0x35EEA __UWORD_S 0 u_fac_64 0.0 63.9990234375
 /begin AXIS_DESCR FIX_AXIS NO_INPUT_QUANTITY u_fwd_gear 8 0 7 /begin FIX_AXIS_PAR_LIST 0 1 2 3 4 5 6 7 /end FIX_AXIS_PAR_LIST /end AXIS_DESCR
/end CHARACTERISTIC
/begin CHARACTERISTIC TQ_C_VSG_INT_FAC "Vehicle Speed Governor integral factor." CURVE 0x35EEA __UWORD_S 0 u_fac_8 0.0 7.9998779296875 FORMAT "%3.2"
 /begin AXIS_DESCR FIX_AXIS NO_INPUT_QUANTITY u_fwd_gear 8 0 7 /begin FIX_AXIS_PAR_LIST 0 1 2 3 4 5 6 7 /end FIX_AXIS_PAR_LIST /end AXIS_DESCR
/end CHARACTERISTIC
/begin CHARACTERISTIC TQ_V_TRNS_R_MX "Maximum reverse gear transmission pump torque." VALUE 0x0002038C __SWORD_S 0 u_tq -2048 2047.9375 FORMAT "%5.2" /end CHARACTERISTIC
/begin CHARACTERISTIC TQ_V_TCM_LMT_TORQ_CFG "TCM limit torque configuration.False:indicate torque;True:flywheel torque." VALUE 0x2886C __UBYTE_S 0 b_true 0 1 FORMAT "%1.0" /end CHARACTERISTIC
/begin CHARACTERISTIC TQ_V_TCM_RED_FTORQ_CFG "TCM reduction request fast torque configuration.False:indicate torque;True:flywheel torque." VALUE 0x2886C __UBYTE_S 0 b_true 0 1 FORMAT "%1.0" /end CHARACTERISTIC
/begin CHARACTERISTIC TQ_V_TCM_RED_STORQ_CFG "TCM reduction request slow torque configuration.False:indicate torque;True:flywheel torque." VALUE 0x2886C __UBYTE_S 0 b_true 0 1 FORMAT "%1.0" /end CHARACTERISTIC
/begin CHARACTERISTIC TQ_V_TCM_INC_TORQ_CFG "TCM increase torque request configuration.False:indicate torque;True:flywheel torque." VALUE 0x2886C __UBYTE_S 0 b_true 0 1 FORMAT "%1.0" /end CHARACTERISTIC
/begin CHARACTERISTIC TQ_V_REF_TORQ "The engine reference torque. " VALUE 0x0002038C __SWORD_S 0 u_tq -2048 2047.9375 FORMAT "%5.2" /end CHARACTERISTIC
/begin CHARACTERISTIC TQ_V_ESG_MN_SPD "Engine speed governor min engine speed." VALUE 0x0002038C __UWORD_S 0 u_espd 0.0 8191.875 FORMAT "%5.1" /end CHARACTERISTIC
/begin CHARACTERISTIC TQ_V_ESG_DERV_TM "Delta time for ES Governor derivative calculation." VALUE 0x0002038C __UWORD_S 0 u_1s_tmr 0.0 65535 /end CHARACTERISTIC
/begin CHARACTERISTIC TQ_V_TORQ_VLD_CFG_MAP "Torque validation configuration,MAP fault will linked to torque estimated validation." VALUE 0x0002038C __UBYTE_S 0 b_true 0 1 FORMAT "%1.0" BIT_MASK 0x80 SYMBOL_LINK "TQ_V_TORQ_VLD_CFG" 0 /end CHARACTERISTIC
/begin CHARACTERISTIC TQ_V_TORQ_VLD_CFG_MAF "Torque validation configuration,MAF fault will linked to torque estimated validation." VALUE 0x0002038C __UBYTE_S 0 b_true 0 1 FORMAT "%1.0" BIT_MASK 0x40 SYMBOL_LINK "TQ_V_TORQ_VLD_CFG" 0 /end CHARACTERISTIC
/begin CHARACTERISTIC TQ_V_TORQ_VLD_CFG_EST "Torque validation configuration,EST fault will linked to torque estimated validation." VALUE 0x0002038C __UBYTE_S 0 b_true 0 1 FORMAT "%1.0" BIT_MASK 0x20 SYMBOL_LINK "TQ_V_TORQ_VLD_CFG" 0 /end CHARACTERISTIC
/begin CHARACTERISTIC TQ_V_TORQ_VLD_CFG_IAT "Torque validation configuration,IAT fault will linked to torque estimated validation." VALUE 0x0002038C __UBYTE_S 0 b_true 0 1 FORMAT "%1.0" BIT_MASK 0x10 SYMBOL_LINK "TQ_V_TORQ_VLD_CFG" 0 /end CHARACTERISTIC
/begin CHARACTERISTIC TQ_V_TORQ_VLD_CFG_INJ "Torque validation configuration,INJ fault will linked to torque estimated validation." VALUE 0x0002038C __UBYTE_S 0 b_true 0 1 FORMAT "%1.0" BIT_MASK 0x08 SYMBOL_LINK "TQ_V_TORQ_VLD_CFG" 0 /end CHARACTERISTIC
/begin CHARACTERISTIC TQ_V_TORQ_VLD_CFG_MISF "Torque validation configuration,MISF fault will linked to torque estimated validation." VALUE 0x0002038C __UBYTE_S 0 b_true 0 1 FORMAT "%1.0" BIT_MASK 0x04 SYMBOL_LINK "TQ_V_TORQ_VLD_CFG" 0 /end CHARACTERISTIC
/begin CHARACTERISTIC TQ_V_TORQ_VLD_CFG_ECT "Torque validation configuration,ECT fault will linked to torque estimated validation." VALUE 0x0002038C __UBYTE_S 0 b_true 0 1 FORMAT "%1.0" BIT_MASK 0x02 SYMBOL_LINK "TQ_V_TORQ_VLD_CFG" 0 /end CHARACTERISTIC
/begin CHARACTERISTIC TQ_V_TORQ_VLD_CFG_LPI "Torque validation configuration,LPI fault will linked to torque estimated validation." VALUE 0x0002038C __UBYTE_S 0 b_true 0 1 FORMAT "%1.0" BIT_MASK 0x01 SYMBOL_LINK "TQ_V_TORQ_VLD_CFG" 0 /end CHARACTERISTIC
/begin CHARACTERISTIC TQ_V_PPS_DRV_RMP "if set use a time based ramp for driver mode modifier otherwise use a mult." VALUE 0x0002038C __UBYTE_S 0 b_true 0 1 FORMAT "%1.0" BIT_MASK 0x10 SYMBOL_LINK "TQ_V_OPT_CFG" 0 /end CHARACTERISTIC
/begin CHARACTERISTIC TQ_V_PPS_GR_RMP "if set use a time based ramp for gear mode modifier otherwise use a mult." VALUE 0x0002038C __UBYTE_S 0 b_true 0 1 FORMAT "%1.0" BIT_MASK 0x20 SYMBOL_LINK "TQ_V_OPT_CFG" 0 /end CHARACTERISTIC
/begin CHARACTERISTIC TQ_V_PPS_RAW_CAN "Per default the progression modified pedal is sent on CAN,if this bit is set,send unmodified pedal position." VALUE 0x0002038C __UBYTE_S 0 b_true 0 1 FORMAT "%1.0" BIT_MASK 0x40 SYMBOL_LINK "TQ_V_OPT_CFG" 0 /end CHARACTERISTIC
/begin CHARACTERISTIC TQ_V_PPS_CRU_SPRT " In case of cruise,return sports mode is activated." VALUE 0x0002038C __UBYTE_S 0 b_true 0 1 FORMAT "%1.0" BIT_MASK 0x80 SYMBOL_LINK "TQ_V_OPT_CFG" 0 /end CHARACTERISTIC
/begin CHARACTERISTIC TQ_M_AC_ESPD_COMP "AC torque load compensation vs engine speed to compensate for compressor friction load." MAP 0x00020320 __SWORD_S 0 u_tq -2048 2047.9375
 /begin AXIS_DESCR FIX_AXIS NO_INPUT_QUANTITY u_ac_cfg 2 0 1 /begin FIX_AXIS_PAR_LIST 0 1 /end FIX_AXIS_PAR_LIST /end AXIS_DESCR
 /begin AXIS_DESCR FIX_AXIS sys_eng_spd u_espd 9 0 6400 /begin FIX_AXIS_PAR_LIST 0 6400 12800 19200 25600 32000 38400 44800 51200 /end FIX_AXIS_PAR_LIST /end AXIS_DESCR
/end CHARACTERISTIC
/begin CHARACTERISTIC TQ_C_AC_DCY_TM_INIT "Time step at which init decay mult is applied for the decay of init pressure." CURVE 0x000200B0 __UWORD_S 0 u_2x_tmr 0 1023.984375
 /begin AXIS_DESCR FIX_AXIS NO_INPUT_QUANTITY u_ac_cfg 2 0 1 /begin FIX_AXIS_PAR_LIST 0 1 /end FIX_AXIS_PAR_LIST /end AXIS_DESCR
/end CHARACTERISTIC
/begin CHARACTERISTIC TQ_V_SHFT_PPS_DLT_THRSH "If the delta of pedal larger than this threshold,over torque shift would be disabled." VALUE 0x0002038C __UWORD_S 0 u_pct_r_lo_s 0 511.9921875 /end CHARACTERISTIC
/begin CHARACTERISTIC TQ_V_LVSPD_PPS_IDX_STP "Ramp step for low speed pedal index." VALUE 0x0002038C __UWORD_S 0 u_pct 0 199.9969482421875 /end CHARACTERISTIC
/begin CHARACTERISTIC TQ_V_ESPD_INC_TM "Engine speed control increase time." VALUE 0x0002038C __UWORD_S 0 u_2x_tmr 0 1023.984375 /end CHARACTERISTIC
/begin CHARACTERISTIC TQ_M_PED2TQ_PCT_LSPD "Pedal position to torque percent in low speed mode." MAP 0x00020320 __UWORD_S 0 u_pct 0 199.996948242187 SYMBOL_LINK "TQ_M_PED2TQ_PCT_LSPD" 4
 /begin AXIS_DESCR COM_AXIS sys_eng_spd u_espd 17 0 8191.875 AXIS_PTS_REF TQ_X_ESPD_E /end AXIS_DESCR
 /begin AXIS_DESCR COM_AXIS tq_pps u_pct_r 21 0 127.998046875 AXIS_PTS_REF TQ_X_PPS /end AXIS_DESCR
/end CHARACTERISTIC
/begin COMPU_METHOD u_volt_32 "voltage" RAT_FUNC "%6.4" "V" COEFFS 0.0 1.0 0.000000 0.0 0.0 0.00048828125 /end COMPU_METHOD
/begin COMPU_METHOD u_kPa_0_256 "press" RAT_FUNC "%5.2" "kPa" COEFFS 0.0 1.0 0.000000 0.0 0.0 0.00390625 /end COMPU_METHOD
/begin COMPU_METHOD u_kPa_0_512 "press" RAT_FUNC "%5.2" "kPa" COEFFS 0.0 1.0 0.000000 0.0 0.0 0.0078125 /end COMPU_METHOD
/begin COMPU_METHOD u_kPa_0_32768 "press" RAT_FUNC "%6.1" "kPa" COEFFS 0.0 1.0 0.000000 0.0 0.0 0.5 /end COMPU_METHOD
/begin COMPU_METHOD u_kPa_256n_256p "press" RAT_FUNC "%5.2" "kPa" COEFFS 0.0 1.0 0.000000 0.0 0.0 0.0078125 /end COMPU_METHOD
/begin COMPU_METHOD u_kPa_512n_512p "press" RAT_FUNC "%5.2" "kPa" COEFFS 0.0 1.0 0.000000 0.0 0.0 0.015625 /end COMPU_METHOD
/begin COMPU_METHOD u_kPa_4096n_4096p "press" RAT_FUNC "%5.1" "kPa" COEFFS 0.0 1.0 0.000000 0.0 0.0 0.125 /end COMPU_METHOD
/begin COMPU_METHOD u_fac_128 "factor" RAT_FUNC "%5.2" "fac" COEFFS 0.0 1.0 0.000000 0.0 0.0 0.001953125 /end COMPU_METHOD
/begin COMPU_METHOD u_fac_64 "factor" RAT_FUNC "%4.2" "fac" COEFFS 0.0 1.0 0.000000 0.0 0.0 0.0009765625 /end COMPU_METHOD
/begin COMPU_METHOD u_fac_32 "factor" RAT_FUNC "%8.6" "fac" COEFFS 0.0 1.0 0.000000 0.0 0.0 0.00048828125 /end COMPU_METHOD
/begin COMPU_METHOD u_fac_16 "factor" RAT_FUNC "%5.3" "fac" COEFFS 0.0 1.0 0.000000 0.0 0.0 0.000244140625 /end COMPU_METHOD
/begin COMPU_METHOD u_fac_8 "factor" RAT_FUNC "%8.7" "fac" COEFFS 0.0 1.0 0.000000 0.0 0.0 0.0001220703125 /end COMPU_METHOD
/begin COMPU_METHOD u_fac_4 "factor" RAT_FUNC "%5.4" "fac" COEFFS 0.0 1.0 0.000000 0.0 0.0 0.00006103515625 /end COMPU_METHOD
/begin COMPU_METHOD u_fac_2 "factor" RAT_FUNC "%3.2" "fac" COEFFS 0.0 1.0 0.000000 0.0 0.0 0.000030517578125 /end COMPU_METHOD
/begin COMPU_METHOD u_fac_1 "factor" RAT_FUNC "%4.3" "fac" COEFFS 0.0 1.0 0.000000 0.0 0.0 0.0000152587890625 /end COMPU_METHOD
/begin COMPU_METHOD u_fac_2_b "factor" RAT_FUNC "%3.2" "fac" COEFFS 0.0 1.0 0.000000 0.0 0.0 0.0078125 /end COMPU_METHOD
/begin COMPU_METHOD u_amp "current" RAT_FUNC "%5.2" "A" COEFFS 0.0 1.0 0.000000 0.0 0.0 0.001953125 /end COMPU_METHOD
/begin COMPU_METHOD u_fac_n2_p2 "factor" RAT_FUNC "%3.2" "fac" COEFFS 0.0 1.0 0.000000 0.0 0.0 0.00006103515625 /end COMPU_METHOD
/begin COMPU_METHOD u_fac_n4_p4 "factor" RAT_FUNC "%3.2" "fac" COEFFS 0.0 1.0 0.000000 0.0 0.0 0.0001220703125 /end COMPU_METHOD
/begin COMPU_METHOD u_deg_K "degK" RAT_FUNC "%6.2" "K" COEFFS 0.0 1.0 0.0 0.0 0.0 0.03125 /end COMPU_METHOD
/begin COMPU_METHOD u_deg_C "degC" RAT_FUNC "%5.2" "¡æ" COEFFS 0.0 1.0 0.0 0.0 0.0 0.0078125 /end COMPU_METHOD
/begin COMPU_METHOD u_filter "filter" RAT_FUNC "%11.10" "coef" COEFFS 0.0 1.0 0.0 0.0 0.0 0.0000152587890625 /end COMPU_METHOD
/begin COMPU_METHOD u_cnts "counts" RAT_FUNC "%3.0" "cnts" COEFFS 0.0 1.0 0.0 0.0 0.0 1.0 /end COMPU_METHOD
/begin COMPU_METHOD u_min "min timer" RAT_FUNC "%5.0" "min" COEFFS 0.0 1.0 0.0 0.0 0.0 1.00 /end COMPU_METHOD
/begin COMPU_METHOD u_1x_tmr "7.81 timer" RAT_FUNC "%4.3" "s" COEFFS 0.0 1.0 0.0 0.0 0.0 0.0078125 /end COMPU_METHOD
/begin COMPU_METHOD u_2x_tmr "15.6 timer" RAT_FUNC "%6.2" "s" COEFFS 0.0 1.0 0.0 0.0 0.0 0.015625 /end COMPU_METHOD
/begin COMPU_METHOD u_1s_tmr "1 sec timer" RAT_FUNC "%5.0" "s" COEFFS 0.0 1.0 0.0 0.0 0.0 1.0 /end COMPU_METHOD
/begin COMPU_METHOD u_nm "torque" RAT_FUNC "%6.2" "Nm" COEFFS 0.0 1.0 0.0 0.0 0.0 0.015625 /end COMPU_METHOD
/begin COMPU_METHOD u_nm_s "torque" RAT_FUNC "%6.2" "Nm" COEFFS 0.0 1.0 0.0 0.0 0.0 0.0625 /end COMPU_METHOD
/begin COMPU_METHOD u_tq_1024 "torque" RAT_FUNC "%5.1" "Nm" COEFFS 0.0 1.0 0.000000 0.0 0.0 0.03125 /end COMPU_METHOD
/begin COMPU_METHOD b_true "" TAB_VERB "%6.3" "" COMPU_TAB_REF b_true /end COMPU_METHOD
/begin COMPU_VTAB b_true "" TAB_VERB 2 0 "FALSE" 1 "TRUE" /end COMPU_VTAB
/begin COMPU_METHOD u_fwd_gear "" TAB_VERB "%4.0" "" COMPU_TAB_REF u_fwd_gear /end COMPU_METHOD
/begin COMPU_VTAB u_fwd_gear "" TAB_VERB 8 0 "1" 1 "2" 2 "3" 3 "4" 4 "5" 5 "6" 6 "7" 7 "8" /end COMPU_VTAB
/begin COMPU_METHOD u_espd "engine speed" RAT_FUNC "%5.2" "rpm" COEFFS 0.0 1.0 0.000000 0.0 0.0 0.125 /end COMPU_METHOD
/begin COMPU_METHOD u_espd_acl "engine speed acc" RAT_FUNC "%5.2" "rpm/s" COEFFS 0.0 1.0 0.000000 0.0 0.0 0.125 /end COMPU_METHOD
/begin COMPU_METHOD u_espd_acl_hi "engine speed acc" RAT_FUNC "%5.2" "rpm/s" COEFFS 0.0 1.0 0.000000 0.0 0.0 0.0078125 /end COMPU_METHOD
/begin COMPU_METHOD u_lmt_rsn "" TAB_VERB "%10.4" "" COMPU_TAB_REF u_lmt_rsn /end COMPU_METHOD
/begin COMPU_VTAB u_lmt_rsn "" TAB_VERB 14 0 "Normal" 1 "spill value filt" 2 "lift pump low voltage" 3 "charger" 4 "intercooler pump" 5 "super knock" 6 "exhaust over temperature" 7 "engine temperature high" 8 "external torque limit" 9 "throttle over temperature" 10 "low gear" 11 "cam backup" 12 "vvt error" 13 "low octane fuel" /end COMPU_VTAB
/begin COMPU_METHOD u_vspd "vehicle speed" RAT_FUNC "%5.2" "kph" COEFFS 0.0 1.0 0.000000 0.0 0.0 0.0078125 /end COMPU_METHOD
/begin COMPU_METHOD u_vspd_err "vehicle speed error" RAT_FUNC "%5.2" "kph" COEFFS 0.0 1.0 0.000000 0.0 0.0 0.015625 /end COMPU_METHOD
/begin COMPU_METHOD u_pct "percentage" RAT_FUNC "%5.2" "%" COEFFS 0.0 1.0 0.000000 0.0 0.0 0.0030517578125 /end COMPU_METHOD
/begin COMPU_METHOD u_pct_1 "percentage" RAT_FUNC "%5.2" "%" COEFFS 0.0 1.0 0.000000 0.0 0.0 0.00152587890625 /end COMPU_METHOD
/begin COMPU_METHOD u_pct_8 "percentage" RAT_FUNC "%5.2" "%" COEFFS 0.0 1.0 0.000000 0.0 0.0 0.01220703125 /end COMPU_METHOD
/begin COMPU_METHOD u_pct_s "percentage" RAT_FUNC "%5.2" "%" COEFFS 0.0 1.0 0.000000 0.0 0.0 0.006103515625 /end COMPU_METHOD
/begin COMPU_METHOD u_pct_r "real pct" RAT_FUNC "%5.2" "%" COEFFS 0.0 1.0 0.000000 0.0 0.0 0.001953125 /end COMPU_METHOD
/begin COMPU_METHOD u_pct_r_lo_s "real pct" RAT_FUNC "%5.2" "%" COEFFS 0.0 1.0 0.000000 0.0 0.0 0.0078125 /end COMPU_METHOD
/begin COMPU_METHOD u_afr "airfuel" RAT_FUNC "%3.1" "Ratio" COEFFS 0.0 1.0 0.000000 0.0 0.0 0.00048828125 /end COMPU_METHOD
/begin COMPU_METHOD u_kPa_0_4096 "IMEP" RAT_FUNC "%6.2" "kPa" COEFFS 0.0 1.0 0.000000 0.0 0.0 0.0625 /end COMPU_METHOD
/begin COMPU_METHOD u_ht_value "heat value" RAT_FUNC "%4.2" "J/mg" COEFFS 0.0 1.0 0.000000 0.0 0.0 0.0009765625 /end COMPU_METHOD
/begin COMPU_METHOD u_tq "torque" RAT_FUNC "%5.1" "Nm" COEFFS 0.0 1.0 0.000000 0.0 0.0 0.0625 /end COMPU_METHOD
/begin COMPU_METHOD u_espd_n4096_p4096 "engine speed" RAT_FUNC "%6.2" "rpm" COEFFS 0.0 1.0 0.0 0.0 0.0 0.125 /end COMPU_METHOD
/begin COMPU_METHOD u_tq_gr_typ "" TAB_VERB "%5.0" "" COMPU_TAB_REF u_tq_gr_typ /end COMPU_METHOD
/begin COMPU_VTAB u_tq_gr_typ "" TAB_VERB 11 0 "GEAR_1" 1 "GEAR_2" 2 "GEAR_3" 3 "GEAR_4" 4 "GEAR_5" 5 "GEAR_6" 6 "GEAR_7" 7 "GEAR_8" 8 "UNKNOWN" 9 "PN" 10 "R" /end COMPU_VTAB
/begin COMPU_METHOD u_tq_req_typ "" TAB_VERB "%5.0" "" COMPU_TAB_REF u_tq_req_typ /end COMPU_METHOD
/begin COMPU_VTAB u_tq_req_typ "" TAB_VERB 21 0 "DRVER_REQ" 1 "TCM_INC" 2 "TCM_LMT" 3 "TCM_DEC" 4 "ABS_INC" 5 "ABS_LMT" 6 "ABS_DEC" 7 "CRUZ_INC" 8 "ESPD_CTRL_LMT" 9 "VSPD_CTRL_LMT" 10 "ETC_PERF_LMT" 11 "ETC_POW_MNG_DEC" 12 "MAX_TQ_LMT" 13 "F_TQ_INC" 14 "F_TQ_LMT" 15 "F_TQ_DEC" 16 "DRV_CHAIN_PROT" 17 "REV_TCM_LMT_INC" 18 "EXT_ESPD_CTRL_INC" 19 "EXT_ESPD_CTRL_LMT" 20 "EXT_ESPD_CTRL_DEC" /end COMPU_VTAB
/begin COMPU_METHOD u_tq_valid "" TAB_VERB "%6.3" "" COMPU_TAB_REF u_tq_valid /end COMPU_METHOD
/begin COMPU_VTAB u_tq_valid "" TAB_VERB 2 0 "VALID" 3 "INVALID" /end COMPU_VTAB
/begin COMPU_METHOD u_tq_eco_stat "" TAB_VERB "%6.3" "" COMPU_TAB_REF u_tq_eco_stat /end COMPU_METHOD
/begin COMPU_VTAB u_tq_eco_stat "" TAB_VERB 8 0 "Disable_NoReq" 2 "Disable_ECT" 3 "Disable_TqLimitFault" 4 "Disable_RunTime" 5 "Disable_TqReqType" 7 "Disable_PPS" 8 "Disable_DisTime" 11 "Enable" /end COMPU_VTAB
/begin COMPU_METHOD u_all_terrain_mod "" TAB_VERB "%4.0" "" COMPU_TAB_REF u_all_terrain_mod /end COMPU_METHOD
/begin COMPU_VTAB u_all_terrain_mod "" TAB_VERB 4 0 "Normal" 1 "Winter" 2 "Sport" 3 "Fault" /end COMPU_VTAB
/begin COMPU_METHOD u_rmp_dir "" TAB_VERB "%4.0" "" COMPU_TAB_REF u_rmp_dir /end COMPU_METHOD
/begin COMPU_VTAB u_rmp_dir "" TAB_VERB 2 0 "RAMP UP" 1 "RAMP DOWN" /end COMPU_VTAB
/begin COMPU_METHOD u_rmp_mod "" TAB_VERB "%4.0" "" COMPU_TAB_REF u_rmp_mod /end COMPU_METHOD
/begin COMPU_VTAB u_rmp_mod "" TAB_VERB 3 0 "Normal" 1 "Sport" 2 "Economic" /end COMPU_VTAB
/begin COMPU_METHOD u_tq_b "torque" RAT_FUNC "%4.1" "Nm" COEFFS 0.0 1.0 0.000000 0.0 0.0 0.5 /end COMPU_METHOD
/begin COMPU_METHOD u_tq_b_256 "torque" RAT_FUNC "%4.1" "Nm" COEFFS 0.0 1.0 0.000000 0.0 0.0 1 /end COMPU_METHOD
/begin COMPU_METHOD u_tq_256 "torque" RAT_FUNC "%6.3" "Nm" COEFFS 0.0 1.0 0.000000 0.0 0.0 0.00390625 /end COMPU_METHOD
/begin COMPU_METHOD u_mg_4096 "milli gram" RAT_FUNC "%6.2" "mg" COEFFS 0.0 1.0 0.000000 0.0 0.0 0.0625 /end COMPU_METHOD
/begin COMPU_METHOD u_tq_mod "" TAB_VERB "%4.0" "" COMPU_TAB_REF u_tq_mod /end COMPU_METHOD
/begin COMPU_VTAB u_tq_mod "" TAB_VERB 3 0 "SlowLead" 1 "FastLead" 2 "RampFastLead" /end COMPU_VTAB
/begin COMPU_METHOD u_tq_sec "Nm-second" RAT_FUNC "%6.2" "Nm-s" COEFFS 0.0 1.0 0.000000 0.0 0.0 0.015625 /end COMPU_METHOD
/begin COMPU_METHOD u_pct_sec "percent-second" RAT_FUNC "%5.2" "pct-s" COEFFS 0.0 1.0 0.000000 0.0 0.0 0.0078125 /end COMPU_METHOD
/begin COMPU_METHOD u_tq_per_rpm "Nm per rpm" RAT_FUNC "%5.4" "Nm_per_rpm" COEFFS 0.0 1.0 0.000000 0.0 0.0 0.000244140625 /end COMPU_METHOD
/begin COMPU_METHOD u_PUC_exit_dly_mod "" TAB_VERB "%6.3" "" COMPU_TAB_REF u_PUC_exit_dly_mod /end COMPU_METHOD
/begin COMPU_VTAB u_PUC_exit_dly_mod "" TAB_VERB 5 0 "StompTipIn" 1 "Coast" 2 "Declutch" 3 "RacingIdle" 4 "TipIn" /end COMPU_VTAB
/begin COMPU_METHOD u_PUC_exit_gear "" TAB_VERB "%6.3" "" COMPU_TAB_REF u_PUC_exit_gear /end COMPU_METHOD
/begin COMPU_VTAB u_PUC_exit_gear "" TAB_VERB 4 0 "Gear1" 1 "Gear2" 2 "Gear3" 3 "GEAR_PN" /end COMPU_VTAB
/begin COMPU_METHOD u_PUC_exit_mod "" TAB_VERB "%6.3" "" COMPU_TAB_REF u_PUC_exit_mod /end COMPU_METHOD
/begin COMPU_VTAB u_PUC_exit_mod "" TAB_VERB 3 0 "StompTipIn" 1 "Coast" 2 "TipIn" /end COMPU_VTAB
/begin COMPU_METHOD u_gearbox_type "" TAB_VERB "%6.3" "" COMPU_TAB_REF u_gearbox_type /end COMPU_METHOD
/begin COMPU_VTAB u_gearbox_type "" TAB_VERB 3 0 "MT" 1 "AT" 2 "AMT" /end COMPU_VTAB
/begin COMPU_METHOD u_espd_b_4096 "engine speed" RAT_FUNC "%5.2" "rpm" COEFFS 0.0 1.0 0.000000 0.0 0.0 16.0 /end COMPU_METHOD
/begin COMPU_METHOD u_tq_clutch_type "" TAB_VERB "%6.3" "" COMPU_TAB_REF u_tq_clutch_type /end COMPU_METHOD
/begin COMPU_VTAB u_tq_clutch_type "" TAB_VERB 4 0 "NoneClutch" 1 "ActualClutch" 2 "VirtualClutch" 3 "CombineClutch" /end COMPU_VTAB
/begin COMPU_METHOD u_tq_b_512n_512p "Nm" RAT_FUNC "%3.0" "Nm" COEFFS 0.0 1.0 0.000000 0.0 0.0 4.0 /end COMPU_METHOD
/begin COMPU_METHOD u_tq_test_ctrl_mod "" TAB_VERB "%6.3" "" COMPU_TAB_REF u_tq_test_ctrl_mod /end COMPU_METHOD
/begin COMPU_VTAB u_tq_test_ctrl_mod "" TAB_VERB 4 0 "Default" 1 "SlowLead" 2 "FastLead" 3 "RampFastLead" /end COMPU_VTAB
/begin COMPU_METHOD u_ac_st "" TAB_VERB "%6.3" "" COMPU_TAB_REF u_ac_st /end COMPU_METHOD
/begin COMPU_VTAB u_ac_st "" TAB_VERB 2 0 "AC_Off" 1 "AC_On" /end COMPU_VTAB
/begin COMPU_METHOD u_poc_gr "" TAB_VERB "%6.3" "" COMPU_TAB_REF u_poc_gr /end COMPU_METHOD
/begin COMPU_VTAB u_poc_gr "" TAB_VERB 4 0 "Gear1" 1 "Gear2" 2 "Gear3" 3 "OtherGear" /end COMPU_VTAB
/begin COMPU_METHOD u_nm_per_rpm "NewtonMeter Per RPM" RAT_FUNC "%5.2" "Nm_rpm" COEFFS 0.0 1.0 0.000000 0.0 0.0 0.001953125 /end COMPU_METHOD
/begin COMPU_METHOD u_hz "Hz" RAT_FUNC "%5.3" "Hz" COEFFS 0.0 1.0 0.000000 0.0 0.0 0.000244140625 /end COMPU_METHOD
/begin COMPU_METHOD u_load_cfg "" TAB_VERB "%6.3" "" COMPU_TAB_REF u_load_cfg /end COMPU_METHOD
/begin COMPU_VTAB u_load_cfg "" TAB_VERB 3 0 "NoLoadInput" 1 "LoadFromCAN" 2 "LoadFromHW" /end COMPU_VTAB
/begin COMPU_METHOD u_nm_l "NewtonMeter" RAT_FUNC "%10.9" "Nm" COEFFS 0.0 1.0 0.000000 0.0 0.0 0.0000002384185791015625 /end COMPU_METHOD
/begin COMPU_METHOD u_ac_cfg "" TAB_VERB "%6.3" "" COMPU_TAB_REF u_ac_cfg /end COMPU_METHOD
/begin COMPU_VTAB u_ac_cfg "" TAB_VERB 4 0 "Standard" 1 "Clutchless" 2 "Serial" 3 "Default" /end COMPU_VTAB
/begin COMPU_METHOD u_kw "KiloWatt" RAT_FUNC "%6.2" "Kw" COEFFS 0.0 1.0 0.000000 0.0 0.0 0.015625 /end COMPU_METHOD
/begin COMPU_METHOD u_ac_idx "" TAB_VERB "%6.3" "" COMPU_TAB_REF u_ac_idx /end COMPU_METHOD
/begin COMPU_VTAB u_ac_idx "" TAB_VERB 17 0 "0/-40" 1 "250/-28" 2 "500/-16" 3 "750/-4" 4 "1000/8" 5 "1250/20" 6 "1500/32" 7 "1750/44" 8 "2000/56" 9 "2250/68" 10 "2500/80" 11 "2750/92" 12 "3000/104" 13 "3250/116" 14 "3500/128" 15 "3750/140" 16 "4000/152" /end COMPU_VTAB
/begin COMPU_METHOD u_blower_lvl "" TAB_VERB "%6.3" "" COMPU_TAB_REF u_blower_lvl /end COMPU_METHOD
/begin COMPU_VTAB u_blower_lvl "" TAB_VERB 5 0 "BlowerOff" 1 "BlowerLow" 2 "BlowerMedium" 3 "BlowerMediumHigh" 4 "BlowerHigh" /end COMPU_VTAB
/begin COMPU_METHOD u_ped_mod "" TAB_VERB "%6.3" "" COMPU_TAB_REF u_ped_mod /end COMPU_METHOD
/begin COMPU_VTAB u_ped_mod "" TAB_VERB 5 0 "Forward" 1 "Reverse" 2 "LimitPerformance" 3 "PowerManagment" 4 "ParkNeutral" /end COMPU_VTAB
/begin COMPU_METHOD u_fac_4_b "factor" RAT_FUNC "%3.2" "fac" COEFFS 0.0 1.0 0.000000 0.0 0.0 0.015625 /end COMPU_METHOD
/begin FUNCTION tq_general ""
 /begin DEF_CHARACTERISTIC TQ_C_THEM_EFF_AF_FAC TQ_M_THEM_EFF_STOCH TQ_M_FRIC_LOSS TQ_V_MX_FLYW_TORQ_EXH_T_ENBL_THRSH TQ_V_MX_FLYW_TORQ_EXH_T_DSBL_THRSH TQ_V_MX_FLYW_TORQ_EXH_T_TMR_THRSH TQ_M_MX_FLYW_TORQ_EXH_T TQ_M_FRIC_LOSS_ECT_BIAS TQ_M_PMP_MEP_VALV TQ_C_PMP_MEP_THRO TQ_V_HT_VALUE TQ_M_ALT_TORQ TQ_C_FLYW_TORQ_MBT_MX_PROT_ICP TQ_C_FLYW_TORQ_MBT_MX_PROT_CAM_BKP TQ_M_ALT_TORQ_BAT_FAC TQ_C_PCT_TORQ_MAX TQ_V_GR_SRC_CAN TQ_V_ECO_ECT_THR TQ_V_ECO_ECT_THR_HYS TQ_V_ECO_RUN_MIN TQ_V_ECO_PPS_MAX_DUR TQ_V_ECO_PPS_MAX TQ_V_ECO_DIS_TIM_MIN TQ_M_ALL_TERN_PPS TQ_M_PED2TQ_PCT TQ_M_PED2TQ_PCT_ECO TQ_M_PED2TQ_PCT_SPRT TQ_M_CLCH_TQ_SP_RMP_STP TQ_C_IDL_FLW_TQ_GAIN_MX_STR TQ_V_IDL_FLW_TQ_GAIN_MX TQ_M_TRN_PMP_PN TQ_M_TRN_PMP_D TQ_M_TRN_PMP_R TQ_V_CTRL_MOD TQ_V_EXT_ESPD_MX TQ_V_EXT_ESPD_MN TQ_V_EXT_ESPD_ENBL_PRN TQ_V_EXT_ESPD_ENBL_TOOTH_LRN TQ_V_EXT_ESPD_INT_TORQ_LMT TQ_V_EXT_ESPD_INT_TORQ_LMT_BRK TQ_V_RT_EXT_ESPD_INC TQ_V_ECT_EXT_ESPD_INC TQ_C_RT_EXT_ESPD_DEC TQ_V_PPS_EXT_ESPD_DEC TQ_V_VSPD_EXT_ESPD_LNCH TQ_X_ESPD_I TQ_X_ESPD_DLT TQ_X_ESPD_RT TQ_C_EXT_ESPD_TORQ_FAC TQ_V_ROT_J TQ_X_VSPD TQ_X_PPS_B TQ_X_OIL_TEMP TQ_M_EXT_ESPD_VSPD_FAC TQ_M_EXT_ESPD_OILT_FAC TQ_M_EXT_ESPD_TORQ_OFST TQ_V_EXT_ESPD_CHNG_THRSH TQ_X_ESPD_RT_B TQ_C_EXT_ESPD_TORQ_SP_WGHT TQ_M_EXT_ESPD_TORQ_PWRON_DS TQ_M_EXT_ESPD_PROP TQ_M_EXT_ESPD_DERV TQ_M_EXT_ESPD_INT TQ_V_EXT_ESPD_INT_DB TQ_C_EXT_ESPD_TORQ_LMT_RMP_LNCH TQ_C_EXT_ESPD_TORQ_LMT_RMP TQ_V_EXT_ESPD_TORQ_LMT_RMP_IN TQ_V_EXT_ESPD_TORQ_DEC_RMP_OUT TQ_V_EXT_ESPD_TORQ_DEC_RMP_IN TQ_V_EXT_ESPD_TORQ_INC_RMP_OUT TQ_V_EXT_ESPD_TORQ_INC_RMP_IN TQ_X_ECT TQ_X_IMEP_RT TQ_M_IDL_FST_OFST_FAC_PD TQ_M_IDL_FST_OFST_FAC TQ_C_IDL_FST_OFST_ESPD_DLT_FAC TQ_V_RFST_PPS_THRSH TQ_V_RFST_OL TQ_V_PUC_TORQ_CTRL TQ_V_INRT_PUC_TORQ_CTRL TQ_C_PUC_ENTRY_STP TQ_V_PUC_ENTRY_MN_TORQ_OFST TQ_V_STOMP_PPS_THRSH TQ_C_PUC_EXIT_DLY TQ_C_PUC_EXIT_MN_TORQ_OFST TQ_X_ESPD_DLT_RT TQ_C_PUC_EXIT_STP_FAC TQ_V_PUC_EXIT_STP_IDL TQ_V_PUC_EXIT_STP_DECLTCH TQ_M_PUC_EXIT_STP TQ_M_PUC_EXIT_STP_BRK_OFST TQ_V_PUC_EXIT_STP_FAC_SPRT TQ_X_PUC_EXIT_TM TQ_M_PUC_EXIT_STP_FAC_TM TQ_V_PUC_EXIT_ESPD_DLT_THRSH TQ_V_PUC_EXIT_ESPD_DLT_RT_THRSH TQ_V_PUC_EXIT_END_IDL TQ_V_TCS_INC_FAC TQ_V_TCS_INC_OFST TQ_V_TCS_INC_FLYW_TYP TQ_V_TCS_LMT_FAC TQ_V_TCS_LMT_OFST TQ_V_TCS_LMT_FLYW_TYP TQ_V_TCS_DEC_FAC TQ_V_TCS_DEC_OFST TQ_V_TCS_DEC_FLYW_TYP TQ_X_TORQ_DLT TQ_C_ADD_INC_TORQ TQ_V_TEST_INC_ENBL TQ_V_TEST_LMT_ENBL TQ_V_TEST_DEC_ENBL TQ_V_TEST_FOFF_ENBL TQ_V_TEST_CTRL_MOD TQ_V_TEST_INC_TORQ_SP TQ_V_DRVBL_ENBL_DLY TQ_V_TEST_LMT_TORQ_SP TQ_V_DEC_FOFF_PPS_THRSH TQ_V_DEC_FOFF_ECT_THRSH TQ_V_DEC_FOFF_ENBL TQ_V_EXT_ESPD_FOFF_ENBL TQ_V_TEST_DEC_TORQ_SP TQ_C_LIMP_TORQ TQ_V_LIMP_RMP_TM TQ_C_PWRM_TORQ TQ_V_PWRM_RMP_TM TQ_V_CLTCH_FCO_UP_EXIT_ESPD TQ_M_GR_RT TQ_M_CLTCH_FCO_MN_ESPD TQ_V_CLTCH_FCO_MN_ESPD_HYS TQ_V_CLTCH_TYP TQ_V_CLTCH_FCO_MN_VSPD TQ_V_CLTCH_FCO_MX_PPS TQ_V_CLTCH_FCO_CAT_HT_DSBL TQ_V_CLTCH_FCO_TPO_ESPD TQ_V_CLTCH_FCO_TPO_ESPD_HYS TQ_V_CLTCH_FCO_TPO_VSPD TQ_V_CLTCH_FCO_TPO_VSPD_HYS TQ_V_CLTCH_FCO_ENBL TQ_X_ESPD_J TQ_C_CLTCH_FCO_EXIT_ESPD_FILT TQ_X_CLTCH_FCO_TM TQ_C_CLTCH_FCO_EXIT_TM_FILT TQ_V_CLTCH_FCO_MN_TORQ TQ_V_TPO_CTRL_MOD TQ_V_TPO_IGA_RTD_ENBL TQ_V_TPO_FCO_MN_ESPD TQ_V_TPO_FCO_MN_ECT TQ_X_PQ TQ_X_IAT TQ_X_AMP_B TQ_X_DCY_TM TQ_C_RMP_FST_TM TQ_X_ESPD_K TQ_C_MX_IMEP TQ_V_LO_IMEP_VSPD_THRSH TQ_C_LO_IMEP_PUC TQ_C_LO_IMEP TQ_X_AMP_C TQ_C_LO_IMEP_FAC TQ_V_LO_IMEP_STP_PUC TQ_V_LO_IMEP_HYST TQ_X_REF_TORQ TQ_M_R_PED2TQ_PCT TQ_X_TORQ_RT TQ_X_ESPD_DLT_B TQ_M_IDL_FST_OFST_PD_FAC TQ_V_CTRL_MOD_RMP_S2F_STP TQ_V_CTRL_MOD_RMP_F2S_STP TQ_X_PPS_C TQ_X_ESPD_L TQ_M_MN_IMEP_FCO_DEC TQ_V_POC_ENBL_PUC TQ_C_F_RT_OFF_CYL_PUC TQ_C_F_RT_ON_CYL_PUC TQ_C_F_RT_OFF_CYL TQ_C_F_RT_ON_CYL TQ_V_CRK_IG_RTD TQ_M_1STFLR_IG_EFF TQ_M_FLR_IG_EFF TQ_V_IG_RT_CLTCH_FCO TQ_V_IG_RT_ENBL_PUC TQ_M_IG_RT_PUC TQ_V_ADD_OFF_PPS_VSPD_THRSH TQ_V_ADD_OFF_PPS_MAP_THRSH TQ_X_ECT_B TQ_C_ADD_OFF_PPS_TM_THRSH TQ_V_ADD_AT_TM TQ_V_ADD_AT_IDL_WRM TQ_V_ADD_AT_IDL TQ_V_ADD_AT_IDL_IN TQ_V_ADD_AT_IDL_OUT TQ_M_ADD_CRP TQ_X_TQ_DLT TQ_X_TQ TQ_V_ADD_CRP_RMP_THRSH TQ_V_ADD_CRP_RMP_INC TQ_V_ADD_CRP_RMP_DEC TQ_M_ADD_WRM TQ_X_ESPD_M TQ_M_ADD_PFST_ECT_FAC TQ_C_ADD_PFST_ESPD_FAC TQ_V_ADD_RMP_MX TQ_V_ADD_LNCH_MN TQ_V_ADD_MX_MRG TQ_V_POC_AT_TRNS TQ_V_POC_HCLTCH_MN_TORQ TQ_V_POC_HCLTCH_MN_PPS TQ_V_POC_HCLTCH_INRT TQ_V_POC_MN_VSPD TQ_V_POC_TM TQ_V_POC_ECT TQ_V_POC_ESPD_MN TQ_V_POC_ESPD_MX TQ_V_POC_INH_PUC TQ_V_POC_THRO_LO TQ_V_POC_THRO_HI TQ_V_POC_TPI_THRO_THRSH TQ_V_POC_PN_DSBL TQ_V_POC_CVT_TC TQ_V_POC_ESPD_DLT TQ_C_POC_MN_DB TQ_V_POC_MN_DB_FAC TQ_V_POC_RST_P_ESPD TQ_M_POC_FAC_G1 TQ_M_POC_FAC_G2 TQ_M_POC_FAC_G3 TQ_M_POC_FAC_G4 TQ_M_POC_FAC_G5 TQ_M_POC_FAC_G6 TQ_M_POC_FAC_G7 TQ_M_POC_FAC_G8 TQ_M_POC_FAC_U TQ_M_POC_FAC_PN TQ_M_POC_FAC_R TQ_X_POC_ESPD_DLT TQ_M_POC_ESPD_TPI_FAC TQ_M_POC_ESPD_TPO_FAC TQ_M_POC_TORQ_THRSH TQ_V_POC_TORQ_HYS TQ_V_POC_ESPD_TOOTH_COR TQ_C_TRNS_FREQ TQ_V_POC_FILT_B1 TQ_V_POC_FILT_B2 TQ_V_POC_FILT_A2 TQ_V_POC_FILT_A3 TQ_V_ILD_GAIN_FILT_ENBL TQ_V_ILD_GAIN_FILT TQ_V_OR_IDL_LMT TQ_X_IDL_GAIN TQ_C_OR_IDL_GAIN TQ_C_TC_TORQ TQ_X_ESPD_TC_TORQ TQ_X_PPS_D TQ_M_ECO_TORQ_SP_FAC TQ_V_ECO_VSPD_LMT_RMP_OUT_STP TQ_V_ECO_TORQ_RMP_ENBL TQ_V_ECO_RMP_OUT_FAC TQ_C_TPO_LO_ECO_FAC TQ_C_TPO_HI_ECO_FAC TQ_V_IMEP_MN_ECO_PUC_FAC TQ_V_IMEP_MN_ECO_FAC TQ_C_TPI_DSBL_FAC_ECO TQ_C_TPI_ENBL_FAC_ECO TQ_C_TPI_FILTER_FAC_ECO TQ_C_TPI_RMP_STP_FAC_ECO TQ_V_TPI_PDSBL_FAC_ECO TQ_V_ECO_VSPD_LMT TQ_V_ECO_VSPD_LMT_RMP_IN_STP TQ_V_ECO_RMP_IN_FAC TQ_V_ALT_STR_RT_THRSH TQ_V_ALT_RMP_DLY_ESPD TQ_V_ALT_RMP_DLY TQ_C_ALT_VLT_FAC TQ_C_ALT_ECT_OFST TQ_V_PS_CFG TQ_C_ALT_PS_LD TQ_V_BEAM_CFG TQ_V_ALT_BEAM_LD TQ_V_DEFRST_CFG TQ_V_ALT_DEFRST_LD TQ_V_ALT_ELD1 TQ_V_ALT_ELD2 TQ_V_ALT_RMP_STR_INC TQ_V_ALT_RMP_INC TQ_V_ALT_RMP_ESPD_THRSH TQ_V_ALT_RMP_STR_DEC TQ_V_ALT_RMP_DEC TQ_V_AC_CFG TQ_V_AC_FRIC_RMP TQ_V_AC_DFLT_TORQ TQ_M_AC_INIT_LD TQ_M_AC_INIT_DEC_FAC TQ_C_AC_PWR TQ_C_AC_POS_DLT_P TQ_C_AC_POS_DLY TQ_C_AC_NEG_DLT_P TQ_C_AC_NEG_DLY TQ_C_PS_INIT_STRT_TORQ TQ_X_ECT_C TQ_X_OFF_DUR TQ_C_PS_OFF_DUR_FAC TQ_C_PS_DCY_FAC TQ_V_DTORQ_LMT_PPS TQ_V_DTORQ_LMT_MX_DLT_PPS TQ_X_VSPD_B TQ_X_TMR TQ_M_DTORQ_LMT_BRK TQ_M_DTORQ_LMT_PPS TQ_V_DTORQ_LMT_RMP TQ_X_ESPD_N TQ_X_ECT_D TQ_M_SLW_MN_LMT_TCM TQ_M_FST_MN_LMT_TCM TQ_M_INC_MX_LMT_TCM TQ_M_SLW_MN_LMT_TCS TQ_M_FST_MN_LMT_TCS TQ_M_INC_MX_LMT_TCS TQ_C_MX_IND_TORQ_AMP_FAC TQ_V_F_RT_DLT_LMT TQ_V_F_RT_MX TQ_V_F_RT_MN TQ_V_F_RT_FILT TQ_V_PUC_ENTR_DLY TQ_C_IND_TORQ_MN TQ_V_F_RT_MX_TRNS TQ_V_F_RT_MN_TRNS TQ_V_TRNS_RT_IDL TQ_V_TRNS_RT_ESPD_POS_DB TQ_V_TRNS_RT_ESPD_NEG_DB TQ_V_TRNS_RT_ECT_MN TQ_C_TRNS_RT_RTM TQ_V_LNCH_FLYW_TORQ_MX TQ_V_LNCH_FLYW_TORQ_MN TQ_V_LNCH_INIT_PPS_THRSH TQ_V_CRU_VSPD_DLT_MX TQ_V_FST2SLW_UNLMT_POC TQ_V_ACT_TORQ_NON_POC TQ_C_ADD_TORQ_PS_R TQ_C_ALT_PWM_FAN TQ_M_ALT_FAN TQ_V_BLW_CFG TQ_C_RBLW_LD TQ_C_FBLW_LD TQ_C_BRK_PPS_FAC TQ_X_TMR_B TQ_C_PED_MOD_RMP TQ_V_MN_PPS_BRK_MOD TQ_V_VPPS_CRU_FILT TQ_C_MX_IND_TORQ_ESPD_FAC TQ_V_TC_FILT_DLY_TPO TQ_V_TC_FILT_DLY_SHFT TQ_V_IMEP_INC_FILT TQ_V_IMEP_DEC_FILT TQ_C_IMEP_DLT_FILT TQ_X_IMEP TQ_V_MX_FLYW_TORQ_RMP_TM TQ_M_MX_FLYW_TORQ_PROT TQ_X_TEMP TQ_X_ESPD_O TQ_V_MX_FLYW_TORQ_BTM TQ_V_TC_INC_RMP TQ_V_TC_DEC_RMP TQ_M_ADD_TC_FAC TQ_X_VSPD_C TQ_X_PPS_E TQ_C_TC_DLY TQ_X_OIL_TEMP_B TQ_V_TRNS_PUMP_FILT TQ_M_TC_LD TQ_X_RT TQ_X_ESPD_P TQ_C_TC_TEMP_FAC TQ_X_OIL_TEMP_C TQ_C_TC_ESPD_FAC TQ_X_RT_B TQ_C_ADD_MX_TORQ_TC TQ_V_TC_MDL_ENBL TQ_V_ESG_OVR_HYS TQ_V_ESG_ESPD_LMT_GR_L TQ_V_ESG_OVR_TM TQ_V_ESG_ESPD_LMT_GR TQ_V_ESG_LMT_TM_L TQ_V_ESG_ESPD_LMT_OIL TQ_V_ESG_ESPD_DCY TQ_V_ESG_ESPD_LMT_VSPD_ENBL TQ_V_ESG_ESPD_RMP_TM_THRSH TQ_V_ESG_ESPD_N_L TQ_V_ESG_ESPD_N_L_OFST TQ_V_ESG_ESPD_N TQ_C_ESG_PRE_LD TQ_V_ESG_FAC TQ_V_ESG_FAC_MN TQ_V_ESG_INT_FAC TQ_V_ESG_PROP_FAC TQ_V_ESG_PROP_MN TQ_V_ESG_PROP_MX TQ_V_ESG_DERV_FAC TQ_V_ESG_FILT_DSBL TQ_V_ESG_TORQ_FILT_PN TQ_V_ESG_TORQ_FILT TQ_C_VSG_MX TQ_V_VSG_MX_FILT TQ_V_VSG_MN TQ_C_VSG_PROP_FAC TQ_C_VSG_INT_FAC TQ_V_TRNS_R_MX TQ_V_TCM_LMT_TORQ_CFG TQ_V_TCM_RED_FTORQ_CFG TQ_V_TCM_RED_STORQ_CFG TQ_V_TCM_INC_TORQ_CFG TQ_V_REF_TORQ TQ_V_ESG_MN_SPD TQ_V_ESG_DERV_TM TQ_V_TORQ_VLD_CFG_LPI TQ_V_TORQ_VLD_CFG_ECT TQ_V_TORQ_VLD_CFG_MISF TQ_V_TORQ_VLD_CFG_INJ TQ_V_TORQ_VLD_CFG_IAT TQ_V_TORQ_VLD_CFG_EST TQ_V_TORQ_VLD_CFG_MAF TQ_V_TORQ_VLD_CFG_MAP TQ_V_PPS_CRU_SPRT TQ_V_PPS_RAW_CAN TQ_V_PPS_GR_RMP TQ_V_PPS_DRV_RMP TQ_V_SHFT_PPS_DLT_THRSH TQ_V_LVSPD_PPS_IDX_STP TQ_V_ESPD_INC_TM TQ_M_PED2TQ_PCT_LSPD TQ_M_AC_ESPD_COMP TQ_C_AC_DCY_TM_INIT TQ_M_FLYW_TORQ_MX_CHRG_AMP_FAC TQ_C_FLYW_TORQ_MBT_MX_PROT_OB TQ_C_FLYW_TORQ_MBT_MX_PROT_KN TQ_V_THROT_MDL_T_FLT TQ_V_SURG_FCO_ENBL TQ_V_SURG_INIT_TM TQ_M_SURG_MX_SLW_TORQ TQ_M_SURG_IAT_TORQ_FAC TQ_M_SURG_AMP_TORQ_FAC TQ_C_SURG_DCY_FAC /end DEF_CHARACTERISTIC
 /begin OUT_MEASUREMENT tq_imep_ref tq_tot_req_pct tq_them_eff_sp tq_exh_to_intk_p_dlt tq_estd_imep_ref tq_imep_act tq_imep_base tq_vr_pps tq_imep_sp tq_clch_torq tq_ind_torq tq_aux_torq tq_alt_torq tq_ps_torq tq_req_typ tq_veh_gr_st tq_fc_en tq_calc_rpm tq_calc_rpm_chng_rt tq_clch_slp_rt tq_exh_press tq_map tq_pump_mep_thrt tq_pump_mep_vlv tq_pump_mep tq_mep2tq_fac tq_pump tq_pump_espd_sp tq_pump_wot tq_pump_mx tq_rub_bs tq_fric_loss tq_rub_espd_sp tq_rub_ect_bias tq_rub_ect_bias_espd_sp tq_fric tq_fric_mx tq_fric_wot tq_fric_espd_sp tq_clch_torq_mn tq_them_eff_fac tq_flyw_torq_mbt_mx tq_flyw_torq_mx_chrg_amp_fac tq_lmt_rsn tq_ind_torq_mbt_mx_raw tq_trns_fric_torq tq_idl_torq tq_mx_flyw_torq_exh_t_tm tq_mx_flyw_torq_exh_t_rmp_tm tq_ind_torq_mbt_mx tq_est_tq_vld tq_lmt_flt_actv tq_eco_stat tq_sprt_mode_actv tq_flyw_torq_raw_sp tq_iga_fac tq_pps_fac tq_pps_raw tq_pps tq_clch_torq_rmp_fn_sprt tq_clch_torq_rmp_fn tq_clch_torq_rmp_fn_eco tq_clch_torq_pct_sp_raw tq_clch_torq_pct_sp_mx tq_clch_torq_sp tq_air_ms_sp tq_imep_rt tq_imep_fst_sp tq_fuel_rt tq_ctrl_mod tq_sp2act_fm_rt tq_ctrl_mod_fac tq_ctrl_mod_trn_fac tq_vsg_vspd_lmt tq_vsg_int tq_vsg_actv tq_vsg_prop tq_vsg_torq_sp tq_vsg_vspd_dlt tq_poc_enbl tq_poc_ctrl_enbl tq_poc_ctrl_met tq_throt_mdl_t /end OUT_MEASUREMENT
/end FUNCTION
/begin FUNCTION tq_axis ""
 /begin DEF_CHARACTERISTIC TQ_X_ESPD_A TQ_X_AFR TQ_X_STRK_FLW_A TQ_X_ESPD_B TQ_X_IMEP_REF TQ_X_ESPD_C TQ_X_ESPD_D TQ_X_BAT_VLT_A TQ_X_ESPD_E TQ_X_ESPD_F TQ_X_ESPD_G TQ_X_AMP_A TQ_X_AFR_A TQ_X_EXH_T_A TQ_X_TPO_ESPD TQ_X_CLTCH_TORQ TQ_X_PPS_FILT TQ_X_PPS_DLT TQ_X_TPI_DSBL_ADC TQ_X_TPI_DSBL_IAT TQ_X_TPI_ESPD TQ_X_TPI_RMP_STP TQ_X_PPS TQ_X_ESPD_H /end DEF_CHARACTERISTIC
 /begin OUT_MEASUREMENT /end OUT_MEASUREMENT
/end FUNCTION
/begin RECORD_LAYOUT __UBYTE_S FNC_VALUES 1 UBYTE COLUMN_DIR DIRECT /end RECORD_LAYOUT
/begin RECORD_LAYOUT __UWORD_S FNC_VALUES 1 UWORD COLUMN_DIR DIRECT /end RECORD_LAYOUT
/begin RECORD_LAYOUT __ULONG_S FNC_VALUES 1 ULONG COLUMN_DIR DIRECT /end RECORD_LAYOUT
/begin RECORD_LAYOUT __SBYTE_S FNC_VALUES 1 SBYTE COLUMN_DIR DIRECT /end RECORD_LAYOUT
/begin RECORD_LAYOUT __SWORD_S FNC_VALUES 1 SWORD COLUMN_DIR DIRECT /end RECORD_LAYOUT
/begin RECORD_LAYOUT SSV__UWORD_S AXIS_PTS_X 1 UWORD INDEX_INCR DIRECT /end RECORD_LAYOUT
/begin RECORD_LAYOUT SSV__SWORD_S AXIS_PTS_X 1 SWORD INDEX_INCR DIRECT /end RECORD_LAYOUT
/end MODULE
/end PROJECT
