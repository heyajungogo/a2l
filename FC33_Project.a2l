ASAP2_VERSION 1 60
/begin PROJECT FC33 ""
/begin HEADER "" VERSION "1.0" /end HEADER
/begin MODULE FC33 ""
/begin MOD_COMMON "" BYTE_ORDER MSB_FIRST ALIGNMENT_LONG 2 ALIGNMENT_WORD 1 /end MOD_COMMON
/begin CHARACTERISTIC CAN_TX_ECU_ST_ID "ecu state msg number" VALUE 0x0002038C __UBYTE_S 0 u_can_txmsg_num 0 255 FORMAT "%3.0" SYMBOL_LINK "CAN_TX_ECU_ST" 0 /end CHARACTERISTIC
/begin CHARACTERISTIC CAN_TX_ECU_ST_BYTE_LOC "ecu state msg location number" VALUE 0x0002038C __UBYTE_S 0 u_can_byte_num 0 7 FORMAT "%1.0" SYMBOL_LINK "CAN_TX_ECU_ST" 1 /end CHARACTERISTIC
/begin CHARACTERISTIC CAN_TX_ECU_ST_BIT_LOC "ecu state msg bit location" VALUE 0x0002038C __UBYTE_S 0 u_can_bit_loc 0 7 FORMAT "%1.0" SYMBOL_LINK "CAN_TX_ECU_ST" 2 /end CHARACTERISTIC
/begin CHARACTERISTIC CAN_TX_ECU_ST_BIT_LEN "ecu state msg bit length" VALUE 0x0002038C __UBYTE_S 0 u_cnts 0 255 SYMBOL_LINK "CAN_TX_ECU_ST" 3 /end CHARACTERISTIC
/begin CHARACTERISTIC CAN_TX_ECU_ST_TABLE "ecu state msg table" CURVE 0x375CE __UBYTE_S 0 u_cnts 0 255 SYMBOL_LINK "CAN_TX_ECU_ST" 4
 /begin AXIS_DESCR FIX_AXIS NO_INPUT_QUANTITY u_can_ecu_st 5 0 4 /begin FIX_AXIS_PAR_LIST 0 1 2 3 4 /end FIX_AXIS_PAR_LIST /end AXIS_DESCR
/end CHARACTERISTIC
/begin CHARACTERISTIC CAN_TX_BRK_PEDL_ST_ID "break pedal state msg number" VALUE 0x0002038C __UBYTE_S 0 u_can_txmsg_num 0 255 FORMAT "%3.0" SYMBOL_LINK "CAN_TX_BRK_PEDL_ST" 0 /end CHARACTERISTIC
/begin CHARACTERISTIC CAN_TX_BRK_PEDL_ST_BYTE_LOC "break pedal state msg location number" VALUE 0x0002038C __UBYTE_S 0 u_can_byte_num 0 7 FORMAT "%1.0" SYMBOL_LINK "CAN_TX_BRK_PEDL_ST" 1 /end CHARACTERISTIC
/begin CHARACTERISTIC CAN_TX_BRK_PEDL_ST_BIT_LOC "break pedal state msg bit location" VALUE 0x0002038C __UBYTE_S 0 u_can_bit_loc 0 7 FORMAT "%1.0" SYMBOL_LINK "CAN_TX_BRK_PEDL_ST" 2 /end CHARACTERISTIC
/begin CHARACTERISTIC CAN_TX_BRK_PEDL_ST_BIT_LEN "break pedal state msg bit length" VALUE 0x0002038C __UBYTE_S 0 u_cnts 0 255 SYMBOL_LINK "CAN_TX_BRK_PEDL_ST" 3 /end CHARACTERISTIC
/begin CHARACTERISTIC CAN_TX_BRK_PEDL_ST_INVALID "break pedal state msg invalid value" VALUE 0x0002038C __UBYTE_S 0 u_cnts 0 255 SYMBOL_LINK "CAN_TX_BRK_PEDL_ST" 4 /end CHARACTERISTIC
/begin CHARACTERISTIC CAN_TX_BRK_PEDL_ST_TABLE "start stop lamp active msg table" VAL_BLK 0x0002038C __UBYTE_S 0 u_cnts 0 255 NUMBER 2 SYMBOL_LINK "CAN_TX_BRK_PEDL_ST" 5 /end CHARACTERISTIC
/begin CHARACTERISTIC CAN_TX_N_SW_ST_ID "N switch state msg number" VALUE 0x0002038C __UBYTE_S 0 u_can_txmsg_num 0 255 FORMAT "%3.0" SYMBOL_LINK "CAN_TX_N_SW_ST" 0 /end CHARACTERISTIC
/begin CHARACTERISTIC CAN_TX_N_SW_ST_BYTE_LOC "N switch state msg location number" VALUE 0x0002038C __UBYTE_S 0 u_can_byte_num 0 7 FORMAT "%1.0" SYMBOL_LINK "CAN_TX_N_SW_ST" 1 /end CHARACTERISTIC
/begin CHARACTERISTIC CAN_TX_N_SW_ST_BIT_LOC "N switch state msg bit location" VALUE 0x0002038C __UBYTE_S 0 u_can_bit_loc 0 7 FORMAT "%1.0" SYMBOL_LINK "CAN_TX_N_SW_ST" 2 /end CHARACTERISTIC
/begin CHARACTERISTIC CAN_TX_N_SW_ST_BIT_LEN "N switch state msg bit length" VALUE 0x0002038C __UBYTE_S 0 u_cnts 0 255 SYMBOL_LINK "CAN_TX_N_SW_ST" 3 /end CHARACTERISTIC
/begin CHARACTERISTIC CAN_TX_N_SW_ST_TABLE "N switch state msg table" CURVE 0x375CE __UBYTE_S 0 u_cnts 0 255 SYMBOL_LINK "CAN_TX_N_SW_ST" 4
 /begin AXIS_DESCR FIX_AXIS NO_INPUT_QUANTITY u_can_n_sw_st 4 0 3 /begin FIX_AXIS_PAR_LIST 0 1 2 3 /end FIX_AXIS_PAR_LIST /end AXIS_DESCR
/end CHARACTERISTIC
/begin CHARACTERISTIC CAN_TX_CLTCH_PEDL_ST_ID "clutch pedal state msg number" VALUE 0x0002038C __UBYTE_S 0 u_can_txmsg_num 0 255 FORMAT "%3.0" SYMBOL_LINK "CAN_TX_CLTCH_PEDL_ST" 0 /end CHARACTERISTIC
/begin CHARACTERISTIC CAN_TX_CLTCH_PEDL_ST_BYTE_LOC "clutch pedal state msg location number" VALUE 0x0002038C __UBYTE_S 0 u_can_byte_num 0 7 FORMAT "%1.0" SYMBOL_LINK "CAN_TX_CLTCH_PEDL_ST" 1 /end CHARACTERISTIC
/begin CHARACTERISTIC CAN_TX_CLTCH_PEDL_ST_BIT_LOC "clutch pedal state msg bit location" VALUE 0x0002038C __UBYTE_S 0 u_can_bit_loc 0 7 FORMAT "%1.0" SYMBOL_LINK "CAN_TX_CLTCH_PEDL_ST" 2 /end CHARACTERISTIC
/begin CHARACTERISTIC CAN_TX_CLTCH_PEDL_ST_BIT_LEN "clutch pedal state msg bit length" VALUE 0x0002038C __UBYTE_S 0 u_cnts 0 255 SYMBOL_LINK "CAN_TX_CLTCH_PEDL_ST" 3 /end CHARACTERISTIC
/begin CHARACTERISTIC CAN_TX_CLTCH_PEDL_ST_TABLE "clutch pedal state msg table" CURVE 0x375CE __UBYTE_S 0 u_cnts 0 255 SYMBOL_LINK "CAN_TX_CLTCH_PEDL_ST" 4
 /begin AXIS_DESCR FIX_AXIS NO_INPUT_QUANTITY u_can_cltch_pedl_st 4 0 3 /begin FIX_AXIS_PAR_LIST 0 1 2 3 /end FIX_AXIS_PAR_LIST /end AXIS_DESCR
/end CHARACTERISTIC
/begin CHARACTERISTIC CAN_TX_IMMO_STATE_ID "immo receive msg number" VALUE 0x0002038C __UBYTE_S 0 u_can_txmsg_num 0 255 FORMAT "%3.0" SYMBOL_LINK "CAN_TX_IMMO_STATE" 0 /end CHARACTERISTIC
/begin CHARACTERISTIC CAN_TX_IMMO_STATE_BYTE_LOC "immo receive msg location number" VALUE 0x0002038C __UBYTE_S 0 u_can_byte_num 0 7 FORMAT "%1.0" SYMBOL_LINK "CAN_TX_IMMO_STATE" 1 /end CHARACTERISTIC
/begin CHARACTERISTIC CAN_TX_IMMO_STATE_BIT_LOC "immo receive msg bit location" VALUE 0x0002038C __UBYTE_S 0 u_can_bit_loc 0 7 FORMAT "%1.0" SYMBOL_LINK "CAN_TX_IMMO_STATE" 2 /end CHARACTERISTIC
/begin CHARACTERISTIC CAN_TX_IMMO_STATE_BIT_LEN "immo receive msg bit length" VALUE 0x0002038C __UBYTE_S 0 u_cnts 0 255 SYMBOL_LINK "CAN_TX_IMMO_STATE" 3 /end CHARACTERISTIC
/begin CHARACTERISTIC CAN_TX_IMMO_STATE_TABLE "immo receive msg table" CURVE 0x375CE __UBYTE_S 0 u_cnts 0 255 SYMBOL_LINK "CAN_TX_IMMO_STATE" 4
 /begin AXIS_DESCR FIX_AXIS NO_INPUT_QUANTITY u_can_immo_recv 6 0 5 /begin FIX_AXIS_PAR_LIST 0 1 2 3 4 5 /end FIX_AXIS_PAR_LIST /end AXIS_DESCR
/end CHARACTERISTIC
/begin CHARACTERISTIC CAN_TX_STRT_OVERTM_ID "engine start overtime msg number" VALUE 0x0002038C __UBYTE_S 0 u_can_txmsg_num 0 255 FORMAT "%3.0" SYMBOL_LINK "CAN_TX_STRT_OVERTM" 0 /end CHARACTERISTIC
/begin CHARACTERISTIC CAN_TX_STRT_OVERTM_BYTE_LOC "engine start overtime msg location number" VALUE 0x0002038C __UBYTE_S 0 u_can_byte_num 0 7 FORMAT "%1.0" SYMBOL_LINK "CAN_TX_STRT_OVERTM" 1 /end CHARACTERISTIC
/begin CHARACTERISTIC CAN_TX_STRT_OVERTM_BIT_LOC "engine start overtime msg bit location" VALUE 0x0002038C __UBYTE_S 0 u_can_bit_loc 0 7 FORMAT "%1.0" SYMBOL_LINK "CAN_TX_STRT_OVERTM" 2 /end CHARACTERISTIC
/begin CHARACTERISTIC CAN_TX_STRT_OVERTM_BIT_LEN "engine start overtime msg bit length" VALUE 0x0002038C __UBYTE_S 0 u_cnts 0 255 SYMBOL_LINK "CAN_TX_STRT_OVERTM" 3 /end CHARACTERISTIC
/begin CHARACTERISTIC CAN_TX_STRT_OVERTM_TABLE "engine start overtime msg table" VAL_BLK 0x0002038C __UBYTE_S 0 u_cnts 0 255 NUMBER 2 SYMBOL_LINK "CAN_TX_STRT_OVERTM" 4 /end CHARACTERISTIC
/begin CHARACTERISTIC CAN_TX_CLR_DIAG_MSG_ID "clear diag msg number" VALUE 0x0002038C __UBYTE_S 0 u_can_txmsg_num 0 255 FORMAT "%3.0" SYMBOL_LINK "CAN_TX_CLR_DIAG_MSG" 0 /end CHARACTERISTIC
/begin CHARACTERISTIC CAN_TX_CLR_DIAG_MSG_BYTE_LOC "clear diag msg location number" VALUE 0x0002038C __UBYTE_S 0 u_can_byte_num 0 7 FORMAT "%1.0" SYMBOL_LINK "CAN_TX_CLR_DIAG_MSG" 1 /end CHARACTERISTIC
/begin CHARACTERISTIC CAN_TX_CLR_DIAG_MSG_BIT_LOC "clear diag msg bit location" VALUE 0x0002038C __UBYTE_S 0 u_can_bit_loc 0 7 FORMAT "%1.0" SYMBOL_LINK "CAN_TX_CLR_DIAG_MSG" 2 /end CHARACTERISTIC
/begin CHARACTERISTIC CAN_TX_CLR_DIAG_MSG_BIT_LEN "clear diag msg bit length" VALUE 0x0002038C __UBYTE_S 0 u_cnts 0 255 SYMBOL_LINK "CAN_TX_CLR_DIAG_MSG" 3 /end CHARACTERISTIC
/begin CHARACTERISTIC CAN_TX_CLR_DIAG_MSG_TABLE "clear diag msg table" VAL_BLK 0x0002038C __UBYTE_S 0 u_cnts 0 255 NUMBER 2 SYMBOL_LINK "CAN_TX_CLR_DIAG_MSG" 4 /end CHARACTERISTIC
/begin CHARACTERISTIC CAN_TX_PPS_ID "pedal position msg number" VALUE 0x0002038C __UBYTE_S 0 u_can_txmsg_num 0 255 FORMAT "%3.0" SYMBOL_LINK "CAN_TX_PPS" 0 /end CHARACTERISTIC
/begin CHARACTERISTIC CAN_TX_PPS_BYTE_LOC "pedal position msg location number" VALUE 0x0002038C __UBYTE_S 0 u_can_byte_num 0 7 FORMAT "%1.0" SYMBOL_LINK "CAN_TX_PPS" 1 /end CHARACTERISTIC
/begin CHARACTERISTIC CAN_TX_PPS_BIT_LOC "pedal position msg bit location" VALUE 0x0002038C __UBYTE_S 0 u_can_bit_loc 0 7 FORMAT "%1.0" SYMBOL_LINK "CAN_TX_PPS" 2 /end CHARACTERISTIC
/begin CHARACTERISTIC CAN_TX_PPS_BIT_LEN "pedal position msg bit length" VALUE 0x0002038C __UBYTE_S 0 u_cnts 0 255 SYMBOL_LINK "CAN_TX_PPS" 3 /end CHARACTERISTIC
/begin CHARACTERISTIC CAN_TX_PPS_A "pedal position msg scaling A" VALUE 0x0002038C __ULONG_S 0 u_fac_65536L 0 65535.9999847412109375 FORMAT "%8.3" SYMBOL_LINK "CAN_TX_PPS" 4 /end CHARACTERISTIC
/begin CHARACTERISTIC CAN_TX_PPS_B "pedal position msg scaling B" VALUE 0x0002038C __SWORD_S 0 u_cnt_n3277_p3277 -3276.8 3276.7 FORMAT "%5.1" SYMBOL_LINK "CAN_TX_PPS" 8 /end CHARACTERISTIC
/begin CHARACTERISTIC CAN_TX_PPS_MIN "pedal position msg min" VALUE 0x0002038C __UWORD_S 0 u_pct 0 199.996948 SYMBOL_LINK "CAN_TX_PPS" 10 /end CHARACTERISTIC
/begin CHARACTERISTIC CAN_TX_PPS_MAX "pedal position msg max" VALUE 0x0002038C __UWORD_S 0 u_pct 0 199.996948 SYMBOL_LINK "CAN_TX_PPS" 12 /end CHARACTERISTIC
/begin CHARACTERISTIC CAN_TX_PPS_INVALID "pedal position msg invalid value" VALUE 0x0002038C __UWORD_S 0 u_cnts 0 65535 FORMAT "%5.0" SYMBOL_LINK "CAN_TX_PPS" 14 /end CHARACTERISTIC
/begin CHARACTERISTIC CAN_TX_FUEL_ACCUM_ID "fuel accumulation msg number" VALUE 0x0002038C __UBYTE_S 0 u_can_txmsg_num 0 255 FORMAT "%3.0" SYMBOL_LINK "CAN_TX_FUEL_ACCUM" 0 /end CHARACTERISTIC
/begin CHARACTERISTIC CAN_TX_FUEL_ACCUM_BYTE_LOC "fuel accumulation msg location number" VALUE 0x0002038C __UBYTE_S 0 u_can_byte_num 0 7 FORMAT "%1.0" SYMBOL_LINK "CAN_TX_FUEL_ACCUM" 1 /end CHARACTERISTIC
/begin CHARACTERISTIC CAN_TX_FUEL_ACCUM_BIT_LOC "fuel accumulation msg bit location" VALUE 0x0002038C __UBYTE_S 0 u_can_bit_loc 0 7 FORMAT "%1.0" SYMBOL_LINK "CAN_TX_FUEL_ACCUM" 2 /end CHARACTERISTIC
/begin CHARACTERISTIC CAN_TX_FUEL_ACCUM_BIT_LEN "fuel accumulation msg bit length" VALUE 0x0002038C __UBYTE_S 0 u_cnts 0 255 SYMBOL_LINK "CAN_TX_FUEL_ACCUM" 3 /end CHARACTERISTIC
/begin CHARACTERISTIC CAN_TX_FUEL_ACCUM_A "fuel accumulation msg scaling A" VALUE 0x0002038C __ULONG_S 0 u_fac_65536L 0 65535.9999847412109375 FORMAT "%8.3" SYMBOL_LINK "CAN_TX_FUEL_ACCUM" 4 /end CHARACTERISTIC
/begin CHARACTERISTIC CAN_TX_FUEL_ACCUM_B "fuel accumulation msg scaling B" VALUE 0x0002038C __SWORD_S 0 u_cnt_n3277_p3277 -3276.8 3276.7 FORMAT "%5.1" SYMBOL_LINK "CAN_TX_FUEL_ACCUM" 8 /end CHARACTERISTIC
/begin CHARACTERISTIC CAN_TX_FUEL_ACCUM_MIN "fuel accumulation msg min" VALUE 0x0002038C __ULONG_S 0 u_ul_lo 0 67108863.9844 FORMAT "%11.3" SYMBOL_LINK "CAN_TX_FUEL_ACCUM" 10 /end CHARACTERISTIC
/begin CHARACTERISTIC CAN_TX_FUEL_ACCUM_MAX "fuel accumulation msg max" VALUE 0x0002038C __ULONG_S 0 u_ul_lo 0 67108863.9844 FORMAT "%11.3" SYMBOL_LINK "CAN_TX_FUEL_ACCUM" 14 /end CHARACTERISTIC
/begin CHARACTERISTIC CAN_TX_FUEL_ACCUM_INVALID "fuel accumulation msg invalid value" VALUE 0x0002038C __ULONG_S 0 u_cnts 0 4294967295 FORMAT "%10.0" SYMBOL_LINK "CAN_TX_FUEL_ACCUM" 18 /end CHARACTERISTIC
/begin CHARACTERISTIC CAN_TX_CLTCH_TQ_ID "clutch torq msg number" VALUE 0x0002038C __UBYTE_S 0 u_can_txmsg_num 0 255 FORMAT "%3.0" SYMBOL_LINK "CAN_TX_CLTCH_TQ" 0 /end CHARACTERISTIC
/begin CHARACTERISTIC CAN_TX_CLTCH_TQ_BYTE_LOC "clutch torq msg location number" VALUE 0x0002038C __UBYTE_S 0 u_can_byte_num 0 7 FORMAT "%1.0" SYMBOL_LINK "CAN_TX_CLTCH_TQ" 1 /end CHARACTERISTIC
/begin CHARACTERISTIC CAN_TX_CLTCH_TQ_BIT_LOC "clutch torq msg bit location" VALUE 0x0002038C __UBYTE_S 0 u_can_bit_loc 0 7 FORMAT "%1.0" SYMBOL_LINK "CAN_TX_CLTCH_TQ" 2 /end CHARACTERISTIC
/begin CHARACTERISTIC CAN_TX_CLTCH_TQ_BIT_LEN "clutch torq msg bit length" VALUE 0x0002038C __UBYTE_S 0 u_cnts 0 255 SYMBOL_LINK "CAN_TX_CLTCH_TQ" 3 /end CHARACTERISTIC
/begin CHARACTERISTIC CAN_TX_CLTCH_TQ_A "clutch torq msg scaling A" VALUE 0x0002038C __ULONG_S 0 u_fac_65536L 0 65535.9999847412109375 FORMAT "%8.3" SYMBOL_LINK "CAN_TX_CLTCH_TQ" 4 /end CHARACTERISTIC
/begin CHARACTERISTIC CAN_TX_CLTCH_TQ_B "clutch torq msg scaling B" VALUE 0x0002038C __SWORD_S 0 u_cnt_n3277_p3277 -3276.8 3276.7 FORMAT "%5.1" SYMBOL_LINK "CAN_TX_CLTCH_TQ" 8 /end CHARACTERISTIC
/begin CHARACTERISTIC CAN_TX_CLTCH_TQ_MIN "clutch torq msg min" VALUE 0x0002038C __SWORD_S 0 u_nm_s -2048 2047.9375 SYMBOL_LINK "CAN_TX_CLTCH_TQ" 10 /end CHARACTERISTIC
/begin CHARACTERISTIC CAN_TX_CLTCH_TQ_MAX "clutch torq msg max" VALUE 0x0002038C __SWORD_S 0 u_nm_s -2048 2047.9375 SYMBOL_LINK "CAN_TX_CLTCH_TQ" 12 /end CHARACTERISTIC
/begin CHARACTERISTIC CAN_TX_CLTCH_TQ_INVALID "clutch torq msg invalid value" VALUE 0x0002038C __UWORD_S 0 u_cnts 0 65535 FORMAT "%5.0" SYMBOL_LINK "CAN_TX_CLTCH_TQ" 14 /end CHARACTERISTIC
/begin CHARACTERISTIC CAN_TX_CLTCH_TQ_UNIT "clutch torq msg invalid value" VALUE 0x0002038C __UBYTE_S 0 u_can_tq_unit 0 1 FORMAT "%1.0" SYMBOL_LINK "CAN_TX_CLTCH_TQ" 16 /end CHARACTERISTIC
/begin CHARACTERISTIC CAN_TX_AMP_ID "ambient press msg number" VALUE 0x0002038C __UBYTE_S 0 u_can_txmsg_num 0 255 FORMAT "%3.0" SYMBOL_LINK "CAN_TX_AMP" 0 /end CHARACTERISTIC
/begin CHARACTERISTIC CAN_TX_AMP_BYTE_LOC "ambient press msg location number" VALUE 0x0002038C __UBYTE_S 0 u_can_byte_num 0 7 FORMAT "%1.0" SYMBOL_LINK "CAN_TX_AMP" 1 /end CHARACTERISTIC
/begin CHARACTERISTIC CAN_TX_AMP_BIT_LOC "ambient press msg bit location" VALUE 0x0002038C __UBYTE_S 0 u_can_bit_loc 0 7 FORMAT "%1.0" SYMBOL_LINK "CAN_TX_AMP" 2 /end CHARACTERISTIC
/begin CHARACTERISTIC CAN_TX_AMP_BIT_LEN "ambient press msg bit length" VALUE 0x0002038C __UBYTE_S 0 u_cnts 0 255 SYMBOL_LINK "CAN_TX_AMP" 3 /end CHARACTERISTIC
/begin CHARACTERISTIC CAN_TX_AMP_A "ambient press msg scaling A" VALUE 0x0002038C __ULONG_S 0 u_fac_65536L 0 65535.9999847412109375 FORMAT "%8.3" SYMBOL_LINK "CAN_TX_AMP" 4 /end CHARACTERISTIC
/begin CHARACTERISTIC CAN_TX_AMP_B "ambient press msg scaling B" VALUE 0x0002038C __SWORD_S 0 u_cnt_n3277_p3277 -3276.8 3276.7 FORMAT "%5.1" SYMBOL_LINK "CAN_TX_AMP" 8 /end CHARACTERISTIC
/begin CHARACTERISTIC CAN_TX_AMP_MIN "ambient press msg min" VALUE 0x0002038C __UWORD_S 0 u_kPa_0_256 0 255.99609375 SYMBOL_LINK "CAN_TX_AMP" 10 /end CHARACTERISTIC
/begin CHARACTERISTIC CAN_TX_AMP_MAX "ambient press msg max" VALUE 0x0002038C __UWORD_S 0 u_kPa_0_256 0 255.99609375 SYMBOL_LINK "CAN_TX_AMP" 12 /end CHARACTERISTIC
/begin CHARACTERISTIC CAN_TX_AMP_INVALID "ambient press msg invalid value" VALUE 0x0002038C __UWORD_S 0 u_cnts 0 65535 FORMAT "%5.0" SYMBOL_LINK "CAN_TX_AMP" 14 /end CHARACTERISTIC
/begin CHARACTERISTIC CAN_TX_AMP_FL_ACTV_ID "amp fail active msg number" VALUE 0x0002038C __UBYTE_S 0 u_can_txmsg_num 0 255 FORMAT "%3.0" SYMBOL_LINK "CAN_TX_AMP_FL_ACTV" 0 /end CHARACTERISTIC
/begin CHARACTERISTIC CAN_TX_AMP_FL_ACTV_BYTE_LOC "amp fail active msg location number" VALUE 0x0002038C __UBYTE_S 0 u_can_byte_num 0 7 FORMAT "%1.0" SYMBOL_LINK "CAN_TX_AMP_FL_ACTV" 1 /end CHARACTERISTIC
/begin CHARACTERISTIC CAN_TX_AMP_FL_ACTV_BIT_LOC "amp fail active msg bit location" VALUE 0x0002038C __UBYTE_S 0 u_can_bit_loc 0 7 FORMAT "%1.0" SYMBOL_LINK "CAN_TX_AMP_FL_ACTV" 2 /end CHARACTERISTIC
/begin CHARACTERISTIC CAN_TX_AMP_FL_ACTV_BIT_LEN "amp fail active msg bit length" VALUE 0x0002038C __UBYTE_S 0 u_cnts 0 255 SYMBOL_LINK "CAN_TX_AMP_FL_ACTV" 3 /end CHARACTERISTIC
/begin CHARACTERISTIC CAN_TX_AMP_FL_ACTV_TABLE "amp fail active msg table" VAL_BLK 0x0002038C __UBYTE_S 0 u_cnts 0 255 NUMBER 2 SYMBOL_LINK "CAN_TX_AMP_FL_ACTV" 4 /end CHARACTERISTIC
/begin CHARACTERISTIC CAN_TX_BAT_VLT_ID "battery voltage msg number" VALUE 0x0002038C __UBYTE_S 0 u_can_txmsg_num 0 255 FORMAT "%3.0" SYMBOL_LINK "CAN_TX_BAT_VLT" 0 /end CHARACTERISTIC
/begin CHARACTERISTIC CAN_TX_BAT_VLT_BYTE_LOC "battery voltage msg location number" VALUE 0x0002038C __UBYTE_S 0 u_can_byte_num 0 7 FORMAT "%1.0" SYMBOL_LINK "CAN_TX_BAT_VLT" 1 /end CHARACTERISTIC
/begin CHARACTERISTIC CAN_TX_BAT_VLT_BIT_LOC "battery voltage msg bit location" VALUE 0x0002038C __UBYTE_S 0 u_can_bit_loc 0 7 FORMAT "%1.0" SYMBOL_LINK "CAN_TX_BAT_VLT" 2 /end CHARACTERISTIC
/begin CHARACTERISTIC CAN_TX_BAT_VLT_BIT_LEN "battery voltage msg bit length" VALUE 0x0002038C __UBYTE_S 0 u_cnts 0 255 SYMBOL_LINK "CAN_TX_BAT_VLT" 3 /end CHARACTERISTIC
/begin CHARACTERISTIC CAN_TX_BAT_VLT_A "battery voltage msg scaling A" VALUE 0x0002038C __ULONG_S 0 u_fac_65536L 0 65535.9999847412109375 FORMAT "%8.3" SYMBOL_LINK "CAN_TX_BAT_VLT" 4 /end CHARACTERISTIC
/begin CHARACTERISTIC CAN_TX_BAT_VLT_B "battery voltage msg scaling B" VALUE 0x0002038C __SWORD_S 0 u_cnt_n3277_p3277 -3276.8 3276.7 FORMAT "%5.1" SYMBOL_LINK "CAN_TX_BAT_VLT" 8 /end CHARACTERISTIC
/begin CHARACTERISTIC CAN_TX_BAT_VLT_MIN "battery voltage msg min" VALUE 0x0002038C __UWORD_S 0 u_volt_32 0 31.99951171875 FORMAT "%4.2" SYMBOL_LINK "CAN_TX_BAT_VLT" 10 /end CHARACTERISTIC
/begin CHARACTERISTIC CAN_TX_BAT_VLT_MAX "battery voltage msg max" VALUE 0x0002038C __UWORD_S 0 u_volt_32 0 31.99951171875 FORMAT "%4.2" SYMBOL_LINK "CAN_TX_BAT_VLT" 12 /end CHARACTERISTIC
/begin CHARACTERISTIC CAN_TX_BAT_VLT_INVALID "battery voltage msg invalid value" VALUE 0x0002038C __UWORD_S 0 u_cnts 0 65535 FORMAT "%5.0" SYMBOL_LINK "CAN_TX_BAT_VLT" 14 /end CHARACTERISTIC
/begin CHARACTERISTIC CAN_TX_CAT_TEMP_ID "catalyst temp msg number" VALUE 0x0002038C __UBYTE_S 0 u_can_txmsg_num 0 255 FORMAT "%3.0" SYMBOL_LINK "CAN_TX_CAT_TEMP" 0 /end CHARACTERISTIC
/begin CHARACTERISTIC CAN_TX_CAT_TEMP_BYTE_LOC "catalyst temp msg location number" VALUE 0x0002038C __UBYTE_S 0 u_can_byte_num 0 7 FORMAT "%1.0" SYMBOL_LINK "CAN_TX_CAT_TEMP" 1 /end CHARACTERISTIC
/begin CHARACTERISTIC CAN_TX_CAT_TEMP_BIT_LOC "catalyst temp msg bit location" VALUE 0x0002038C __UBYTE_S 0 u_can_bit_loc 0 7 FORMAT "%1.0" SYMBOL_LINK "CAN_TX_CAT_TEMP" 2 /end CHARACTERISTIC
/begin CHARACTERISTIC CAN_TX_CAT_TEMP_BIT_LEN "catalyst temp msg bit length" VALUE 0x0002038C __UBYTE_S 0 u_cnts 0 255 SYMBOL_LINK "CAN_TX_CAT_TEMP" 3 /end CHARACTERISTIC
/begin CHARACTERISTIC CAN_TX_CAT_TEMP_A "catalyst temp msg scaling A" VALUE 0x0002038C __ULONG_S 0 u_fac_65536L 0 65535.9999847412109375 FORMAT "%8.3" SYMBOL_LINK "CAN_TX_CAT_TEMP" 4 /end CHARACTERISTIC
/begin CHARACTERISTIC CAN_TX_CAT_TEMP_B "catalyst temp msg scaling B" VALUE 0x0002038C __SWORD_S 0 u_cnt_n3277_p3277 -3276.8 3276.7 FORMAT "%5.1" SYMBOL_LINK "CAN_TX_CAT_TEMP" 8 /end CHARACTERISTIC
/begin CHARACTERISTIC CAN_TX_CAT_TEMP_MIN "catalyst temp msg min" VALUE 0x0002038C __SWORD_S 0 u_deg_C_n2048_p2048 -2048 2047.9375 SYMBOL_LINK "CAN_TX_CAT_TEMP" 10 /end CHARACTERISTIC
/begin CHARACTERISTIC CAN_TX_CAT_TEMP_MAX "catalyst temp msg max" VALUE 0x0002038C __SWORD_S 0 u_deg_C_n2048_p2048 -2048 2047.9375 SYMBOL_LINK "CAN_TX_CAT_TEMP" 12 /end CHARACTERISTIC
/begin CHARACTERISTIC CAN_TX_CAT_TEMP_INVALID "catalyst temp msg invalid value" VALUE 0x0002038C __UWORD_S 0 u_cnts 0 65535 FORMAT "%5.0" SYMBOL_LINK "CAN_TX_CAT_TEMP" 14 /end CHARACTERISTIC
/begin CHARACTERISTIC CAN_TX_CHRG_LAMP_ID "charge lamp msg number" VALUE 0x0002038C __UBYTE_S 0 u_can_txmsg_num 0 255 FORMAT "%3.0" SYMBOL_LINK "CAN_TX_CHRG_LAMP" 0 /end CHARACTERISTIC
/begin CHARACTERISTIC CAN_TX_CHRG_LAMP_BYTE_LOC "charge lamp msg location number" VALUE 0x0002038C __UBYTE_S 0 u_can_byte_num 0 7 FORMAT "%1.0" SYMBOL_LINK "CAN_TX_CHRG_LAMP" 1 /end CHARACTERISTIC
/begin CHARACTERISTIC CAN_TX_CHRG_LAMP_BIT_LOC "charge lamp msg bit location" VALUE 0x0002038C __UBYTE_S 0 u_can_bit_loc 0 7 FORMAT "%1.0" SYMBOL_LINK "CAN_TX_CHRG_LAMP" 2 /end CHARACTERISTIC
/begin CHARACTERISTIC CAN_TX_CHRG_LAMP_BIT_LEN "charge lamp msg bit length" VALUE 0x0002038C __UBYTE_S 0 u_cnts 0 255 SYMBOL_LINK "CAN_TX_CHRG_LAMP" 3 /end CHARACTERISTIC
/begin CHARACTERISTIC CAN_TX_CHRG_LAMP_TABLE "charge lamp msg table" VAL_BLK 0x0002038C __UBYTE_S 0 u_cnts 0 255 NUMBER 2 SYMBOL_LINK "CAN_TX_CHRG_LAMP" 4 /end CHARACTERISTIC
/begin CHARACTERISTIC CAN_TX_BRK_SW_ACTV_ID "brake switch active msg number" VALUE 0x0002038C __UBYTE_S 0 u_can_txmsg_num 0 255 FORMAT "%3.0" SYMBOL_LINK "CAN_TX_BRK_SW_ACTV" 0 /end CHARACTERISTIC
/begin CHARACTERISTIC CAN_TX_BRK_SW_ACTV_BYTE_LOC "brake switch active msg location number" VALUE 0x0002038C __UBYTE_S 0 u_can_byte_num 0 7 FORMAT "%1.0" SYMBOL_LINK "CAN_TX_BRK_SW_ACTV" 1 /end CHARACTERISTIC
/begin CHARACTERISTIC CAN_TX_BRK_SW_ACTV_BIT_LOC "brake switch active msg bit location" VALUE 0x0002038C __UBYTE_S 0 u_can_bit_loc 0 7 FORMAT "%1.0" SYMBOL_LINK "CAN_TX_BRK_SW_ACTV" 2 /end CHARACTERISTIC
/begin CHARACTERISTIC CAN_TX_BRK_SW_ACTV_BIT_LEN "brake switch active msg bit length" VALUE 0x0002038C __UBYTE_S 0 u_cnts 0 255 SYMBOL_LINK "CAN_TX_BRK_SW_ACTV" 3 /end CHARACTERISTIC
/begin CHARACTERISTIC CAN_TX_BRK_SW_ACTV_TABLE "brake switch active msg table" VAL_BLK 0x0002038C __UBYTE_S 0 u_cnts 0 255 NUMBER 2 SYMBOL_LINK "CAN_TX_BRK_SW_ACTV" 4 /end CHARACTERISTIC
/begin CHARACTERISTIC CAN_TX_CRU_DIS_ID "cruise disable msg number" VALUE 0x0002038C __UBYTE_S 0 u_can_txmsg_num 0 255 FORMAT "%3.0" SYMBOL_LINK "CAN_TX_CRU_DIS" 0 /end CHARACTERISTIC
/begin CHARACTERISTIC CAN_TX_CRU_DIS_BYTE_LOC "cruise disable msg location number" VALUE 0x0002038C __UBYTE_S 0 u_can_byte_num 0 7 FORMAT "%1.0" SYMBOL_LINK "CAN_TX_CRU_DIS" 1 /end CHARACTERISTIC
/begin CHARACTERISTIC CAN_TX_CRU_DIS_BIT_LOC "cruise disable msg bit location" VALUE 0x0002038C __UBYTE_S 0 u_can_bit_loc 0 7 FORMAT "%1.0" SYMBOL_LINK "CAN_TX_CRU_DIS" 2 /end CHARACTERISTIC
/begin CHARACTERISTIC CAN_TX_CRU_DIS_BIT_LEN "cruise disable msg bit length" VALUE 0x0002038C __UBYTE_S 0 u_cnts 0 255 SYMBOL_LINK "CAN_TX_CRU_DIS" 3 /end CHARACTERISTIC
/begin CHARACTERISTIC CAN_TX_CRU_DIS_TABLE "cruise disable msg table" VAL_BLK 0x0002038C __UBYTE_S 0 u_cnts 0 255 NUMBER 2 SYMBOL_LINK "CAN_TX_CRU_DIS" 4 /end CHARACTERISTIC
/begin CHARACTERISTIC CAN_TX_SHFT_ST_ID "shift state msg number" VALUE 0x0002038C __UBYTE_S 0 u_can_txmsg_num 0 255 FORMAT "%3.0" SYMBOL_LINK "CAN_TX_SHFT_ST" 0 /end CHARACTERISTIC
/begin CHARACTERISTIC CAN_TX_SHFT_ST_BYTE_LOC "shift state msg location number" VALUE 0x0002038C __UBYTE_S 0 u_can_byte_num 0 7 FORMAT "%1.0" SYMBOL_LINK "CAN_TX_SHFT_ST" 1 /end CHARACTERISTIC
/begin CHARACTERISTIC CAN_TX_SHFT_ST_BIT_LOC "shift state msg bit location" VALUE 0x0002038C __UBYTE_S 0 u_can_bit_loc 0 7 FORMAT "%1.0" SYMBOL_LINK "CAN_TX_SHFT_ST" 2 /end CHARACTERISTIC
/begin CHARACTERISTIC CAN_TX_SHFT_ST_BIT_LEN "shift state msg bit length" VALUE 0x0002038C __UBYTE_S 0 u_cnts 0 255 SYMBOL_LINK "CAN_TX_SHFT_ST" 3 /end CHARACTERISTIC
/begin CHARACTERISTIC CAN_TX_SHFT_ST_TABLE "shift state msg table" CURVE 0x375CE __UBYTE_S 0 u_cnts 0 255 SYMBOL_LINK "CAN_TX_SHFT_ST" 4
 /begin AXIS_DESCR FIX_AXIS NO_INPUT_QUANTITY u_can_shft_st 4 0 3 /begin FIX_AXIS_PAR_LIST 0 1 2 3 /end FIX_AXIS_PAR_LIST /end AXIS_DESCR
/end CHARACTERISTIC
/begin CHARACTERISTIC CAN_TX_ENG_SPD_ID "engine speed msg number" VALUE 0x0002038C __UBYTE_S 0 u_can_txmsg_num 0 255 FORMAT "%3.0" SYMBOL_LINK "CAN_TX_ENG_SPD" 0 /end CHARACTERISTIC
/begin CHARACTERISTIC CAN_TX_ENG_SPD_BYTE_LOC "engine speed msg location number" VALUE 0x0002038C __UBYTE_S 0 u_can_byte_num 0 7 FORMAT "%1.0" SYMBOL_LINK "CAN_TX_ENG_SPD" 1 /end CHARACTERISTIC
/begin CHARACTERISTIC CAN_TX_ENG_SPD_BIT_LOC "engine speed msg bit location" VALUE 0x0002038C __UBYTE_S 0 u_can_bit_loc 0 7 FORMAT "%1.0" SYMBOL_LINK "CAN_TX_ENG_SPD" 2 /end CHARACTERISTIC
/begin CHARACTERISTIC CAN_TX_ENG_SPD_BIT_LEN "engine speed msg bit length" VALUE 0x0002038C __UBYTE_S 0 u_cnts 0 255 SYMBOL_LINK "CAN_TX_ENG_SPD" 3 /end CHARACTERISTIC
/begin CHARACTERISTIC CAN_TX_ENG_SPD_A "engine speed msg scaling A" VALUE 0x0002038C __ULONG_S 0 u_fac_65536L 0 65535.9999847412109375 FORMAT "%8.3" SYMBOL_LINK "CAN_TX_ENG_SPD" 4 /end CHARACTERISTIC
/begin CHARACTERISTIC CAN_TX_ENG_SPD_B "engine speed msg scaling B" VALUE 0x0002038C __SWORD_S 0 u_cnt_n3277_p3277 -3276.8 3276.7 FORMAT "%5.1" SYMBOL_LINK "CAN_TX_ENG_SPD" 8 /end CHARACTERISTIC
/begin CHARACTERISTIC CAN_TX_ENG_SPD_MIN "engine speed msg min" VALUE 0x0002038C __UWORD_S 0 u_espd 0 8191.875 FORMAT "%5.1" SYMBOL_LINK "CAN_TX_ENG_SPD" 10 /end CHARACTERISTIC
/begin CHARACTERISTIC CAN_TX_ENG_SPD_MAX "engine speed msg max" VALUE 0x0002038C __UWORD_S 0 u_espd 0 8191.875 FORMAT "%5.1" SYMBOL_LINK "CAN_TX_ENG_SPD" 12 /end CHARACTERISTIC
/begin CHARACTERISTIC CAN_TX_ENG_SPD_INVALID "engine speed msg invalid value" VALUE 0x0002038C __UWORD_S 0 u_cnts 0 65535 FORMAT "%5.0" SYMBOL_LINK "CAN_TX_ENG_SPD" 14 /end CHARACTERISTIC
/begin CHARACTERISTIC CAN_TX_VSPD_FL_DUR_ID "vehicle speed fail duration msg number" VALUE 0x0002038C __UBYTE_S 0 u_can_txmsg_num 0 255 FORMAT "%3.0" SYMBOL_LINK "CAN_TX_VSPD_FL_DUR" 0 /end CHARACTERISTIC
/begin CHARACTERISTIC CAN_TX_VSPD_FL_DUR_BYTE_LOC "vehicle speed fail duration msg location number" VALUE 0x0002038C __UBYTE_S 0 u_can_byte_num 0 7 FORMAT "%1.0" SYMBOL_LINK "CAN_TX_VSPD_FL_DUR" 1 /end CHARACTERISTIC
/begin CHARACTERISTIC CAN_TX_VSPD_FL_DUR_BIT_LOC "vehicle speed fail duration msg bit location" VALUE 0x0002038C __UBYTE_S 0 u_can_bit_loc 0 7 FORMAT "%1.0" SYMBOL_LINK "CAN_TX_VSPD_FL_DUR" 2 /end CHARACTERISTIC
/begin CHARACTERISTIC CAN_TX_VSPD_FL_DUR_BIT_LEN "vehicle speed fail duration msg bit length" VALUE 0x0002038C __UBYTE_S 0 u_cnts 0 255 SYMBOL_LINK "CAN_TX_VSPD_FL_DUR" 3 /end CHARACTERISTIC
/begin CHARACTERISTIC CAN_TX_VSPD_FL_DUR_A "vehicle speed fail duration msg scaling A" VALUE 0x0002038C __ULONG_S 0 u_fac_65536L 0 65535.9999847412109375 FORMAT "%8.3" SYMBOL_LINK "CAN_TX_VSPD_FL_DUR" 4 /end CHARACTERISTIC
/begin CHARACTERISTIC CAN_TX_VSPD_FL_DUR_B "vehicle speed fail duration msg scaling B" VALUE 0x0002038C __SWORD_S 0 u_cnt_n3277_p3277 -3276.8 3276.7 FORMAT "%5.1" SYMBOL_LINK "CAN_TX_VSPD_FL_DUR" 8 /end CHARACTERISTIC
/begin CHARACTERISTIC CAN_TX_VSPD_FL_DUR_MIN "vehicle speed fail duration msg min" VALUE 0x0002038C __UWORD_S 0 u_1s_tmr 0 65535 SYMBOL_LINK "CAN_TX_VSPD_FL_DUR" 10 /end CHARACTERISTIC
/begin CHARACTERISTIC CAN_TX_VSPD_FL_DUR_MAX "vehicle speed fail duration msg max" VALUE 0x0002038C __UWORD_S 0 u_1s_tmr 0 65535 SYMBOL_LINK "CAN_TX_VSPD_FL_DUR" 12 /end CHARACTERISTIC
/begin CHARACTERISTIC CAN_TX_VSPD_FL_DUR_INVALID "vehicle speed fail duration msg invalid value" VALUE 0x0002038C __UWORD_S 0 u_cnts 0 65535 FORMAT "%5.0" SYMBOL_LINK "CAN_TX_VSPD_FL_DUR" 14 /end CHARACTERISTIC
/begin CHARACTERISTIC CAN_TX_ESPD_AVG_ID "average engine speed msg number" VALUE 0x0002038C __UBYTE_S 0 u_can_txmsg_num 0 255 FORMAT "%3.0" SYMBOL_LINK "CAN_TX_ESPD_AVG" 0 /end CHARACTERISTIC
/begin CHARACTERISTIC CAN_TX_ESPD_AVG_BYTE_LOC "average engine speed msg location number" VALUE 0x0002038C __UBYTE_S 0 u_can_byte_num 0 7 FORMAT "%1.0" SYMBOL_LINK "CAN_TX_ESPD_AVG" 1 /end CHARACTERISTIC
/begin CHARACTERISTIC CAN_TX_ESPD_AVG_BIT_LOC "average engine speed msg bit location" VALUE 0x0002038C __UBYTE_S 0 u_can_bit_loc 0 7 FORMAT "%1.0" SYMBOL_LINK "CAN_TX_ESPD_AVG" 2 /end CHARACTERISTIC
/begin CHARACTERISTIC CAN_TX_ESPD_AVG_BIT_LEN "average engine speed msg bit length" VALUE 0x0002038C __UBYTE_S 0 u_cnts 0 255 SYMBOL_LINK "CAN_TX_ESPD_AVG" 3 /end CHARACTERISTIC
/begin CHARACTERISTIC CAN_TX_ESPD_AVG_A "average engine speed msg scaling A" VALUE 0x0002038C __ULONG_S 0 u_fac_65536L 0 65535.9999847412109375 FORMAT "%8.3" SYMBOL_LINK "CAN_TX_ESPD_AVG" 4 /end CHARACTERISTIC
/begin CHARACTERISTIC CAN_TX_ESPD_AVG_B "average engine speed msg scaling B" VALUE 0x0002038C __SWORD_S 0 u_cnt_n3277_p3277 -3276.8 3276.7 FORMAT "%5.1" SYMBOL_LINK "CAN_TX_ESPD_AVG" 8 /end CHARACTERISTIC
/begin CHARACTERISTIC CAN_TX_ESPD_AVG_MIN "average engine speed msg min" VALUE 0x0002038C __UWORD_S 0 u_espd 0 8191.875 FORMAT "%5.1" SYMBOL_LINK "CAN_TX_ESPD_AVG" 10 /end CHARACTERISTIC
/begin CHARACTERISTIC CAN_TX_ESPD_AVG_MAX "average engine speed msg max" VALUE 0x0002038C __UWORD_S 0 u_espd 0 8191.875 FORMAT "%5.1" SYMBOL_LINK "CAN_TX_ESPD_AVG" 12 /end CHARACTERISTIC
/begin CHARACTERISTIC CAN_TX_ESPD_AVG_INVALID "average engine speed msg invalid value" VALUE 0x0002038C __UWORD_S 0 u_cnts 0 65535 FORMAT "%5.0" SYMBOL_LINK "CAN_TX_ESPD_AVG" 14 /end CHARACTERISTIC
/begin CHARACTERISTIC CAN_TX_VEH_SPD_ID "vehicle speed msg number" VALUE 0x0002038C __UBYTE_S 0 u_can_txmsg_num 0 255 FORMAT "%3.0" SYMBOL_LINK "CAN_TX_VEH_SPD" 0 /end CHARACTERISTIC
/begin CHARACTERISTIC CAN_TX_VEH_SPD_BYTE_LOC "vehicle speed msg location number" VALUE 0x0002038C __UBYTE_S 0 u_can_byte_num 0 7 FORMAT "%1.0" SYMBOL_LINK "CAN_TX_VEH_SPD" 1 /end CHARACTERISTIC
/begin CHARACTERISTIC CAN_TX_VEH_SPD_BIT_LOC "vehicle speed msg bit location" VALUE 0x0002038C __UBYTE_S 0 u_can_bit_loc 0 7 FORMAT "%1.0" SYMBOL_LINK "CAN_TX_VEH_SPD" 2 /end CHARACTERISTIC
/begin CHARACTERISTIC CAN_TX_VEH_SPD_BIT_LEN "vehicle speed msg bit length" VALUE 0x0002038C __UBYTE_S 0 u_cnts 0 255 SYMBOL_LINK "CAN_TX_VEH_SPD" 3 /end CHARACTERISTIC
/begin CHARACTERISTIC CAN_TX_VEH_SPD_A "vehicle speed msg scaling A" VALUE 0x0002038C __ULONG_S 0 u_fac_65536L 0 65535.9999847412109375 FORMAT "%8.3" SYMBOL_LINK "CAN_TX_VEH_SPD" 4 /end CHARACTERISTIC
/begin CHARACTERISTIC CAN_TX_VEH_SPD_B "vehicle speed msg scaling B" VALUE 0x0002038C __SWORD_S 0 u_cnt_n3277_p3277 -3276.8 3276.7 FORMAT "%5.1" SYMBOL_LINK "CAN_TX_VEH_SPD" 8 /end CHARACTERISTIC
/begin CHARACTERISTIC CAN_TX_VEH_SPD_MIN "vehicle speed msg min" VALUE 0x0002038C __UWORD_S 0 u_vspd 0 511.9921875 FORMAT "%4.1" SYMBOL_LINK "CAN_TX_VEH_SPD" 10 /end CHARACTERISTIC
/begin CHARACTERISTIC CAN_TX_VEH_SPD_MAX "vehicle speed speed msg max" VALUE 0x0002038C __UWORD_S 0 u_vspd 0 511.9921875 FORMAT "%4.1" SYMBOL_LINK "CAN_TX_VEH_SPD" 12 /end CHARACTERISTIC
/begin CHARACTERISTIC CAN_TX_VEH_SPD_INVALID "vehicle speed msg invalid value" VALUE 0x0002038C __UWORD_S 0 u_cnts 0 65535 FORMAT "%5.0" SYMBOL_LINK "CAN_TX_VEH_SPD" 14 /end CHARACTERISTIC
/begin CHARACTERISTIC CAN_TX_CRU_VSPD_SP_ID "cruise vehicle speed setpoint msg number" VALUE 0x0002038C __UBYTE_S 0 u_can_txmsg_num 0 255 FORMAT "%3.0" SYMBOL_LINK "CAN_TX_CRU_VSPD_SP" 0 /end CHARACTERISTIC
/begin CHARACTERISTIC CAN_TX_CRU_VSPD_SP_BYTE_LOC "cruise vehicle speed setpoint msg location number" VALUE 0x0002038C __UBYTE_S 0 u_can_byte_num 0 7 FORMAT "%1.0" SYMBOL_LINK "CAN_TX_CRU_VSPD_SP" 1 /end CHARACTERISTIC
/begin CHARACTERISTIC CAN_TX_CRU_VSPD_SP_BIT_LOC "cruise vehicle speed setpoint msg bit location" VALUE 0x0002038C __UBYTE_S 0 u_can_bit_loc 0 7 FORMAT "%1.0" SYMBOL_LINK "CAN_TX_CRU_VSPD_SP" 2 /end CHARACTERISTIC
/begin CHARACTERISTIC CAN_TX_CRU_VSPD_SP_BIT_LEN "cruise vehicle speed setpoint msg bit length" VALUE 0x0002038C __UBYTE_S 0 u_cnts 0 255 SYMBOL_LINK "CAN_TX_CRU_VSPD_SP" 3 /end CHARACTERISTIC
/begin CHARACTERISTIC CAN_TX_CRU_VSPD_SP_A "cruise vehicle speed setpoint msg scaling A" VALUE 0x0002038C __ULONG_S 0 u_fac_65536L 0 65535.9999847412109375 FORMAT "%8.3" SYMBOL_LINK "CAN_TX_CRU_VSPD_SP" 4 /end CHARACTERISTIC
/begin CHARACTERISTIC CAN_TX_CRU_VSPD_SP_B "cruise vehicle speed setpoint msg scaling B" VALUE 0x0002038C __SWORD_S 0 u_cnt_n3277_p3277 -3276.8 3276.7 FORMAT "%5.1" SYMBOL_LINK "CAN_TX_VEH_SPD" 8 /end CHARACTERISTIC
/begin CHARACTERISTIC CAN_TX_CRU_VSPD_SP_MIN "cruise vehicle speed setpoint msg min" VALUE 0x0002038C __UWORD_S 0 u_vspd 0 511.9921875 FORMAT "%4.1" SYMBOL_LINK "CAN_TX_CRU_VSPD_SP" 10 /end CHARACTERISTIC
/begin CHARACTERISTIC CAN_TX_CRU_VSPD_SP_MAX "cruise vehicle speed setpoint msg max" VALUE 0x0002038C __UWORD_S 0 u_vspd 0 511.9921875 FORMAT "%4.1" SYMBOL_LINK "CAN_TX_CRU_VSPD_SP" 12 /end CHARACTERISTIC
/begin CHARACTERISTIC CAN_TX_CRU_VSPD_SP_INVALID "cruise vehicle speed setpoint msg invalid value" VALUE 0x0002038C __UWORD_S 0 u_cnts 0 65535 FORMAT "%5.0" SYMBOL_LINK "CAN_TX_CRU_VSPD_SP" 14 /end CHARACTERISTIC
/begin CHARACTERISTIC CAN_TX_IDL_ESPD_SP_ID "idle engine speed msg number" VALUE 0x0002038C __UBYTE_S 0 u_can_txmsg_num 0 255 FORMAT "%3.0" SYMBOL_LINK "CAN_TX_IDL_ESPD_SP" 0 /end CHARACTERISTIC
/begin CHARACTERISTIC CAN_TX_IDL_ESPD_SP_BYTE_LOC "idle engine speed msg location number" VALUE 0x0002038C __UBYTE_S 0 u_can_byte_num 0 7 FORMAT "%1.0" SYMBOL_LINK "CAN_TX_IDL_ESPD_SP" 1 /end CHARACTERISTIC
/begin CHARACTERISTIC CAN_TX_IDL_ESPD_SP_BIT_LOC "idle engine speed msg bit location" VALUE 0x0002038C __UBYTE_S 0 u_can_bit_loc 0 7 FORMAT "%1.0" SYMBOL_LINK "CAN_TX_IDL_ESPD_SP" 2 /end CHARACTERISTIC
/begin CHARACTERISTIC CAN_TX_IDL_ESPD_SP_BIT_LEN "idle engine speed msg bit length" VALUE 0x0002038C __UBYTE_S 0 u_cnts 0 255 SYMBOL_LINK "CAN_TX_IDL_ESPD_SP" 3 /end CHARACTERISTIC
/begin CHARACTERISTIC CAN_TX_IDL_ESPD_SP_A "idle engine speed msg scaling A" VALUE 0x0002038C __ULONG_S 0 u_fac_65536L 0 65535.9999847412109375 FORMAT "%8.3" SYMBOL_LINK "CAN_TX_IDL_ESPD_SP" 4 /end CHARACTERISTIC
/begin CHARACTERISTIC CAN_TX_IDL_ESPD_SP_B "idle engine speed msg scaling B" VALUE 0x0002038C __SWORD_S 0 u_cnt_n3277_p3277 -3276.8 3276.7 FORMAT "%5.1" SYMBOL_LINK "CAN_TX_IDL_ESPD_SP" 8 /end CHARACTERISTIC
/begin CHARACTERISTIC CAN_TX_IDL_ESPD_SP_MIN "idle engine speed msg min" VALUE 0x0002038C __UWORD_S 0 u_espd 0 8191.875 FORMAT "%5.1" SYMBOL_LINK "CAN_TX_IDL_ESPD_SP" 10 /end CHARACTERISTIC
/begin CHARACTERISTIC CAN_TX_IDL_ESPD_SP_MAX "idle engine speed msg max" VALUE 0x0002038C __UWORD_S 0 u_espd 0 8191.875 FORMAT "%5.1" SYMBOL_LINK "CAN_TX_IDL_ESPD_SP" 12 /end CHARACTERISTIC
/begin CHARACTERISTIC CAN_TX_IDL_ESPD_SP_INVALID "idle engine speed msg invalid value" VALUE 0x0002038C __UWORD_S 0 u_cnts 0 65535 FORMAT "%5.0" SYMBOL_LINK "CAN_TX_IDL_ESPD_SP" 14 /end CHARACTERISTIC
/begin CHARACTERISTIC CAN_TX_IAT_ID "IAT msg number" VALUE 0x0002038C __UBYTE_S 0 u_can_txmsg_num 0 255 FORMAT "%3.0" SYMBOL_LINK "CAN_TX_IAT" 0 /end CHARACTERISTIC
/begin CHARACTERISTIC CAN_TX_IAT_BYTE_LOC "IAT msg location number" VALUE 0x0002038C __UBYTE_S 0 u_can_byte_num 0 7 FORMAT "%1.0" SYMBOL_LINK "CAN_TX_IAT" 1 /end CHARACTERISTIC
/begin CHARACTERISTIC CAN_TX_IAT_BIT_LOC "IAT msg bit location" VALUE 0x0002038C __UBYTE_S 0 u_can_bit_loc 0 7 FORMAT "%1.0" SYMBOL_LINK "CAN_TX_IAT" 2 /end CHARACTERISTIC
/begin CHARACTERISTIC CAN_TX_IAT_BIT_LEN "IAT msg bit length" VALUE 0x0002038C __UBYTE_S 0 u_cnts 0 255 SYMBOL_LINK "CAN_TX_IAT" 3 /end CHARACTERISTIC
/begin CHARACTERISTIC CAN_TX_IAT_A "IAT msg scaling A" VALUE 0x0002038C __ULONG_S 0 u_fac_65536L 0 65535.9999847412109375 FORMAT "%8.3" SYMBOL_LINK "CAN_TX_IAT" 4 /end CHARACTERISTIC
/begin CHARACTERISTIC CAN_TX_IAT_B "IAT msg scaling B" VALUE 0x0002038C __SWORD_S 0 u_cnt_n3277_p3277 -3276.8 3276.7 FORMAT "%5.1" SYMBOL_LINK "CAN_TX_IAT" 8 /end CHARACTERISTIC
/begin CHARACTERISTIC CAN_TX_IAT_MIN "IAT msg min" VALUE 0x0002038C __SWORD_S 0 u_deg_C -256 255.9921875 SYMBOL_LINK "CAN_TX_IAT" 10 /end CHARACTERISTIC
/begin CHARACTERISTIC CAN_TX_IAT_MAX "IAT msg max" VALUE 0x0002038C __SWORD_S 0 u_deg_C -256 255.9921875 SYMBOL_LINK "CAN_TX_IAT" 12 /end CHARACTERISTIC
/begin CHARACTERISTIC CAN_TX_IAT_INVALID "IAT msg invalid value" VALUE 0x0002038C __UWORD_S 0 u_cnts 0 65535 FORMAT "%5.0" SYMBOL_LINK "CAN_TX_IAT" 14 /end CHARACTERISTIC
/begin CHARACTERISTIC CAN_TX_ECT_ID "ECT msg number" VALUE 0x0002038C __UBYTE_S 0 u_can_txmsg_num 0 255 FORMAT "%3.0" SYMBOL_LINK "CAN_TX_ECT" 0 /end CHARACTERISTIC
/begin CHARACTERISTIC CAN_TX_ECT_BYTE_LOC "ECT msg location number" VALUE 0x0002038C __UBYTE_S 0 u_can_byte_num 0 7 FORMAT "%1.0" SYMBOL_LINK "CAN_TX_ECT" 1 /end CHARACTERISTIC
/begin CHARACTERISTIC CAN_TX_ECT_BIT_LOC "ECT msg bit location" VALUE 0x0002038C __UBYTE_S 0 u_can_bit_loc 0 7 FORMAT "%1.0" SYMBOL_LINK "CAN_TX_ECT" 2 /end CHARACTERISTIC
/begin CHARACTERISTIC CAN_TX_ECT_BIT_LEN "ECT msg bit length" VALUE 0x0002038C __UBYTE_S 0 u_cnts 0 255 SYMBOL_LINK "CAN_TX_ECT" 3 /end CHARACTERISTIC
/begin CHARACTERISTIC CAN_TX_ECT_A "ECT msg scaling A" VALUE 0x0002038C __ULONG_S 0 u_fac_65536L 0 65535.9999847412109375 FORMAT "%8.3" SYMBOL_LINK "CAN_TX_ECT" 4 /end CHARACTERISTIC
/begin CHARACTERISTIC CAN_TX_ECT_B "ECT msg scaling B" VALUE 0x0002038C __SWORD_S 0 u_cnt_n3277_p3277 -3276.8 3276.7 FORMAT "%5.1" SYMBOL_LINK "CAN_TX_ECT" 8 /end CHARACTERISTIC
/begin CHARACTERISTIC CAN_TX_ECT_MIN "ECT msg min" VALUE 0x0002038C __SWORD_S 0 u_deg_C -256 255.9921875 SYMBOL_LINK "CAN_TX_ECT" 10 /end CHARACTERISTIC
/begin CHARACTERISTIC CAN_TX_ECT_MAX "ECT msg max" VALUE 0x0002038C __SWORD_S 0 u_deg_C -256 255.9921875 SYMBOL_LINK "CAN_TX_ECT" 12 /end CHARACTERISTIC
/begin CHARACTERISTIC CAN_TX_ECT_INVALID "ECT msg invalid value" VALUE 0x0002038C __UWORD_S 0 u_cnts 0 65535 FORMAT "%5.0" SYMBOL_LINK "CAN_TX_ECT" 14 /end CHARACTERISTIC
/begin CHARACTERISTIC CAN_TX_MAP_ID "MAP msg number" VALUE 0x0002038C __UBYTE_S 0 u_can_txmsg_num 0 255 FORMAT "%3.0" SYMBOL_LINK "CAN_TX_MAP" 0 /end CHARACTERISTIC
/begin CHARACTERISTIC CAN_TX_MAP_BYTE_LOC "MAP msg location number" VALUE 0x0002038C __UBYTE_S 0 u_can_byte_num 0 7 FORMAT "%1.0" SYMBOL_LINK "CAN_TX_MAP" 1 /end CHARACTERISTIC
/begin CHARACTERISTIC CAN_TX_MAP_BIT_LOC "MAP msg bit location" VALUE 0x0002038C __UBYTE_S 0 u_can_bit_loc 0 7 FORMAT "%1.0" SYMBOL_LINK "CAN_TX_MAP" 2 /end CHARACTERISTIC
/begin CHARACTERISTIC CAN_TX_MAP_BIT_LEN "MAP msg bit length" VALUE 0x0002038C __UBYTE_S 0 u_cnts 0 255 SYMBOL_LINK "CAN_TX_MAP" 3 /end CHARACTERISTIC
/begin CHARACTERISTIC CAN_TX_MAP_A "MAP msg scaling A" VALUE 0x0002038C __ULONG_S 0 u_fac_65536L 0 65535.9999847412109375 FORMAT "%8.3" SYMBOL_LINK "CAN_TX_MAP" 4 /end CHARACTERISTIC
/begin CHARACTERISTIC CAN_TX_MAP_B "MAP msg scaling B" VALUE 0x0002038C __SWORD_S 0 u_cnt_n3277_p3277 -3276.8 3276.7 FORMAT "%5.1" SYMBOL_LINK "CAN_TX_MAP" 8 /end CHARACTERISTIC
/begin CHARACTERISTIC CAN_TX_MAP_MIN "MAP msg min" VALUE 0x0002038C __UWORD_S 0 u_kPa_0_256 0 255.99609375 SYMBOL_LINK "CAN_TX_MAP" 10 /end CHARACTERISTIC
/begin CHARACTERISTIC CAN_TX_MAP_MAX "MAP msg max" VALUE 0x0002038C __UWORD_S 0 u_kPa_0_256 0 255.99609375 SYMBOL_LINK "CAN_TX_MAP" 12 /end CHARACTERISTIC
/begin CHARACTERISTIC CAN_TX_MAP_INVALID "MAP msg invalid value" VALUE 0x0002038C __UWORD_S 0 u_cnts 0 65535 FORMAT "%5.0" SYMBOL_LINK "CAN_TX_MAP" 14 /end CHARACTERISTIC
/begin CHARACTERISTIC CAN_TX_TPS_ID "TPS msg number" VALUE 0x0002038C __UBYTE_S 0 u_can_txmsg_num 0 255 FORMAT "%3.0" SYMBOL_LINK "CAN_TX_TPS" 0 /end CHARACTERISTIC
/begin CHARACTERISTIC CAN_TX_TPS_BYTE_LOC "TPS msg location number" VALUE 0x0002038C __UBYTE_S 0 u_can_byte_num 0 7 FORMAT "%1.0" SYMBOL_LINK "CAN_TX_TPS" 1 /end CHARACTERISTIC
/begin CHARACTERISTIC CAN_TX_TPS_BIT_LOC "TPS msg bit location" VALUE 0x0002038C __UBYTE_S 0 u_can_bit_loc 0 7 FORMAT "%1.0" SYMBOL_LINK "CAN_TX_TPS" 2 /end CHARACTERISTIC
/begin CHARACTERISTIC CAN_TX_TPS_BIT_LEN "TPS msg bit length" VALUE 0x0002038C __UBYTE_S 0 u_cnts 0 255 SYMBOL_LINK "CAN_TX_TPS" 3 /end CHARACTERISTIC
/begin CHARACTERISTIC CAN_TX_TPS_A "TPS msg scaling A" VALUE 0x0002038C __ULONG_S 0 u_fac_65536L 0 65535.9999847412109375 FORMAT "%8.3" SYMBOL_LINK "CAN_TX_TPS" 4 /end CHARACTERISTIC
/begin CHARACTERISTIC CAN_TX_TPS_B "TPS msg scaling B" VALUE 0x0002038C __SWORD_S 0 u_cnt_n3277_p3277 -3276.8 3276.7 FORMAT "%5.1" SYMBOL_LINK "CAN_TX_TPS" 8 /end CHARACTERISTIC
/begin CHARACTERISTIC CAN_TX_TPS_MIN "TPS msg min" VALUE 0x0002038C __UWORD_S 0 u_pct 0 199.996948 SYMBOL_LINK "CAN_TX_TPS" 10 /end CHARACTERISTIC
/begin CHARACTERISTIC CAN_TX_TPS_MAX "TPS msg max" VALUE 0x0002038C __UWORD_S 0 u_pct 0 199.996948 SYMBOL_LINK "CAN_TX_TPS" 12 /end CHARACTERISTIC
/begin CHARACTERISTIC CAN_TX_TPS_INVALID "TPS msg invalid value" VALUE 0x0002038C __UWORD_S 0 u_cnts 0 65535 FORMAT "%5.0" SYMBOL_LINK "CAN_TX_TPS" 14 /end CHARACTERISTIC
/begin CHARACTERISTIC CAN_TX_AC_TEMP_ID "AC temp msg number" VALUE 0x0002038C __UBYTE_S 0 u_can_txmsg_num 0 255 FORMAT "%3.0" SYMBOL_LINK "CAN_TX_AC_TEMP" 0 /end CHARACTERISTIC
/begin CHARACTERISTIC CAN_TX_AC_TEMP_BYTE_LOC "AC temp msg location number" VALUE 0x0002038C __UBYTE_S 0 u_can_byte_num 0 7 FORMAT "%1.0" SYMBOL_LINK "CAN_TX_AC_TEMP" 1 /end CHARACTERISTIC
/begin CHARACTERISTIC CAN_TX_AC_TEMP_BIT_LOC "AC temp msg bit location" VALUE 0x0002038C __UBYTE_S 0 u_can_bit_loc 0 7 FORMAT "%1.0" SYMBOL_LINK "CAN_TX_AC_TEMP" 2 /end CHARACTERISTIC
/begin CHARACTERISTIC CAN_TX_AC_TEMP_BIT_LEN "AC temp msg bit length" VALUE 0x0002038C __UBYTE_S 0 u_cnts 0 255 SYMBOL_LINK "CAN_TX_AC_TEMP" 3 /end CHARACTERISTIC
/begin CHARACTERISTIC CAN_TX_AC_TEMP_A "AC temp msg scaling A" VALUE 0x0002038C __ULONG_S 0 u_fac_65536L 0 65535.9999847412109375 FORMAT "%8.3" SYMBOL_LINK "CAN_TX_AC_TEMP" 4 /end CHARACTERISTIC
/begin CHARACTERISTIC CAN_TX_AC_TEMP_B "AC temp msg scaling B" VALUE 0x0002038C __SWORD_S 0 u_cnt_n3277_p3277 -3276.8 3276.7 FORMAT "%5.1" SYMBOL_LINK "CAN_TX_AC_TEMP" 8 /end CHARACTERISTIC
/begin CHARACTERISTIC CAN_TX_AC_TEMP_MIN "AC temp msg min" VALUE 0x0002038C __SWORD_S 0 u_deg_C -256 255.9921875 SYMBOL_LINK "CAN_TX_AC_TEMP" 10 /end CHARACTERISTIC
/begin CHARACTERISTIC CAN_TX_AC_TEMP_MAX "AC temp msg max" VALUE 0x0002038C __SWORD_S 0 u_deg_C -256 255.9921875 SYMBOL_LINK "CAN_TX_AC_TEMP" 12 /end CHARACTERISTIC
/begin CHARACTERISTIC CAN_TX_AC_TEMP_INVALID "AC temp msg invalid value" VALUE 0x0002038C __UWORD_S 0 u_cnts 0 65535 FORMAT "%5.0" SYMBOL_LINK "CAN_TX_AC_TEMP" 14 /end CHARACTERISTIC
/begin CHARACTERISTIC CAN_TX_VIR_PPS_ID "virtual PPS msg number" VALUE 0x0002038C __UBYTE_S 0 u_can_txmsg_num 0 255 FORMAT "%3.0" SYMBOL_LINK "CAN_TX_VIR_PPS" 0 /end CHARACTERISTIC
/begin CHARACTERISTIC CAN_TX_VIR_PPS_BYTE_LOC "virtual PPS msg location number" VALUE 0x0002038C __UBYTE_S 0 u_can_byte_num 0 7 FORMAT "%1.0" SYMBOL_LINK "CAN_TX_VIR_PPS" 1 /end CHARACTERISTIC
/begin CHARACTERISTIC CAN_TX_VIR_PPS_BIT_LOC "virtual PPS msg bit location" VALUE 0x0002038C __UBYTE_S 0 u_can_bit_loc 0 7 FORMAT "%1.0" SYMBOL_LINK "CAN_TX_VIR_PPS" 2 /end CHARACTERISTIC
/begin CHARACTERISTIC CAN_TX_VIR_PPS_BIT_LEN "virtual PPS msg bit length" VALUE 0x0002038C __UBYTE_S 0 u_cnts 0 255 SYMBOL_LINK "CAN_TX_VIR_PPS" 3 /end CHARACTERISTIC
/begin CHARACTERISTIC CAN_TX_VIR_PPS_A "virtual PPS msg scaling A" VALUE 0x0002038C __ULONG_S 0 u_fac_65536L 0 65535.9999847412109375 FORMAT "%8.3" SYMBOL_LINK "CAN_TX_VIR_PPS" 4 /end CHARACTERISTIC
/begin CHARACTERISTIC CAN_TX_VIR_PPS_B "virtual PPS msg scaling B" VALUE 0x0002038C __SWORD_S 0 u_cnt_n3277_p3277 -3276.8 3276.7 FORMAT "%5.1" SYMBOL_LINK "CAN_TX_VIR_PPS" 8 /end CHARACTERISTIC
/begin CHARACTERISTIC CAN_TX_VIR_PPS_MIN "virtual PPS msg min" VALUE 0x0002038C __UWORD_S 0 u_pct 0 199.996948 SYMBOL_LINK "CAN_TX_VIR_PPS" 10 /end CHARACTERISTIC
/begin CHARACTERISTIC CAN_TX_VIR_PPS_MAX "virtual PPS msg max" VALUE 0x0002038C __UWORD_S 0 u_pct 0 199.996948 SYMBOL_LINK "CAN_TX_VIR_PPS" 12 /end CHARACTERISTIC
/begin CHARACTERISTIC CAN_TX_VIR_PPS_INVALID "virtual PPS msg invalid value" VALUE 0x0002038C __UWORD_S 0 u_cnts 0 65535 FORMAT "%5.0" SYMBOL_LINK "CAN_TX_VIR_PPS" 14 /end CHARACTERISTIC
/begin CHARACTERISTIC CAN_TX_FC_PULS_NUM_ID "fuel consumption pulse number msg number" VALUE 0x0002038C __UBYTE_S 0 u_can_txmsg_num 0 255 FORMAT "%3.0" SYMBOL_LINK "CAN_TX_FC_PULS_NUM" 0 /end CHARACTERISTIC
/begin CHARACTERISTIC CAN_TX_FC_PULS_NUM_BYTE_LOC "fuel consumption pulse number msg location number" VALUE 0x0002038C __UBYTE_S 0 u_can_byte_num 0 7 FORMAT "%1.0" SYMBOL_LINK "CAN_TX_FC_PULS_NUM" 1 /end CHARACTERISTIC
/begin CHARACTERISTIC CAN_TX_FC_PULS_NUM_BIT_LOC "fuel consumption pulse number msg bit location" VALUE 0x0002038C __UBYTE_S 0 u_can_bit_loc 0 7 FORMAT "%1.0" SYMBOL_LINK "CAN_TX_FC_PULS_NUM" 2 /end CHARACTERISTIC
/begin CHARACTERISTIC CAN_TX_FC_PULS_NUM_BIT_LEN "fuel consumption pulse number msg bit length" VALUE 0x0002038C __UBYTE_S 0 u_cnts 0 255 SYMBOL_LINK "CAN_TX_FC_PULS_NUM" 3 /end CHARACTERISTIC
/begin CHARACTERISTIC CAN_TX_FC_PULS_NUM_A "fuel consumption pulse number msg scaling A" VALUE 0x0002038C __ULONG_S 0 u_fac_65536L 0 65535.9999847412109375 FORMAT "%8.3" SYMBOL_LINK "CAN_TX_FC_PULS_NUM" 4 /end CHARACTERISTIC
/begin CHARACTERISTIC CAN_TX_FC_PULS_NUM_B "fuel consumption pulse number msg scaling B" VALUE 0x0002038C __SWORD_S 0 u_cnt_n3277_p3277 -3276.8 3276.7 FORMAT "%5.1" SYMBOL_LINK "CAN_TX_FC_PULS_NUM" 8 /end CHARACTERISTIC
/begin CHARACTERISTIC CAN_TX_FC_PULS_NUM_MIN "fuel consumption pulse number msg min" VALUE 0x0002038C __UWORD_S 0 u_cnts 0 65535 FORMAT "%5.0" SYMBOL_LINK "CAN_TX_FC_PULS_NUM" 10 /end CHARACTERISTIC
/begin CHARACTERISTIC CAN_TX_FC_PULS_NUM_MAX "fuel consumption pulse number msg max" VALUE 0x0002038C __UWORD_S 0 u_cnts 0 65535 FORMAT "%5.0" SYMBOL_LINK "CAN_TX_FC_PULS_NUM" 12 /end CHARACTERISTIC
/begin CHARACTERISTIC CAN_TX_FC_PULS_NUM_INVALID "fuel consumption pulse number msg invalid value" VALUE 0x0002038C __UWORD_S 0 u_cnts 0 65535 FORMAT "%5.0" SYMBOL_LINK "CAN_TX_FC_PULS_NUM" 14 /end CHARACTERISTIC
/begin CHARACTERISTIC CAN_TX_OFF_TIME_ID "ecu off time msg number" VALUE 0x0002038C __UBYTE_S 0 u_can_txmsg_num 0 255 FORMAT "%3.0" SYMBOL_LINK "CAN_TX_OFF_TIME" 0 /end CHARACTERISTIC
/begin CHARACTERISTIC CAN_TX_OFF_TIME_BYTE_LOC "ecu off time msg location number" VALUE 0x0002038C __UBYTE_S 0 u_can_byte_num 0 7 FORMAT "%1.0" SYMBOL_LINK "CAN_TX_OFF_TIME" 1 /end CHARACTERISTIC
/begin CHARACTERISTIC CAN_TX_OFF_TIME_BIT_LOC "ecu off time msg bit location" VALUE 0x0002038C __UBYTE_S 0 u_can_bit_loc 0 7 FORMAT "%1.0" SYMBOL_LINK "CAN_TX_OFF_TIME" 2 /end CHARACTERISTIC
/begin CHARACTERISTIC CAN_TX_OFF_TIME_BIT_LEN "ecu off time msg bit length" VALUE 0x0002038C __UBYTE_S 0 u_cnts 0 255 SYMBOL_LINK "CAN_TX_OFF_TIME" 3 /end CHARACTERISTIC
/begin CHARACTERISTIC CAN_TX_OFF_TIME_A "ecu off time msg scaling A" VALUE 0x0002038C __ULONG_S 0 u_fac_65536L 0 65535.9999847412109375 FORMAT "%8.3" SYMBOL_LINK "CAN_TX_OFF_TIME" 4 /end CHARACTERISTIC
/begin CHARACTERISTIC CAN_TX_OFF_TIME_B "ecu off time msg scaling B" VALUE 0x0002038C __SWORD_S 0 u_cnt_n3277_p3277 -3276.8 3276.7 FORMAT "%5.1" SYMBOL_LINK "CAN_TX_OFF_TIME" 8 /end CHARACTERISTIC
/begin CHARACTERISTIC CAN_TX_OFF_TIME_MIN "ecu off time msg min" VALUE 0x0002038C __UWORD_S 0 u_min 0 65535 SYMBOL_LINK "CAN_TX_OFF_TIME" 10 /end CHARACTERISTIC
/begin CHARACTERISTIC CAN_TX_OFF_TIME_MAX "ecu off time msg max" VALUE 0x0002038C __UWORD_S 0 u_min 0 65535 SYMBOL_LINK "CAN_TX_OFF_TIME" 12 /end CHARACTERISTIC
/begin CHARACTERISTIC CAN_TX_OFF_TIME_INVALID "ecu off time msg invalid value" VALUE 0x0002038C __UWORD_S 0 u_cnts 0 65535 FORMAT "%5.0" SYMBOL_LINK "CAN_TX_OFF_TIME" 14 /end CHARACTERISTIC
/begin CHARACTERISTIC CAN_TX_ACCUM_ODO_ID "accumulated odometer msg number" VALUE 0x0002038C __UBYTE_S 0 u_can_txmsg_num 0 255 FORMAT "%3.0" SYMBOL_LINK "CAN_TX_ACCUM_ODO" 0 /end CHARACTERISTIC
/begin CHARACTERISTIC CAN_TX_ACCUM_ODO_BYTE_LOC "accumulated odometer msg location number" VALUE 0x0002038C __UBYTE_S 0 u_can_byte_num 0 7 FORMAT "%1.0" SYMBOL_LINK "CAN_TX_ACCUM_ODO" 1 /end CHARACTERISTIC
/begin CHARACTERISTIC CAN_TX_ACCUM_ODO_BIT_LOC "accumulated odometer msg bit location" VALUE 0x0002038C __UBYTE_S 0 u_can_bit_loc 0 7 FORMAT "%1.0" SYMBOL_LINK "CAN_TX_ACCUM_ODO" 2 /end CHARACTERISTIC
/begin CHARACTERISTIC CAN_TX_ACCUM_ODO_BIT_LEN "accumulated odometer msg bit length" VALUE 0x0002038C __UBYTE_S 0 u_cnts 0 255 SYMBOL_LINK "CAN_TX_ACCUM_ODO" 3 /end CHARACTERISTIC
/begin CHARACTERISTIC CAN_TX_ACCUM_ODO_A "accumulated odometer msg scaling A" VALUE 0x0002038C __ULONG_S 0 u_fac_65536L 0 65535.9999847412109375 FORMAT "%8.3" SYMBOL_LINK "CAN_TX_ACCUM_ODO" 4 /end CHARACTERISTIC
/begin CHARACTERISTIC CAN_TX_ACCUM_ODO_B "accumulated odometer msg scaling B" VALUE 0x0002038C __SWORD_S 0 u_cnt_n3277_p3277 -3276.8 3276.7 FORMAT "%5.1" SYMBOL_LINK "CAN_TX_ACCUM_ODO" 8 /end CHARACTERISTIC
/begin CHARACTERISTIC CAN_TX_ACCUM_ODO_MIN "accumulated odometer msg min" VALUE 0x0002038C __ULONG_S 0 u_km_hi 0 16777215.99609375 FORMAT "%10.2" SYMBOL_LINK "CAN_TX_ACCUM_ODO" 12 /end CHARACTERISTIC
/begin CHARACTERISTIC CAN_TX_ACCUM_ODO_MAX "accumulated odometer msg max" VALUE 0x0002038C __UWORD_S 0 u_km_hi 0 16777215.99609375 FORMAT "%10.2" SYMBOL_LINK "CAN_TX_ACCUM_ODO" 16 /end CHARACTERISTIC
/begin CHARACTERISTIC CAN_TX_ACCUM_ODO_INVALID "accumulated odometer msg invalid value" VALUE 0x0002038C __UWORD_S 0 u_cnts 0 65535 FORMAT "%5.0" SYMBOL_LINK "CAN_TX_ACCUM_ODO" 20 /end CHARACTERISTIC
/begin CHARACTERISTIC CAN_TX_ROLL_CNT01_ID "rolling counter msg number" VALUE 0x0002038C __UBYTE_S 0 u_can_txmsg_num 0 255 FORMAT "%3.0" SYMBOL_LINK "CAN_TX_ROLL_CNT01" 0 /end CHARACTERISTIC
/begin CHARACTERISTIC CAN_TX_ROLL_CNT01_BYTE_LOC "rolling counter msg location number" VALUE 0x0002038C __UBYTE_S 0 u_can_byte_num 0 7 FORMAT "%1.0" SYMBOL_LINK "CAN_TX_ROLL_CNT01" 1 /end CHARACTERISTIC
/begin CHARACTERISTIC CAN_TX_ROLL_CNT01_BIT_LOC "rolling counter msg bit location" VALUE 0x0002038C __UBYTE_S 0 u_can_bit_loc 0 7 FORMAT "%1.0" SYMBOL_LINK "CAN_TX_ROLL_CNT01" 2 /end CHARACTERISTIC
/begin CHARACTERISTIC CAN_TX_ROLL_CNT01_BIT_LEN "rolling counter msg bit length" VALUE 0x0002038C __UBYTE_S 0 u_cnts 0 255 SYMBOL_LINK "CAN_TX_ROLL_CNT01" 3 /end CHARACTERISTIC
/begin CHARACTERISTIC CAN_TX_ROLL_CNT01_STP "rolling counter msg increase step" VALUE 0x0002038C __UBYTE_S 0 u_cnts 0 255 SYMBOL_LINK "CAN_TX_ROLL_CNT01" 4 /end CHARACTERISTIC
/begin CHARACTERISTIC CAN_TX_ROLL_CNT01_THR "rolling counter msg thr" VALUE 0x0002038C __UBYTE_S 0 u_cnts 0 255 SYMBOL_LINK "CAN_TX_ROLL_CNT01" 5 /end CHARACTERISTIC
/begin CHARACTERISTIC CAN_TX_ROLL_CNT02_ID "rolling counter msg number" VALUE 0x0002038C __UBYTE_S 0 u_can_txmsg_num 0 255 FORMAT "%3.0" SYMBOL_LINK "CAN_TX_ROLL_CNT02" 0 /end CHARACTERISTIC
/begin CHARACTERISTIC CAN_TX_ROLL_CNT02_BYTE_LOC "rolling counter msg location number" VALUE 0x0002038C __UBYTE_S 0 u_can_byte_num 0 7 FORMAT "%1.0" SYMBOL_LINK "CAN_TX_ROLL_CNT02" 1 /end CHARACTERISTIC
/begin CHARACTERISTIC CAN_TX_ROLL_CNT02_BIT_LOC "rolling counter msg bit location" VALUE 0x0002038C __UBYTE_S 0 u_can_bit_loc 0 7 FORMAT "%1.0" SYMBOL_LINK "CAN_TX_ROLL_CNT02" 2 /end CHARACTERISTIC
/begin CHARACTERISTIC CAN_TX_ROLL_CNT02_BIT_LEN "rolling counter msg bit length" VALUE 0x0002038C __UBYTE_S 0 u_cnts 0 255 SYMBOL_LINK "CAN_TX_ROLL_CNT02" 3 /end CHARACTERISTIC
/begin CHARACTERISTIC CAN_TX_ROLL_CNT02_STP "rolling counter msg increase step" VALUE 0x0002038C __UBYTE_S 0 u_cnts 0 255 SYMBOL_LINK "CAN_TX_ROLL_CNT02" 4 /end CHARACTERISTIC
/begin CHARACTERISTIC CAN_TX_ROLL_CNT02_THR "rolling counter msg thr" VALUE 0x0002038C __UBYTE_S 0 u_cnts 0 255 SYMBOL_LINK "CAN_TX_ROLL_CNT02" 5 /end CHARACTERISTIC
/begin CHARACTERISTIC CAN_TX_ROLL_CNT03_ID "rolling counter msg number" VALUE 0x0002038C __UBYTE_S 0 u_can_txmsg_num 0 255 FORMAT "%3.0" SYMBOL_LINK "CAN_TX_ROLL_CNT03" 0 /end CHARACTERISTIC
/begin CHARACTERISTIC CAN_TX_ROLL_CNT03_BYTE_LOC "rolling counter msg location number" VALUE 0x0002038C __UBYTE_S 0 u_can_byte_num 0 7 FORMAT "%1.0" SYMBOL_LINK "CAN_TX_ROLL_CNT03" 1 /end CHARACTERISTIC
/begin CHARACTERISTIC CAN_TX_ROLL_CNT03_BIT_LOC "rolling counter msg bit location" VALUE 0x0002038C __UBYTE_S 0 u_can_bit_loc 0 7 FORMAT "%1.0" SYMBOL_LINK "CAN_TX_ROLL_CNT03" 2 /end CHARACTERISTIC
/begin CHARACTERISTIC CAN_TX_ROLL_CNT03_BIT_LEN "rolling counter msg bit length" VALUE 0x0002038C __UBYTE_S 0 u_cnts 0 255 SYMBOL_LINK "CAN_TX_ROLL_CNT03" 3 /end CHARACTERISTIC
/begin CHARACTERISTIC CAN_TX_ROLL_CNT03_STP "rolling counter msg increase step" VALUE 0x0002038C __UBYTE_S 0 u_cnts 0 255 SYMBOL_LINK "CAN_TX_ROLL_CNT03" 4 /end CHARACTERISTIC
/begin CHARACTERISTIC CAN_TX_ROLL_CNT03_THR "rolling counter msg thr" VALUE 0x0002038C __UBYTE_S 0 u_cnts 0 255 SYMBOL_LINK "CAN_TX_ROLL_CNT03" 5 /end CHARACTERISTIC
/begin CHARACTERISTIC CAN_TX_ROLL_CNT04_ID "rolling counter msg number" VALUE 0x0002038C __UBYTE_S 0 u_can_txmsg_num 0 255 FORMAT "%3.0" SYMBOL_LINK "CAN_TX_ROLL_CNT04" 0 /end CHARACTERISTIC
/begin CHARACTERISTIC CAN_TX_ROLL_CNT04_BYTE_LOC "rolling counter msg location number" VALUE 0x0002038C __UBYTE_S 0 u_can_byte_num 0 7 FORMAT "%1.0" SYMBOL_LINK "CAN_TX_ROLL_CNT04" 1 /end CHARACTERISTIC
/begin CHARACTERISTIC CAN_TX_ROLL_CNT04_BIT_LOC "rolling counter msg bit location" VALUE 0x0002038C __UBYTE_S 0 u_can_bit_loc 0 7 FORMAT "%1.0" SYMBOL_LINK "CAN_TX_ROLL_CNT04" 2 /end CHARACTERISTIC
/begin CHARACTERISTIC CAN_TX_ROLL_CNT04_BIT_LEN "rolling counter msg bit length" VALUE 0x0002038C __UBYTE_S 0 u_cnts 0 255 SYMBOL_LINK "CAN_TX_ROLL_CNT04" 3 /end CHARACTERISTIC
/begin CHARACTERISTIC CAN_TX_ROLL_CNT04_STP "rolling counter msg increase step" VALUE 0x0002038C __UBYTE_S 0 u_cnts 0 255 SYMBOL_LINK "CAN_TX_ROLL_CNT04" 4 /end CHARACTERISTIC
/begin CHARACTERISTIC CAN_TX_ROLL_CNT04_THR "rolling counter msg thr" VALUE 0x0002038C __UBYTE_S 0 u_cnts 0 255 SYMBOL_LINK "CAN_TX_ROLL_CNT04" 5 /end CHARACTERISTIC
/begin CHARACTERISTIC CAN_TX_ROLL_CNT05_ID "rolling counter msg number" VALUE 0x0002038C __UBYTE_S 0 u_can_txmsg_num 0 255 FORMAT "%3.0" SYMBOL_LINK "CAN_TX_ROLL_CNT05" 0 /end CHARACTERISTIC
/begin CHARACTERISTIC CAN_TX_ROLL_CNT05_BYTE_LOC "rolling counter msg location number" VALUE 0x0002038C __UBYTE_S 0 u_can_byte_num 0 7 FORMAT "%1.0" SYMBOL_LINK "CAN_TX_ROLL_CNT05" 1 /end CHARACTERISTIC
/begin CHARACTERISTIC CAN_TX_ROLL_CNT05_BIT_LOC "rolling counter msg bit location" VALUE 0x0002038C __UBYTE_S 0 u_can_bit_loc 0 7 FORMAT "%1.0" SYMBOL_LINK "CAN_TX_ROLL_CNT05" 2 /end CHARACTERISTIC
/begin CHARACTERISTIC CAN_TX_ROLL_CNT05_BIT_LEN "rolling counter msg bit length" VALUE 0x0002038C __UBYTE_S 0 u_cnts 0 255 SYMBOL_LINK "CAN_TX_ROLL_CNT05" 3 /end CHARACTERISTIC
/begin CHARACTERISTIC CAN_TX_ROLL_CNT05_STP "rolling counter msg increase step" VALUE 0x0002038C __UBYTE_S 0 u_cnts 0 255 SYMBOL_LINK "CAN_TX_ROLL_CNT05" 4 /end CHARACTERISTIC
/begin CHARACTERISTIC CAN_TX_ROLL_CNT05_THR "rolling counter msg thr" VALUE 0x0002038C __UBYTE_S 0 u_cnts 0 255 SYMBOL_LINK "CAN_TX_ROLL_CNT05" 5 /end CHARACTERISTIC
/begin CHARACTERISTIC CAN_TX_ROLL_CNT06_ID "rolling counter msg number" VALUE 0x0002038C __UBYTE_S 0 u_can_txmsg_num 0 255 FORMAT "%3.0" SYMBOL_LINK "CAN_TX_ROLL_CNT06" 0 /end CHARACTERISTIC
/begin CHARACTERISTIC CAN_TX_ROLL_CNT06_BYTE_LOC "rolling counter msg location number" VALUE 0x0002038C __UBYTE_S 0 u_can_byte_num 0 7 FORMAT "%1.0" SYMBOL_LINK "CAN_TX_ROLL_CNT06" 1 /end CHARACTERISTIC
/begin CHARACTERISTIC CAN_TX_ROLL_CNT06_BIT_LOC "rolling counter msg bit location" VALUE 0x0002038C __UBYTE_S 0 u_can_bit_loc 0 7 FORMAT "%1.0" SYMBOL_LINK "CAN_TX_ROLL_CNT06" 2 /end CHARACTERISTIC
/begin CHARACTERISTIC CAN_TX_ROLL_CNT06_BIT_LEN "rolling counter msg bit length" VALUE 0x0002038C __UBYTE_S 0 u_cnts 0 255 SYMBOL_LINK "CAN_TX_ROLL_CNT06" 3 /end CHARACTERISTIC
/begin CHARACTERISTIC CAN_TX_ROLL_CNT06_STP "rolling counter msg increase step" VALUE 0x0002038C __UBYTE_S 0 u_cnts 0 255 SYMBOL_LINK "CAN_TX_ROLL_CNT06" 4 /end CHARACTERISTIC
/begin CHARACTERISTIC CAN_TX_ROLL_CNT06_THR "rolling counter msg thr" VALUE 0x0002038C __UBYTE_S 0 u_cnts 0 255 SYMBOL_LINK "CAN_TX_ROLL_CNT06" 5 /end CHARACTERISTIC
/begin CHARACTERISTIC CAN_TX_ROLL_CNT07_ID "rolling counter msg number" VALUE 0x0002038C __UBYTE_S 0 u_can_txmsg_num 0 255 FORMAT "%3.0" SYMBOL_LINK "CAN_TX_ROLL_CNT07" 0 /end CHARACTERISTIC
/begin CHARACTERISTIC CAN_TX_ROLL_CNT07_BYTE_LOC "rolling counter msg location number" VALUE 0x0002038C __UBYTE_S 0 u_can_byte_num 0 7 FORMAT "%1.0" SYMBOL_LINK "CAN_TX_ROLL_CNT07" 1 /end CHARACTERISTIC
/begin CHARACTERISTIC CAN_TX_ROLL_CNT07_BIT_LOC "rolling counter msg bit location" VALUE 0x0002038C __UBYTE_S 0 u_can_bit_loc 0 7 FORMAT "%1.0" SYMBOL_LINK "CAN_TX_ROLL_CNT07" 2 /end CHARACTERISTIC
/begin CHARACTERISTIC CAN_TX_ROLL_CNT07_BIT_LEN "rolling counter msg bit length" VALUE 0x0002038C __UBYTE_S 0 u_cnts 0 255 SYMBOL_LINK "CAN_TX_ROLL_CNT07" 3 /end CHARACTERISTIC
/begin CHARACTERISTIC CAN_TX_ROLL_CNT07_STP "rolling counter msg increase step" VALUE 0x0002038C __UBYTE_S 0 u_cnts 0 255 SYMBOL_LINK "CAN_TX_ROLL_CNT07" 4 /end CHARACTERISTIC
/begin CHARACTERISTIC CAN_TX_ROLL_CNT07_THR "rolling counter msg thr" VALUE 0x0002038C __UBYTE_S 0 u_cnts 0 255 SYMBOL_LINK "CAN_TX_ROLL_CNT07" 5 /end CHARACTERISTIC
/begin CHARACTERISTIC CAN_TX_ROLL_CNT08_ID "rolling counter msg number" VALUE 0x0002038C __UBYTE_S 0 u_can_txmsg_num 0 255 FORMAT "%3.0" SYMBOL_LINK "CAN_TX_ROLL_CNT08" 0 /end CHARACTERISTIC
/begin CHARACTERISTIC CAN_TX_ROLL_CNT08_BYTE_LOC "rolling counter msg location number" VALUE 0x0002038C __UBYTE_S 0 u_can_byte_num 0 7 FORMAT "%1.0" SYMBOL_LINK "CAN_TX_ROLL_CNT08" 1 /end CHARACTERISTIC
/begin CHARACTERISTIC CAN_TX_ROLL_CNT08_BIT_LOC "rolling counter msg bit location" VALUE 0x0002038C __UBYTE_S 0 u_can_bit_loc 0 7 FORMAT "%1.0" SYMBOL_LINK "CAN_TX_ROLL_CNT08" 2 /end CHARACTERISTIC
/begin CHARACTERISTIC CAN_TX_ROLL_CNT08_BIT_LEN "rolling counter msg bit length" VALUE 0x0002038C __UBYTE_S 0 u_cnts 0 255 SYMBOL_LINK "CAN_TX_ROLL_CNT08" 3 /end CHARACTERISTIC
/begin CHARACTERISTIC CAN_TX_ROLL_CNT08_STP "rolling counter msg increase step" VALUE 0x0002038C __UBYTE_S 0 u_cnts 0 255 SYMBOL_LINK "CAN_TX_ROLL_CNT08" 4 /end CHARACTERISTIC
/begin CHARACTERISTIC CAN_TX_ROLL_CNT08_THR "rolling counter msg thr" VALUE 0x0002038C __UBYTE_S 0 u_cnts 0 255 SYMBOL_LINK "CAN_TX_ROLL_CNT08" 5 /end CHARACTERISTIC
/begin CHARACTERISTIC CAN_TX_CHKSUM00_ID "checksum msg number" VALUE 0x0002038C __UBYTE_S 0 u_can_txmsg_num 0 255 FORMAT "%3.0" SYMBOL_LINK "CAN_TX_CHKSUM00" 0 /end CHARACTERISTIC
/begin CHARACTERISTIC CAN_TX_CHKSUM00_BYTE_LOC "checksum msg location number" VALUE 0x0002038C __UBYTE_S 0 u_can_byte_num 0 7 FORMAT "%1.0" SYMBOL_LINK "CAN_TX_CHKSUM00" 1 /end CHARACTERISTIC
/begin CHARACTERISTIC CAN_TX_CHKSUM00_BIT_LOC "checksum msg bit location" VALUE 0x0002038C __UBYTE_S 0 u_can_bit_loc 0 7 FORMAT "%1.0" SYMBOL_LINK "CAN_TX_CHKSUM00" 2 /end CHARACTERISTIC
/begin CHARACTERISTIC CAN_TX_CHKSUM00_BIT_LEN "checksum msg bit length" VALUE 0x0002038C __UBYTE_S 0 u_cnts 0 255 SYMBOL_LINK "CAN_TX_CHKSUM00" 3 /end CHARACTERISTIC
/begin CHARACTERISTIC CAN_TX_CHKSUM00_METHOD "checksum calculated method" VALUE 0x0002038C __UBYTE_S 0 u_can_chk_sum 0 19 FORMAT "%2.0" SYMBOL_LINK "CAN_TX_CHKSUM00" 4 /end CHARACTERISTIC
/begin CHARACTERISTIC CAN_TX_CHKSUM01_ID "checksum msg number" VALUE 0x0002038C __UBYTE_S 0 u_can_txmsg_num 0 255 FORMAT "%3.0" SYMBOL_LINK "CAN_TX_CHKSUM01" 0 /end CHARACTERISTIC
/begin CHARACTERISTIC CAN_TX_CHKSUM01_BYTE_LOC "checksum msg location number" VALUE 0x0002038C __UBYTE_S 0 u_can_byte_num 0 7 FORMAT "%1.0" SYMBOL_LINK "CAN_TX_CHKSUM01" 1 /end CHARACTERISTIC
/begin CHARACTERISTIC CAN_TX_CHKSUM01_BIT_LOC "checksum msg bit location" VALUE 0x0002038C __UBYTE_S 0 u_can_bit_loc 0 7 FORMAT "%1.0" SYMBOL_LINK "CAN_TX_CHKSUM01" 2 /end CHARACTERISTIC
/begin CHARACTERISTIC CAN_TX_CHKSUM01_BIT_LEN "checksum msg bit length" VALUE 0x0002038C __UBYTE_S 0 u_cnts 0 255 SYMBOL_LINK "CAN_TX_CHKSUM01" 3 /end CHARACTERISTIC
/begin CHARACTERISTIC CAN_TX_CHKSUM01_METHOD "checksum calculated method" VALUE 0x0002038C __UBYTE_S 0 u_can_chk_sum 0 19 FORMAT "%2.0" SYMBOL_LINK "CAN_TX_CHKSUM01" 4 /end CHARACTERISTIC
/begin CHARACTERISTIC CAN_TX_CHKSUM02_ID "checksum msg number" VALUE 0x0002038C __UBYTE_S 0 u_can_txmsg_num 0 255 FORMAT "%3.0" SYMBOL_LINK "CAN_TX_CHKSUM02" 0 /end CHARACTERISTIC
/begin CHARACTERISTIC CAN_TX_CHKSUM02_BYTE_LOC "checksum msg location number" VALUE 0x0002038C __UBYTE_S 0 u_can_byte_num 0 7 FORMAT "%1.0" SYMBOL_LINK "CAN_TX_CHKSUM02" 1 /end CHARACTERISTIC
/begin CHARACTERISTIC CAN_TX_CHKSUM02_BIT_LOC "checksum msg bit location" VALUE 0x0002038C __UBYTE_S 0 u_can_bit_loc 0 7 FORMAT "%1.0" SYMBOL_LINK "CAN_TX_CHKSUM02" 2 /end CHARACTERISTIC
/begin CHARACTERISTIC CAN_TX_CHKSUM02_BIT_LEN "checksum msg bit length" VALUE 0x0002038C __UBYTE_S 0 u_cnts 0 255 SYMBOL_LINK "CAN_TX_CHKSUM02" 3 /end CHARACTERISTIC
/begin CHARACTERISTIC CAN_TX_CHKSUM02_METHOD "checksum calculated method" VALUE 0x0002038C __UBYTE_S 0 u_can_chk_sum 0 19 FORMAT "%2.0" SYMBOL_LINK "CAN_TX_CHKSUM02" 4 /end CHARACTERISTIC
/begin CHARACTERISTIC CAN_TX_CHKSUM03_ID "checksum msg number" VALUE 0x0002038C __UBYTE_S 0 u_can_txmsg_num 0 255 FORMAT "%3.0" SYMBOL_LINK "CAN_TX_CHKSUM03" 0 /end CHARACTERISTIC
/begin CHARACTERISTIC CAN_TX_CHKSUM03_BYTE_LOC "checksum msg location number" VALUE 0x0002038C __UBYTE_S 0 u_can_byte_num 0 7 FORMAT "%1.0" SYMBOL_LINK "CAN_TX_CHKSUM03" 1 /end CHARACTERISTIC
/begin CHARACTERISTIC CAN_TX_CHKSUM03_BIT_LOC "checksum msg bit location" VALUE 0x0002038C __UBYTE_S 0 u_can_bit_loc 0 7 FORMAT "%1.0" SYMBOL_LINK "CAN_TX_CHKSUM03" 2 /end CHARACTERISTIC
/begin CHARACTERISTIC CAN_TX_CHKSUM03_BIT_LEN "checksum msg bit length" VALUE 0x0002038C __UBYTE_S 0 u_cnts 0 255 SYMBOL_LINK "CAN_TX_CHKSUM03" 3 /end CHARACTERISTIC
/begin CHARACTERISTIC CAN_TX_CHKSUM03_METHOD "checksum calculated method" VALUE 0x0002038C __UBYTE_S 0 u_can_chk_sum 0 19 FORMAT "%2.0" SYMBOL_LINK "CAN_TX_CHKSUM03" 4 /end CHARACTERISTIC
/begin CHARACTERISTIC CAN_TX_CHKSUM04_ID "checksum msg number" VALUE 0x0002038C __UBYTE_S 0 u_can_txmsg_num 0 255 FORMAT "%3.0" SYMBOL_LINK "CAN_TX_CHKSUM04" 0 /end CHARACTERISTIC
/begin CHARACTERISTIC CAN_TX_CHKSUM04_BYTE_LOC "checksum msg location number" VALUE 0x0002038C __UBYTE_S 0 u_can_byte_num 0 7 FORMAT "%1.0" SYMBOL_LINK "CAN_TX_CHKSUM04" 1 /end CHARACTERISTIC
/begin CHARACTERISTIC CAN_TX_CHKSUM04_BIT_LOC "checksum msg bit location" VALUE 0x0002038C __UBYTE_S 0 u_can_bit_loc 0 7 FORMAT "%1.0" SYMBOL_LINK "CAN_TX_CHKSUM04" 2 /end CHARACTERISTIC
/begin CHARACTERISTIC CAN_TX_CHKSUM04_BIT_LEN "checksum msg bit length" VALUE 0x0002038C __UBYTE_S 0 u_cnts 0 255 SYMBOL_LINK "CAN_TX_CHKSUM04" 3 /end CHARACTERISTIC
/begin CHARACTERISTIC CAN_TX_CHKSUM04_METHOD "checksum calculated method" VALUE 0x0002038C __UBYTE_S 0 u_can_chk_sum 0 19 FORMAT "%2.0" SYMBOL_LINK "CAN_TX_CHKSUM04" 4 /end CHARACTERISTIC
/begin CHARACTERISTIC CAN_TX_CHKSUM05_ID "checksum msg number" VALUE 0x0002038C __UBYTE_S 0 u_can_txmsg_num 0 255 FORMAT "%3.0" SYMBOL_LINK "CAN_TX_CHKSUM05" 0 /end CHARACTERISTIC
/begin CHARACTERISTIC CAN_TX_CHKSUM05_BYTE_LOC "checksum msg location number" VALUE 0x0002038C __UBYTE_S 0 u_can_byte_num 0 7 FORMAT "%1.0" SYMBOL_LINK "CAN_TX_CHKSUM05" 1 /end CHARACTERISTIC
/begin CHARACTERISTIC CAN_TX_CHKSUM05_BIT_LOC "checksum msg bit location" VALUE 0x0002038C __UBYTE_S 0 u_can_bit_loc 0 7 FORMAT "%1.0" SYMBOL_LINK "CAN_TX_CHKSUM05" 2 /end CHARACTERISTIC
/begin CHARACTERISTIC CAN_TX_CHKSUM05_BIT_LEN "checksum msg bit length" VALUE 0x0002038C __UBYTE_S 0 u_cnts 0 255 SYMBOL_LINK "CAN_TX_CHKSUM05" 3 /end CHARACTERISTIC
/begin CHARACTERISTIC CAN_TX_CHKSUM05_METHOD "checksum calculated method" VALUE 0x0002038C __UBYTE_S 0 u_can_chk_sum 0 19 FORMAT "%2.0" SYMBOL_LINK "CAN_TX_CHKSUM05" 4 /end CHARACTERISTIC
/begin CHARACTERISTIC CAN_TX_CHKSUM06_ID "checksum msg number" VALUE 0x0002038C __UBYTE_S 0 u_can_txmsg_num 0 255 FORMAT "%3.0" SYMBOL_LINK "CAN_TX_CHKSUM06" 0 /end CHARACTERISTIC
/begin CHARACTERISTIC CAN_TX_CHKSUM06_BYTE_LOC "checksum msg location number" VALUE 0x0002038C __UBYTE_S 0 u_can_byte_num 0 7 FORMAT "%1.0" SYMBOL_LINK "CAN_TX_CHKSUM06" 1 /end CHARACTERISTIC
/begin CHARACTERISTIC CAN_TX_CHKSUM06_BIT_LOC "checksum msg bit location" VALUE 0x0002038C __UBYTE_S 0 u_can_bit_loc 0 7 FORMAT "%1.0" SYMBOL_LINK "CAN_TX_CHKSUM06" 2 /end CHARACTERISTIC
/begin CHARACTERISTIC CAN_TX_CHKSUM06_BIT_LEN "checksum msg bit length" VALUE 0x0002038C __UBYTE_S 0 u_cnts 0 255 SYMBOL_LINK "CAN_TX_CHKSUM06" 3 /end CHARACTERISTIC
/begin CHARACTERISTIC CAN_TX_CHKSUM06_METHOD "checksum calculated method" VALUE 0x0002038C __UBYTE_S 0 u_can_chk_sum 0 19 FORMAT "%2.0" SYMBOL_LINK "CAN_TX_CHKSUM06" 4 /end CHARACTERISTIC
/begin CHARACTERISTIC CAN_TX_CHKSUM07_ID "checksum msg number" VALUE 0x0002038C __UBYTE_S 0 u_can_txmsg_num 0 255 FORMAT "%3.0" SYMBOL_LINK "CAN_TX_CHKSUM07" 0 /end CHARACTERISTIC
/begin CHARACTERISTIC CAN_TX_CHKSUM07_BYTE_LOC "checksum msg location number" VALUE 0x0002038C __UBYTE_S 0 u_can_byte_num 0 7 FORMAT "%1.0" SYMBOL_LINK "CAN_TX_CHKSUM07" 1 /end CHARACTERISTIC
/begin CHARACTERISTIC CAN_TX_CHKSUM07_BIT_LOC "checksum msg bit location" VALUE 0x0002038C __UBYTE_S 0 u_can_bit_loc 0 7 FORMAT "%1.0" SYMBOL_LINK "CAN_TX_CHKSUM07" 2 /end CHARACTERISTIC
/begin CHARACTERISTIC CAN_TX_CHKSUM07_BIT_LEN "checksum msg bit length" VALUE 0x0002038C __UBYTE_S 0 u_cnts 0 255 SYMBOL_LINK "CAN_TX_CHKSUM07" 3 /end CHARACTERISTIC
/begin CHARACTERISTIC CAN_TX_CHKSUM07_METHOD "checksum calculated method" VALUE 0x0002038C __UBYTE_S 0 u_can_chk_sum 0 19 FORMAT "%2.0" SYMBOL_LINK "CAN_TX_CHKSUM07" 4 /end CHARACTERISTIC
/begin CHARACTERISTIC CAN_TX_CLTCH_TQ_SP_ID "clutch torq msg number" VALUE 0x0002038C __UBYTE_S 0 u_can_txmsg_num 0 255 FORMAT "%3.0" SYMBOL_LINK "CAN_TX_CLTCH_TQ_SP" 0 /end CHARACTERISTIC
/begin CHARACTERISTIC CAN_TX_CLTCH_TQ_SP_BYTE_LOC "clutch torq msg location number" VALUE 0x0002038C __UBYTE_S 0 u_can_byte_num 0 7 FORMAT "%1.0" SYMBOL_LINK "CAN_TX_CLTCH_TQ_SP" 1 /end CHARACTERISTIC
/begin CHARACTERISTIC CAN_TX_CLTCH_TQ_SP_BIT_LOC "clutch torq msg bit location" VALUE 0x0002038C __UBYTE_S 0 u_can_bit_loc 0 7 FORMAT "%1.0" SYMBOL_LINK "CAN_TX_CLTCH_TQ_SP" 2 /end CHARACTERISTIC
/begin CHARACTERISTIC CAN_TX_CLTCH_TQ_SP_BIT_LEN "clutch torq msg bit length" VALUE 0x0002038C __UBYTE_S 0 u_cnts 0 255 SYMBOL_LINK "CAN_TX_CLTCH_TQ_SP" 3 /end CHARACTERISTIC
/begin CHARACTERISTIC CAN_TX_CLTCH_TQ_SP_A "clutch torq msg scaling A" VALUE 0x0002038C __ULONG_S 0 u_fac_65536L 0 65535.9999847412109375 FORMAT "%8.3" SYMBOL_LINK "CAN_TX_CLTCH_TQ_SP" 4 /end CHARACTERISTIC
/begin CHARACTERISTIC CAN_TX_CLTCH_TQ_SP_B "clutch torq msg scaling B" VALUE 0x0002038C __SWORD_S 0 u_cnt_n3277_p3277 -3276.8 3276.7 FORMAT "%5.1" SYMBOL_LINK "CAN_TX_CLTCH_TQ_SP" 8 /end CHARACTERISTIC
/begin CHARACTERISTIC CAN_TX_CLTCH_TQ_SP_MIN "clutch torq msg min" VALUE 0x0002038C __SWORD_S 0 u_nm_s -2048 2047.9375 SYMBOL_LINK "CAN_TX_CLTCH_TQ_SP" 10 /end CHARACTERISTIC
/begin CHARACTERISTIC CAN_TX_CLTCH_TQ_SP_MAX "clutch torq msg max" VALUE 0x0002038C __SWORD_S 0 u_nm_s -2048 2047.9375 SYMBOL_LINK "CAN_TX_CLTCH_TQ_SP" 12 /end CHARACTERISTIC
/begin CHARACTERISTIC CAN_TX_CLTCH_TQ_SP_INVALID "clutch torq msg invalid value" VALUE 0x0002038C __UWORD_S 0 u_cnts 0 65535 FORMAT "%5.0" SYMBOL_LINK "CAN_TX_CLTCH_TQ_SP" 14 /end CHARACTERISTIC
/begin CHARACTERISTIC CAN_TX_CLTCH_TQ_SP_UNIT "clutch torq msg invalid value" VALUE 0x0002038C __UBYTE_S 0 u_can_tq_unit 0 1 FORMAT "%1.0" SYMBOL_LINK "CAN_TX_CLTCH_TQ_SP" 16 /end CHARACTERISTIC
/begin CHARACTERISTIC CAN_TX_CRU_ACTV_ID "cruise active msg number" VALUE 0x0002038C __UBYTE_S 0 u_can_txmsg_num 0 255 FORMAT "%3.0" SYMBOL_LINK "CAN_TX_CRU_ACTV" 0 /end CHARACTERISTIC
/begin CHARACTERISTIC CAN_TX_CRU_ACTV_BYTE_LOC "cruise active msg location number" VALUE 0x0002038C __UBYTE_S 0 u_can_byte_num 0 7 FORMAT "%1.0" SYMBOL_LINK "CAN_TX_CRU_ACTV" 1 /end CHARACTERISTIC
/begin CHARACTERISTIC CAN_TX_CRU_ACTV_BIT_LOC "cruise active msg bit location" VALUE 0x0002038C __UBYTE_S 0 u_can_bit_loc 0 7 FORMAT "%1.0" SYMBOL_LINK "CAN_TX_CRU_ACTV" 2 /end CHARACTERISTIC
/begin CHARACTERISTIC CAN_TX_CRU_ACTV_BIT_LEN "cruise active msg bit length" VALUE 0x0002038C __UBYTE_S 0 u_cnts 0 255 SYMBOL_LINK "CAN_TX_CRU_ACTV" 3 /end CHARACTERISTIC
/begin CHARACTERISTIC CAN_TX_CRU_ACTV_TABLE "cruise active msg table" VAL_BLK 0x0002038C __UBYTE_S 0 u_cnts 0 255 NUMBER 2 SYMBOL_LINK "CAN_TX_CRU_ACTV" 4 /end CHARACTERISTIC
/begin CHARACTERISTIC CAN_TX_TQ_REQ_PCT_ID "torq request percent msg number" VALUE 0x0002038C __UBYTE_S 0 u_can_txmsg_num 0 255 FORMAT "%3.0" SYMBOL_LINK "CAN_TX_TQ_REQ_PCT" 0 /end CHARACTERISTIC
/begin CHARACTERISTIC CAN_TX_TQ_REQ_PCT_BYTE_LOC "torq request percent msg location number" VALUE 0x0002038C __UBYTE_S 0 u_can_byte_num 0 7 FORMAT "%1.0" SYMBOL_LINK "CAN_TX_TQ_REQ_PCT" 1 /end CHARACTERISTIC
/begin CHARACTERISTIC CAN_TX_TQ_REQ_PCT_BIT_LOC "torq request percent msg bit location" VALUE 0x0002038C __UBYTE_S 0 u_can_bit_loc 0 7 FORMAT "%1.0" SYMBOL_LINK "CAN_TX_TQ_REQ_PCT" 2 /end CHARACTERISTIC
/begin CHARACTERISTIC CAN_TX_TQ_REQ_PCT_BIT_LEN "torq request percent msg bit length" VALUE 0x0002038C __UBYTE_S 0 u_cnts 0 255 SYMBOL_LINK "CAN_TX_TQ_REQ_PCT" 3 /end CHARACTERISTIC
/begin CHARACTERISTIC CAN_TX_TQ_REQ_PCT_A "torq request percent msg scaling A" VALUE 0x0002038C __ULONG_S 0 u_fac_65536L 0 65535.9999847412109375 FORMAT "%8.3" SYMBOL_LINK "CAN_TX_TQ_REQ_PCT" 4 /end CHARACTERISTIC
/begin CHARACTERISTIC CAN_TX_TQ_REQ_PCT_B "torq request percent msg scaling B" VALUE 0x0002038C __SWORD_S 0 u_cnt_n3277_p3277 -3276.8 3276.7 FORMAT "%5.1" SYMBOL_LINK "CAN_TX_TQ_REQ_PCT" 8 /end CHARACTERISTIC
/begin CHARACTERISTIC CAN_TX_TQ_REQ_PCT_MIN "torq request percent msg min" VALUE 0x0002038C __UWORD_S 0 u_pct 0 199.996948 SYMBOL_LINK "CAN_TX_TQ_REQ_PCT" 10 /end CHARACTERISTIC
/begin CHARACTERISTIC CAN_TX_TQ_REQ_PCT_MAX "torq request percent msg max" VALUE 0x0002038C __UWORD_S 0 u_pct 0 199.996948 SYMBOL_LINK "CAN_TX_TQ_REQ_PCT" 12 /end CHARACTERISTIC
/begin CHARACTERISTIC CAN_TX_TQ_REQ_PCT_INVALID "torq request percent msg invalid value" VALUE 0x0002038C __UWORD_S 0 u_cnts 0 65535 FORMAT "%5.0" SYMBOL_LINK "CAN_TX_TQ_REQ_PCT" 14 /end CHARACTERISTIC
/begin CHARACTERISTIC CAN_TX_STRT_ACTV_ID "engine start active msg number" VALUE 0x0002038C __UBYTE_S 0 u_can_txmsg_num 0 255 FORMAT "%3.0" SYMBOL_LINK "CAN_TX_STRT_ACTV" 0 /end CHARACTERISTIC
/begin CHARACTERISTIC CAN_TX_STRT_ACTV_BYTE_LOC "engine start active msg location number" VALUE 0x0002038C __UBYTE_S 0 u_can_byte_num 0 7 FORMAT "%1.0" SYMBOL_LINK "CAN_TX_STRT_ACTV" 1 /end CHARACTERISTIC
/begin CHARACTERISTIC CAN_TX_STRT_ACTV_BIT_LOC "engine start active msg bit location" VALUE 0x0002038C __UBYTE_S 0 u_can_bit_loc 0 7 FORMAT "%1.0" SYMBOL_LINK "CAN_TX_STRT_ACTV" 2 /end CHARACTERISTIC
/begin CHARACTERISTIC CAN_TX_STRT_ACTV_BIT_LEN "engine start active msg bit length" VALUE 0x0002038C __UBYTE_S 0 u_cnts 0 255 SYMBOL_LINK "CAN_TX_STRT_ACTV" 3 /end CHARACTERISTIC
/begin CHARACTERISTIC CAN_TX_STRT_ACTV_TABLE "engine start active msg table" VAL_BLK 0x0002038C __UBYTE_S 0 u_cnts 0 255 NUMBER 2 SYMBOL_LINK "CAN_TX_STRT_ACTV" 4 /end CHARACTERISTIC
/begin CHARACTERISTIC CAN_TX_TCU_CAN_FAIL_ID "can fail msg number" VALUE 0x0002038C __UBYTE_S 0 u_can_txmsg_num 0 255 FORMAT "%3.0" SYMBOL_LINK "CAN_TX_TCU_CAN_FAIL" 0 /end CHARACTERISTIC
/begin CHARACTERISTIC CAN_TX_TCU_CAN_FAIL_BYTE_LOC "can fail msg location number" VALUE 0x0002038C __UBYTE_S 0 u_can_byte_num 0 7 FORMAT "%1.0" SYMBOL_LINK "CAN_TX_TCU_CAN_FAIL" 1 /end CHARACTERISTIC
/begin CHARACTERISTIC CAN_TX_TCU_CAN_FAIL_BIT_LOC "can fail msg bit location" VALUE 0x0002038C __UBYTE_S 0 u_can_bit_loc 0 7 FORMAT "%1.0" SYMBOL_LINK "CAN_TX_TCU_CAN_FAIL" 2 /end CHARACTERISTIC
/begin CHARACTERISTIC CAN_TX_TCU_CAN_FAIL_BIT_LEN "can fail msg bit length" VALUE 0x0002038C __UBYTE_S 0 u_cnts 0 255 SYMBOL_LINK "CAN_TX_TCU_CAN_FAIL" 3 /end CHARACTERISTIC
/begin CHARACTERISTIC CAN_TX_TCU_CAN_FAIL_TABLE "can fail msg table" VAL_BLK 0x0002038C __UBYTE_S 0 u_cnts 0 255 NUMBER 2 SYMBOL_LINK "CAN_TX_TCU_CAN_FAIL" 4 /end CHARACTERISTIC
/begin CHARACTERISTIC CAN_TX_DCL_FCO_ID "deceleration fuel cut off msg number" VALUE 0x0002038C __UBYTE_S 0 u_can_txmsg_num 0 255 FORMAT "%3.0" SYMBOL_LINK "CAN_TX_DCL_FCO" 0 /end CHARACTERISTIC
/begin CHARACTERISTIC CAN_TX_DCL_FCO_BYTE_LOC "deceleration fuel cut off msg location number" VALUE 0x0002038C __UBYTE_S 0 u_can_byte_num 0 7 FORMAT "%1.0" SYMBOL_LINK "CAN_TX_DCL_FCO" 1 /end CHARACTERISTIC
/begin CHARACTERISTIC CAN_TX_DCL_FCO_BIT_LOC "deceleration fuel cut off msg bit location" VALUE 0x0002038C __UBYTE_S 0 u_can_bit_loc 0 7 FORMAT "%1.0" SYMBOL_LINK "CAN_TX_DCL_FCO" 2 /end CHARACTERISTIC
/begin CHARACTERISTIC CAN_TX_DCL_FCO_BIT_LEN "deceleration fuel cut off msg bit length" VALUE 0x0002038C __UBYTE_S 0 u_cnts 0 255 SYMBOL_LINK "CAN_TX_DCL_FCO" 3 /end CHARACTERISTIC
/begin CHARACTERISTIC CAN_TX_DCL_FCO_TABLE "deceleration fuel cut off msg table" VAL_BLK 0x0002038C __UBYTE_S 0 u_cnts 0 255 NUMBER 2 SYMBOL_LINK "CAN_TX_DCL_FCO" 4 /end CHARACTERISTIC
/begin CHARACTERISTIC CAN_TX_ETC_ST_ID "ETC state msg number" VALUE 0x0002038C __UBYTE_S 0 u_can_txmsg_num 0 255 FORMAT "%3.0" SYMBOL_LINK "CAN_TX_ETC_ST" 0 /end CHARACTERISTIC
/begin CHARACTERISTIC CAN_TX_ETC_ST_BYTE_LOC "ETC state msg location number" VALUE 0x0002038C __UBYTE_S 0 u_can_byte_num 0 7 FORMAT "%1.0" SYMBOL_LINK "CAN_TX_ETC_ST" 1 /end CHARACTERISTIC
/begin CHARACTERISTIC CAN_TX_ETC_ST_BIT_LOC "ETC state msg bit location" VALUE 0x0002038C __UBYTE_S 0 u_can_bit_loc 0 7 FORMAT "%1.0" SYMBOL_LINK "CAN_TX_ETC_ST" 2 /end CHARACTERISTIC
/begin CHARACTERISTIC CAN_TX_ETC_ST_BIT_LEN "ETC state msg bit length" VALUE 0x0002038C __UBYTE_S 0 u_cnts 0 255 SYMBOL_LINK "CAN_TX_ETC_ST" 3 /end CHARACTERISTIC
/begin CHARACTERISTIC CAN_TX_ETC_ST_TABLE "ETC state msg table" VAL_BLK 0x0002038C __UBYTE_S 0 u_cnts 0 255 NUMBER 6 SYMBOL_LINK "CAN_TX_ETC_ST" 4 /end CHARACTERISTIC
/begin CHARACTERISTIC CAN_TX_GEAR_R_ID "gear reverse msg number" VALUE 0x0002038C __UBYTE_S 0 u_can_txmsg_num 0 255 FORMAT "%3.0" SYMBOL_LINK "CAN_TX_GEAR_R" 0 /end CHARACTERISTIC
/begin CHARACTERISTIC CAN_TX_GEAR_R_BYTE_LOC "gear reverse msg location number" VALUE 0x0002038C __UBYTE_S 0 u_can_byte_num 0 7 FORMAT "%1.0" SYMBOL_LINK "CAN_TX_GEAR_R" 1 /end CHARACTERISTIC
/begin CHARACTERISTIC CAN_TX_GEAR_R_BIT_LOC "gear reverse msg bit location" VALUE 0x0002038C __UBYTE_S 0 u_can_bit_loc 0 7 FORMAT "%1.0" SYMBOL_LINK "CAN_TX_GEAR_R" 2 /end CHARACTERISTIC
/begin CHARACTERISTIC CAN_TX_GEAR_R_BIT_LEN "gear reverse msg bit length" VALUE 0x0002038C __UBYTE_S 0 u_cnts 0 255 SYMBOL_LINK "CAN_TX_GEAR_R" 3 /end CHARACTERISTIC
/begin CHARACTERISTIC CAN_TX_GEAR_R_TABLE "gear reverse msg table" VAL_BLK 0x0002038C __UBYTE_S 0 u_cnts 0 255 NUMBER 2 SYMBOL_LINK "CAN_TX_GEAR_R" 4 /end CHARACTERISTIC
/begin CHARACTERISTIC CAN_TX_CRUZ_ACTV_LAMP_REQ_ID "cruise active lamp request msg number" VALUE 0x0002038C __UBYTE_S 0 u_can_txmsg_num 0 255 FORMAT "%3.0" SYMBOL_LINK "CAN_TX_CRUZ_ACTV_LAMP_REQ" 0 /end CHARACTERISTIC
/begin CHARACTERISTIC CAN_TX_CRUZ_ACTV_LAMP_REQ_BYTE_LOC "cruise active lamp request msg location number" VALUE 0x0002038C __UBYTE_S 0 u_can_byte_num 0 7 FORMAT "%1.0" SYMBOL_LINK "CAN_TX_CRUZ_ACTV_LAMP_REQ" 1 /end CHARACTERISTIC
/begin CHARACTERISTIC CAN_TX_CRUZ_ACTV_LAMP_REQ_BIT_LOC "cruise active lamp request msg bit location" VALUE 0x0002038C __UBYTE_S 0 u_can_bit_loc 0 7 FORMAT "%1.0" SYMBOL_LINK "CAN_TX_CRUZ_ACTV_LAMP_REQ" 2 /end CHARACTERISTIC
/begin CHARACTERISTIC CAN_TX_CRUZ_ACTV_LAMP_REQ_BIT_LEN "cruise active lamp request msg bit length" VALUE 0x0002038C __UBYTE_S 0 u_cnts 0 255 SYMBOL_LINK "CAN_TX_CRUZ_ACTV_LAMP_REQ" 3 /end CHARACTERISTIC
/begin CHARACTERISTIC CAN_TX_CRUZ_ACTV_LAMP_REQ_TABLE "cruise active lamp request msg table" VAL_BLK 0x0002038C __UBYTE_S 0 u_cnts 0 255 NUMBER 2 SYMBOL_LINK "CAN_TX_CRUZ_ACTV_LAMP_REQ" 4 /end CHARACTERISTIC
/begin CHARACTERISTIC CAN_TX_AC_REQ_ID "AC request msg number" VALUE 0x0002038C __UBYTE_S 0 u_can_txmsg_num 0 255 FORMAT "%3.0" SYMBOL_LINK "CAN_TX_AC_REQ" 0 /end CHARACTERISTIC
/begin CHARACTERISTIC CAN_TX_AC_REQ_BYTE_LOC "AC request msg location number" VALUE 0x0002038C __UBYTE_S 0 u_can_byte_num 0 7 FORMAT "%1.0" SYMBOL_LINK "CAN_TX_AC_REQ" 1 /end CHARACTERISTIC
/begin CHARACTERISTIC CAN_TX_AC_REQ_BIT_LOC "AC request msg bit location" VALUE 0x0002038C __UBYTE_S 0 u_can_bit_loc 0 7 FORMAT "%1.0" SYMBOL_LINK "CAN_TX_AC_REQ" 2 /end CHARACTERISTIC
/begin CHARACTERISTIC CAN_TX_AC_REQ_BIT_LEN "AC request msg bit length" VALUE 0x0002038C __UBYTE_S 0 u_cnts 0 255 SYMBOL_LINK "CAN_TX_AC_REQ" 3 /end CHARACTERISTIC
/begin CHARACTERISTIC CAN_TX_AC_REQ_TABLE "AC request msg table" VAL_BLK 0x0002038C __UBYTE_S 0 u_cnts 0 255 NUMBER 2 SYMBOL_LINK "CAN_TX_AC_REQ" 4 /end CHARACTERISTIC
/begin CHARACTERISTIC CAN_TX_VSPD_LMT_SP_ID "vehicle speed limit setpoint msg number" VALUE 0x0002038C __UBYTE_S 0 u_can_txmsg_num 0 255 FORMAT "%3.0" SYMBOL_LINK "CAN_TX_VSPD_LMT_SP" 0 /end CHARACTERISTIC
/begin CHARACTERISTIC CAN_TX_VSPD_LMT_SP_BYTE_LOC "vehicle speed limit setpoint msg location number" VALUE 0x0002038C __UBYTE_S 0 u_can_byte_num 0 7 FORMAT "%1.0" SYMBOL_LINK "CAN_TX_VSPD_LMT_SP" 1 /end CHARACTERISTIC
/begin CHARACTERISTIC CAN_TX_VSPD_LMT_SP_BIT_LOC "vehicle speed limit setpoint msg bit location" VALUE 0x0002038C __UBYTE_S 0 u_can_bit_loc 0 7 FORMAT "%1.0" SYMBOL_LINK "CAN_TX_VSPD_LMT_SP" 2 /end CHARACTERISTIC
/begin CHARACTERISTIC CAN_TX_VSPD_LMT_SP_BIT_LEN "vehicle speed limit setpoint msg bit length" VALUE 0x0002038C __UBYTE_S 0 u_cnts 0 255 SYMBOL_LINK "CAN_TX_VSPD_LMT_SP" 3 /end CHARACTERISTIC
/begin CHARACTERISTIC CAN_TX_VSPD_LMT_SP_A "vehicle speed limit setpoint msg scaling A" VALUE 0x0002038C __ULONG_S 0 u_fac_65536L 0 65535.9999847412109375 FORMAT "%8.3" SYMBOL_LINK "CAN_TX_VSPD_LMT_SP" 4 /end CHARACTERISTIC
/begin CHARACTERISTIC CAN_TX_VSPD_LMT_SP_B "vehicle speed limit setpoint msg scaling B" VALUE 0x0002038C __SWORD_S 0 u_cnt_n3277_p3277 -3276.8 3276.7 FORMAT "%5.1" SYMBOL_LINK "CAN_TX_VSPD_LMT_SP" 8 /end CHARACTERISTIC
/begin CHARACTERISTIC CAN_TX_VSPD_LMT_SP_MIN "vehicle speed limit setpoint msg min" VALUE 0x0002038C __UWORD_S 0 u_espd 0 8191.875 SYMBOL_LINK "CAN_TX_VSPD_LMT_SP" 10 /end CHARACTERISTIC
/begin CHARACTERISTIC CAN_TX_VSPD_LMT_SP_MAX "vehicle speed limit setpoint msg max" VALUE 0x0002038C __UWORD_S 0 u_espd 0 8191.875 SYMBOL_LINK "CAN_TX_VSPD_LMT_SP" 12 /end CHARACTERISTIC
/begin CHARACTERISTIC CAN_TX_VSPD_LMT_EN_ID "vehicle speed limit enable msg number" VALUE 0x0002038C __UBYTE_S 0 u_can_txmsg_num 0 255 FORMAT "%3.0" SYMBOL_LINK "CAN_TX_VSPD_LMT_EN" 0 /end CHARACTERISTIC
/begin CHARACTERISTIC CAN_TX_VSPD_LMT_EN_BYTE_LOC "vehicle speed limit enable msg location number" VALUE 0x0002038C __UBYTE_S 0 u_can_byte_num 0 7 FORMAT "%1.0" SYMBOL_LINK "CAN_TX_VSPD_LMT_EN" 1 /end CHARACTERISTIC
/begin CHARACTERISTIC CAN_TX_VSPD_LMT_EN_BIT_LOC "vehicle speed limit enable msg bit location" VALUE 0x0002038C __UBYTE_S 0 u_can_bit_loc 0 7 FORMAT "%1.0" SYMBOL_LINK "CAN_TX_VSPD_LMT_EN" 2 /end CHARACTERISTIC
/begin CHARACTERISTIC CAN_TX_VSPD_LMT_EN_BIT_LEN "vehicle speed limit enable msg bit length" VALUE 0x0002038C __UBYTE_S 0 u_cnts 0 255 SYMBOL_LINK "CAN_TX_VSPD_LMT_EN" 3 /end CHARACTERISTIC
/begin CHARACTERISTIC CAN_TX_VSPD_LMT_EN_TABLE "vehicle speed limit enable msg table" VAL_BLK 0x0002038C __UBYTE_S 0 u_cnts 0 255 NUMBER 2 SYMBOL_LINK "CAN_TX_VSPD_LMT_EN" 4 /end CHARACTERISTIC
/begin CHARACTERISTIC CAN_TX_VSPD_LMT_EXCD_ID "vehicle speed limit exceeded msg number" VALUE 0x0002038C __UBYTE_S 0 u_can_txmsg_num 0 255 FORMAT "%3.0" SYMBOL_LINK "CAN_TX_VSPD_LMT_EXCD" 0 /end CHARACTERISTIC
/begin CHARACTERISTIC CAN_TX_VSPD_LMT_EXCD_BYTE_LOC "vehicle speed limit exceeded msg location number" VALUE 0x0002038C __UBYTE_S 0 u_can_byte_num 0 7 FORMAT "%1.0" SYMBOL_LINK "CAN_TX_VSPD_LMT_EXCD" 1 /end CHARACTERISTIC
/begin CHARACTERISTIC CAN_TX_VSPD_LMT_EXCD_BIT_LOC "vehicle speed limit exceeded msg bit location" VALUE 0x0002038C __UBYTE_S 0 u_can_bit_loc 0 7 FORMAT "%1.0" SYMBOL_LINK "CAN_TX_VSPD_LMT_EXCD" 2 /end CHARACTERISTIC
/begin CHARACTERISTIC CAN_TX_VSPD_LMT_EXCD_BIT_LEN "vehicle speed limit exceeded msg bit length" VALUE 0x0002038C __UBYTE_S 0 u_cnts 0 255 SYMBOL_LINK "CAN_TX_VSPD_LMT_EXCD" 3 /end CHARACTERISTIC
/begin CHARACTERISTIC CAN_TX_VSPD_LMT_EXCD_TABLE "vehicle speed limit exceeded msg table" VAL_BLK 0x0002038C __UBYTE_S 0 u_cnts 0 255 NUMBER 2 SYMBOL_LINK "CAN_TX_VSPD_LMT_EXCD" 4 /end CHARACTERISTIC
/begin CHARACTERISTIC CAN_TX_STRT_RLY_EN_ID "start motor relay enable msg number" VALUE 0x0002038C __UBYTE_S 0 u_can_txmsg_num 0 255 FORMAT "%3.0" SYMBOL_LINK "CAN_TX_STRT_RLY_EN" 0 /end CHARACTERISTIC
/begin CHARACTERISTIC CAN_TX_STRT_RLY_EN_BYTE_LOC "start motor relay enable msg location number" VALUE 0x0002038C __UBYTE_S 0 u_can_byte_num 0 7 FORMAT "%1.0" SYMBOL_LINK "CAN_TX_STRT_RLY_EN" 1 /end CHARACTERISTIC
/begin CHARACTERISTIC CAN_TX_STRT_RLY_EN_BIT_LOC "start motor relay enable msg bit location" VALUE 0x0002038C __UBYTE_S 0 u_can_bit_loc 0 7 FORMAT "%1.0" SYMBOL_LINK "CAN_TX_STRT_RLY_EN" 2 /end CHARACTERISTIC
/begin CHARACTERISTIC CAN_TX_STRT_RLY_EN_BIT_LEN "start motor relay enable msg bit length" VALUE 0x0002038C __UBYTE_S 0 u_cnts 0 255 SYMBOL_LINK "CAN_TX_STRT_RLY_EN" 3 /end CHARACTERISTIC
/begin CHARACTERISTIC CAN_TX_STRT_RLY_EN_TABLE "start motor relay enable msg table" VAL_BLK 0x0002038C __UBYTE_S 0 u_cnts 0 255 NUMBER 2 SYMBOL_LINK "CAN_TX_STRT_RLY_EN" 4 /end CHARACTERISTIC
/begin CHARACTERISTIC CAN_TX_STRT_RLY_FL_ID "start motor relay fail msg number" VALUE 0x0002038C __UBYTE_S 0 u_can_txmsg_num 0 255 FORMAT "%3.0" SYMBOL_LINK "CAN_TX_STRT_RLY_FL" 0 /end CHARACTERISTIC
/begin CHARACTERISTIC CAN_TX_STRT_RLY_FL_BYTE_LOC "start motor relay fail msg location number" VALUE 0x0002038C __UBYTE_S 0 u_can_byte_num 0 7 FORMAT "%1.0" SYMBOL_LINK "CAN_TX_STRT_RLY_FL" 1 /end CHARACTERISTIC
/begin CHARACTERISTIC CAN_TX_STRT_RLY_FL_BIT_LOC "start motor relay fail msg bit location" VALUE 0x0002038C __UBYTE_S 0 u_can_bit_loc 0 7 FORMAT "%1.0" SYMBOL_LINK "CAN_TX_STRT_RLY_FL" 2 /end CHARACTERISTIC
/begin CHARACTERISTIC CAN_TX_STRT_RLY_FL_BIT_LEN "start motor relay fail msg bit length" VALUE 0x0002038C __UBYTE_S 0 u_cnts 0 255 SYMBOL_LINK "CAN_TX_STRT_RLY_FL" 3 /end CHARACTERISTIC
/begin CHARACTERISTIC CAN_TX_STRT_RLY_FL_TABLE "start motor relay fail msg table" VAL_BLK 0x0002038C __UBYTE_S 0 u_cnts 0 255 NUMBER 2 SYMBOL_LINK "CAN_TX_STRT_RLY_FL" 4 /end CHARACTERISTIC
/begin CHARACTERISTIC CAN_TX_DIAG_DEN_COND_MET_ID "diag denom conditions met msg number" VALUE 0x0002038C __UBYTE_S 0 u_can_txmsg_num 0 255 FORMAT "%3.0" SYMBOL_LINK "CAN_TX_DIAG_DEN_COND_MET" 0 /end CHARACTERISTIC
/begin CHARACTERISTIC CAN_TX_DIAG_DEN_COND_MET_BYTE_LOC "diag denom conditions met msg location number" VALUE 0x0002038C __UBYTE_S 0 u_can_byte_num 0 7 FORMAT "%1.0" SYMBOL_LINK "CAN_TX_DIAG_DEN_COND_MET" 1 /end CHARACTERISTIC
/begin CHARACTERISTIC CAN_TX_DIAG_DEN_COND_MET_BIT_LOC "diag denom conditions met msg bit location" VALUE 0x0002038C __UBYTE_S 0 u_can_bit_loc 0 7 FORMAT "%1.0" SYMBOL_LINK "CAN_TX_DIAG_DEN_COND_MET" 2 /end CHARACTERISTIC
/begin CHARACTERISTIC CAN_TX_DIAG_DEN_COND_MET_BIT_LEN "diag denom conditions met msg bit length" VALUE 0x0002038C __UBYTE_S 0 u_cnts 0 255 SYMBOL_LINK "CAN_TX_DIAG_DEN_COND_MET" 3 /end CHARACTERISTIC
/begin CHARACTERISTIC CAN_TX_DIAG_DEN_COND_MET_TABLE "diag denom conditions met msg table" VAL_BLK 0x0002038C __UBYTE_S 0 u_cnts 0 255 NUMBER 2 SYMBOL_LINK "CAN_TX_DIAG_DEN_COND_MET" 4 /end CHARACTERISTIC
/begin CHARACTERISTIC CAN_TX_DIAG_DEN_COND_FL_ID "diag denom conditions fail msg number" VALUE 0x0002038C __UBYTE_S 0 u_can_txmsg_num 0 255 FORMAT "%3.0" SYMBOL_LINK "CAN_TX_DIAG_DEN_COND_FL" 0 /end CHARACTERISTIC
/begin CHARACTERISTIC CAN_TX_DIAG_DEN_COND_FL_BYTE_LOC "diag denom conditions fail msg location number" VALUE 0x0002038C __UBYTE_S 0 u_can_byte_num 0 7 FORMAT "%1.0" SYMBOL_LINK "CAN_TX_DIAG_DEN_COND_FL" 1 /end CHARACTERISTIC
/begin CHARACTERISTIC CAN_TX_DIAG_DEN_COND_FL_BIT_LOC "diag denom conditions fail msg bit location" VALUE 0x0002038C __UBYTE_S 0 u_can_bit_loc 0 7 FORMAT "%1.0" SYMBOL_LINK "CAN_TX_DIAG_DEN_COND_FL" 2 /end CHARACTERISTIC
/begin CHARACTERISTIC CAN_TX_DIAG_DEN_COND_FL_BIT_LEN "diag denom conditions fail msg bit length" VALUE 0x0002038C __UBYTE_S 0 u_cnts 0 255 SYMBOL_LINK "CAN_TX_DIAG_DEN_COND_FL" 3 /end CHARACTERISTIC
/begin CHARACTERISTIC CAN_TX_DIAG_DEN_COND_FL_TABLE "diag denom conditions fail msg table" VAL_BLK 0x0002038C __UBYTE_S 0 u_cnts 0 255 NUMBER 2 SYMBOL_LINK "CAN_TX_DIAG_DEN_COND_FL" 4 /end CHARACTERISTIC
/begin CHARACTERISTIC CAN_TX_TCS_TQ_REDC_EN_ID "TCS torq reduction enable msg number" VALUE 0x0002038C __UBYTE_S 0 u_can_txmsg_num 0 255 FORMAT "%3.0" SYMBOL_LINK "CAN_TX_TCS_TQ_REDC_EN" 0 /end CHARACTERISTIC
/begin CHARACTERISTIC CAN_TX_TCS_TQ_REDC_EN_BYTE_LOC "TCS torq reduction enable msg location number" VALUE 0x0002038C __UBYTE_S 0 u_can_byte_num 0 7 FORMAT "%1.0" SYMBOL_LINK "CAN_TX_TCS_TQ_REDC_EN" 1 /end CHARACTERISTIC
/begin CHARACTERISTIC CAN_TX_TCS_TQ_REDC_EN_BIT_LOC "TCS torq reduction enable msg bit location" VALUE 0x0002038C __UBYTE_S 0 u_can_bit_loc 0 7 FORMAT "%1.0" SYMBOL_LINK "CAN_TX_TCS_TQ_REDC_EN" 2 /end CHARACTERISTIC
/begin CHARACTERISTIC CAN_TX_TCS_TQ_REDC_EN_BIT_LEN "TCS torq reduction enable msg bit length" VALUE 0x0002038C __UBYTE_S 0 u_cnts 0 255 SYMBOL_LINK "CAN_TX_TCS_TQ_REDC_EN" 3 /end CHARACTERISTIC
/begin CHARACTERISTIC CAN_TX_TCS_TQ_REDC_EN_TABLE "TCS torq reduction enable msg table" VAL_BLK 0x0002038C __UBYTE_S 0 u_cnts 0 255 NUMBER 2 SYMBOL_LINK "CAN_TX_TCS_TQ_REDC_EN" 4 /end CHARACTERISTIC
/begin CHARACTERISTIC CAN_TX_CRUZ_ACTV_LAMP_ON_ID "cruise active lamp state msg number" VALUE 0x0002038C __UBYTE_S 0 u_can_txmsg_num 0 255 FORMAT "%3.0" SYMBOL_LINK "CAN_TX_CRUZ_ACTV_LAMP_ON" 0 /end CHARACTERISTIC
/begin CHARACTERISTIC CAN_TX_CRUZ_ACTV_LAMP_ON_BYTE_LOC "cruise active lamp state msg location number" VALUE 0x0002038C __UBYTE_S 0 u_can_byte_num 0 7 FORMAT "%1.0" SYMBOL_LINK "CAN_TX_CRUZ_ACTV_LAMP_ON" 1 /end CHARACTERISTIC
/begin CHARACTERISTIC CAN_TX_CRUZ_ACTV_LAMP_ON_BIT_LOC "cruise active lamp state msg bit location" VALUE 0x0002038C __UBYTE_S 0 u_can_bit_loc 0 7 FORMAT "%1.0" SYMBOL_LINK "CAN_TX_CRUZ_ACTV_LAMP_ON" 2 /end CHARACTERISTIC
/begin CHARACTERISTIC CAN_TX_CRUZ_ACTV_LAMP_ON_BIT_LEN "cruise active lamp state msg bit length" VALUE 0x0002038C __UBYTE_S 0 u_cnts 0 255 SYMBOL_LINK "CAN_TX_CRUZ_ACTV_LAMP_ON" 3 /end CHARACTERISTIC
/begin CHARACTERISTIC CAN_TX_CRUZ_ACTV_LAMP_ON_TABLE "cruise active lamp state msg table" VAL_BLK 0x0002038C __UBYTE_S 0 u_cnts 0 255 NUMBER 2 SYMBOL_LINK "CAN_TX_CRUZ_ACTV_LAMP_ON" 4 /end CHARACTERISTIC
/begin CHARACTERISTIC CAN_TX_CRUZ_IN_FL_ID "cruise input fail msg number" VALUE 0x0002038C __UBYTE_S 0 u_can_txmsg_num 0 255 FORMAT "%3.0" SYMBOL_LINK "CAN_TX_CRUZ_IN_FL" 0 /end CHARACTERISTIC
/begin CHARACTERISTIC CAN_TX_CRUZ_IN_FL_BYTE_LOC "cruise input fail msg location number" VALUE 0x0002038C __UBYTE_S 0 u_can_byte_num 0 7 FORMAT "%1.0" SYMBOL_LINK "CAN_TX_CRUZ_IN_FL" 1 /end CHARACTERISTIC
/begin CHARACTERISTIC CAN_TX_CRUZ_IN_FL_BIT_LOC "cruise input fail msg bit location" VALUE 0x0002038C __UBYTE_S 0 u_can_bit_loc 0 7 FORMAT "%1.0" SYMBOL_LINK "CAN_TX_CRUZ_IN_FL" 2 /end CHARACTERISTIC
/begin CHARACTERISTIC CAN_TX_CRUZ_IN_FL_BIT_LEN "cruise input fail msg bit length" VALUE 0x0002038C __UBYTE_S 0 u_cnts 0 255 SYMBOL_LINK "CAN_TX_CRUZ_IN_FL" 3 /end CHARACTERISTIC
/begin CHARACTERISTIC CAN_TX_CRUZ_IN_FL_TABLE "cruise input fail msg table" VAL_BLK 0x0002038C __UBYTE_S 0 u_cnts 0 255 NUMBER 2 SYMBOL_LINK "CAN_TX_CRUZ_IN_FL" 4 /end CHARACTERISTIC
/begin CHARACTERISTIC CAN_TX_NO_HYS_PPS_ID "pedal position without hys msg number" VALUE 0x0002038C __UBYTE_S 0 u_can_txmsg_num 0 255 FORMAT "%3.0" SYMBOL_LINK "CAN_TX_NO_HYS_PPS" 0 /end CHARACTERISTIC
/begin CHARACTERISTIC CAN_TX_NO_HYS_PPS_BYTE_LOC "pedal position without hys msg location number" VALUE 0x0002038C __UBYTE_S 0 u_can_byte_num 0 7 FORMAT "%1.0" SYMBOL_LINK "CAN_TX_NO_HYS_PPS" 1 /end CHARACTERISTIC
/begin CHARACTERISTIC CAN_TX_NO_HYS_PPS_BIT_LOC "pedal position without hys msg bit location" VALUE 0x0002038C __UBYTE_S 0 u_can_bit_loc 0 7 FORMAT "%1.0" SYMBOL_LINK "CAN_TX_NO_HYS_PPS" 2 /end CHARACTERISTIC
/begin CHARACTERISTIC CAN_TX_NO_HYS_PPS_BIT_LEN "pedal position without hys msg bit length" VALUE 0x0002038C __UBYTE_S 0 u_cnts 0 255 SYMBOL_LINK "CAN_TX_NO_HYS_PPS" 3 /end CHARACTERISTIC
/begin CHARACTERISTIC CAN_TX_NO_HYS_PPS_A "pedal position without hys msg scaling A" VALUE 0x0002038C __ULONG_S 0 u_fac_65536L 0 65535.9999847412109375 FORMAT "%8.3" SYMBOL_LINK "CAN_TX_NO_HYS_PPS" 4 /end CHARACTERISTIC
/begin CHARACTERISTIC CAN_TX_NO_HYS_PPS_B "pedal position without hys msg scaling B" VALUE 0x0002038C __SWORD_S 0 u_cnt_n3277_p3277 -3276.8 3276.7 FORMAT "%5.1" SYMBOL_LINK "CAN_TX_NO_HYS_PPS" 8 /end CHARACTERISTIC
/begin CHARACTERISTIC CAN_TX_NO_HYS_PPS_MIN "pedal position without hys msg min" VALUE 0x0002038C __UWORD_S 0 u_pct 0 199.996948 SYMBOL_LINK "CAN_TX_NO_HYS_PPS" 10 /end CHARACTERISTIC
/begin CHARACTERISTIC CAN_TX_NO_HYS_PPS_MAX "pedal position without hys msg max" VALUE 0x0002038C __UWORD_S 0 u_pct 0 199.996948 SYMBOL_LINK "CAN_TX_NO_HYS_PPS" 12 /end CHARACTERISTIC
/begin CHARACTERISTIC CAN_TX_NO_HYS_PPS_INVALID "pedal position without hys msg invalid value" VALUE 0x0002038C __UWORD_S 0 u_cnts 0 65535 FORMAT "%5.0" SYMBOL_LINK "CAN_TX_NO_HYS_PPS" 14 /end CHARACTERISTIC
/begin CHARACTERISTIC CAN_TX_BRK_P_ID "break press msg number" VALUE 0x0002038C __UBYTE_S 0 u_can_txmsg_num 0 255 FORMAT "%3.0" SYMBOL_LINK "CAN_TX_BRK_P" 0 /end CHARACTERISTIC
/begin CHARACTERISTIC CAN_TX_BRK_P_BYTE_LOC "break press msg location number" VALUE 0x0002038C __UBYTE_S 0 u_can_byte_num 0 7 FORMAT "%1.0" SYMBOL_LINK "CAN_TX_BRK_P" 1 /end CHARACTERISTIC
/begin CHARACTERISTIC CAN_TX_BRK_P_BIT_LOC "break press msg bit location" VALUE 0x0002038C __UBYTE_S 0 u_can_bit_loc 0 7 FORMAT "%1.0" SYMBOL_LINK "CAN_TX_BRK_P" 2 /end CHARACTERISTIC
/begin CHARACTERISTIC CAN_TX_BRK_P_BIT_LEN "break press msg bit length" VALUE 0x0002038C __UBYTE_S 0 u_cnts 0 255 SYMBOL_LINK "CAN_TX_BRK_P" 3 /end CHARACTERISTIC
/begin CHARACTERISTIC CAN_TX_BRK_P_A "break press scaling A" VALUE 0x0002038C __ULONG_S 0 u_fac_65536L 0 65535.9999847412109375 FORMAT "%8.3" SYMBOL_LINK "CAN_TX_BRK_P" 4 /end CHARACTERISTIC
/begin CHARACTERISTIC CAN_TX_BRK_P_B "break press msg scaling B" VALUE 0x0002038C __SWORD_S 0 u_cnt_n3277_p3277 -3276.8 3276.7 FORMAT "%5.1" SYMBOL_LINK "CAN_TX_BRK_P" 8 /end CHARACTERISTIC
/begin CHARACTERISTIC CAN_TX_BRK_P_MIN "break press msg min" VALUE 0x0002038C __UWORD_S 0 u_kPa_0_256 0 255.99609375 SYMBOL_LINK "CAN_TX_BRK_P" 10 /end CHARACTERISTIC
/begin CHARACTERISTIC CAN_TX_BRK_P_MAX "break press msg max" VALUE 0x0002038C __UWORD_S 0 u_kPa_0_256 0 255.99609375 SYMBOL_LINK "CAN_TX_BRK_P" 12 /end CHARACTERISTIC
/begin CHARACTERISTIC CAN_TX_BRK_P_INVALID "break press msg invalid value" VALUE 0x0002038C __UWORD_S 0 u_cnts 0 65535 FORMAT "%5.0" SYMBOL_LINK "CAN_TX_BRK_P" 14 /end CHARACTERISTIC
/begin CHARACTERISTIC CAN_TX_BRK_P_FL_ID "break press fail msg number" VALUE 0x0002038C __UBYTE_S 0 u_can_txmsg_num 0 255 FORMAT "%3.0" SYMBOL_LINK "CAN_TX_BRK_P_FL" 0 /end CHARACTERISTIC
/begin CHARACTERISTIC CAN_TX_BRK_P_FL_BYTE_LOC "break press fail msg location number" VALUE 0x0002038C __UBYTE_S 0 u_can_byte_num 0 7 FORMAT "%1.0" SYMBOL_LINK "CAN_TX_BRK_P_FL" 1 /end CHARACTERISTIC
/begin CHARACTERISTIC CAN_TX_BRK_P_FL_BIT_LOC "break press fail msg bit location" VALUE 0x0002038C __UBYTE_S 0 u_can_bit_loc 0 7 FORMAT "%1.0" SYMBOL_LINK "CAN_TX_BRK_P_FL" 2 /end CHARACTERISTIC
/begin CHARACTERISTIC CAN_TX_BRK_P_FL_BIT_LEN "break press fail msg bit length" VALUE 0x0002038C __UBYTE_S 0 u_cnts 0 255 SYMBOL_LINK "CAN_TX_BRK_P_FL" 3 /end CHARACTERISTIC
/begin CHARACTERISTIC CAN_TX_BRK_P_FL_TABLE "break press fail msg table" VAL_BLK 0x0002038C __UBYTE_S 0 u_cnts 0 255 NUMBER 2 SYMBOL_LINK "CAN_TX_BRK_P_FL" 4 /end CHARACTERISTIC
/begin CHARACTERISTIC CAN_TX_ENG_STOP_REQ_ID "engine stop request msg number" VALUE 0x0002038C __UBYTE_S 0 u_can_txmsg_num 0 255 FORMAT "%3.0" SYMBOL_LINK "CAN_TX_ENG_STOP_REQ" 0 /end CHARACTERISTIC
/begin CHARACTERISTIC CAN_TX_ENG_STOP_REQ_BYTE_LOC "engine stop request msg location number" VALUE 0x0002038C __UBYTE_S 0 u_can_byte_num 0 7 FORMAT "%1.0" SYMBOL_LINK "CAN_TX_ENG_STOP_REQ" 1 /end CHARACTERISTIC
/begin CHARACTERISTIC CAN_TX_ENG_STOP_REQ_BIT_LOC "engine stop request msg bit location" VALUE 0x0002038C __UBYTE_S 0 u_can_bit_loc 0 7 FORMAT "%1.0" SYMBOL_LINK "CAN_TX_ENG_STOP_REQ" 2 /end CHARACTERISTIC
/begin CHARACTERISTIC CAN_TX_ENG_STOP_REQ_BIT_LEN "engine stop request msg bit length" VALUE 0x0002038C __UBYTE_S 0 u_cnts 0 255 SYMBOL_LINK "CAN_TX_ENG_STOP_REQ" 3 /end CHARACTERISTIC
/begin CHARACTERISTIC CAN_TX_ENG_STOP_REQ_TABLE "engine stop request msg table" VAL_BLK 0x0002038C __UBYTE_S 0 u_cnts 0 255 NUMBER 2 SYMBOL_LINK "CAN_TX_ENG_STOP_REQ" 4 /end CHARACTERISTIC
/begin CHARACTERISTIC CAN_TX_CLTCH_POS_ID "clutch pedal postion msg number" VALUE 0x0002038C __UBYTE_S 0 u_can_txmsg_num 0 255 FORMAT "%3.0" SYMBOL_LINK "CAN_TX_CLTCH_POS" 0 /end CHARACTERISTIC
/begin CHARACTERISTIC CAN_TX_CLTCH_POS_BYTE_LOC "clutch pedal postion msg location number" VALUE 0x0002038C __UBYTE_S 0 u_can_byte_num 0 7 FORMAT "%1.0" SYMBOL_LINK "CAN_TX_CLTCH_POS" 1 /end CHARACTERISTIC
/begin CHARACTERISTIC CAN_TX_CLTCH_POS_BIT_LOC "clutch pedal postion msg bit location" VALUE 0x0002038C __UBYTE_S 0 u_can_bit_loc 0 7 FORMAT "%1.0" SYMBOL_LINK "CAN_TX_CLTCH_POS" 2 /end CHARACTERISTIC
/begin CHARACTERISTIC CAN_TX_CLTCH_POS_BIT_LEN "clutch pedal postion msg bit length" VALUE 0x0002038C __UBYTE_S 0 u_cnts 0 255 SYMBOL_LINK "CAN_TX_CLTCH_POS" 3 /end CHARACTERISTIC
/begin CHARACTERISTIC CAN_TX_CLTCH_POS_A "clutch pedal postion scaling A" VALUE 0x0002038C __ULONG_S 0 u_fac_65536L 0 65535.9999847412109375 FORMAT "%8.3" SYMBOL_LINK "CAN_TX_CLTCH_POS" 4 /end CHARACTERISTIC
/begin CHARACTERISTIC CAN_TX_CLTCH_POS_B "clutch pedal postion msg scaling B" VALUE 0x0002038C __SWORD_S 0 u_cnt_n3277_p3277 -3276.8 3276.7 FORMAT "%5.1" SYMBOL_LINK "CAN_TX_CLTCH_POS" 8 /end CHARACTERISTIC
/begin CHARACTERISTIC CAN_TX_CLTCH_POS_MIN "clutch pedal postion msg min" VALUE 0x0002038C __UWORD_S 0 u_pct_1 0 99.9984741210937 SYMBOL_LINK "CAN_TX_CLTCH_POS" 10 /end CHARACTERISTIC
/begin CHARACTERISTIC CAN_TX_CLTCH_POS_MAX "clutch pedal postion msg max" VALUE 0x0002038C __UWORD_S 0 u_pct_1 0 99.9984741210937 SYMBOL_LINK "CAN_TX_CLTCH_POS" 12 /end CHARACTERISTIC
/begin CHARACTERISTIC CAN_TX_CLTCH_POS_INVALID "clutch pedal postion msg invalid value" VALUE 0x0002038C __UWORD_S 0 u_cnts 0 65535 FORMAT "%5.0" SYMBOL_LINK "CAN_TX_CLTCH_POS" 14 /end CHARACTERISTIC
/begin CHARACTERISTIC CAN_TX_CLTCH_POS_VLD_ID "engine clutch postion valid msg number" VALUE 0x0002038C __UBYTE_S 0 u_can_txmsg_num 0 255 FORMAT "%3.0" SYMBOL_LINK "CAN_TX_CLTCH_POS_VLD" 0 /end CHARACTERISTIC
/begin CHARACTERISTIC CAN_TX_CLTCH_POS_VLD_BYTE_LOC "engine clutch postion valid msg location number" VALUE 0x0002038C __UBYTE_S 0 u_can_byte_num 0 7 FORMAT "%1.0" SYMBOL_LINK "CAN_TX_CLTCH_POS_VLD" 1 /end CHARACTERISTIC
/begin CHARACTERISTIC CAN_TX_CLTCH_POS_VLD_BIT_LOC "engine clutch postion valid msg bit location" VALUE 0x0002038C __UBYTE_S 0 u_can_bit_loc 0 7 FORMAT "%1.0" SYMBOL_LINK "CAN_TX_CLTCH_POS_VLD" 2 /end CHARACTERISTIC
/begin CHARACTERISTIC CAN_TX_CLTCH_POS_VLD_BIT_LEN "engine clutch postion valid msg bit length" VALUE 0x0002038C __UBYTE_S 0 u_cnts 0 255 SYMBOL_LINK "CAN_TX_CLTCH_POS_VLD" 3 /end CHARACTERISTIC
/begin CHARACTERISTIC CAN_TX_CLTCH_POS_VLD_TABLE "engine clutch postion valid msg table" VAL_BLK 0x0002038C __UBYTE_S 0 u_cnts 0 255 NUMBER 2 SYMBOL_LINK "CAN_TX_CLTCH_POS_VLD" 4 /end CHARACTERISTIC
/begin CHARACTERISTIC CAN_TX_PPS_RAW_ID "PPS raw percent msg number" VALUE 0x0002038C __UBYTE_S 0 u_can_txmsg_num 0 255 FORMAT "%3.0" SYMBOL_LINK "CAN_TX_PPS_RAW" 0 /end CHARACTERISTIC
/begin CHARACTERISTIC CAN_TX_PPS_RAW_BYTE_LOC "PPS raw percent msg location number" VALUE 0x0002038C __UBYTE_S 0 u_can_byte_num 0 7 FORMAT "%1.0" SYMBOL_LINK "CAN_TX_PPS_RAW" 1 /end CHARACTERISTIC
/begin CHARACTERISTIC CAN_TX_PPS_RAW_BIT_LOC "PPS raw percent msg bit location" VALUE 0x0002038C __UBYTE_S 0 u_can_bit_loc 0 7 FORMAT "%1.0" SYMBOL_LINK "CAN_TX_PPS_RAW" 2 /end CHARACTERISTIC
/begin CHARACTERISTIC CAN_TX_PPS_RAW_BIT_LEN "PPS raw percent msg bit length" VALUE 0x0002038C __UBYTE_S 0 u_cnts 0 255 SYMBOL_LINK "CAN_TX_PPS_RAW" 3 /end CHARACTERISTIC
/begin CHARACTERISTIC CAN_TX_PPS_RAW_A "PPS raw percent msg scaling A" VALUE 0x0002038C __ULONG_S 0 u_fac_65536L 0 65535.9999847412109375 FORMAT "%8.3" SYMBOL_LINK "CAN_TX_PPS_RAW" 4 /end CHARACTERISTIC
/begin CHARACTERISTIC CAN_TX_PPS_RAW_B "PPS raw percent msg scaling B" VALUE 0x0002038C __SWORD_S 0 u_cnt_n3277_p3277 -3276.8 3276.7 FORMAT "%5.1" SYMBOL_LINK "CAN_TX_PPS_RAW" 8 /end CHARACTERISTIC
/begin CHARACTERISTIC CAN_TX_PPS_RAW_MIN "PPS raw percent msg min" VALUE 0x0002038C __UWORD_S 0 u_pct 0 199.996948 SYMBOL_LINK "CAN_TX_PPS_RAW" 10 /end CHARACTERISTIC
/begin CHARACTERISTIC CAN_TX_PPS_RAW_MAX "PPS raw percent msg max" VALUE 0x0002038C __UWORD_S 0 u_pct 0 199.996948 SYMBOL_LINK "CAN_TX_PPS_RAW" 12 /end CHARACTERISTIC
/begin CHARACTERISTIC CAN_TX_PPS_RAW_INVALID "PPS raw percent msg invalid value" VALUE 0x0002038C __UWORD_S 0 u_cnts 0 65535 FORMAT "%5.0" SYMBOL_LINK "CAN_TX_PPS_RAW" 14 /end CHARACTERISTIC
/begin CHARACTERISTIC CAN_TX_OIL_P_LO_ID "oil press low msg number" VALUE 0x0002038C __UBYTE_S 0 u_can_txmsg_num 0 255 FORMAT "%3.0" SYMBOL_LINK "CAN_TX_OIL_P_LO" 0 /end CHARACTERISTIC
/begin CHARACTERISTIC CAN_TX_OIL_P_LO_BYTE_LOC "oil press low msg location number" VALUE 0x0002038C __UBYTE_S 0 u_can_byte_num 0 7 FORMAT "%1.0" SYMBOL_LINK "CAN_TX_OIL_P_LO" 1 /end CHARACTERISTIC
/begin CHARACTERISTIC CAN_TX_OIL_P_LO_BIT_LOC "oil press low msg bit location" VALUE 0x0002038C __UBYTE_S 0 u_can_bit_loc 0 7 FORMAT "%1.0" SYMBOL_LINK "CAN_TX_OIL_P_LO" 2 /end CHARACTERISTIC
/begin CHARACTERISTIC CAN_TX_OIL_P_LO_BIT_LEN "oil press low msg bit length" VALUE 0x0002038C __UBYTE_S 0 u_cnts 0 255 SYMBOL_LINK "CAN_TX_OIL_P_LO" 3 /end CHARACTERISTIC
/begin CHARACTERISTIC CAN_TX_OIL_P_LO_TABLE "oil press low msg table" VAL_BLK 0x0002038C __UBYTE_S 0 u_cnts 0 255 NUMBER 2 SYMBOL_LINK "CAN_TX_OIL_P_LO" 4 /end CHARACTERISTIC
/begin CHARACTERISTIC CAN_TX_GR_SHFT_UP_ID "gear shift up msg number" VALUE 0x0002038C __UBYTE_S 0 u_can_txmsg_num 0 255 FORMAT "%3.0" SYMBOL_LINK "CAN_TX_GR_SHFT_UP" 0 /end CHARACTERISTIC
/begin CHARACTERISTIC CAN_TX_GR_SHFT_UP_BYTE_LOC "gear shift up msg location number" VALUE 0x0002038C __UBYTE_S 0 u_can_byte_num 0 7 FORMAT "%1.0" SYMBOL_LINK "CAN_TX_GR_SHFT_UP" 1 /end CHARACTERISTIC
/begin CHARACTERISTIC CAN_TX_GR_SHFT_UP_BIT_LOC "gear shift up msg bit location" VALUE 0x0002038C __UBYTE_S 0 u_can_bit_loc 0 7 FORMAT "%1.0" SYMBOL_LINK "CAN_TX_GR_SHFT_UP" 2 /end CHARACTERISTIC
/begin CHARACTERISTIC CAN_TX_GR_SHFT_UP_BIT_LEN "gear shift up msg bit length" VALUE 0x0002038C __UBYTE_S 0 u_cnts 0 255 SYMBOL_LINK "CAN_TX_GR_SHFT_UP" 3 /end CHARACTERISTIC
/begin CHARACTERISTIC CAN_TX_GR_SHFT_UP_TABLE "gear shift up msg table" VAL_BLK 0x0002038C __UBYTE_S 0 u_cnts 0 255 NUMBER 2 SYMBOL_LINK "CAN_TX_GR_SHFT_UP" 4 /end CHARACTERISTIC
/begin CHARACTERISTIC CAN_TX_GR_SHFT_DWN_ID "gear shift down msg number" VALUE 0x0002038C __UBYTE_S 0 u_can_txmsg_num 0 255 FORMAT "%3.0" SYMBOL_LINK "CAN_TX_GR_SHFT_DWN" 0 /end CHARACTERISTIC
/begin CHARACTERISTIC CAN_TX_GR_SHFT_DWN_BYTE_LOC "gear shift down msg location number" VALUE 0x0002038C __UBYTE_S 0 u_can_byte_num 0 7 FORMAT "%1.0" SYMBOL_LINK "CAN_TX_GR_SHFT_DWN" 1 /end CHARACTERISTIC
/begin CHARACTERISTIC CAN_TX_GR_SHFT_DWN_BIT_LOC "gear shift down msg bit location" VALUE 0x0002038C __UBYTE_S 0 u_can_bit_loc 0 7 FORMAT "%1.0" SYMBOL_LINK "CAN_TX_GR_SHFT_DWN" 2 /end CHARACTERISTIC
/begin CHARACTERISTIC CAN_TX_GR_SHFT_DWN_BIT_LEN "gear shift down msg bit length" VALUE 0x0002038C __UBYTE_S 0 u_cnts 0 255 SYMBOL_LINK "CAN_TX_GR_SHFT_DWN" 3 /end CHARACTERISTIC
/begin CHARACTERISTIC CAN_TX_GR_SHFT_DWN_TABLE "gear shift down msg table" VAL_BLK 0x0002038C __UBYTE_S 0 u_cnts 0 255 NUMBER 2 SYMBOL_LINK "CAN_TX_GR_SHFT_DWN" 4 /end CHARACTERISTIC
/begin CHARACTERISTIC CAN_TX_GR_SHFT_SP_ID "shift gear setpoint msg number" VALUE 0x0002038C __UBYTE_S 0 u_can_txmsg_num 0 255 FORMAT "%3.0" SYMBOL_LINK "CAN_TX_GR_SHFT_SP" 0 /end CHARACTERISTIC
/begin CHARACTERISTIC CAN_TX_GR_SHFT_SP_BYTE_LOC "shift gear setpoint msg location number" VALUE 0x0002038C __UBYTE_S 0 u_can_byte_num 0 7 FORMAT "%1.0" SYMBOL_LINK "CAN_TX_GR_SHFT_SP" 1 /end CHARACTERISTIC
/begin CHARACTERISTIC CAN_TX_GR_SHFT_SP_BIT_LOC "shift gear setpoint msg bit location" VALUE 0x0002038C __UBYTE_S 0 u_can_bit_loc 0 7 FORMAT "%1.0" SYMBOL_LINK "CAN_TX_GR_SHFT_SP" 2 /end CHARACTERISTIC
/begin CHARACTERISTIC CAN_TX_GR_SHFT_SP_BIT_LEN "shift gear setpoint msg bit length" VALUE 0x0002038C __UBYTE_S 0 u_cnts 0 255 SYMBOL_LINK "CAN_TX_GR_SHFT_SP" 3 /end CHARACTERISTIC
/begin CHARACTERISTIC CAN_TX_GR_SHFT_SP_TABLE "shift gear setpoint msg table" CURVE 0x375CE __UBYTE_S 0 u_cnts 0 255 SYMBOL_LINK "CAN_TX_GR_SHFT_SP" 4
 /begin AXIS_DESCR FIX_AXIS NO_INPUT_QUANTITY u_can_shft_gear 7 0 6 /begin FIX_AXIS_PAR_LIST 0 1 2 3 4 5 6 /end FIX_AXIS_PAR_LIST /end AXIS_DESCR
/end CHARACTERISTIC
/begin CHARACTERISTIC CAN_TX_CRU_SW_ST_ID "cruise switch state msg number" VALUE 0x0002038C __UBYTE_S 0 u_can_txmsg_num 0 255 FORMAT "%3.0" SYMBOL_LINK "CAN_TX_CRU_SW_ST" 0 /end CHARACTERISTIC
/begin CHARACTERISTIC CAN_TX_CRU_SW_ST_BYTE_LOC "cruise switch state msg location number" VALUE 0x0002038C __UBYTE_S 0 u_can_byte_num 0 7 FORMAT "%1.0" SYMBOL_LINK "CAN_TX_CRU_SW_ST" 1 /end CHARACTERISTIC
/begin CHARACTERISTIC CAN_TX_CRU_SW_ST_BIT_LOC "cruise switch state msg bit location" VALUE 0x0002038C __UBYTE_S 0 u_can_bit_loc 0 7 FORMAT "%1.0" SYMBOL_LINK "CAN_TX_CRU_SW_ST" 2 /end CHARACTERISTIC
/begin CHARACTERISTIC CAN_TX_CRU_SW_ST_BIT_LEN "cruise switch state msg bit length" VALUE 0x0002038C __UBYTE_S 0 u_cnts 0 255 SYMBOL_LINK "CAN_TX_CRU_SW_ST" 3 /end CHARACTERISTIC
/begin CHARACTERISTIC CAN_TX_CRU_SW_ST_TABLE "cruise switch state msg table" CURVE 0x375CE __UBYTE_S 0 u_cnts 0 255 SYMBOL_LINK "CAN_TX_CRU_SW_ST" 4
 /begin AXIS_DESCR FIX_AXIS NO_INPUT_QUANTITY u_can_cru_sw_st 6 0 5 /begin FIX_AXIS_PAR_LIST 0 1 2 3 4 5 /end FIX_AXIS_PAR_LIST /end AXIS_DESCR
/end CHARACTERISTIC
/begin CHARACTERISTIC CAN_TX_FC_100MS_ID "100ms fuel accumulation msg number" VALUE 0x0002038C __UBYTE_S 0 u_can_txmsg_num 0 255 FORMAT "%3.0" SYMBOL_LINK "CAN_TX_FC_100MS" 0 /end CHARACTERISTIC
/begin CHARACTERISTIC CAN_TX_FC_100MS_BYTE_LOC "100ms fuel accumulation msg location number" VALUE 0x0002038C __UBYTE_S 0 u_can_byte_num 0 7 FORMAT "%1.0" SYMBOL_LINK "CAN_TX_FC_100MS" 1 /end CHARACTERISTIC
/begin CHARACTERISTIC CAN_TX_FC_100MS_BIT_LOC "100ms fuel accumulation msg bit location" VALUE 0x0002038C __UBYTE_S 0 u_can_bit_loc 0 7 FORMAT "%1.0" SYMBOL_LINK "CAN_TX_FC_100MS" 2 /end CHARACTERISTIC
/begin CHARACTERISTIC CAN_TX_FC_100MS_BIT_LEN "100ms fuel accumulation msg bit length" VALUE 0x0002038C __UBYTE_S 0 u_cnts 0 255 SYMBOL_LINK "CAN_TX_FC_100MS" 3 /end CHARACTERISTIC
/begin CHARACTERISTIC CAN_TX_FC_100MS_A "100ms fuel accumulation msg scaling A" VALUE 0x0002038C __ULONG_S 0 u_fac_65536L 0 65535.9999847412109375 FORMAT "%8.3" SYMBOL_LINK "CAN_TX_FC_100MS" 4 /end CHARACTERISTIC
/begin CHARACTERISTIC CAN_TX_FC_100MS_B "100ms fuel accumulation msg scaling B" VALUE 0x0002038C __SWORD_S 0 u_cnt_n3277_p3277 -3276.8 3276.7 FORMAT "%5.1" SYMBOL_LINK "CAN_TX_FC_100MS" 8 /end CHARACTERISTIC
/begin CHARACTERISTIC CAN_TX_FC_100MS_MIN "100ms fuel accumulation msg min" VALUE 0x0002038C __ULONG_S 0 u_ul 0 134217727.96875 FORMAT "%12.3" SYMBOL_LINK "CAN_TX_FC_100MS" 10 /end CHARACTERISTIC
/begin CHARACTERISTIC CAN_TX_FC_100MS_MAX "100ms fuel accumulation msg max" VALUE 0x0002038C __ULONG_S 0 u_ul 0 134217727.96875 FORMAT "%12.3" SYMBOL_LINK "CAN_TX_FC_100MS" 14 /end CHARACTERISTIC
/begin CHARACTERISTIC CAN_TX_FC_100MS_INVALID "100ms fuel accumulation msg invalid value" VALUE 0x0002038C __ULONG_S 0 u_cnts 0 4294967295 FORMAT "%10.0" SYMBOL_LINK "CAN_TX_FC_100MS" 18 /end CHARACTERISTIC
/begin CHARACTERISTIC CAN_TX_VSPD_LMT_ACTV_ID "vehicle speed limit active msg number" VALUE 0x0002038C __UBYTE_S 0 u_can_txmsg_num 0 255 FORMAT "%3.0" SYMBOL_LINK "CAN_TX_VSPD_LMT_ACTV" 0 /end CHARACTERISTIC
/begin CHARACTERISTIC CAN_TX_VSPD_LMT_ACTV_BYTE_LOC "vehicle speed limit active msg location number" VALUE 0x0002038C __UBYTE_S 0 u_can_byte_num 0 7 FORMAT "%1.0" SYMBOL_LINK "CAN_TX_VSPD_LMT_ACTV" 1 /end CHARACTERISTIC
/begin CHARACTERISTIC CAN_TX_VSPD_LMT_ACTV_BIT_LOC "vehicle speed limit active msg bit location" VALUE 0x0002038C __UBYTE_S 0 u_can_bit_loc 0 7 FORMAT "%1.0" SYMBOL_LINK "CAN_TX_VSPD_LMT_ACTV" 2 /end CHARACTERISTIC
/begin CHARACTERISTIC CAN_TX_VSPD_LMT_ACTV_BIT_LEN "vehicle speed limit active msg bit length" VALUE 0x0002038C __UBYTE_S 0 u_cnts 0 255 SYMBOL_LINK "CAN_TX_VSPD_LMT_ACTV" 3 /end CHARACTERISTIC
/begin CHARACTERISTIC CAN_TX_VSPD_LMT_ACTV_TABLE "vehicle speed limit active msg table" VAL_BLK 0x0002038C __UBYTE_S 0 u_cnts 0 255 NUMBER 2 SYMBOL_LINK "CAN_TX_VSPD_LMT_ACTV" 4 /end CHARACTERISTIC
/begin CHARACTERISTIC CAN_TX_CLTCH_POS_FL_ID "clutch position fail msg number" VALUE 0x0002038C __UBYTE_S 0 u_can_txmsg_num 0 255 FORMAT "%3.0" SYMBOL_LINK "CAN_TX_CLTCH_POS_FL" 0 /end CHARACTERISTIC
/begin CHARACTERISTIC CAN_TX_CLTCH_POS_FL_BYTE_LOC "clutch position fail msg location number" VALUE 0x0002038C __UBYTE_S 0 u_can_byte_num 0 7 FORMAT "%1.0" SYMBOL_LINK "CAN_TX_CLTCH_POS_FL" 1 /end CHARACTERISTIC
/begin CHARACTERISTIC CAN_TX_CLTCH_POS_FL_BIT_LOC "clutch position fail msg bit location" VALUE 0x0002038C __UBYTE_S 0 u_can_bit_loc 0 7 FORMAT "%1.0" SYMBOL_LINK "CAN_TX_CLTCH_POS_FL" 2 /end CHARACTERISTIC
/begin CHARACTERISTIC CAN_TX_CLTCH_POS_FL_BIT_LEN "clutch position fail msg bit length" VALUE 0x0002038C __UBYTE_S 0 u_cnts 0 255 SYMBOL_LINK "CAN_TX_CLTCH_POS_FL" 3 /end CHARACTERISTIC
/begin CHARACTERISTIC CAN_TX_CLTCH_POS_FL_TABLE "clutch position fail msg table" VAL_BLK 0x0002038C __UBYTE_S 0 u_cnts 0 255 NUMBER 2 SYMBOL_LINK "CAN_TX_CLTCH_POS_FL" 4 /end CHARACTERISTIC
/begin CHARACTERISTIC CAN_TX_FAN_ST_ID "fan state msg number" VALUE 0x0002038C __UBYTE_S 0 u_can_txmsg_num 0 255 FORMAT "%3.0" SYMBOL_LINK "CAN_TX_FAN_ST" 0 /end CHARACTERISTIC
/begin CHARACTERISTIC CAN_TX_FAN_ST_BYTE_LOC "fan state msg location number" VALUE 0x0002038C __UBYTE_S 0 u_can_byte_num 0 7 FORMAT "%1.0" SYMBOL_LINK "CAN_TX_FAN_ST" 1 /end CHARACTERISTIC
/begin CHARACTERISTIC CAN_TX_FAN_ST_BIT_LOC "fan state msg bit location" VALUE 0x0002038C __UBYTE_S 0 u_can_bit_loc 0 7 FORMAT "%1.0" SYMBOL_LINK "CAN_TX_FAN_ST" 2 /end CHARACTERISTIC
/begin CHARACTERISTIC CAN_TX_FAN_ST_BIT_LEN "fan state msg bit length" VALUE 0x0002038C __UBYTE_S 0 u_cnts 0 255 SYMBOL_LINK "CAN_TX_FAN_ST" 3 /end CHARACTERISTIC
/begin CHARACTERISTIC CAN_TX_FAN_ST_TABLE "fan state msg table" CURVE 0x375CE __UBYTE_S 0 u_cnts 0 255 SYMBOL_LINK "CAN_TX_FAN_ST" 4
 /begin AXIS_DESCR FIX_AXIS NO_INPUT_QUANTITY u_fan_ctrl_typ 4 0 3 /begin FIX_AXIS_PAR_LIST 0 1 2 3 /end FIX_AXIS_PAR_LIST /end AXIS_DESCR
/end CHARACTERISTIC
/begin CHARACTERISTIC CAN_TX_BRK_FL_ID "break pos fail msg number" VALUE 0x0002038C __UBYTE_S 0 u_can_txmsg_num 0 255 FORMAT "%3.0" SYMBOL_LINK "CAN_TX_BRK_FL" 0 /end CHARACTERISTIC
/begin CHARACTERISTIC CAN_TX_BRK_FL_BYTE_LOC "break pos fail msg location number" VALUE 0x0002038C __UBYTE_S 0 u_can_byte_num 0 7 FORMAT "%1.0" SYMBOL_LINK "CAN_TX_BRK_FL" 1 /end CHARACTERISTIC
/begin CHARACTERISTIC CAN_TX_BRK_FL_BIT_LOC "break pos fail msg bit location" VALUE 0x0002038C __UBYTE_S 0 u_can_bit_loc 0 7 FORMAT "%1.0" SYMBOL_LINK "CAN_TX_BRK_FL" 2 /end CHARACTERISTIC
/begin CHARACTERISTIC CAN_TX_BRK_FL_BIT_LEN "break pos fail msg bit length" VALUE 0x0002038C __UBYTE_S 0 u_cnts 0 255 SYMBOL_LINK "CAN_TX_BRK_FL" 3 /end CHARACTERISTIC
/begin CHARACTERISTIC CAN_TX_BRK_FL_TABLE "break pos fail msg table" VAL_BLK 0x0002038C __UBYTE_S 0 u_cnts 0 255 NUMBER 2 SYMBOL_LINK "CAN_TX_BRK_FL" 4 /end CHARACTERISTIC
/begin CHARACTERISTIC CAN_TX_CHKSUM08_ID "checksum msg number" VALUE 0x0002038C __UBYTE_S 0 u_can_txmsg_num 0 255 FORMAT "%3.0" SYMBOL_LINK "CAN_TX_CHKSUM08" 0 /end CHARACTERISTIC
/begin CHARACTERISTIC CAN_TX_CHKSUM08_BYTE_LOC "checksum msg location number" VALUE 0x0002038C __UBYTE_S 0 u_can_byte_num 0 7 FORMAT "%1.0" SYMBOL_LINK "CAN_TX_CHKSUM08" 1 /end CHARACTERISTIC
/begin CHARACTERISTIC CAN_TX_CHKSUM08_BIT_LOC "checksum msg bit location" VALUE 0x0002038C __UBYTE_S 0 u_can_bit_loc 0 7 FORMAT "%1.0" SYMBOL_LINK "CAN_TX_CHKSUM08" 2 /end CHARACTERISTIC
/begin CHARACTERISTIC CAN_TX_CHKSUM08_BIT_LEN "checksum msg bit length" VALUE 0x0002038C __UBYTE_S 0 u_cnts 0 255 SYMBOL_LINK "CAN_TX_CHKSUM08" 3 /end CHARACTERISTIC
/begin CHARACTERISTIC CAN_TX_CHKSUM08_METHOD "checksum calculated method" VALUE 0x0002038C __UBYTE_S 0 u_can_chk_sum 0 19 FORMAT "%2.0" SYMBOL_LINK "CAN_TX_CHKSUM08" 4 /end CHARACTERISTIC
/begin CHARACTERISTIC CAN_TX_CHKSUM09_ID "checksum msg number" VALUE 0x0002038C __UBYTE_S 0 u_can_txmsg_num 0 255 FORMAT "%3.0" SYMBOL_LINK "CAN_TX_CHKSUM09" 0 /end CHARACTERISTIC
/begin CHARACTERISTIC CAN_TX_CHKSUM09_BYTE_LOC "checksum msg location number" VALUE 0x0002038C __UBYTE_S 0 u_can_byte_num 0 7 FORMAT "%1.0" SYMBOL_LINK "CAN_TX_CHKSUM09" 1 /end CHARACTERISTIC
/begin CHARACTERISTIC CAN_TX_CHKSUM09_BIT_LOC "checksum msg bit location" VALUE 0x0002038C __UBYTE_S 0 u_can_bit_loc 0 7 FORMAT "%1.0" SYMBOL_LINK "CAN_TX_CHKSUM09" 2 /end CHARACTERISTIC
/begin CHARACTERISTIC CAN_TX_CHKSUM09_BIT_LEN "checksum msg bit length" VALUE 0x0002038C __UBYTE_S 0 u_cnts 0 255 SYMBOL_LINK "CAN_TX_CHKSUM09" 3 /end CHARACTERISTIC
/begin CHARACTERISTIC CAN_TX_CHKSUM09_METHOD "checksum calculated method" VALUE 0x0002038C __UBYTE_S 0 u_can_chk_sum 0 19 FORMAT "%2.0" SYMBOL_LINK "CAN_TX_CHKSUM09" 4 /end CHARACTERISTIC
/begin CHARACTERISTIC CAN_TX_ROLL_CNT09_ID "rolling counter msg number" VALUE 0x0002038C __UBYTE_S 0 u_can_txmsg_num 0 255 FORMAT "%3.0" SYMBOL_LINK "CAN_TX_ROLL_CNT09" 0 /end CHARACTERISTIC
/begin CHARACTERISTIC CAN_TX_ROLL_CNT09_BYTE_LOC "rolling counter msg location number" VALUE 0x0002038C __UBYTE_S 0 u_can_byte_num 0 7 FORMAT "%1.0" SYMBOL_LINK "CAN_TX_ROLL_CNT09" 1 /end CHARACTERISTIC
/begin CHARACTERISTIC CAN_TX_ROLL_CNT09_BIT_LOC "rolling counter msg bit location" VALUE 0x0002038C __UBYTE_S 0 u_can_bit_loc 0 7 FORMAT "%1.0" SYMBOL_LINK "CAN_TX_ROLL_CNT09" 2 /end CHARACTERISTIC
/begin CHARACTERISTIC CAN_TX_ROLL_CNT09_BIT_LEN "rolling counter msg bit length" VALUE 0x0002038C __UBYTE_S 0 u_cnts 0 255 SYMBOL_LINK "CAN_TX_ROLL_CNT09" 3 /end CHARACTERISTIC
/begin CHARACTERISTIC CAN_TX_ROLL_CNT09_STP "rolling counter msg increase step" VALUE 0x0002038C __UBYTE_S 0 u_cnts 0 255 SYMBOL_LINK "CAN_TX_ROLL_CNT09" 4 /end CHARACTERISTIC
/begin CHARACTERISTIC CAN_TX_ROLL_CNT09_THR "rolling counter msg thr" VALUE 0x0002038C __UBYTE_S 0 u_cnts 0 255 SYMBOL_LINK "CAN_TX_ROLL_CNT09" 5 /end CHARACTERISTIC
/begin CHARACTERISTIC CAN_TX_ROLL_CNT00_ID "rolling counter msg number" VALUE 0x0002038C __UBYTE_S 0 u_can_txmsg_num 0 255 FORMAT "%3.0" SYMBOL_LINK "CAN_TX_ROLL_CNT00" 0 /end CHARACTERISTIC
/begin CHARACTERISTIC CAN_TX_ROLL_CNT00_BYTE_LOC "rolling counter msg location number" VALUE 0x0002038C __UBYTE_S 0 u_can_byte_num 0 7 FORMAT "%1.0" SYMBOL_LINK "CAN_TX_ROLL_CNT00" 1 /end CHARACTERISTIC
/begin CHARACTERISTIC CAN_TX_ROLL_CNT00_BIT_LOC "rolling counter msg bit location" VALUE 0x0002038C __UBYTE_S 0 u_can_bit_loc 0 7 FORMAT "%1.0" SYMBOL_LINK "CAN_TX_ROLL_CNT00" 2 /end CHARACTERISTIC
/begin CHARACTERISTIC CAN_TX_ROLL_CNT00_BIT_LEN "rolling counter msg bit length" VALUE 0x0002038C __UBYTE_S 0 u_cnts 0 255 SYMBOL_LINK "CAN_TX_ROLL_CNT00" 3 /end CHARACTERISTIC
/begin CHARACTERISTIC CAN_TX_ROLL_CNT00_STP "rolling counter msg increase step" VALUE 0x0002038C __UBYTE_S 0 u_cnts 0 255 SYMBOL_LINK "CAN_TX_ROLL_CNT00" 4 /end CHARACTERISTIC
/begin CHARACTERISTIC CAN_TX_ROLL_CNT00_THR "rolling counter msg thr" VALUE 0x0002038C __UBYTE_S 0 u_cnts 0 255 SYMBOL_LINK "CAN_TX_ROLL_CNT00" 5 /end CHARACTERISTIC
/begin CHARACTERISTIC CAN_TX_CUR_DTC_ID "current DTC msg number" VALUE 0x0002038C __UBYTE_S 0 u_can_txmsg_num 0 255 FORMAT "%3.0" SYMBOL_LINK "CAN_TX_CUR_DTC" 0 /end CHARACTERISTIC
/begin CHARACTERISTIC CAN_TX_CUR_DTC_BYTE_LOC "current DTC msg location number" VALUE 0x0002038C __UBYTE_S 0 u_can_byte_num 0 7 FORMAT "%1.0" SYMBOL_LINK "CAN_TX_CUR_DTC" 1 /end CHARACTERISTIC
/begin CHARACTERISTIC CAN_TX_CUR_DTC_BIT_LOC "current DTC msg bit location" VALUE 0x0002038C __UBYTE_S 0 u_can_bit_loc 0 7 FORMAT "%1.0" SYMBOL_LINK "CAN_TX_CUR_DTC" 2 /end CHARACTERISTIC
/begin CHARACTERISTIC CAN_TX_CUR_DTC_BIT_LEN "current DTC msg bit length" VALUE 0x0002038C __UBYTE_S 0 u_cnts 0 255 SYMBOL_LINK "CAN_TX_CUR_DTC" 3 /end CHARACTERISTIC
/begin CHARACTERISTIC CAN_TX_CUR_DTC_A "current DTC msg scaling A" VALUE 0x0002038C __ULONG_S 0 u_fac_65536L 0 65535.9999847412109375 FORMAT "%8.3" SYMBOL_LINK "CAN_TX_CUR_DTC" 4 /end CHARACTERISTIC
/begin CHARACTERISTIC CAN_TX_CUR_DTC_B "current DTC msg scaling B" VALUE 0x0002038C __SWORD_S 0 u_cnt_n3277_p3277 -3276.8 3276.7 FORMAT "%5.1" SYMBOL_LINK "CAN_TX_CUR_DTC" 8 /end CHARACTERISTIC
/begin CHARACTERISTIC CAN_TX_CUR_DTC_MIN "current DTC msg min" VALUE 0x0002038C __UWORD_S 0 u_cnts 0 65535 FORMAT "%5.0" SYMBOL_LINK "CAN_TX_CUR_DTC" 10 /end CHARACTERISTIC
/begin CHARACTERISTIC CAN_TX_CUR_DTC_MAX "current DTC msg max" VALUE 0x0002038C __UWORD_S 0 u_cnts 0 65535 FORMAT "%5.0" SYMBOL_LINK "CAN_TX_CUR_DTC" 12 /end CHARACTERISTIC
/begin CHARACTERISTIC CAN_TX_CUR_DTC_INVALID "current DTC msg invalid value" VALUE 0x0002038C __UWORD_S 0 u_cnts 0 65535 FORMAT "%5.0" SYMBOL_LINK "CAN_TX_CUR_DTC" 14 /end CHARACTERISTIC
/begin CHARACTERISTIC CAN_TX_IGA_AVG_ID "ignition advance average msg number" VALUE 0x0002038C __UBYTE_S 0 u_can_txmsg_num 0 255 FORMAT "%3.0" SYMBOL_LINK "CAN_TX_IGA_AVG" 0 /end CHARACTERISTIC
/begin CHARACTERISTIC CAN_TX_IGA_AVG_BYTE_LOC "ignition advance average msg location number" VALUE 0x0002038C __UBYTE_S 0 u_can_byte_num 0 7 FORMAT "%1.0" SYMBOL_LINK "CAN_TX_IGA_AVG" 1 /end CHARACTERISTIC
/begin CHARACTERISTIC CAN_TX_IGA_AVG_BIT_LOC "ignition advance average msg bit location" VALUE 0x0002038C __UBYTE_S 0 u_can_bit_loc 0 7 FORMAT "%1.0" SYMBOL_LINK "CAN_TX_IGA_AVG" 2 /end CHARACTERISTIC
/begin CHARACTERISTIC CAN_TX_IGA_AVG_BIT_LEN "ignition advance average msg bit length" VALUE 0x0002038C __UBYTE_S 0 u_cnts 0 255 SYMBOL_LINK "CAN_TX_IGA_AVG" 3 /end CHARACTERISTIC
/begin CHARACTERISTIC CAN_TX_IGA_AVG_A "ignition advance average msg scaling A" VALUE 0x0002038C __ULONG_S 0 u_fac_65536L 0 65535.9999847412109375 FORMAT "%8.3" SYMBOL_LINK "CAN_TX_IGA_AVG" 4 /end CHARACTERISTIC
/begin CHARACTERISTIC CAN_TX_IGA_AVG_B "ignition advance average msg scaling B" VALUE 0x0002038C __SWORD_S 0 u_cnt_n3277_p3277 -3276.8 3276.7 FORMAT "%5.1" SYMBOL_LINK "CAN_TX_IGA_AVG" 8 /end CHARACTERISTIC
/begin CHARACTERISTIC CAN_TX_IGA_AVG_MIN "ignition advance average msg min" VALUE 0x0002038C __SWORD_S 0 u_iga -256.000000 255.9921875 FORMAT "%5.2" SYMBOL_LINK "CAN_TX_IGA_AVG" 10 /end CHARACTERISTIC
/begin CHARACTERISTIC CAN_TX_IGA_AVG_MAX "ignition advance average msg max" VALUE 0x0002038C __SWORD_S 0 u_iga -256.000000 255.9921875 FORMAT "%5.2" SYMBOL_LINK "CAN_TX_IGA_AVG" 12 /end CHARACTERISTIC
/begin CHARACTERISTIC CAN_TX_IGA_AVG_INVALID "ignition advance average msg invalid value" VALUE 0x0002038C __UWORD_S 0 u_cnts 0 65535 FORMAT "%5.0" SYMBOL_LINK "CAN_TX_IGA_AVG" 14 /end CHARACTERISTIC
/begin CHARACTERISTIC CAN_TX_IGA_CUR_ID "ignition advance current msg number" VALUE 0x0002038C __UBYTE_S 0 u_can_txmsg_num 0 255 FORMAT "%3.0" SYMBOL_LINK "CAN_TX_IGA_CUR" 0 /end CHARACTERISTIC
/begin CHARACTERISTIC CAN_TX_IGA_CUR_BYTE_LOC "ignition advance current msg location number" VALUE 0x0002038C __UBYTE_S 0 u_can_byte_num 0 7 FORMAT "%1.0" SYMBOL_LINK "CAN_TX_IGA_CUR" 1 /end CHARACTERISTIC
/begin CHARACTERISTIC CAN_TX_IGA_CUR_BIT_LOC "ignition advance current msg bit location" VALUE 0x0002038C __UBYTE_S 0 u_can_bit_loc 0 7 FORMAT "%1.0" SYMBOL_LINK "CAN_TX_IGA_CUR" 2 /end CHARACTERISTIC
/begin CHARACTERISTIC CAN_TX_IGA_CUR_BIT_LEN "ignition advance current msg bit length" VALUE 0x0002038C __UBYTE_S 0 u_cnts 0 255 SYMBOL_LINK "CAN_TX_IGA_CUR" 3 /end CHARACTERISTIC
/begin CHARACTERISTIC CAN_TX_IGA_CUR_A "ignition advance current msg scaling A" VALUE 0x0002038C __ULONG_S 0 u_fac_65536L 0 65535.9999847412109375 FORMAT "%8.3" SYMBOL_LINK "CAN_TX_IGA_CUR" 4 /end CHARACTERISTIC
/begin CHARACTERISTIC CAN_TX_IGA_CUR_B "ignition advance current msg scaling B" VALUE 0x0002038C __SWORD_S 0 u_cnt_n3277_p3277 -3276.8 3276.7 FORMAT "%5.1" SYMBOL_LINK "CAN_TX_IGA_CUR" 8 /end CHARACTERISTIC
/begin CHARACTERISTIC CAN_TX_IGA_CUR_MIN "ignition advance current msg min" VALUE 0x0002038C __SWORD_S 0 u_iga -256.000000 255.9921875 FORMAT "%5.2" SYMBOL_LINK "CAN_TX_IGA_CUR" 10 /end CHARACTERISTIC
/begin CHARACTERISTIC CAN_TX_IGA_CUR_MAX "ignition advance current msg max" VALUE 0x0002038C __SWORD_S 0 u_iga -256.000000 255.9921875 FORMAT "%5.2" SYMBOL_LINK "CAN_TX_IGA_CUR" 12 /end CHARACTERISTIC
/begin CHARACTERISTIC CAN_TX_IGA_CUR_INVALID "ignition advance current msg invalid value" VALUE 0x0002038C __UWORD_S 0 u_cnts 0 65535 FORMAT "%5.0" SYMBOL_LINK "CAN_TX_IGA_CUR" 14 /end CHARACTERISTIC
/begin CHARACTERISTIC CAN_TX_AC_P_FL_ID "AC press fail msg number" VALUE 0x0002038C __UBYTE_S 0 u_can_txmsg_num 0 255 FORMAT "%3.0" SYMBOL_LINK "CAN_TX_AC_P_FL" 0 /end CHARACTERISTIC
/begin CHARACTERISTIC CAN_TX_AC_P_FL_BYTE_LOC "AC press fail msg location number" VALUE 0x0002038C __UBYTE_S 0 u_can_byte_num 0 7 FORMAT "%1.0" SYMBOL_LINK "CAN_TX_AC_P_FL" 1 /end CHARACTERISTIC
/begin CHARACTERISTIC CAN_TX_AC_P_FL_BIT_LOC "AC press fail msg bit location" VALUE 0x0002038C __UBYTE_S 0 u_can_bit_loc 0 7 FORMAT "%1.0" SYMBOL_LINK "CAN_TX_AC_P_FL" 2 /end CHARACTERISTIC
/begin CHARACTERISTIC CAN_TX_AC_P_FL_BIT_LEN "AC press fail msg bit length" VALUE 0x0002038C __UBYTE_S 0 u_cnts 0 255 SYMBOL_LINK "CAN_TX_AC_P_FL" 3 /end CHARACTERISTIC
/begin CHARACTERISTIC CAN_TX_AC_P_FL_TABLE "AC press fail msg table" VAL_BLK 0x0002038C __UBYTE_S 0 u_cnts 0 255 NUMBER 2 SYMBOL_LINK "CAN_TX_AC_P_FL" 4 /end CHARACTERISTIC
/begin CHARACTERISTIC CAN_TX_CLTCH_TOT_DPRS_ST_ID "clutch pedal depressed state msg number" VALUE 0x0002038C __UBYTE_S 0 u_can_txmsg_num 0 255 FORMAT "%3.0" SYMBOL_LINK "CAN_TX_CLTCH_TOT_DPRS_ST" 0 /end CHARACTERISTIC
/begin CHARACTERISTIC CAN_TX_CLTCH_TOT_DPRS_ST_BYTE_LOC "clutch pedal depressed state msg location number" VALUE 0x0002038C __UBYTE_S 0 u_can_byte_num 0 7 FORMAT "%1.0" SYMBOL_LINK "CAN_TX_CLTCH_TOT_DPRS_ST" 1 /end CHARACTERISTIC
/begin CHARACTERISTIC CAN_TX_CLTCH_TOT_DPRS_ST_BIT_LOC "clutch pedal depressed state msg bit location" VALUE 0x0002038C __UBYTE_S 0 u_can_bit_loc 0 7 FORMAT "%1.0" SYMBOL_LINK "CAN_TX_CLTCH_TOT_DPRS_ST" 2 /end CHARACTERISTIC
/begin CHARACTERISTIC CAN_TX_CLTCH_TOT_DPRS_ST_BIT_LEN "clutch pedal depressed state msg bit length" VALUE 0x0002038C __UBYTE_S 0 u_cnts 0 255 SYMBOL_LINK "CAN_TX_CLTCH_TOT_DPRS_ST" 3 /end CHARACTERISTIC
/begin CHARACTERISTIC CAN_TX_CLTCH_TOT_DPRS_ST_TABLE "clutch pedal depressed state msg table" CURVE 0x375CE __UBYTE_S 0 u_cnts 0 255 SYMBOL_LINK "CAN_TX_CLTCH_TOT_DPRS_ST" 4
 /begin AXIS_DESCR FIX_AXIS NO_INPUT_QUANTITY u_can_cltch_dprs_st 4 0 3 /begin FIX_AXIS_PAR_LIST 0 1 2 3 /end FIX_AXIS_PAR_LIST /end AXIS_DESCR
/end CHARACTERISTIC
/begin CHARACTERISTIC CAN_TX_CLTCH_TOT_DPRS_VLD_ID "clutch pedal depressed valid msg number" VALUE 0x0002038C __UBYTE_S 0 u_can_txmsg_num 0 255 FORMAT "%3.0" SYMBOL_LINK "CAN_TX_CLTCH_TOT_DPRS_VLD" 0 /end CHARACTERISTIC
/begin CHARACTERISTIC CAN_TX_CLTCH_TOT_DPRS_VLD_BYTE_LOC "clutch pedal depressed valid msg location number" VALUE 0x0002038C __UBYTE_S 0 u_can_byte_num 0 7 FORMAT "%1.0" SYMBOL_LINK "CAN_TX_CLTCH_TOT_DPRS_VLD" 1 /end CHARACTERISTIC
/begin CHARACTERISTIC CAN_TX_CLTCH_TOT_DPRS_VLD_BIT_LOC "clutch pedal depressed valid msg bit location" VALUE 0x0002038C __UBYTE_S 0 u_can_bit_loc 0 7 FORMAT "%1.0" SYMBOL_LINK "CAN_TX_CLTCH_TOT_DPRS_VLD" 2 /end CHARACTERISTIC
/begin CHARACTERISTIC CAN_TX_CLTCH_TOT_DPRS_VLD_BIT_LEN "clutch pedal depressed valid msg bit length" VALUE 0x0002038C __UBYTE_S 0 u_cnts 0 255 SYMBOL_LINK "CAN_TX_CLTCH_TOT_DPRS_VLD" 3 /end CHARACTERISTIC
/begin CHARACTERISTIC CAN_TX_CLTCH_TOT_DPRS_VLD_TABLE "clutch pedal depressed valid msg table" VAL_BLK 0x0002038C __UBYTE_S 0 u_cnts 0 255 NUMBER 2 SYMBOL_LINK "CAN_TX_CLTCH_TOT_DPRS_VLD" 4 /end CHARACTERISTIC
/begin CHARACTERISTIC CAN_TX_STRT_RLY_CTRL_DIS_ID "starter relay control disable msg number" VALUE 0x0002038C __UBYTE_S 0 u_can_txmsg_num 0 255 FORMAT "%3.0" SYMBOL_LINK "CAN_TX_STRT_RLY_CTRL_DIS" 0 /end CHARACTERISTIC
/begin CHARACTERISTIC CAN_TX_STRT_RLY_CTRL_DIS_BYTE_LOC "starter relay control disable msg location number" VALUE 0x0002038C __UBYTE_S 0 u_can_byte_num 0 7 FORMAT "%1.0" SYMBOL_LINK "CAN_TX_STRT_RLY_CTRL_DIS" 1 /end CHARACTERISTIC
/begin CHARACTERISTIC CAN_TX_STRT_RLY_CTRL_DIS_BIT_LOC "starter relay control disable msg bit location" VALUE 0x0002038C __UBYTE_S 0 u_can_bit_loc 0 7 FORMAT "%1.0" SYMBOL_LINK "CAN_TX_STRT_RLY_CTRL_DIS" 2 /end CHARACTERISTIC
/begin CHARACTERISTIC CAN_TX_STRT_RLY_CTRL_DIS_BIT_LEN "starter relay control disable msg bit length" VALUE 0x0002038C __UBYTE_S 0 u_cnts 0 255 SYMBOL_LINK "CAN_TX_STRT_RLY_CTRL_DIS" 3 /end CHARACTERISTIC
/begin CHARACTERISTIC CAN_TX_STRT_RLY_CTRL_DIS_TABLE "starter relay control disable msg table" VAL_BLK 0x0002038C __UBYTE_S 0 u_cnts 0 255 NUMBER 2 SYMBOL_LINK "CAN_TX_STRT_RLY_CTRL_DIS" 4 /end CHARACTERISTIC
/begin CHARACTERISTIC CAN_TX_AMP_FAC_ID "amp factor msg number" VALUE 0x0002038C __UBYTE_S 0 u_can_txmsg_num 0 255 FORMAT "%3.0" SYMBOL_LINK "CAN_TX_AMP_FAC" 0 /end CHARACTERISTIC
/begin CHARACTERISTIC CAN_TX_AMP_FAC_BYTE_LOC "amp factor msg location number" VALUE 0x0002038C __UBYTE_S 0 u_can_byte_num 0 7 FORMAT "%1.0" SYMBOL_LINK "CAN_TX_AMP_FAC" 1 /end CHARACTERISTIC
/begin CHARACTERISTIC CAN_TX_AMP_FAC_BIT_LOC "amp factor msg bit location" VALUE 0x0002038C __UBYTE_S 0 u_can_bit_loc 0 7 FORMAT "%1.0" SYMBOL_LINK "CAN_TX_AMP_FAC" 2 /end CHARACTERISTIC
/begin CHARACTERISTIC CAN_TX_AMP_FAC_BIT_LEN "amp factor msg bit length" VALUE 0x0002038C __UBYTE_S 0 u_cnts 0 255 SYMBOL_LINK "CAN_TX_AMP_FAC" 3 /end CHARACTERISTIC
/begin CHARACTERISTIC CAN_TX_AMP_FAC_A "amp factor msg scaling A" VALUE 0x0002038C __ULONG_S 0 u_fac_65536L 0 65535.9999847412109375 FORMAT "%8.3" SYMBOL_LINK "CAN_TX_AMP_FAC" 4 /end CHARACTERISTIC
/begin CHARACTERISTIC CAN_TX_AMP_FAC_B "amp factor msg scaling B" VALUE 0x0002038C __SWORD_S 0 u_cnt_n3277_p3277 -3276.8 3276.7 FORMAT "%5.1" SYMBOL_LINK "CAN_TX_AMP_FAC" 8 /end CHARACTERISTIC
/begin CHARACTERISTIC CAN_TX_AMP_FAC_MIN "amp factor msg min" VALUE 0x0002038C __UWORD_S 0 u_fac_4 0 3.99993896484375 FORMAT "%4.3" SYMBOL_LINK "CAN_TX_AMP_FAC" 10 /end CHARACTERISTIC
/begin CHARACTERISTIC CAN_TX_AMP_FAC_MAX "amp factor msg max" VALUE 0x0002038C __UWORD_S 0 u_fac_4 0 3.99993896484375 FORMAT "%4.3" SYMBOL_LINK "CAN_TX_AMP_FAC" 12 /end CHARACTERISTIC
/begin CHARACTERISTIC CAN_TX_AMP_FAC_INVALID "amp factor msg invalid value" VALUE 0x0002038C __UWORD_S 0 u_cnts 0 65535 FORMAT "%5.0" SYMBOL_LINK "CAN_TX_AMP_FAC" 14 /end CHARACTERISTIC
/begin CHARACTERISTIC CAN_TX_CLTCH_EFF_POS_ID "clutch effective position msg number" VALUE 0x0002038C __UBYTE_S 0 u_can_txmsg_num 0 255 FORMAT "%3.0" SYMBOL_LINK "CAN_TX_CLTCH_EFF_POS" 0 /end CHARACTERISTIC
/begin CHARACTERISTIC CAN_TX_CLTCH_EFF_POS_BYTE_LOC "clutch effective position msg location number" VALUE 0x0002038C __UBYTE_S 0 u_can_byte_num 0 7 FORMAT "%1.0" SYMBOL_LINK "CAN_TX_CLTCH_EFF_POS" 1 /end CHARACTERISTIC
/begin CHARACTERISTIC CAN_TX_CLTCH_EFF_POS_BIT_LOC "clutch effective position msg bit location" VALUE 0x0002038C __UBYTE_S 0 u_can_bit_loc 0 7 FORMAT "%1.0" SYMBOL_LINK "CAN_TX_CLTCH_EFF_POS" 2 /end CHARACTERISTIC
/begin CHARACTERISTIC CAN_TX_CLTCH_EFF_POS_BIT_LEN "clutch effective position msg bit length" VALUE 0x0002038C __UBYTE_S 0 u_cnts 0 255 SYMBOL_LINK "CAN_TX_CLTCH_EFF_POS" 3 /end CHARACTERISTIC
/begin CHARACTERISTIC CAN_TX_CLTCH_EFF_POS_A "clutch effective position msg scaling A" VALUE 0x0002038C __ULONG_S 0 u_fac_65536L 0 65535.9999847412109375 FORMAT "%8.3" SYMBOL_LINK "CAN_TX_CLTCH_EFF_POS" 4 /end CHARACTERISTIC
/begin CHARACTERISTIC CAN_TX_CLTCH_EFF_POS_B "clutch effective position msg scaling B" VALUE 0x0002038C __SWORD_S 0 u_cnt_n3277_p3277 -3276.8 3276.7 FORMAT "%5.1" SYMBOL_LINK "CAN_TX_CLTCH_EFF_POS" 8 /end CHARACTERISTIC
/begin CHARACTERISTIC CAN_TX_CLTCH_EFF_POS_MIN "clutch effective position msg min" VALUE 0x0002038C __UWORD_S 0 u_pct_1 0 99.9984741210937 FORMAT "%4.2" SYMBOL_LINK "CAN_TX_CLTCH_EFF_POS" 10 /end CHARACTERISTIC
/begin CHARACTERISTIC CAN_TX_CLTCH_EFF_POS_MAX "clutch effective position msg max" VALUE 0x0002038C __UWORD_S 0 u_pct_1 0 99.9984741210937 FORMAT "%4.2" SYMBOL_LINK "CAN_TX_CLTCH_EFF_POS" 12 /end CHARACTERISTIC
/begin CHARACTERISTIC CAN_TX_CLTCH_EFF_POS_INVALID "clutch effective position msg invalid value" VALUE 0x0002038C __UWORD_S 0 u_cnts 0 65535 FORMAT "%5.0" SYMBOL_LINK "CAN_TX_CLTCH_EFF_POS" 14 /end CHARACTERISTIC
/begin CHARACTERISTIC CAN_TX_BRK_PDL_PARITY_ID "break pedal parity msg number" VALUE 0x0002038C __UBYTE_S 0 u_can_txmsg_num 0 255 FORMAT "%3.0" SYMBOL_LINK "CAN_TX_BRK_PDL_PARITY" 0 /end CHARACTERISTIC
/begin CHARACTERISTIC CAN_TX_BRK_PDL_PARITY_BYTE_LOC "break pedal parity msg location number" VALUE 0x0002038C __UBYTE_S 0 u_can_byte_num 0 7 FORMAT "%1.0" SYMBOL_LINK "CAN_TX_BRK_PDL_PARITY" 1 /end CHARACTERISTIC
/begin CHARACTERISTIC CAN_TX_BRK_PDL_PARITY_BIT_LOC "break pedal parity msg bit location" VALUE 0x0002038C __UBYTE_S 0 u_can_bit_loc 0 7 FORMAT "%1.0" SYMBOL_LINK "CAN_TX_BRK_PDL_PARITY" 2 /end CHARACTERISTIC
/begin CHARACTERISTIC CAN_TX_BRK_PDL_PARITY_BIT_LEN "break pedal parity msg bit length" VALUE 0x0002038C __UBYTE_S 0 u_cnts 0 255 SYMBOL_LINK "CAN_TX_BRK_PDL_PARITY" 3 /end CHARACTERISTIC
/begin CHARACTERISTIC CAN_TX_BRK_PDL_PARITY_TABLE "break pedal parity msg table" VAL_BLK 0x0002038C __UBYTE_S 0 u_cnts 0 255 NUMBER 2 SYMBOL_LINK "CAN_TX_BRK_PDL_PARITY" 4 /end CHARACTERISTIC
/begin CHARACTERISTIC CAN_TX_CLTCH_DPRS_ID "clutch pedal depressed msg number" VALUE 0x0002038C __UBYTE_S 0 u_can_txmsg_num 0 255 FORMAT "%3.0" SYMBOL_LINK "CAN_TX_CLTCH_DPRS" 0 /end CHARACTERISTIC
/begin CHARACTERISTIC CAN_TX_CLTCH_DPRS_BYTE_LOC "clutch pedal depressed msg location number" VALUE 0x0002038C __UBYTE_S 0 u_can_byte_num 0 7 FORMAT "%1.0" SYMBOL_LINK "CAN_TX_CLTCH_DPRS" 1 /end CHARACTERISTIC
/begin CHARACTERISTIC CAN_TX_CLTCH_DPRS_BIT_LOC "clutch pedal depressed msg bit location" VALUE 0x0002038C __UBYTE_S 0 u_can_bit_loc 0 7 FORMAT "%1.0" SYMBOL_LINK "CAN_TX_CLTCH_DPRS" 2 /end CHARACTERISTIC
/begin CHARACTERISTIC CAN_TX_CLTCH_DPRS_BIT_LEN "clutch pedal depressed msg bit length" VALUE 0x0002038C __UBYTE_S 0 u_cnts 0 255 SYMBOL_LINK "CAN_TX_CLTCH_DPRS" 3 /end CHARACTERISTIC
/begin CHARACTERISTIC CAN_TX_CLTCH_DPRS_TABLE "clutch pedal depressed msg table" VAL_BLK 0x0002038C __UBYTE_S 0 u_cnts 0 255 NUMBER 2 SYMBOL_LINK "CAN_TX_CLTCH_DPRS" 4 /end CHARACTERISTIC
/begin CHARACTERISTIC CAN_TX_INFO_1_ID "info msg number" VALUE 0x0002038C __UBYTE_S 0 u_can_txmsg_num 0 255 FORMAT "%3.0" SYMBOL_LINK "CAN_TX_INFO_1" 0 /end CHARACTERISTIC
/begin CHARACTERISTIC CAN_TX_INFO_1_BYTE_LOC "info msg location number" VALUE 0x0002038C __UBYTE_S 0 u_can_byte_num 0 7 FORMAT "%1.0" SYMBOL_LINK "CAN_TX_INFO_1" 1 /end CHARACTERISTIC
/begin CHARACTERISTIC CAN_TX_INFO_1_BIT_LOC "info msg bit location" VALUE 0x0002038C __UBYTE_S 0 u_can_bit_loc 0 7 FORMAT "%1.0" SYMBOL_LINK "CAN_TX_INFO_1" 2 /end CHARACTERISTIC
/begin CHARACTERISTIC CAN_TX_INFO_1_BIT_LEN "info msg bit length" VALUE 0x0002038C __UBYTE_S 0 u_cnts 0 255 SYMBOL_LINK "CAN_TX_INFO_1" 3 /end CHARACTERISTIC
/begin CHARACTERISTIC CAN_TX_INFO_2_ID "info msg number" VALUE 0x0002038C __UBYTE_S 0 u_can_txmsg_num 0 255 FORMAT "%3.0" SYMBOL_LINK "CAN_TX_INFO_2" 0 /end CHARACTERISTIC
/begin CHARACTERISTIC CAN_TX_INFO_2_BYTE_LOC "info msg location number" VALUE 0x0002038C __UBYTE_S 0 u_can_byte_num 0 7 FORMAT "%1.0" SYMBOL_LINK "CAN_TX_INFO_2" 1 /end CHARACTERISTIC
/begin CHARACTERISTIC CAN_TX_INFO_2_BIT_LOC "info msg bit location" VALUE 0x0002038C __UBYTE_S 0 u_can_bit_loc 0 7 FORMAT "%1.0" SYMBOL_LINK "CAN_TX_INFO_2" 2 /end CHARACTERISTIC
/begin CHARACTERISTIC CAN_TX_INFO_2_BIT_LEN "info msg bit length" VALUE 0x0002038C __UBYTE_S 0 u_cnts 0 255 SYMBOL_LINK "CAN_TX_INFO_2" 3 /end CHARACTERISTIC
/begin CHARACTERISTIC CAN_TX_INFO_3_ID "info msg number" VALUE 0x0002038C __UBYTE_S 0 u_can_txmsg_num 0 255 FORMAT "%3.0" SYMBOL_LINK "CAN_TX_INFO_3" 0 /end CHARACTERISTIC
/begin CHARACTERISTIC CAN_TX_INFO_3_BYTE_LOC "info msg location number" VALUE 0x0002038C __UBYTE_S 0 u_can_byte_num 0 7 FORMAT "%1.0" SYMBOL_LINK "CAN_TX_INFO_3" 1 /end CHARACTERISTIC
/begin CHARACTERISTIC CAN_TX_INFO_3_BIT_LOC "info msg bit location" VALUE 0x0002038C __UBYTE_S 0 u_can_bit_loc 0 7 FORMAT "%1.0" SYMBOL_LINK "CAN_TX_INFO_3" 2 /end CHARACTERISTIC
/begin CHARACTERISTIC CAN_TX_INFO_3_BIT_LEN "info msg bit length" VALUE 0x0002038C __UBYTE_S 0 u_cnts 0 255 SYMBOL_LINK "CAN_TX_INFO_3" 3 /end CHARACTERISTIC
/begin CHARACTERISTIC CAN_TX_INFO_4_ID "info msg number" VALUE 0x0002038C __UBYTE_S 0 u_can_txmsg_num 0 255 FORMAT "%3.0" SYMBOL_LINK "CAN_TX_INFO_4" 0 /end CHARACTERISTIC
/begin CHARACTERISTIC CAN_TX_INFO_4_BYTE_LOC "info msg location number" VALUE 0x0002038C __UBYTE_S 0 u_can_byte_num 0 7 FORMAT "%1.0" SYMBOL_LINK "CAN_TX_INFO_4" 1 /end CHARACTERISTIC
/begin CHARACTERISTIC CAN_TX_INFO_4_BIT_LOC "info msg bit location" VALUE 0x0002038C __UBYTE_S 0 u_can_bit_loc 0 7 FORMAT "%1.0" SYMBOL_LINK "CAN_TX_INFO_2" 2 /end CHARACTERISTIC
/begin CHARACTERISTIC CAN_TX_INFO_4_BIT_LEN "info msg bit length" VALUE 0x0002038C __UBYTE_S 0 u_cnts 0 255 SYMBOL_LINK "CAN_TX_INFO_4" 3 /end CHARACTERISTIC
/begin CHARACTERISTIC CAN_TX_INFO_5_ID "info msg number" VALUE 0x0002038C __UBYTE_S 0 u_can_txmsg_num 0 255 FORMAT "%3.0" SYMBOL_LINK "CAN_TX_INFO_5" 0 /end CHARACTERISTIC
/begin CHARACTERISTIC CAN_TX_INFO_5_BYTE_LOC "info msg location number" VALUE 0x0002038C __UBYTE_S 0 u_can_byte_num 0 7 FORMAT "%1.0" SYMBOL_LINK "CAN_TX_INFO_5" 1 /end CHARACTERISTIC
/begin CHARACTERISTIC CAN_TX_INFO_5_BIT_LOC "info msg bit location" VALUE 0x0002038C __UBYTE_S 0 u_can_bit_loc 0 7 FORMAT "%1.0" SYMBOL_LINK "CAN_TX_INFO_5" 2 /end CHARACTERISTIC
/begin CHARACTERISTIC CAN_TX_INFO_5_BIT_LEN "info msg bit length" VALUE 0x0002038C __UBYTE_S 0 u_cnts 0 255 SYMBOL_LINK "CAN_TX_INFO_5" 3 /end CHARACTERISTIC
/begin CHARACTERISTIC CAN_TX_INFO_6_ID "info msg number" VALUE 0x0002038C __UBYTE_S 0 u_can_txmsg_num 0 255 FORMAT "%3.0" SYMBOL_LINK "CAN_TX_INFO_6" 0 /end CHARACTERISTIC
/begin CHARACTERISTIC CAN_TX_INFO_6_BYTE_LOC "info msg location number" VALUE 0x0002038C __UBYTE_S 0 u_can_byte_num 0 7 FORMAT "%1.0" SYMBOL_LINK "CAN_TX_INFO_6" 1 /end CHARACTERISTIC
/begin CHARACTERISTIC CAN_TX_INFO_6_BIT_LOC "info msg bit location" VALUE 0x0002038C __UBYTE_S 0 u_can_bit_loc 0 7 FORMAT "%1.0" SYMBOL_LINK "CAN_TX_INFO_6" 2 /end CHARACTERISTIC
/begin CHARACTERISTIC CAN_TX_INFO_6_BIT_LEN "info msg bit length" VALUE 0x0002038C __UBYTE_S 0 u_cnts 0 255 SYMBOL_LINK "CAN_TX_INFO_6" 3 /end CHARACTERISTIC
/begin CHARACTERISTIC CAN_TX_INFO_7_ID "info msg number" VALUE 0x0002038C __UBYTE_S 0 u_can_txmsg_num 0 255 FORMAT "%3.0" SYMBOL_LINK "CAN_TX_INFO_7" 0 /end CHARACTERISTIC
/begin CHARACTERISTIC CAN_TX_INFO_7_BYTE_LOC "info msg location number" VALUE 0x0002038C __UBYTE_S 0 u_can_byte_num 0 7 FORMAT "%1.0" SYMBOL_LINK "CAN_TX_INFO_7" 1 /end CHARACTERISTIC
/begin CHARACTERISTIC CAN_TX_INFO_7_BIT_LOC "info msg bit location" VALUE 0x0002038C __UBYTE_S 0 u_can_bit_loc 0 7 FORMAT "%1.0" SYMBOL_LINK "CAN_TX_INFO_7" 2 /end CHARACTERISTIC
/begin CHARACTERISTIC CAN_TX_INFO_7_BIT_LEN "info msg bit length" VALUE 0x0002038C __UBYTE_S 0 u_cnts 0 255 SYMBOL_LINK "CAN_TX_INFO_7" 3 /end CHARACTERISTIC
/begin CHARACTERISTIC CAN_TX_INFO_8_ID "info msg number" VALUE 0x0002038C __UBYTE_S 0 u_can_txmsg_num 0 255 FORMAT "%3.0" SYMBOL_LINK "CAN_TX_INFO_8" 0 /end CHARACTERISTIC
/begin CHARACTERISTIC CAN_TX_INFO_8_BYTE_LOC "info msg location number" VALUE 0x0002038C __UBYTE_S 0 u_can_byte_num 0 7 FORMAT "%1.0" SYMBOL_LINK "CAN_TX_INFO_8" 1 /end CHARACTERISTIC
/begin CHARACTERISTIC CAN_TX_INFO_8_BIT_LOC "info msg bit location" VALUE 0x0002038C __UBYTE_S 0 u_can_bit_loc 0 7 FORMAT "%1.0" SYMBOL_LINK "CAN_TX_INFO_8" 2 /end CHARACTERISTIC
/begin CHARACTERISTIC CAN_TX_INFO_8_BIT_LEN "info msg bit length" VALUE 0x0002038C __UBYTE_S 0 u_cnts 0 255 SYMBOL_LINK "CAN_TX_INFO_8" 3 /end CHARACTERISTIC
/begin CHARACTERISTIC CAN_TX_SS_ST_ID "start stop state msg number" VALUE 0x0002038C __UBYTE_S 0 u_can_txmsg_num 0 255 FORMAT "%3.0" SYMBOL_LINK "CAN_TX_SS_ST" 0 /end CHARACTERISTIC
/begin CHARACTERISTIC CAN_TX_SS_ST_BYTE_LOC "start stop state msg location number" VALUE 0x0002038C __UBYTE_S 0 u_can_byte_num 0 7 FORMAT "%1.0" SYMBOL_LINK "CAN_TX_SS_ST" 1 /end CHARACTERISTIC
/begin CHARACTERISTIC CAN_TX_SS_ST_BIT_LOC "start stop state msg bit location" VALUE 0x0002038C __UBYTE_S 0 u_can_bit_loc 0 7 FORMAT "%1.0" SYMBOL_LINK "CAN_TX_SS_ST" 2 /end CHARACTERISTIC
/begin CHARACTERISTIC CAN_TX_SS_ST_BIT_LEN "start stop state msg bit length" VALUE 0x0002038C __UBYTE_S 0 u_cnts 0 255 SYMBOL_LINK "CAN_TX_SS_ST" 3 /end CHARACTERISTIC
/begin CHARACTERISTIC CAN_TX_SS_ST_TABLE "start stop state msg table" CURVE 0x375CE __UBYTE_S 0 u_cnts 0 255 SYMBOL_LINK "CAN_TX_SS_ST" 4
 /begin AXIS_DESCR FIX_AXIS NO_INPUT_QUANTITY u_can_ss_st 17 0 16 /begin FIX_AXIS_PAR_LIST 0 1 2 3 4 5 6 7 8 9 10 11 12 13 14 15 16 /end FIX_AXIS_PAR_LIST /end AXIS_DESCR
/end CHARACTERISTIC
/begin CHARACTERISTIC CAN_TX_STBL_TROT_TQ_ID "Stable throttle flow torque msg number" VALUE 0x0002038C __UBYTE_S 0 u_can_txmsg_num 0 255 FORMAT "%3.0" SYMBOL_LINK "CAN_TX_STBL_TROT_TQ" 0 /end CHARACTERISTIC
/begin CHARACTERISTIC CAN_TX_STBL_TROT_TQ_BYTE_LOC "Stable throttle flow torque msg location number" VALUE 0x0002038C __UBYTE_S 0 u_can_byte_num 0 7 FORMAT "%1.0" SYMBOL_LINK "CAN_TX_STBL_TROT_TQ" 1 /end CHARACTERISTIC
/begin CHARACTERISTIC CAN_TX_STBL_TROT_TQ_BIT_LOC "Stable throttle flow torque msg bit location" VALUE 0x0002038C __UBYTE_S 0 u_can_bit_loc 0 7 FORMAT "%1.0" SYMBOL_LINK "CAN_TX_STBL_TROT_TQ" 2 /end CHARACTERISTIC
/begin CHARACTERISTIC CAN_TX_STBL_TROT_TQ_BIT_LEN "Stable throttle flow torque msg bit length" VALUE 0x0002038C __UBYTE_S 0 u_cnts 0 255 SYMBOL_LINK "CAN_TX_STBL_TROT_TQ" 3 /end CHARACTERISTIC
/begin CHARACTERISTIC CAN_TX_STBL_TROT_TQ_A "Stable throttle flow torque msg scaling A" VALUE 0x0002038C __ULONG_S 0 u_fac_65536L 0 65535.9999847412109375 FORMAT "%8.3" SYMBOL_LINK "CAN_TX_STBL_TROT_TQ" 4 /end CHARACTERISTIC
/begin CHARACTERISTIC CAN_TX_STBL_TROT_TQ_B "Stable throttle flow torque msg scaling B" VALUE 0x0002038C __SWORD_S 0 u_cnt_n3277_p3277 -3276.8 3276.7 FORMAT "%5.1" SYMBOL_LINK "CAN_TX_STBL_TROT_TQ" 8 /end CHARACTERISTIC
/begin CHARACTERISTIC CAN_TX_STBL_TROT_TQ_MIN "Stable throttle flow torque msg min" VALUE 0x0002038C __SWORD_S 0 u_nm_s -2048 2047.9375 SYMBOL_LINK "CAN_TX_STBL_TROT_TQ" 10 /end CHARACTERISTIC
/begin CHARACTERISTIC CAN_TX_STBL_TROT_TQ_MAX "Stable throttle flow torque msg max" VALUE 0x0002038C __SWORD_S 0 u_nm_s -2048 2047.9375 SYMBOL_LINK "CAN_TX_STBL_TROT_TQ" 12 /end CHARACTERISTIC
/begin CHARACTERISTIC CAN_TX_STBL_TROT_TQ_INVALID "Stable throttle flow torque msg invalid value" VALUE 0x0002038C __UWORD_S 0 u_cnts 0 65535 FORMAT "%5.0" SYMBOL_LINK "CAN_TX_STBL_TROT_TQ" 14 /end CHARACTERISTIC
/begin CHARACTERISTIC CAN_TX_STBL_TROT_TQ_UNIT "Stable throttle flow torque msg invalid value" VALUE 0x0002038C __UBYTE_S 0 u_can_tq_unit 0 1 FORMAT "%1.0" SYMBOL_LINK "CAN_TX_STBL_TROT_TQ" 16 /end CHARACTERISTIC
/begin CHARACTERISTIC CAN_TX_FLYW_TQ_RAW_SP_TQ_ID "Raw flywheel torque setpoint msg number" VALUE 0x0002038C __UBYTE_S 0 u_can_txmsg_num 0 255 FORMAT "%3.0" SYMBOL_LINK "CAN_TX_FLYW_TQ_RAW_SP" 0 /end CHARACTERISTIC
/begin CHARACTERISTIC CAN_TX_FLYW_TQ_RAW_SP_BYTE_LOC "Raw flywheel torque setpoint msg location number" VALUE 0x0002038C __UBYTE_S 0 u_can_byte_num 0 7 FORMAT "%1.0" SYMBOL_LINK "CAN_TX_FLYW_TQ_RAW_SP" 1 /end CHARACTERISTIC
/begin CHARACTERISTIC CAN_TX_FLYW_TQ_RAW_SP_BIT_LOC "Raw flywheel torque setpoint msg bit location" VALUE 0x0002038C __UBYTE_S 0 u_can_bit_loc 0 7 FORMAT "%1.0" SYMBOL_LINK "CAN_TX_FLYW_TQ_RAW_SP" 2 /end CHARACTERISTIC
/begin CHARACTERISTIC CAN_TX_FLYW_TQ_RAW_SP_BIT_LEN "Raw flywheel torque setpoint msg bit length" VALUE 0x0002038C __UBYTE_S 0 u_cnts 0 255 SYMBOL_LINK "CAN_TX_FLYW_TQ_RAW_SP" 3 /end CHARACTERISTIC
/begin CHARACTERISTIC CAN_TX_FLYW_TQ_RAW_SP_A "Raw flywheel torque setpoint msg scaling A" VALUE 0x0002038C __ULONG_S 0 u_fac_65536L 0 65535.9999847412109375 FORMAT "%8.3" SYMBOL_LINK "CAN_TX_FLYW_TQ_RAW_SP" 4 /end CHARACTERISTIC
/begin CHARACTERISTIC CAN_TX_FLYW_TQ_RAW_SP_B "Raw flywheel torque setpoint msg scaling B" VALUE 0x0002038C __SWORD_S 0 u_cnt_n3277_p3277 -3276.8 3276.7 FORMAT "%5.1" SYMBOL_LINK "CAN_TX_FLYW_TQ_RAW_SP" 8 /end CHARACTERISTIC
/begin CHARACTERISTIC CAN_TX_FLYW_TQ_RAW_SP_MIN "Raw flywheel torque setpoint msg min" VALUE 0x0002038C __SWORD_S 0 u_nm_s -2048 2047.9375 SYMBOL_LINK "CAN_TX_FLYW_TQ_RAW_SP" 10 /end CHARACTERISTIC
/begin CHARACTERISTIC CAN_TX_FLYW_TQ_RAW_SP_MAX "Raw flywheel torque setpoint msg max" VALUE 0x0002038C __SWORD_S 0 u_nm_s -2048 2047.9375 SYMBOL_LINK "CAN_TX_FLYW_TQ_RAW_SP" 12 /end CHARACTERISTIC
/begin CHARACTERISTIC CAN_TX_FLYW_TQ_RAW_SP_INVALID "Raw flywheel torque setpoint msg invalid value" VALUE 0x0002038C __UWORD_S 0 u_cnts 0 65535 FORMAT "%5.0" SYMBOL_LINK "CAN_TX_FLYW_TQ_RAW_SP" 14 /end CHARACTERISTIC
/begin CHARACTERISTIC CAN_TX_FLYW_TQ_RAW_SP_UNIT "Raw flywheel torque setpoint msg invalid value" VALUE 0x0002038C __UBYTE_S 0 u_can_tq_unit 0 1 FORMAT "%1.0" SYMBOL_LINK "CAN_TX_FLYW_TQ_RAW_SP" 16 /end CHARACTERISTIC
/begin CHARACTERISTIC CAN_TX_FLYW_TQ_SLW_SP_TQ_ID "Slow flywheel torque setpoint msg number" VALUE 0x0002038C __UBYTE_S 0 u_can_txmsg_num 0 255 FORMAT "%3.0" SYMBOL_LINK "CAN_TX_FLYW_TQ_SLW_SP" 0 /end CHARACTERISTIC
/begin CHARACTERISTIC CAN_TX_FLYW_TQ_SLW_SP_BYTE_LOC "Slow flywheel torque setpoint msg location number" VALUE 0x0002038C __UBYTE_S 0 u_can_byte_num 0 7 FORMAT "%1.0" SYMBOL_LINK "CAN_TX_FLYW_TQ_SLW_SP" 1 /end CHARACTERISTIC
/begin CHARACTERISTIC CAN_TX_FLYW_TQ_SLW_SP_BIT_LOC "Slow flywheel torque setpoint msg bit location" VALUE 0x0002038C __UBYTE_S 0 u_can_bit_loc 0 7 FORMAT "%1.0" SYMBOL_LINK "CAN_TX_FLYW_TQ_SLW_SP" 2 /end CHARACTERISTIC
/begin CHARACTERISTIC CAN_TX_FLYW_TQ_SLW_SP_BIT_LEN "Slow flywheel torque setpoint msg bit length" VALUE 0x0002038C __UBYTE_S 0 u_cnts 0 255 SYMBOL_LINK "CAN_TX_FLYW_TQ_SLW_SP" 3 /end CHARACTERISTIC
/begin CHARACTERISTIC CAN_TX_FLYW_TQ_SLW_SP_A "Slow flywheel torque setpoint msg scaling A" VALUE 0x0002038C __ULONG_S 0 u_fac_65536L 0 65535.9999847412109375 FORMAT "%8.3" SYMBOL_LINK "CAN_TX_FLYW_TQ_SLW_SP" 4 /end CHARACTERISTIC
/begin CHARACTERISTIC CAN_TX_FLYW_TQ_SLW_SP_B "Slow flywheel torque setpoint msg scaling B" VALUE 0x0002038C __SWORD_S 0 u_cnt_n3277_p3277 -3276.8 3276.7 FORMAT "%5.1" SYMBOL_LINK "CAN_TX_FLYW_TQ_SLW_SP" 8 /end CHARACTERISTIC
/begin CHARACTERISTIC CAN_TX_FLYW_TQ_SLW_SP_MIN "Slow flywheel torque setpoint msg min" VALUE 0x0002038C __SWORD_S 0 u_nm_s -2048 2047.9375 SYMBOL_LINK "CAN_TX_FLYW_TQ_SLW_SP" 10 /end CHARACTERISTIC
/begin CHARACTERISTIC CAN_TX_FLYW_TQ_SLW_SP_MAX "Slow flywheel torque setpoint msg max" VALUE 0x0002038C __SWORD_S 0 u_nm_s -2048 2047.9375 SYMBOL_LINK "CAN_TX_FLYW_TQ_SLW_SP" 12 /end CHARACTERISTIC
/begin CHARACTERISTIC CAN_TX_FLYW_TQ_SLW_SP_INVALID "Slow flywheel torque setpoint msg invalid value" VALUE 0x0002038C __UWORD_S 0 u_cnts 0 65535 FORMAT "%5.0" SYMBOL_LINK "CAN_TX_FLYW_TQ_SLW_SP" 14 /end CHARACTERISTIC
/begin CHARACTERISTIC CAN_TX_FLYW_TQ_SLW_SP_UNIT "Slow flywheel torque setpoint msg invalid value" VALUE 0x0002038C __UBYTE_S 0 u_can_tq_unit 0 1 FORMAT "%1.0" SYMBOL_LINK "CAN_TX_FLYW_TQ_SLW_SP" 16 /end CHARACTERISTIC
/begin CHARACTERISTIC CAN_TX_FRIC_TQ_ID "Actual friction torque including rubbing,pumping and total accessory torque msg number" VALUE 0x0002038C __UBYTE_S 0 u_can_txmsg_num 0 255 FORMAT "%3.0" SYMBOL_LINK "CAN_TX_FRIC_TQ" 0 /end CHARACTERISTIC
/begin CHARACTERISTIC CAN_TX_FRIC_TQ_BYTE_LOC "Actual friction torque including rubbing,pumping and total accessory torque msg location number" VALUE 0x0002038C __UBYTE_S 0 u_can_byte_num 0 7 FORMAT "%1.0" SYMBOL_LINK "CAN_TX_FRIC_TQ" 1 /end CHARACTERISTIC
/begin CHARACTERISTIC CAN_TX_FRIC_TQ_BIT_LOC "Actual friction torque including rubbing,pumping and total accessory torque msg bit location" VALUE 0x0002038C __UBYTE_S 0 u_can_bit_loc 0 7 FORMAT "%1.0" SYMBOL_LINK "CAN_TX_FRIC_TQ" 2 /end CHARACTERISTIC
/begin CHARACTERISTIC CAN_TX_FRIC_TQ_BIT_LEN "Actual friction torque including rubbing,pumping and total accessory torque msg bit length" VALUE 0x0002038C __UBYTE_S 0 u_cnts 0 255 SYMBOL_LINK "CAN_TX_FRIC_TQ" 3 /end CHARACTERISTIC
/begin CHARACTERISTIC CAN_TX_FRIC_TQ_A "Actual friction torque including rubbing,pumping and total accessory torque msg scaling A" VALUE 0x0002038C __ULONG_S 0 u_fac_65536L 0 65535.9999847412109375 FORMAT "%8.3" SYMBOL_LINK "CAN_TX_FRIC_TQ" 4 /end CHARACTERISTIC
/begin CHARACTERISTIC CAN_TX_FRIC_TQ_B "Actual friction torque including rubbing,pumping and total accessory torque msg scaling B" VALUE 0x0002038C __SWORD_S 0 u_cnt_n3277_p3277 -3276.8 3276.7 FORMAT "%5.1" SYMBOL_LINK "CAN_TX_FRIC_TQ" 8 /end CHARACTERISTIC
/begin CHARACTERISTIC CAN_TX_FRIC_TQ_MIN "Actual friction torque including rubbing,pumping and total accessory torque msg min" VALUE 0x0002038C __SWORD_S 0 u_nm_s -2048 2047.9375 SYMBOL_LINK "CAN_TX_FRIC_TQ" 10 /end CHARACTERISTIC
/begin CHARACTERISTIC CAN_TX_FRIC_TQ_MAX "Actual friction torque including rubbing,pumping and total accessory torque msg max" VALUE 0x0002038C __SWORD_S 0 u_nm_s -2048 2047.9375 SYMBOL_LINK "CAN_TX_FRIC_TQ" 12 /end CHARACTERISTIC
/begin CHARACTERISTIC CAN_TX_FRIC_TQ_INVALID "Actual friction torque including rubbing,pumping and total accessory torque msg invalid value" VALUE 0x0002038C __UWORD_S 0 u_cnts 0 65535 FORMAT "%5.0" SYMBOL_LINK "CAN_TX_FRIC_TQ" 14 /end CHARACTERISTIC
/begin CHARACTERISTIC CAN_TX_FRIC_TQ_UNIT "Actual friction torque including rubbing,pumping and total accessory torque msg invalid value" VALUE 0x0002038C __UBYTE_S 0 u_can_tq_unit 0 1 FORMAT "%1.0" SYMBOL_LINK "CAN_TX_FRIC_TQ" 16 /end CHARACTERISTIC
/begin CHARACTERISTIC CAN_TX_MX_TQ_ID "Max indicate torque or flywheel torque decided by the cal selection msg number" VALUE 0x0002038C __UBYTE_S 0 u_can_txmsg_num 0 255 FORMAT "%3.0" SYMBOL_LINK "CAN_TX_MX_TQ" 0 /end CHARACTERISTIC
/begin CHARACTERISTIC CAN_TX_MX_TQ_BYTE_LOC "Max indicate torque or flywheel torque decided by the cal selection msg location number" VALUE 0x0002038C __UBYTE_S 0 u_can_byte_num 0 7 FORMAT "%1.0" SYMBOL_LINK "CAN_TX_MX_TQ" 1 /end CHARACTERISTIC
/begin CHARACTERISTIC CAN_TX_MX_TQ_BIT_LOC "Max indicate torque or flywheel torque decided by the cal selection msg bit location" VALUE 0x0002038C __UBYTE_S 0 u_can_bit_loc 0 7 FORMAT "%1.0" SYMBOL_LINK "CAN_TX_MX_TQ" 2 /end CHARACTERISTIC
/begin CHARACTERISTIC CAN_TX_MX_TQ_BIT_LEN "Max indicate torque or flywheel torque decided by the cal selection msg bit length" VALUE 0x0002038C __UBYTE_S 0 u_cnts 0 255 SYMBOL_LINK "CAN_TX_MX_TQ" 3 /end CHARACTERISTIC
/begin CHARACTERISTIC CAN_TX_MX_TQ_A "Max indicate torque or flywheel torque decided by the cal selection msg scaling A" VALUE 0x0002038C __ULONG_S 0 u_fac_65536L 0 65535.9999847412109375 FORMAT "%8.3" SYMBOL_LINK "CAN_TX_MX_TQ" 4 /end CHARACTERISTIC
/begin CHARACTERISTIC CAN_TX_MX_TQ_B "Max indicate torque or flywheel torque decided by the cal selection msg scaling B" VALUE 0x0002038C __SWORD_S 0 u_cnt_n3277_p3277 -3276.8 3276.7 FORMAT "%5.1" SYMBOL_LINK "CAN_TX_MX_TQ" 8 /end CHARACTERISTIC
/begin CHARACTERISTIC CAN_TX_MX_TQ_MIN "Max indicate torque or flywheel torque decided by the cal selection msg min" VALUE 0x0002038C __SWORD_S 0 u_nm_s -2048 2047.9375 SYMBOL_LINK "CAN_TX_MX_TQ" 10 /end CHARACTERISTIC
/begin CHARACTERISTIC CAN_TX_MX_TQ_MAX "Max indicate torque or flywheel torque decided by the cal selection msg max" VALUE 0x0002038C __SWORD_S 0 u_nm_s -2048 2047.9375 SYMBOL_LINK "CAN_TX_MX_TQ" 12 /end CHARACTERISTIC
/begin CHARACTERISTIC CAN_TX_MX_TQ_INVALID "Max indicate torque or flywheel torque decided by the cal selection msg invalid value" VALUE 0x0002038C __UWORD_S 0 u_cnts 0 65535 FORMAT "%5.0" SYMBOL_LINK "CAN_TX_MX_TQ" 14 /end CHARACTERISTIC
/begin CHARACTERISTIC CAN_TX_MX_TQ_UNIT "Max indicate torque or flywheel torque decided by the cal selection msg invalid value" VALUE 0x0002038C __UBYTE_S 0 u_can_tq_unit 0 1 FORMAT "%1.0" SYMBOL_LINK "CAN_TX_MX_TQ" 16 /end CHARACTERISTIC
/begin CHARACTERISTIC CAN_TX_MN_TQ_ID "Minimum torque msg number" VALUE 0x0002038C __UBYTE_S 0 u_can_txmsg_num 0 255 FORMAT "%3.0" SYMBOL_LINK "CAN_TX_MN_TQ" 0 /end CHARACTERISTIC
/begin CHARACTERISTIC CAN_TX_MN_TQ_BYTE_LOC "Minimum torque msg location number" VALUE 0x0002038C __UBYTE_S 0 u_can_byte_num 0 7 FORMAT "%1.0" SYMBOL_LINK "CAN_TX_MN_TQ" 1 /end CHARACTERISTIC
/begin CHARACTERISTIC CAN_TX_MN_TQ_BIT_LOC "Minimum torque msg bit location" VALUE 0x0002038C __UBYTE_S 0 u_can_bit_loc 0 7 FORMAT "%1.0" SYMBOL_LINK "CAN_TX_MN_TQ" 2 /end CHARACTERISTIC
/begin CHARACTERISTIC CAN_TX_MN_TQ_BIT_LEN "Minimum torque msg bit length" VALUE 0x0002038C __UBYTE_S 0 u_cnts 0 255 SYMBOL_LINK "CAN_TX_MN_TQ" 3 /end CHARACTERISTIC
/begin CHARACTERISTIC CAN_TX_MN_TQ_A "Minimum torque msg scaling A" VALUE 0x0002038C __ULONG_S 0 u_fac_65536L 0 65535.9999847412109375 FORMAT "%8.3" SYMBOL_LINK "CAN_TX_MN_TQ" 4 /end CHARACTERISTIC
/begin CHARACTERISTIC CAN_TX_MN_TQ_B "Minimum torque msg scaling B" VALUE 0x0002038C __SWORD_S 0 u_cnt_n3277_p3277 -3276.8 3276.7 FORMAT "%5.1" SYMBOL_LINK "CAN_TX_MN_TQ" 8 /end CHARACTERISTIC
/begin CHARACTERISTIC CAN_TX_MN_TQ_MIN "Minimum torque msg min" VALUE 0x0002038C __SWORD_S 0 u_nm_s -2048 2047.9375 SYMBOL_LINK "CAN_TX_MN_TQ" 10 /end CHARACTERISTIC
/begin CHARACTERISTIC CAN_TX_MN_TQ_MAX "Minimum torque msg max" VALUE 0x0002038C __SWORD_S 0 u_nm_s -2048 2047.9375 SYMBOL_LINK "CAN_TX_MN_TQ" 12 /end CHARACTERISTIC
/begin CHARACTERISTIC CAN_TX_MN_TQ_INVALID "Minimum torque msg invalid value" VALUE 0x0002038C __UWORD_S 0 u_cnts 0 65535 FORMAT "%5.0" SYMBOL_LINK "CAN_TX_MN_TQ" 14 /end CHARACTERISTIC
/begin CHARACTERISTIC CAN_TX_MN_TQ_UNIT "Minimum torque msg invalid value" VALUE 0x0002038C __UBYTE_S 0 u_can_tq_unit 0 1 FORMAT "%1.0" SYMBOL_LINK "CAN_TX_MN_TQ" 16 /end CHARACTERISTIC
/begin COMPU_METHOD u_volt_32 "voltage" RAT_FUNC "%6.4" "V" COEFFS 0.0 1.0 0.000000 0.0 0.0 0.00048828125 /end COMPU_METHOD
/begin COMPU_METHOD u_kPa_0_256 "press" RAT_FUNC "%5.2" "kPa" COEFFS 0.0 1.0 0.000000 0.0 0.0 0.00390625 /end COMPU_METHOD
/begin COMPU_METHOD u_fac_4 "factor" RAT_FUNC "%5.4" "fac" COEFFS 0.0 1.0 0.000000 0.0 0.0 0.00006103515625 /end COMPU_METHOD
/begin COMPU_METHOD u_km_hi "kilometers" RAT_FUNC "%5.0" "km" COEFFS 0.0 1.0 0.000000 0.0 0.0 0.00390625 /end COMPU_METHOD
/begin COMPU_METHOD u_ul "microliter" RAT_FUNC "%7.3" "ul" COEFFS 0.0 1.0 0.000000 0.0 0.0 0.03125 /end COMPU_METHOD
/begin COMPU_METHOD u_ul_lo "microliter" RAT_FUNC "%7.3" "ul" COEFFS 0.0 1.0 0.000000 0.0 0.0 0.015625 /end COMPU_METHOD
/begin COMPU_METHOD u_deg_C "degC" RAT_FUNC "%5.2" "¡æ" COEFFS 0.0 1.0 0.0 0.0 0.0 0.0078125 /end COMPU_METHOD
/begin COMPU_METHOD u_deg_C_n2048_p2048 "degC" RAT_FUNC "%5.1" "¡æ" COEFFS 0.0 1.0 0.0 0.0 0.0 0.0625 /end COMPU_METHOD
/begin COMPU_METHOD u_cnts "counts" RAT_FUNC "%3.0" "cnts" COEFFS 0.0 1.0 0.0 0.0 0.0 1.0 /end COMPU_METHOD
/begin COMPU_METHOD u_min "min timer" RAT_FUNC "%5.0" "min" COEFFS 0.0 1.0 0.0 0.0 0.0 1.00 /end COMPU_METHOD
/begin COMPU_METHOD u_1s_tmr "1 sec timer" RAT_FUNC "%5.0" "s" COEFFS 0.0 1.0 0.0 0.0 0.0 1.0 /end COMPU_METHOD
/begin COMPU_METHOD u_nm_s "torque" RAT_FUNC "%6.2" "Nm" COEFFS 0.0 1.0 0.0 0.0 0.0 0.0625 /end COMPU_METHOD
/begin COMPU_METHOD u_fan_ctrl_typ "" TAB_VERB "%4.0" "" COMPU_TAB_REF u_fan_ctrl_typ /end COMPU_METHOD
/begin COMPU_VTAB u_fan_ctrl_typ "" TAB_VERB 4 0 "OFF" 1 "LOW" 2 "MED" 3 "HIGH" /end COMPU_VTAB
/begin COMPU_METHOD u_espd "engine speed" RAT_FUNC "%5.2" "rpm" COEFFS 0.0 1.0 0.000000 0.0 0.0 0.125 /end COMPU_METHOD
/begin COMPU_METHOD u_vspd "vehicle speed" RAT_FUNC "%5.2" "kph" COEFFS 0.0 1.0 0.000000 0.0 0.0 0.0078125 /end COMPU_METHOD
/begin COMPU_METHOD u_pct "percentage" RAT_FUNC "%5.2" "%" COEFFS 0.0 1.0 0.000000 0.0 0.0 0.0030517578125 /end COMPU_METHOD
/begin COMPU_METHOD u_pct_1 "percentage" RAT_FUNC "%5.2" "%" COEFFS 0.0 1.0 0.000000 0.0 0.0 0.00152587890625 /end COMPU_METHOD
/begin COMPU_METHOD u_iga "ignition angle" RAT_FUNC "%3.1" "Deg" COEFFS 0.0 1.0 0.000000 0.0 0.0 0.0078125 /end COMPU_METHOD
/begin COMPU_METHOD u_fac_65536L "factor" RAT_FUNC "%10.5" "fac" COEFFS 0.0 1.0 0.000000 0.0 0.0 0.0000152587890625 /end COMPU_METHOD
/begin COMPU_METHOD u_cnt_n3277_p3277 "counts" RAT_FUNC "%10.5" "cnt" COEFFS 0.0 1.0 0.000000 0.0 0.0 0.1 /end COMPU_METHOD
/begin COMPU_METHOD u_can_txmsg_num "" TAB_VERB "%6.3" "" COMPU_TAB_REF u_can_txmsg_num /end COMPU_METHOD
/begin COMPU_VTAB u_can_txmsg_num "" TAB_VERB 17 0 "MSG0" 1 "MSG1" 2 "MSG2" 3 "MSG3" 4 "MSG4" 5 "MSG5" 6 "MSG6" 7 "MSG7" 8 "MSG8" 9 "MSG9" 10 "MSG10" 11 "MSG11" 12 "MSG12" 13 "MSG13" 14 "MSG14" 15 "MSG15" 255 "OFF" /end COMPU_VTAB
/begin COMPU_METHOD u_can_byte_num "" TAB_VERB "%6.3" "" COMPU_TAB_REF u_can_byte_num /end COMPU_METHOD
/begin COMPU_VTAB u_can_byte_num "" TAB_VERB 8 0 "BYTE0" 1 "BYTE1" 2 "BYTE2" 3 "BYTE3" 4 "BYTE4" 5 "BYTE5" 6 "BYTE6" 7 "BYTE7" /end COMPU_VTAB
/begin COMPU_METHOD u_can_bit_loc "" TAB_VERB "%6.3" "" COMPU_TAB_REF u_can_bit_loc /end COMPU_METHOD
/begin COMPU_VTAB u_can_bit_loc "" TAB_VERB 8 0 "BIT0" 1 "BIT1" 2 "BIT2" 3 "BIT3" 4 "BIT4" 5 "BIT5" 6 "BIT6" 7 "BIT7" /end COMPU_VTAB
/begin COMPU_METHOD u_can_ecu_st "" TAB_VERB "%6.3" "" COMPU_TAB_REF u_can_ecu_st /end COMPU_METHOD
/begin COMPU_VTAB u_can_ecu_st "" TAB_VERB 14 0 "OFF" 1 "KEYON" 2 "CRANK" 3 "RUN" 4 "STALL" 5 "POWEROFFDELAY" 6 "SHUTTING_DOWN" 7 "STOPPING" 8 "STOPPED" 9 "FUEL_CUT" 10 "ENG_IDLE" 11 "ENG_FULL_LOAD" 12 "ENG_DASHPOT" 13 "ENG_PART_LOAD" /end COMPU_VTAB
/begin COMPU_METHOD u_can_n_sw_st "" TAB_VERB "%6.3" "" COMPU_TAB_REF u_can_n_sw_st /end COMPU_METHOD
/begin COMPU_VTAB u_can_n_sw_st "" TAB_VERB 4 0 "N_INACTV" 1 "N_ACTV" 2 "RESERVE" 3 "ERROR" /end COMPU_VTAB
/begin COMPU_METHOD u_can_cltch_pedl_st "" TAB_VERB "%6.3" "" COMPU_TAB_REF u_can_cltch_pedl_st /end COMPU_METHOD
/begin COMPU_VTAB u_can_cltch_pedl_st "" TAB_VERB 4 0 "UNPRESSED" 1 "PRESSED" 2 "RESERVED" 3 "ERROR" /end COMPU_VTAB
/begin COMPU_METHOD u_can_immo_recv "" TAB_VERB "%6.3" "" COMPU_TAB_REF u_can_immo_recv /end COMPU_METHOD
/begin COMPU_VTAB u_can_immo_recv "" TAB_VERB 6 0 "INACTIVE" 1 "FAIL" 2 "SUCCESS" 3 "AUTHENTICATING" 4 "EMPTY_ECU" 5 "DISABLE" /end COMPU_VTAB
/begin COMPU_METHOD u_can_tq_unit "" TAB_VERB "%6.3" "" COMPU_TAB_REF u_can_tq_unit /end COMPU_METHOD
/begin COMPU_VTAB u_can_tq_unit "" TAB_VERB 2 0 "Nm" 1 "Pct" /end COMPU_VTAB
/begin COMPU_METHOD u_can_shft_st "" TAB_VERB "%6.3" "" COMPU_TAB_REF u_can_shft_st /end COMPU_METHOD
/begin COMPU_VTAB u_can_shft_st "" TAB_VERB 4 0 "NO_SHIFT" 1 "SHIFT_UP" 2 "SHIFT_DOWN" 3 "INVALID" /end COMPU_VTAB
/begin COMPU_METHOD u_can_shft_gear "" TAB_VERB "%6.3" "" COMPU_TAB_REF u_can_shft_gear /end COMPU_METHOD
/begin COMPU_VTAB u_can_shft_gear "" TAB_VERB 7 0 "UNKNOOW" 1 "GEAR_1" 2 "GEAR_2" 3 "GEAR_3" 4 "GEAR_4" 5 "GEAR_5" 6 "GEAR_6" /end COMPU_VTAB
/begin COMPU_METHOD u_can_cru_sw_st "" TAB_VERB "%10.4" "" COMPU_TAB_REF u_can_cru_sw_st /end COMPU_METHOD
/begin COMPU_VTAB u_can_cru_sw_st "" TAB_VERB 6 0 "NONE" 1 "MAIN" 2 "SET_COAST" 3 "RES_ACC" 4 "CANCEL" 5 "INVALID" /end COMPU_VTAB
/begin COMPU_METHOD u_can_chk_sum "" TAB_VERB "%10.4" "" COMPU_TAB_REF u_can_chk_sum /end COMPU_METHOD
/begin COMPU_VTAB u_can_chk_sum "" TAB_VERB 20 0 "SUM_XOR_FF" 1 "XOR_BY_BYTE_WITH_ID" 2 "CRASHOUT_XOR_HALF_BYTE" 3 "SUM_ALL_XOR_FF" 4 "SUM_TWO_COMPLEMENT" 5 "XOR_IN_7_BYTES" 6 "CRC8" 7 "XOR_7_BYTES_4_BITS" 8 "SUM_7_BYTES_XOR_FF" 9 "XOR_FIRST_4_BYTES_4_BITS" 10 "DFLZM_SRS" 11 "UPPER_NIBBLE_BYTE_SUM_XOR_F0" 12 "CRC32" 13 "SUM_AND_FF" 14 "7_BYTES_XOR" 15 "HALF_BYTE_INVERT" 16 "SUM_7_BYTES_ADD_UNCHKSUM_4_BIT_AND_0F" 17 "CRC8_GW" 18 "CRC8_COMMON" 19 "7_BYTES_XOR_ROLLING_CNTS_4_BITS" /end COMPU_VTAB
/begin COMPU_METHOD u_can_cltch_dprs_st "" TAB_VERB "%10.4" "" COMPU_TAB_REF u_can_cltch_dprs_st /end COMPU_METHOD
/begin COMPU_VTAB u_can_cltch_dprs_st "" TAB_VERB 4 0 "NotFullyDepressed" 1 "FullyDepressed" 2 "NoBottomSensor" 3 "Invalid" /end COMPU_VTAB
/begin COMPU_METHOD u_can_ss_st "" TAB_VERB "%10.4" "" COMPU_TAB_REF u_can_ss_st /end COMPU_METHOD
/begin COMPU_VTAB u_can_ss_st "" TAB_VERB 17 0 "ISG_INIT" 1 "RUN" 2 "STOP_READY" 3 "STOP_PREPARATION" 4 "STOP_SUCCESS" 5 "START_READY" 6 "START_REQ" 7 "START_SUCCESS" 8 "START_ABORTED" 9 "STOP_FAILED" 10 "DRIVER_RESTART" 11 "ISG_DISABLED" 12 "StarterEngagWait" 13 "StarterMotorWait" 14 "STOP_ACTION" 15 "START_INTENDED" 16 "START_EngNotBurn" /end COMPU_VTAB
/begin COMPU_METHOD p_t_GPF_COEF_N0P125_0P125_LONG "Ax + B" RAT_FUNC "%10.6" "PaL" COEFFS 0.0 1.0 0.000000 0.0 0.0 0.000000000058 /end COMPU_METHOD
/begin FUNCTION can_tx "tx"
 /begin DEF_CHARACTERISTIC CAN_TX_ECU_ST_ID CAN_TX_ECU_ST_BYTE_LOC CAN_TX_ECU_ST_BIT_LOC CAN_TX_ECU_ST_BIT_LEN CAN_TX_ECU_ST_TABLE CAN_TX_BRK_PEDL_ST_ID CAN_TX_BRK_PEDL_ST_BYTE_LOC CAN_TX_BRK_PEDL_ST_BIT_LOC CAN_TX_BRK_PEDL_ST_BIT_LEN CAN_TX_BRK_PEDL_ST_INVALID CAN_TX_BRK_PEDL_ST_TABLE CAN_TX_N_SW_ST_ID CAN_TX_N_SW_ST_BYTE_LOC CAN_TX_N_SW_ST_BIT_LOC CAN_TX_N_SW_ST_BIT_LEN CAN_TX_N_SW_ST_TABLE CAN_TX_CLTCH_PEDL_ST_ID CAN_TX_CLTCH_PEDL_ST_BYTE_LOC CAN_TX_CLTCH_PEDL_ST_BIT_LOC CAN_TX_CLTCH_PEDL_ST_BIT_LEN CAN_TX_CLTCH_PEDL_ST_TABLE CAN_TX_IMMO_STATE_ID CAN_TX_IMMO_STATE_BYTE_LOC CAN_TX_IMMO_STATE_BIT_LOC CAN_TX_IMMO_STATE_BIT_LEN CAN_TX_IMMO_STATE_TABLE CAN_TX_STRT_OVERTM_ID CAN_TX_STRT_OVERTM_BYTE_LOC CAN_TX_STRT_OVERTM_BIT_LOC CAN_TX_STRT_OVERTM_BIT_LEN CAN_TX_STRT_OVERTM_TABLE CAN_TX_CLR_DIAG_MSG_ID CAN_TX_CLR_DIAG_MSG_BYTE_LOC CAN_TX_CLR_DIAG_MSG_BIT_LOC CAN_TX_CLR_DIAG_MSG_BIT_LEN CAN_TX_CLR_DIAG_MSG_TABLE CAN_TX_PPS_ID CAN_TX_PPS_BYTE_LOC CAN_TX_PPS_BIT_LOC CAN_TX_PPS_BIT_LEN CAN_TX_PPS_A CAN_TX_PPS_B CAN_TX_PPS_MIN CAN_TX_PPS_MAX CAN_TX_PPS_INVALID CAN_TX_FUEL_ACCUM_ID CAN_TX_FUEL_ACCUM_BYTE_LOC CAN_TX_FUEL_ACCUM_BIT_LOC CAN_TX_FUEL_ACCUM_BIT_LEN CAN_TX_FUEL_ACCUM_A CAN_TX_FUEL_ACCUM_B CAN_TX_FUEL_ACCUM_MIN CAN_TX_FUEL_ACCUM_MAX CAN_TX_FUEL_ACCUM_INVALID CAN_TX_CLTCH_TQ_ID CAN_TX_CLTCH_TQ_BYTE_LOC CAN_TX_CLTCH_TQ_BIT_LOC CAN_TX_CLTCH_TQ_BIT_LEN CAN_TX_CLTCH_TQ_A CAN_TX_CLTCH_TQ_B CAN_TX_CLTCH_TQ_MIN CAN_TX_CLTCH_TQ_MAX CAN_TX_CLTCH_TQ_INVALID CAN_TX_CLTCH_TQ_UNIT CAN_TX_AMP_ID CAN_TX_AMP_BYTE_LOC CAN_TX_AMP_BIT_LOC CAN_TX_AMP_BIT_LEN CAN_TX_AMP_A CAN_TX_AMP_B CAN_TX_AMP_MIN CAN_TX_AMP_MAX CAN_TX_AMP_INVALID CAN_TX_AMP_FL_ACTV_ID CAN_TX_AMP_FL_ACTV_BYTE_LOC CAN_TX_AMP_FL_ACTV_BIT_LOC CAN_TX_AMP_FL_ACTV_BIT_LEN CAN_TX_AMP_FL_ACTV_TABLE CAN_TX_BAT_VLT_ID CAN_TX_BAT_VLT_BYTE_LOC CAN_TX_BAT_VLT_BIT_LOC CAN_TX_BAT_VLT_BIT_LEN CAN_TX_BAT_VLT_A CAN_TX_BAT_VLT_B CAN_TX_BAT_VLT_MIN CAN_TX_BAT_VLT_MAX CAN_TX_BAT_VLT_INVALID CAN_TX_CAT_TEMP_ID CAN_TX_CAT_TEMP_BYTE_LOC CAN_TX_CAT_TEMP_BIT_LOC CAN_TX_CAT_TEMP_BIT_LEN CAN_TX_CAT_TEMP_A CAN_TX_CAT_TEMP_B CAN_TX_CAT_TEMP_MIN CAN_TX_CAT_TEMP_MAX CAN_TX_CAT_TEMP_INVALID CAN_TX_CHRG_LAMP_ID CAN_TX_CHRG_LAMP_BYTE_LOC CAN_TX_CHRG_LAMP_BIT_LOC CAN_TX_CHRG_LAMP_BIT_LEN CAN_TX_CHRG_LAMP_TABLE CAN_TX_BRK_SW_ACTV_ID CAN_TX_BRK_SW_ACTV_BYTE_LOC CAN_TX_BRK_SW_ACTV_BIT_LOC CAN_TX_BRK_SW_ACTV_BIT_LEN CAN_TX_BRK_SW_ACTV_TABLE CAN_TX_CRU_DIS_ID CAN_TX_CRU_DIS_BYTE_LOC CAN_TX_CRU_DIS_BIT_LOC CAN_TX_CRU_DIS_BIT_LEN CAN_TX_CRU_DIS_TABLE CAN_TX_SHFT_ST_ID CAN_TX_SHFT_ST_BYTE_LOC CAN_TX_SHFT_ST_BIT_LOC CAN_TX_SHFT_ST_BIT_LEN CAN_TX_SHFT_ST_TABLE CAN_TX_ENG_SPD_ID CAN_TX_ENG_SPD_BYTE_LOC CAN_TX_ENG_SPD_BIT_LOC CAN_TX_ENG_SPD_BIT_LEN CAN_TX_ENG_SPD_A CAN_TX_ENG_SPD_B CAN_TX_ENG_SPD_MIN CAN_TX_ENG_SPD_MAX CAN_TX_ENG_SPD_INVALID CAN_TX_VSPD_FL_DUR_ID CAN_TX_VSPD_FL_DUR_BYTE_LOC CAN_TX_VSPD_FL_DUR_BIT_LOC CAN_TX_VSPD_FL_DUR_BIT_LEN CAN_TX_VSPD_FL_DUR_A CAN_TX_VSPD_FL_DUR_B CAN_TX_VSPD_FL_DUR_MIN CAN_TX_VSPD_FL_DUR_MAX CAN_TX_VSPD_FL_DUR_INVALID CAN_TX_ESPD_AVG_ID CAN_TX_ESPD_AVG_BYTE_LOC CAN_TX_ESPD_AVG_BIT_LOC CAN_TX_ESPD_AVG_BIT_LEN CAN_TX_ESPD_AVG_A CAN_TX_ESPD_AVG_B CAN_TX_ESPD_AVG_MIN CAN_TX_ESPD_AVG_MAX CAN_TX_ESPD_AVG_INVALID CAN_TX_VEH_SPD_ID CAN_TX_VEH_SPD_BYTE_LOC CAN_TX_VEH_SPD_BIT_LOC CAN_TX_VEH_SPD_BIT_LEN CAN_TX_VEH_SPD_A CAN_TX_VEH_SPD_B CAN_TX_VEH_SPD_MIN CAN_TX_VEH_SPD_MAX CAN_TX_VEH_SPD_INVALID CAN_TX_CRU_VSPD_SP_ID CAN_TX_CRU_VSPD_SP_BYTE_LOC CAN_TX_CRU_VSPD_SP_BIT_LOC CAN_TX_CRU_VSPD_SP_BIT_LEN CAN_TX_CRU_VSPD_SP_A CAN_TX_CRU_VSPD_SP_B CAN_TX_CRU_VSPD_SP_MIN CAN_TX_CRU_VSPD_SP_MAX CAN_TX_CRU_VSPD_SP_INVALID CAN_TX_IDL_ESPD_SP_ID CAN_TX_IDL_ESPD_SP_BYTE_LOC CAN_TX_IDL_ESPD_SP_BIT_LOC CAN_TX_IDL_ESPD_SP_BIT_LEN CAN_TX_IDL_ESPD_SP_A CAN_TX_IDL_ESPD_SP_B CAN_TX_IDL_ESPD_SP_MIN CAN_TX_IDL_ESPD_SP_MAX CAN_TX_IDL_ESPD_SP_INVALID CAN_TX_IAT_ID CAN_TX_IAT_BYTE_LOC CAN_TX_IAT_BIT_LOC CAN_TX_IAT_BIT_LEN CAN_TX_IAT_A CAN_TX_IAT_B CAN_TX_IAT_MIN CAN_TX_IAT_MAX CAN_TX_IAT_INVALID CAN_TX_ECT_ID CAN_TX_ECT_BYTE_LOC CAN_TX_ECT_BIT_LOC CAN_TX_ECT_BIT_LEN CAN_TX_ECT_A CAN_TX_ECT_B CAN_TX_ECT_MIN CAN_TX_ECT_MAX CAN_TX_ECT_INVALID CAN_TX_MAP_ID CAN_TX_MAP_BYTE_LOC CAN_TX_MAP_BIT_LOC CAN_TX_MAP_BIT_LEN CAN_TX_MAP_A CAN_TX_MAP_B CAN_TX_MAP_MIN CAN_TX_MAP_MAX CAN_TX_MAP_INVALID CAN_TX_TPS_ID CAN_TX_TPS_BYTE_LOC CAN_TX_TPS_BIT_LOC CAN_TX_TPS_BIT_LEN CAN_TX_TPS_A CAN_TX_TPS_B CAN_TX_TPS_MIN CAN_TX_TPS_MAX CAN_TX_TPS_INVALID CAN_TX_AC_TEMP_ID CAN_TX_AC_TEMP_BYTE_LOC CAN_TX_AC_TEMP_BIT_LOC CAN_TX_AC_TEMP_BIT_LEN CAN_TX_AC_TEMP_A CAN_TX_AC_TEMP_B CAN_TX_AC_TEMP_MIN CAN_TX_AC_TEMP_MAX CAN_TX_AC_TEMP_INVALID CAN_TX_VIR_PPS_ID CAN_TX_VIR_PPS_BYTE_LOC CAN_TX_VIR_PPS_BIT_LOC CAN_TX_VIR_PPS_BIT_LEN CAN_TX_VIR_PPS_A CAN_TX_VIR_PPS_B CAN_TX_VIR_PPS_MIN CAN_TX_VIR_PPS_MAX CAN_TX_VIR_PPS_INVALID CAN_TX_FC_PULS_NUM_ID CAN_TX_FC_PULS_NUM_BYTE_LOC CAN_TX_FC_PULS_NUM_BIT_LOC CAN_TX_FC_PULS_NUM_BIT_LEN CAN_TX_FC_PULS_NUM_A CAN_TX_FC_PULS_NUM_B CAN_TX_FC_PULS_NUM_MIN CAN_TX_FC_PULS_NUM_MAX CAN_TX_FC_PULS_NUM_INVALID CAN_TX_OFF_TIME_ID CAN_TX_OFF_TIME_BYTE_LOC CAN_TX_OFF_TIME_BIT_LOC CAN_TX_OFF_TIME_BIT_LEN CAN_TX_OFF_TIME_A CAN_TX_OFF_TIME_B CAN_TX_OFF_TIME_MIN CAN_TX_OFF_TIME_MAX CAN_TX_OFF_TIME_INVALID CAN_TX_ACCUM_ODO_ID CAN_TX_ACCUM_ODO_BYTE_LOC CAN_TX_ACCUM_ODO_BIT_LOC CAN_TX_ACCUM_ODO_BIT_LEN CAN_TX_ACCUM_ODO_A CAN_TX_ACCUM_ODO_B CAN_TX_ACCUM_ODO_MIN CAN_TX_ACCUM_ODO_MAX CAN_TX_ACCUM_ODO_INVALID CAN_TX_ROLL_CNT00_ID CAN_TX_ROLL_CNT00_BYTE_LOC CAN_TX_ROLL_CNT00_BIT_LOC CAN_TX_ROLL_CNT00_BIT_LEN CAN_TX_ROLL_CNT00_STP CAN_TX_ROLL_CNT00_THR CAN_TX_ROLL_CNT01_ID CAN_TX_ROLL_CNT01_BYTE_LOC CAN_TX_ROLL_CNT01_BIT_LOC CAN_TX_ROLL_CNT01_BIT_LEN CAN_TX_ROLL_CNT01_STP CAN_TX_ROLL_CNT01_THR CAN_TX_ROLL_CNT02_ID CAN_TX_ROLL_CNT02_BYTE_LOC CAN_TX_ROLL_CNT02_BIT_LOC CAN_TX_ROLL_CNT02_BIT_LEN CAN_TX_ROLL_CNT02_STP CAN_TX_ROLL_CNT02_THR CAN_TX_ROLL_CNT03_ID CAN_TX_ROLL_CNT03_BYTE_LOC CAN_TX_ROLL_CNT03_BIT_LOC CAN_TX_ROLL_CNT03_BIT_LEN CAN_TX_ROLL_CNT03_STP CAN_TX_ROLL_CNT03_THR CAN_TX_ROLL_CNT04_ID CAN_TX_ROLL_CNT04_BYTE_LOC CAN_TX_ROLL_CNT04_BIT_LOC CAN_TX_ROLL_CNT04_BIT_LEN CAN_TX_ROLL_CNT04_STP CAN_TX_ROLL_CNT04_THR CAN_TX_ROLL_CNT05_ID CAN_TX_ROLL_CNT05_BYTE_LOC CAN_TX_ROLL_CNT05_BIT_LOC CAN_TX_ROLL_CNT05_BIT_LEN CAN_TX_ROLL_CNT05_STP CAN_TX_ROLL_CNT05_THR CAN_TX_ROLL_CNT06_ID CAN_TX_ROLL_CNT06_BYTE_LOC CAN_TX_ROLL_CNT06_BIT_LOC CAN_TX_ROLL_CNT06_BIT_LEN CAN_TX_ROLL_CNT06_STP CAN_TX_ROLL_CNT06_THR CAN_TX_ROLL_CNT07_ID CAN_TX_ROLL_CNT07_BYTE_LOC CAN_TX_ROLL_CNT07_BIT_LOC CAN_TX_ROLL_CNT07_BIT_LEN CAN_TX_ROLL_CNT07_STP CAN_TX_ROLL_CNT07_THR CAN_TX_ROLL_CNT08_ID CAN_TX_ROLL_CNT08_BYTE_LOC CAN_TX_ROLL_CNT08_BIT_LOC CAN_TX_ROLL_CNT08_BIT_LEN CAN_TX_ROLL_CNT08_STP CAN_TX_ROLL_CNT08_THR CAN_TX_ROLL_CNT09_ID CAN_TX_ROLL_CNT09_BYTE_LOC CAN_TX_ROLL_CNT09_BIT_LOC CAN_TX_ROLL_CNT09_BIT_LEN CAN_TX_ROLL_CNT09_STP CAN_TX_ROLL_CNT09_THR CAN_TX_CHKSUM00_ID CAN_TX_CHKSUM00_BYTE_LOC CAN_TX_CHKSUM00_BIT_LOC CAN_TX_CHKSUM00_BIT_LEN CAN_TX_CHKSUM00_METHOD CAN_TX_CHKSUM01_ID CAN_TX_CHKSUM01_BYTE_LOC CAN_TX_CHKSUM01_BIT_LOC CAN_TX_CHKSUM01_BIT_LEN CAN_TX_CHKSUM01_METHOD CAN_TX_CHKSUM02_ID CAN_TX_CHKSUM02_BYTE_LOC CAN_TX_CHKSUM02_BIT_LOC CAN_TX_CHKSUM02_BIT_LEN CAN_TX_CHKSUM02_METHOD CAN_TX_CHKSUM03_ID CAN_TX_CHKSUM03_BYTE_LOC CAN_TX_CHKSUM03_BIT_LOC CAN_TX_CHKSUM03_BIT_LEN CAN_TX_CHKSUM03_METHOD CAN_TX_CHKSUM04_ID CAN_TX_CHKSUM04_BYTE_LOC CAN_TX_CHKSUM04_BIT_LOC CAN_TX_CHKSUM04_BIT_LEN CAN_TX_CHKSUM04_METHOD CAN_TX_CHKSUM05_ID CAN_TX_CHKSUM05_BYTE_LOC CAN_TX_CHKSUM05_BIT_LOC CAN_TX_CHKSUM05_BIT_LEN CAN_TX_CHKSUM05_METHOD CAN_TX_CHKSUM06_ID CAN_TX_CHKSUM06_BYTE_LOC CAN_TX_CHKSUM06_BIT_LOC CAN_TX_CHKSUM06_BIT_LEN CAN_TX_CHKSUM06_METHOD CAN_TX_CHKSUM07_ID CAN_TX_CHKSUM07_BYTE_LOC CAN_TX_CHKSUM07_BIT_LOC CAN_TX_CHKSUM07_BIT_LEN CAN_TX_CHKSUM07_METHOD CAN_TX_CHKSUM08_ID CAN_TX_CHKSUM08_BYTE_LOC CAN_TX_CHKSUM08_BIT_LOC CAN_TX_CHKSUM08_BIT_LEN CAN_TX_CHKSUM08_METHOD CAN_TX_CHKSUM09_ID CAN_TX_CHKSUM09_BYTE_LOC CAN_TX_CHKSUM09_BIT_LOC CAN_TX_CHKSUM09_BIT_LEN CAN_TX_CHKSUM09_METHOD CAN_TX_CLTCH_TQ_SP_ID CAN_TX_CLTCH_TQ_SP_BYTE_LOC CAN_TX_CLTCH_TQ_SP_BIT_LOC CAN_TX_CLTCH_TQ_SP_BIT_LEN CAN_TX_CLTCH_TQ_SP_A CAN_TX_CLTCH_TQ_SP_B CAN_TX_CLTCH_TQ_SP_MIN CAN_TX_CLTCH_TQ_SP_MAX CAN_TX_CLTCH_TQ_SP_INVALID CAN_TX_CLTCH_TQ_SP_UNIT CAN_TX_CRU_ACTV_ID CAN_TX_CRU_ACTV_BYTE_LOC CAN_TX_CRU_ACTV_BIT_LOC CAN_TX_CRU_ACTV_BIT_LEN CAN_TX_CRU_ACTV_TABLE CAN_TX_TQ_REQ_PCT_ID CAN_TX_TQ_REQ_PCT_BYTE_LOC CAN_TX_TQ_REQ_PCT_BIT_LOC CAN_TX_TQ_REQ_PCT_BIT_LEN CAN_TX_TQ_REQ_PCT_A CAN_TX_TQ_REQ_PCT_B CAN_TX_TQ_REQ_PCT_MIN CAN_TX_TQ_REQ_PCT_MAX CAN_TX_TQ_REQ_PCT_INVALID CAN_TX_STRT_ACTV_ID CAN_TX_STRT_ACTV_BYTE_LOC CAN_TX_STRT_ACTV_BIT_LOC CAN_TX_STRT_ACTV_BIT_LEN CAN_TX_STRT_ACTV_TABLE CAN_TX_TCU_CAN_FAIL_ID CAN_TX_TCU_CAN_FAIL_BYTE_LOC CAN_TX_TCU_CAN_FAIL_BIT_LOC CAN_TX_TCU_CAN_FAIL_BIT_LEN CAN_TX_TCU_CAN_FAIL_TABLE CAN_TX_DCL_FCO_ID CAN_TX_DCL_FCO_BYTE_LOC CAN_TX_DCL_FCO_BIT_LOC CAN_TX_DCL_FCO_BIT_LEN CAN_TX_DCL_FCO_TABLE CAN_TX_ETC_ST_ID CAN_TX_ETC_ST_BYTE_LOC CAN_TX_ETC_ST_BIT_LOC CAN_TX_ETC_ST_BIT_LEN CAN_TX_ETC_ST_TABLE CAN_TX_GEAR_R_ID CAN_TX_GEAR_R_BYTE_LOC CAN_TX_GEAR_R_BIT_LOC CAN_TX_GEAR_R_BIT_LEN CAN_TX_GEAR_R_TABLE CAN_TX_AC_REQ_ID CAN_TX_AC_REQ_BYTE_LOC CAN_TX_AC_REQ_BIT_LOC CAN_TX_AC_REQ_BIT_LEN CAN_TX_AC_REQ_TABLE CAN_TX_CRUZ_ACTV_LAMP_REQ_ID CAN_TX_CRUZ_ACTV_LAMP_REQ_BYTE_LOC CAN_TX_CRUZ_ACTV_LAMP_REQ_BIT_LOC CAN_TX_CRUZ_ACTV_LAMP_REQ_BIT_LEN CAN_TX_CRUZ_ACTV_LAMP_REQ_TABLE CAN_TX_VSPD_LMT_SP_ID CAN_TX_VSPD_LMT_SP_BYTE_LOC CAN_TX_VSPD_LMT_SP_BIT_LOC CAN_TX_VSPD_LMT_SP_BIT_LEN CAN_TX_VSPD_LMT_SP_A CAN_TX_VSPD_LMT_SP_B CAN_TX_VSPD_LMT_SP_MIN CAN_TX_VSPD_LMT_SP_MAX CAN_TX_VSPD_LMT_EN_ID CAN_TX_VSPD_LMT_EN_BYTE_LOC CAN_TX_VSPD_LMT_EN_BIT_LOC CAN_TX_VSPD_LMT_EN_BIT_LEN CAN_TX_VSPD_LMT_EN_TABLE CAN_TX_VSPD_LMT_EXCD_ID CAN_TX_VSPD_LMT_EXCD_BYTE_LOC CAN_TX_VSPD_LMT_EXCD_BIT_LOC CAN_TX_VSPD_LMT_EXCD_BIT_LEN CAN_TX_VSPD_LMT_EXCD_TABLE CAN_TX_STRT_RLY_EN_ID CAN_TX_STRT_RLY_EN_BYTE_LOC CAN_TX_STRT_RLY_EN_BIT_LOC CAN_TX_STRT_RLY_EN_BIT_LEN CAN_TX_STRT_RLY_EN_TABLE CAN_TX_STRT_RLY_FL_ID CAN_TX_STRT_RLY_FL_BYTE_LOC CAN_TX_STRT_RLY_FL_BIT_LOC CAN_TX_STRT_RLY_FL_BIT_LEN CAN_TX_STRT_RLY_FL_TABLE CAN_TX_DIAG_DEN_COND_MET_ID CAN_TX_DIAG_DEN_COND_MET_BYTE_LOC CAN_TX_DIAG_DEN_COND_MET_BIT_LOC CAN_TX_DIAG_DEN_COND_MET_BIT_LEN CAN_TX_DIAG_DEN_COND_MET_TABLE CAN_TX_DIAG_DEN_COND_FL_ID CAN_TX_DIAG_DEN_COND_FL_BYTE_LOC CAN_TX_DIAG_DEN_COND_FL_BIT_LOC CAN_TX_DIAG_DEN_COND_FL_BIT_LEN CAN_TX_DIAG_DEN_COND_FL_TABLE CAN_TX_TCS_TQ_REDC_EN_ID CAN_TX_TCS_TQ_REDC_EN_BYTE_LOC CAN_TX_TCS_TQ_REDC_EN_BIT_LOC CAN_TX_TCS_TQ_REDC_EN_BIT_LEN CAN_TX_TCS_TQ_REDC_EN_TABLE CAN_TX_CRUZ_ACTV_LAMP_ON_ID CAN_TX_CRUZ_ACTV_LAMP_ON_BYTE_LOC CAN_TX_CRUZ_ACTV_LAMP_ON_BIT_LOC CAN_TX_CRUZ_ACTV_LAMP_ON_BIT_LEN CAN_TX_CRUZ_ACTV_LAMP_ON_TABLE CAN_TX_CRUZ_IN_FL_ID CAN_TX_CRUZ_IN_FL_BYTE_LOC CAN_TX_CRUZ_IN_FL_BIT_LOC CAN_TX_CRUZ_IN_FL_BIT_LEN CAN_TX_CRUZ_IN_FL_TABLE CAN_TX_NO_HYS_PPS_ID CAN_TX_NO_HYS_PPS_BYTE_LOC CAN_TX_NO_HYS_PPS_BIT_LOC CAN_TX_NO_HYS_PPS_BIT_LEN CAN_TX_NO_HYS_PPS_A CAN_TX_NO_HYS_PPS_B CAN_TX_NO_HYS_PPS_MIN CAN_TX_NO_HYS_PPS_MAX CAN_TX_NO_HYS_PPS_INVALID CAN_TX_BRK_P_ID CAN_TX_BRK_P_BYTE_LOC CAN_TX_BRK_P_BIT_LOC CAN_TX_BRK_P_BIT_LEN CAN_TX_BRK_P_A CAN_TX_BRK_P_B CAN_TX_BRK_P_MIN CAN_TX_BRK_P_MAX CAN_TX_BRK_P_INVALID CAN_TX_BRK_P_FL_ID CAN_TX_BRK_P_FL_BYTE_LOC CAN_TX_BRK_P_FL_BIT_LOC CAN_TX_BRK_P_FL_BIT_LEN CAN_TX_BRK_P_FL_TABLE CAN_TX_ENG_STOP_REQ_ID CAN_TX_ENG_STOP_REQ_BYTE_LOC CAN_TX_ENG_STOP_REQ_BIT_LOC CAN_TX_ENG_STOP_REQ_BIT_LEN CAN_TX_ENG_STOP_REQ_TABLE CAN_TX_CLTCH_POS_ID CAN_TX_CLTCH_POS_BYTE_LOC CAN_TX_CLTCH_POS_BIT_LOC CAN_TX_CLTCH_POS_BIT_LEN CAN_TX_CLTCH_POS_A CAN_TX_CLTCH_POS_B CAN_TX_CLTCH_POS_MIN CAN_TX_CLTCH_POS_MAX CAN_TX_CLTCH_POS_INVALID CAN_TX_CLTCH_POS_VLD_ID CAN_TX_CLTCH_POS_VLD_BYTE_LOC CAN_TX_CLTCH_POS_VLD_BIT_LOC CAN_TX_CLTCH_POS_VLD_BIT_LEN CAN_TX_CLTCH_POS_VLD_TABLE CAN_TX_PPS_RAW_ID CAN_TX_PPS_RAW_BYTE_LOC CAN_TX_PPS_RAW_BIT_LOC CAN_TX_PPS_RAW_BIT_LEN CAN_TX_PPS_RAW_A CAN_TX_PPS_RAW_B CAN_TX_PPS_RAW_MIN CAN_TX_PPS_RAW_MAX CAN_TX_PPS_RAW_INVALID CAN_TX_OIL_P_LO_ID CAN_TX_OIL_P_LO_BYTE_LOC CAN_TX_OIL_P_LO_BIT_LOC CAN_TX_OIL_P_LO_BIT_LEN CAN_TX_OIL_P_LO_TABLE CAN_TX_GR_SHFT_UP_ID CAN_TX_GR_SHFT_UP_BYTE_LOC CAN_TX_GR_SHFT_UP_BIT_LOC CAN_TX_GR_SHFT_UP_BIT_LEN CAN_TX_GR_SHFT_UP_TABLE CAN_TX_GR_SHFT_DWN_ID CAN_TX_GR_SHFT_DWN_BYTE_LOC CAN_TX_GR_SHFT_DWN_BIT_LOC CAN_TX_GR_SHFT_DWN_BIT_LEN CAN_TX_GR_SHFT_DWN_TABLE CAN_TX_GR_SHFT_SP_ID CAN_TX_GR_SHFT_SP_BYTE_LOC CAN_TX_GR_SHFT_SP_BIT_LOC CAN_TX_GR_SHFT_SP_BIT_LEN CAN_TX_GR_SHFT_SP_TABLE CAN_TX_CRU_SW_ST_ID CAN_TX_CRU_SW_ST_BYTE_LOC CAN_TX_CRU_SW_ST_BIT_LOC CAN_TX_CRU_SW_ST_BIT_LEN CAN_TX_CRU_SW_ST_TABLE CAN_TX_FC_100MS_ID CAN_TX_FC_100MS_BYTE_LOC CAN_TX_FC_100MS_BIT_LOC CAN_TX_FC_100MS_BIT_LEN CAN_TX_FC_100MS_A CAN_TX_FC_100MS_B CAN_TX_FC_100MS_MIN CAN_TX_FC_100MS_MAX CAN_TX_FC_100MS_INVALID CAN_TX_VSPD_LMT_ACTV_ID CAN_TX_VSPD_LMT_ACTV_BYTE_LOC CAN_TX_VSPD_LMT_ACTV_BIT_LOC CAN_TX_VSPD_LMT_ACTV_BIT_LEN CAN_TX_VSPD_LMT_ACTV_TABLE CAN_TX_CLTCH_POS_FL_ID CAN_TX_CLTCH_POS_FL_BYTE_LOC CAN_TX_CLTCH_POS_FL_BIT_LOC CAN_TX_CLTCH_POS_FL_BIT_LEN CAN_TX_CLTCH_POS_FL_TABLE CAN_TX_FAN_ST_ID CAN_TX_FAN_ST_BYTE_LOC CAN_TX_FAN_ST_BIT_LOC CAN_TX_FAN_ST_BIT_LEN CAN_TX_FAN_ST_TABLE CAN_TX_BRK_FL_ID CAN_TX_BRK_FL_BYTE_LOC CAN_TX_BRK_FL_BIT_LOC CAN_TX_BRK_FL_BIT_LEN CAN_TX_BRK_FL_TABLE CAN_TX_CUR_DTC_ID CAN_TX_CUR_DTC_BYTE_LOC CAN_TX_CUR_DTC_BIT_LOC CAN_TX_CUR_DTC_BIT_LEN CAN_TX_CUR_DTC_A CAN_TX_CUR_DTC_B CAN_TX_CUR_DTC_MIN CAN_TX_CUR_DTC_MAX CAN_TX_CUR_DTC_INVALID CAN_TX_IGA_AVG_ID CAN_TX_IGA_AVG_BYTE_LOC CAN_TX_IGA_AVG_BIT_LOC CAN_TX_IGA_AVG_BIT_LEN CAN_TX_IGA_AVG_A CAN_TX_IGA_AVG_B CAN_TX_IGA_AVG_MIN CAN_TX_IGA_AVG_MAX CAN_TX_IGA_AVG_INVALID CAN_TX_IGA_CUR_ID CAN_TX_IGA_CUR_BYTE_LOC CAN_TX_IGA_CUR_BIT_LOC CAN_TX_IGA_CUR_BIT_LEN CAN_TX_IGA_CUR_A CAN_TX_IGA_CUR_B CAN_TX_IGA_CUR_MIN CAN_TX_IGA_CUR_MAX CAN_TX_IGA_CUR_INVALID CAN_TX_AC_P_FL_ID CAN_TX_AC_P_FL_BYTE_LOC CAN_TX_AC_P_FL_BIT_LOC CAN_TX_AC_P_FL_BIT_LEN CAN_TX_AC_P_FL_TABLE CAN_TX_CLTCH_TOT_DPRS_ST_ID CAN_TX_CLTCH_TOT_DPRS_ST_BYTE_LOC CAN_TX_CLTCH_TOT_DPRS_ST_BIT_LOC CAN_TX_CLTCH_TOT_DPRS_ST_BIT_LEN CAN_TX_CLTCH_TOT_DPRS_ST_TABLE CAN_TX_CLTCH_TOT_DPRS_VLD_ID CAN_TX_CLTCH_TOT_DPRS_VLD_BYTE_LOC CAN_TX_CLTCH_TOT_DPRS_VLD_BIT_LOC CAN_TX_CLTCH_TOT_DPRS_VLD_BIT_LEN CAN_TX_CLTCH_TOT_DPRS_VLD_TABLE CAN_TX_STRT_RLY_CTRL_DIS_ID CAN_TX_STRT_RLY_CTRL_DIS_BYTE_LOC CAN_TX_STRT_RLY_CTRL_DIS_BIT_LOC CAN_TX_STRT_RLY_CTRL_DIS_BIT_LEN CAN_TX_STRT_RLY_CTRL_DIS_TABLE CAN_TX_AMP_FAC_ID CAN_TX_AMP_FAC_BYTE_LOC CAN_TX_AMP_FAC_BIT_LOC CAN_TX_AMP_FAC_BIT_LEN CAN_TX_AMP_FAC_A CAN_TX_AMP_FAC_B CAN_TX_AMP_FAC_MIN CAN_TX_AMP_FAC_MAX CAN_TX_AMP_FAC_INVALID CAN_TX_CLTCH_EFF_POS_ID CAN_TX_CLTCH_EFF_POS_BYTE_LOC CAN_TX_CLTCH_EFF_POS_BIT_LOC CAN_TX_CLTCH_EFF_POS_BIT_LEN CAN_TX_CLTCH_EFF_POS_A CAN_TX_CLTCH_EFF_POS_B CAN_TX_CLTCH_EFF_POS_MIN CAN_TX_CLTCH_EFF_POS_MAX CAN_TX_CLTCH_EFF_POS_INVALID CAN_TX_BRK_PDL_PARITY_ID CAN_TX_BRK_PDL_PARITY_BYTE_LOC CAN_TX_BRK_PDL_PARITY_BIT_LOC CAN_TX_BRK_PDL_PARITY_BIT_LEN CAN_TX_BRK_PDL_PARITY_TABLE CAN_TX_CLTCH_DPRS_ID CAN_TX_CLTCH_DPRS_BYTE_LOC CAN_TX_CLTCH_DPRS_BIT_LOC CAN_TX_CLTCH_DPRS_BIT_LEN CAN_TX_CLTCH_DPRS_TABLE CAN_TX_INFO_1_ID CAN_TX_INFO_1_BYTE_LOC CAN_TX_INFO_1_BIT_LOC CAN_TX_INFO_1_BIT_LEN CAN_TX_INFO_2_ID CAN_TX_INFO_2_BYTE_LOC CAN_TX_INFO_2_BIT_LOC CAN_TX_INFO_2_BIT_LEN CAN_TX_INFO_3_ID CAN_TX_INFO_3_BYTE_LOC CAN_TX_INFO_3_BIT_LOC CAN_TX_INFO_3_BIT_LEN CAN_TX_INFO_4_ID CAN_TX_INFO_4_BYTE_LOC CAN_TX_INFO_4_BIT_LOC CAN_TX_INFO_4_BIT_LEN CAN_TX_INFO_5_ID CAN_TX_INFO_5_BYTE_LOC CAN_TX_INFO_5_BIT_LOC CAN_TX_INFO_5_BIT_LEN CAN_TX_INFO_6_ID CAN_TX_INFO_6_BYTE_LOC CAN_TX_INFO_6_BIT_LOC CAN_TX_INFO_6_BIT_LEN CAN_TX_INFO_7_ID CAN_TX_INFO_7_BYTE_LOC CAN_TX_INFO_7_BIT_LOC CAN_TX_INFO_7_BIT_LEN CAN_TX_INFO_8_ID CAN_TX_INFO_8_BYTE_LOC CAN_TX_INFO_8_BIT_LOC CAN_TX_INFO_8_BIT_LEN CAN_TX_SS_ST_ID CAN_TX_SS_ST_BYTE_LOC CAN_TX_SS_ST_BIT_LOC CAN_TX_SS_ST_BIT_LEN CAN_TX_SS_ST_TABLE CAN_TX_STBL_TROT_TQ_ID CAN_TX_STBL_TROT_TQ_BYTE_LOC CAN_TX_STBL_TROT_TQ_BIT_LOC CAN_TX_STBL_TROT_TQ_BIT_LEN CAN_TX_STBL_TROT_TQ_A CAN_TX_STBL_TROT_TQ_B CAN_TX_STBL_TROT_TQ_MIN CAN_TX_STBL_TROT_TQ_MAX CAN_TX_STBL_TROT_TQ_INVALID CAN_TX_STBL_TROT_TQ_UNIT CAN_TX_FLYW_TQ_RAW_SP_TQ_ID CAN_TX_FLYW_TQ_RAW_SP_BYTE_LOC CAN_TX_FLYW_TQ_RAW_SP_BIT_LOC CAN_TX_FLYW_TQ_RAW_SP_BIT_LEN CAN_TX_FLYW_TQ_RAW_SP_A CAN_TX_FLYW_TQ_RAW_SP_B CAN_TX_FLYW_TQ_RAW_SP_MIN CAN_TX_FLYW_TQ_RAW_SP_MAX CAN_TX_FLYW_TQ_RAW_SP_INVALID CAN_TX_FLYW_TQ_RAW_SP_UNIT CAN_TX_FLYW_TQ_SLW_SP_TQ_ID CAN_TX_FLYW_TQ_SLW_SP_BYTE_LOC CAN_TX_FLYW_TQ_SLW_SP_BIT_LOC CAN_TX_FLYW_TQ_SLW_SP_BIT_LEN CAN_TX_FLYW_TQ_SLW_SP_A CAN_TX_FLYW_TQ_SLW_SP_B CAN_TX_FLYW_TQ_SLW_SP_MIN CAN_TX_FLYW_TQ_SLW_SP_MAX CAN_TX_FLYW_TQ_SLW_SP_INVALID CAN_TX_FLYW_TQ_SLW_SP_UNIT CAN_TX_FRIC_TQ_ID CAN_TX_FRIC_TQ_BYTE_LOC CAN_TX_FRIC_TQ_BIT_LOC CAN_TX_FRIC_TQ_BIT_LEN CAN_TX_FRIC_TQ_A CAN_TX_FRIC_TQ_B CAN_TX_FRIC_TQ_MIN CAN_TX_FRIC_TQ_MAX CAN_TX_FRIC_TQ_INVALID CAN_TX_FRIC_TQ_UNIT CAN_TX_MX_TQ_ID CAN_TX_MX_TQ_BYTE_LOC CAN_TX_MX_TQ_BIT_LOC CAN_TX_MX_TQ_BIT_LEN CAN_TX_MX_TQ_A CAN_TX_MX_TQ_B CAN_TX_MX_TQ_MIN CAN_TX_MX_TQ_MAX CAN_TX_MX_TQ_INVALID CAN_TX_MX_TQ_UNIT CAN_TX_MN_TQ_ID CAN_TX_MN_TQ_BYTE_LOC CAN_TX_MN_TQ_BIT_LOC CAN_TX_MN_TQ_BIT_LEN CAN_TX_MN_TQ_A CAN_TX_MN_TQ_B CAN_TX_MN_TQ_MIN CAN_TX_MN_TQ_MAX CAN_TX_MN_TQ_INVALID CAN_TX_MN_TQ_UNIT /end DEF_CHARACTERISTIC
/end FUNCTION
/begin RECORD_LAYOUT __UBYTE_S FNC_VALUES 1 UBYTE COLUMN_DIR DIRECT /end RECORD_LAYOUT
/begin RECORD_LAYOUT __UWORD_S FNC_VALUES 1 UWORD COLUMN_DIR DIRECT /end RECORD_LAYOUT
/begin RECORD_LAYOUT __ULONG_S FNC_VALUES 1 ULONG COLUMN_DIR DIRECT /end RECORD_LAYOUT
/begin RECORD_LAYOUT __SWORD_S FNC_VALUES 1 SWORD COLUMN_DIR DIRECT /end RECORD_LAYOUT
/end MODULE
/end PROJECT
