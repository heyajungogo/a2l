ASAP2_VERSION 1 60
/begin PROJECT FC33 ""
/begin HEADER "" VERSION "1.0" /end HEADER
/begin MODULE FC33 ""
/begin MOD_COMMON "" BYTE_ORDER MSB_FIRST ALIGNMENT_LONG 2 ALIGNMENT_WORD 1 /end MOD_COMMON
/begin MEASUREMENT vvtd_b1_exh_sp_neg_vel "exh vvt sp neg velocity" UWORD u_cam_v 0 0 0 1023.984375 ECU_ADDRESS 0x4000DA4E FORMAT "%5.1" /end MEASUREMENT
/begin MEASUREMENT vvtd_b1_exh_sp_pos_vel "exh vvt sp pos velocity" UWORD u_cam_v 0 0 0 1023.984375 ECU_ADDRESS 0x4000DA4E FORMAT "%5.1" /end MEASUREMENT
/begin MEASUREMENT vvtd_b1_intk_sp_neg_vel "intake vvt sp neg velocity" UWORD u_cam_v 0 0 0 1023.984375 ECU_ADDRESS 0x4000DA4E FORMAT "%5.1" /end MEASUREMENT
/begin MEASUREMENT vvtd_b1_intk_sp_pos_vel "intake vvt sp pos velocity" UWORD u_cam_v 0 0 0 1023.984375 ECU_ADDRESS 0x4000DA4E FORMAT "%5.1" /end MEASUREMENT
/begin MEASUREMENT idld_en_dly "idle diag enable delay" UWORD u_16x_tmr 0 0 0 8191.875 ECU_ADDRESS 0x40004EA0 SYMBOL_LINK "idld_tmr" 0 /end MEASUREMENT
/begin MEASUREMENT idld_lo_ps_tmr "idle speed low pass timer" UWORD u_16x_tmr 0 0 0 8191.875 ECU_ADDRESS 0x40004EA0 SYMBOL_LINK "idld_tmr" 2 /end MEASUREMENT
/begin MEASUREMENT idld_lo_fl_tmr "idle speed low fail timer" UWORD u_16x_tmr 0 0 0 8191.875 ECU_ADDRESS 0x40004EA0 SYMBOL_LINK "idld_tmr" 4 /end MEASUREMENT
/begin MEASUREMENT idld_hi_ps_tmr "idle speed high pass timer" UWORD u_16x_tmr 0 0 0 8191.875 ECU_ADDRESS 0x40004EA0 SYMBOL_LINK "idld_tmr" 6 /end MEASUREMENT
/begin MEASUREMENT idld_hi_fl_tmr "idle speed high fail timer" UWORD u_16x_tmr 0 0 0 8191.875 ECU_ADDRESS 0x40004EA0 SYMBOL_LINK "idld_tmr" 8 /end MEASUREMENT
/begin MEASUREMENT idld_cat_ht_ps_tmr "cat heat idle speed low pass timer" UWORD u_16x_tmr 0 0 0 8191.875 ECU_ADDRESS 0x40004EA0 SYMBOL_LINK "idld_tmr" 10 /end MEASUREMENT
/begin MEASUREMENT idld_cat_ht_fl_tmr "cat heat idle speed low fail timer" UWORD u_16x_tmr 0 0 0 8191.875 ECU_ADDRESS 0x40004EA0 SYMBOL_LINK "idld_tmr" 12 /end MEASUREMENT
/begin MEASUREMENT idld_comn_conds_met "common diag enable conditions met" UBYTE b_true 0 0 0.00 1.00 ECU_ADDRESS 0x40004EA0 FORMAT "%5.0" /end MEASUREMENT
/begin MEASUREMENT idld_cat_ht_spd_inc "idle cat heat speed increase" UWORD u_espd 0 0 0 8191.875 ECU_ADDRESS 0x400050DA FORMAT "%6.2" /end MEASUREMENT
/begin MEASUREMENT idld_cat_ht_en "idle cat heat diag enable" UBYTE b_true 0 0 0.00 1.00 ECU_ADDRESS 0x40004EA0 FORMAT "%5.0" /end MEASUREMENT
/begin MEASUREMENT idld_cat_ht_fl_met "idle cat heat fail met" UBYTE b_true 0 0 0.00 1.00 ECU_ADDRESS 0x40004EA0 FORMAT "%5.0" /end MEASUREMENT
/begin MEASUREMENT idld_cat_ht_fl "idle cat heat fail" UBYTE b_true 0 0 0.00 1.00 ECU_ADDRESS 0x40004EA0 FORMAT "%5.0" /end MEASUREMENT
/begin MEASUREMENT idld_cat_ht_fn "idle cat heat finish" UBYTE b_true 0 0 0.00 1.00 ECU_ADDRESS 0x40004EA0 FORMAT "%5.0" /end MEASUREMENT
/begin MEASUREMENT idld_spd_lo_en "speed low diag eanble" UBYTE b_true 0 0 0.00 1.00 ECU_ADDRESS 0x40004EA0 FORMAT "%5.0" /end MEASUREMENT
/begin MEASUREMENT idld_spd_lo_fl_met "idle speed low fail met" UBYTE b_true 0 0 0.00 1.00 ECU_ADDRESS 0x40004EA0 FORMAT "%5.0" /end MEASUREMENT
/begin MEASUREMENT idld_spd_lo_fl "idle speed low fail" UBYTE b_true 0 0 0.00 1.00 ECU_ADDRESS 0x40004EA0 FORMAT "%5.0" /end MEASUREMENT
/begin MEASUREMENT idld_spd_lo_fn "idle speed low finish" UBYTE b_true 0 0 0.00 1.00 ECU_ADDRESS 0x40004EA0 FORMAT "%5.0" /end MEASUREMENT
/begin MEASUREMENT idld_spd_hi_en "speed high diag eanble" UBYTE b_true 0 0 0.00 1.00 ECU_ADDRESS 0x40004EA0 FORMAT "%5.0" /end MEASUREMENT
/begin MEASUREMENT idld_spd_hi_fl_met "idle speed high fail met" UBYTE b_true 0 0 0.00 1.00 ECU_ADDRESS 0x40004EA0 FORMAT "%5.0" /end MEASUREMENT
/begin MEASUREMENT idld_spd_hi_fl "idle speed high fail" UBYTE b_true 0 0 0.00 1.00 ECU_ADDRESS 0x40004EA0 FORMAT "%5.0" /end MEASUREMENT
/begin MEASUREMENT idld_spd_hi_fn "idle speed high finish" UBYTE b_true 0 0 0.00 1.00 ECU_ADDRESS 0x40004EA0 FORMAT "%5.0" /end MEASUREMENT
/begin MEASUREMENT efd_diag_en "egr flow diag enable" UBYTE b_true 0 0 0.00 1.00 ECU_ADDRESS 0x4000440A FORMAT "%1.0" /end MEASUREMENT
/begin MEASUREMENT efd_flw_diag_met "egr flow diag conditions met" UBYTE b_true 0 0 0.00 1.00 ECU_ADDRESS 0x40004EA0 FORMAT "%1.0" /end MEASUREMENT
/begin MEASUREMENT efd_diag_dly_actv "egr flow diag delay active" UBYTE b_true 0 0 0.00 1.00 ECU_ADDRESS 0x4000440A FORMAT "%1.0" /end MEASUREMENT
/begin MEASUREMENT efd_diag_ext_req "egr flow diag exit request" UBYTE b_true 0 0 0.00 1.00 ECU_ADDRESS 0x4000440A FORMAT "%1.0" /end MEASUREMENT
/begin MEASUREMENT efd_eng_conds_met "engine conditions met" UBYTE b_true 0 0 0.00 1.00 ECU_ADDRESS 0x4000440A FORMAT "%1.0" /end MEASUREMENT
/begin MEASUREMENT efd_comn_stbl_met "common stable conditions met" UBYTE b_true 0 0 0.00 1.00 ECU_ADDRESS 0x4000440A FORMAT "%1.0" /end MEASUREMENT
/begin MEASUREMENT efd_stbl_met "common stable conditions met" UBYTE b_true 0 0 0.00 1.00 ECU_ADDRESS 0x4000440A FORMAT "%1.0" /end MEASUREMENT
/begin MEASUREMENT efd_diag_fn "test finish" UBYTE b_true 0 0 0.00 1.00 ECU_ADDRESS 0x4000440A FORMAT "%1.0" /end MEASUREMENT
/begin MEASUREMENT efd_diag_ext_dly "diag exit delay" UBYTE u_16x_tmr 0 0 0 31.875 ECU_ADDRESS 0x40004EA0 FORMAT "%5.3" SYMBOL_LINK "efd_diag_tmr" 0 /end MEASUREMENT
/begin MEASUREMENT efd_vlv_cls_tmr "egr valve close timer" UBYTE u_16x_tmr 0 0 0 31.875 ECU_ADDRESS 0x40004EA0 FORMAT "%5.3" SYMBOL_LINK "efd_diag_tmr" 1 /end MEASUREMENT
/begin MEASUREMENT efd_map_log_tmr "egr map log timer" UBYTE u_16x_tmr 0 0 0 31.875 ECU_ADDRESS 0x40004EA0 FORMAT "%5.3" SYMBOL_LINK "efd_diag_tmr" 2 /end MEASUREMENT
/begin MEASUREMENT efd_vlv_opn_tmr "egr valve open timer" UBYTE u_16x_tmr 0 0 0 31.875 ECU_ADDRESS 0x40004EA0 FORMAT "%5.3" SYMBOL_LINK "efd_diag_tmr" 3 /end MEASUREMENT
/begin MEASUREMENT efd_en_dly "enable delay" UBYTE u_16x_tmr 0 0 0 31.875 ECU_ADDRESS 0x40004EA0 FORMAT "%5.3" SYMBOL_LINK "efd_diag_tmr" 4 /end MEASUREMENT
/begin MEASUREMENT efd_tst_dly "diag delay" UBYTE u_16x_tmr 0 0 0 31.875 ECU_ADDRESS 0x40004EA0 FORMAT "%5.3" SYMBOL_LINK "efd_diag_tmr" 5 /end MEASUREMENT
/begin MEASUREMENT efd_map_stbl_dly "egr valve close timer" UBYTE u_16x_tmr 0 0 0 31.875 ECU_ADDRESS 0x40004EA0 FORMAT "%5.3" SYMBOL_LINK "efd_diag_tmr" 6 /end MEASUREMENT
/begin MEASUREMENT efd_map_stbl_dly_fn "map stable delay finish" UBYTE b_true 0 0 0.00 1.00 ECU_ADDRESS 0x4000440A FORMAT "%1.0" /end MEASUREMENT
/begin MEASUREMENT efd_egr_opn_sp "egr open setpoint" UWORD u_pct 0 0 0 199.996948242187 ECU_ADDRESS 0x4000DA4E FORMAT "%4.1" /end MEASUREMENT
/begin MEASUREMENT efd_min_espd "min engine speed when diag enable" UWORD u_espd 0 0 0 8191.875 ECU_ADDRESS 0x400050DA FORMAT "%6.2" /end MEASUREMENT
/begin MEASUREMENT efd_vlv_opn_stp "egr valve open step" UWORD u_pct 0 0 0 199.996948242187 ECU_ADDRESS 0x4000DA4E FORMAT "%4.1" /end MEASUREMENT
/begin MEASUREMENT efd_vlv_cls_stp "egr valve close step" UWORD u_pct 0 0 0 199.996948242187 ECU_ADDRESS 0x4000DA4E FORMAT "%4.1" /end MEASUREMENT
/begin MEASUREMENT efd_vlv_sp "egr valve setpoint" UWORD u_pct 0 0 0 199.996948242187 ECU_ADDRESS 0x4000DA4E FORMAT "%4.1" /end MEASUREMENT
/begin MEASUREMENT efd_log_fn "log finish" UBYTE b_true 0 0 0.00 1.00 ECU_ADDRESS 0x4000440A FORMAT "%1.0" /end MEASUREMENT
/begin MEASUREMENT efd_vlv_ctrl_fn "valve control finish" UBYTE b_true 0 0 0.00 1.00 ECU_ADDRESS 0x4000440A FORMAT "%1.0" /end MEASUREMENT
/begin MEASUREMENT efd_vlv_max_pos "egr valve max position" UWORD u_pct 0 0 0 199.996948242187 ECU_ADDRESS 0x4000DA4E FORMAT "%4.1" /end MEASUREMENT
/begin MEASUREMENT efd_vlv_opn_lo "valve open low" UBYTE b_true 0 0 0.00 1.00 ECU_ADDRESS 0x4000440A FORMAT "%1.0" /end MEASUREMENT
/begin MEASUREMENT efd_max_map "max map" UWORD u_kPa_0_256 0 0 0 255.99609375 ECU_ADDRESS 0x4000DA4E /end MEASUREMENT
/begin MEASUREMENT efd_min_map "min map" UWORD u_kPa_0_256 0 0 0 255.99609375 ECU_ADDRESS 0x4000DA4E /end MEASUREMENT
/begin MEASUREMENT efd_max_map_dlt "max map delta" UWORD u_kPa_0_256 0 0 0 255.99609375 ECU_ADDRESS 0x4000DA4E /end MEASUREMENT
/begin MEASUREMENT efd_dsr_map_dlt "desired map delta" UWORD u_kPa_0_256 0 0 0 255.99609375 ECU_ADDRESS 0x4000DA4E /end MEASUREMENT
/begin MEASUREMENT efd_map_dlt_diff "map delta difference" SWORD u_kPa_256n_256p 0 0 -256 255.9921875 ECU_ADDRESS 0x4000DA4E /end MEASUREMENT
/begin MEASUREMENT efd_tst_rslt_raw "test result raw" UBYTE u_cfd_fail 0 0 0.00 1.00 ECU_ADDRESS 0x4000440A FORMAT "%1.0" /end MEASUREMENT
/begin MEASUREMENT efd_pass_cnts "diag pass counts" UBYTE u_cnts 0 0 0.00 255.00 ECU_ADDRESS 0x4000440A /end MEASUREMENT
/begin MEASUREMENT efd_mmv_rst_req "daig mmv rest req" UBYTE b_true 0 0 0.00 1.00 ECU_ADDRESS 0x4000440A FORMAT "%1.0" /end MEASUREMENT
/begin MEASUREMENT efd_vlv_sp_fac "egr valve setpoint factor" UWORD u_pct 0 0 0 199.996948242187 ECU_ADDRESS 0x4000DA4E FORMAT "%4.1" /end MEASUREMENT
/begin MEASUREMENT efd_vlv_sp_fac_bs "diag valve open setpoint factor base counts" UBYTE u_cnts 0 0 0.00 255.00 ECU_ADDRESS 0x4000440A /end MEASUREMENT
/begin MEASUREMENT efd_mmv_req "mmv calculate req" UBYTE b_true 0 0 0.00 1.00 ECU_ADDRESS 0x4000440A FORMAT "%1.0" /end MEASUREMENT
/begin MEASUREMENT efd_init_ps_cnt "pass counts after fail" UBYTE u_cnts 0 0 0.00 255.00 ECU_ADDRESS 0x4000440A /end MEASUREMENT
/begin MEASUREMENT efd_base_tst_fn "mmv calculate req" UBYTE b_true 0 0 0.00 1.00 ECU_ADDRESS 0x4000440A FORMAT "%1.0" /end MEASUREMENT
/begin MEASUREMENT efd_mmv_fn "mmv calculate finished" UBYTE b_true 0 0 0.00 1.00 ECU_ADDRESS 0x4000440A FORMAT "%1.0" /end MEASUREMENT
/begin MEASUREMENT efd_trp_ps_cnt "trip pass counts" UBYTE u_cnts 0 0 0.00 255.00 ECU_ADDRESS 0x4000440A /end MEASUREMENT
/begin MEASUREMENT efd_ps_rpt_req "pass report req" UBYTE b_true 0 0 0.00 1.00 ECU_ADDRESS 0x4000440A FORMAT "%1.0" /end MEASUREMENT
/begin MEASUREMENT efd_base_tst_actv "trip base test active" UBYTE b_true 0 0 0.00 1.00 ECU_ADDRESS 0x4000440A FORMAT "%1.0" /end MEASUREMENT
/begin MEASUREMENT efd_map_diff_mmv "map delta difference mmv" SWORD u_kPa_256n_256p 0 0 -256 255.9921875 ECU_ADDRESS 0x4000DA4E /end MEASUREMENT
/begin MEASUREMENT efd_fl_thr "diag fail thr" SWORD u_kPa_256n_256p 0 0 -256 255.9921875 ECU_ADDRESS 0x4000DA4E /end MEASUREMENT
/begin MEASUREMENT efd_diag_fl "diag fail" UBYTE b_true 0 0 0.00 1.00 ECU_ADDRESS 0x4000440A FORMAT "%1.0" /end MEASUREMENT
/begin MEASUREMENT efd_tot_tst_cnt "total test counts" UBYTE u_cnts 0 0 0.00 255.00 ECU_ADDRESS 0x4000440A /end MEASUREMENT
/begin MEASUREMENT efd_trip_tst_cnt "trip test counts" UBYTE u_cnts 0 0 0.00 255.00 ECU_ADDRESS 0x4000440A /end MEASUREMENT
/begin MEASUREMENT efd_rpt_en "diag report enable" UBYTE b_true 0 0 0.00 1.00 ECU_ADDRESS 0x4000440A FORMAT "%1.0" /end MEASUREMENT
/begin MEASUREMENT srv_ctrl_actv "service control active" UBYTE b_true 0 0 0.00 1.00 ECU_ADDRESS 0x40004EA0 FORMAT "%1.0" /end MEASUREMENT
/begin MEASUREMENT srv_vnt_vlv_st "service vent valve state" UBYTE u_srv_evam_vlv_st 0 0 0.00 2.00 ECU_ADDRESS 0x40004EA0 FORMAT "%1.0" /end MEASUREMENT
/begin MEASUREMENT srv_tel_eol_req "eol tooth learn request" UBYTE b_true 0 0 0.00 1.00 ECU_ADDRESS 0x40004EA0 FORMAT "%1.0" /end MEASUREMENT
/begin MEASUREMENT cpud_ecu_seq_fl_cnt "ecu exec sequence fail counts" UWORD u_cnts 0 0 0.00 65535.00 ECU_ADDRESS 0x4000440A FORMAT "%5.0" /end MEASUREMENT
/begin MEASUREMENT cpud_ecu_seq_err "ecu exec sequence error" UBYTE b_true 0 0 0.00 1.00 ECU_ADDRESS 0x4000440A FORMAT "%1.0" /end MEASUREMENT
/begin MEASUREMENT cpud_ecu_seq_fl "ecu exec sequence fail" UBYTE b_true 0 0 0.00 1.00 ECU_ADDRESS 0x4000440A FORMAT "%1.0" /end MEASUREMENT
/begin MEASUREMENT cpud_ecu_seq_fn "ecu exec sequence finish" UBYTE b_true 0 0 0.00 1.00 ECU_ADDRESS 0x4000440A FORMAT "%1.0" /end MEASUREMENT
/begin MEASUREMENT cpud_vref1_fl_cnt "vref1 fail counts" UWORD u_cnts 0 0 0 65535 ECU_ADDRESS 0x40004EA0 FORMAT "%5.0" SYMBOL_LINK "cpud_vref_info" 0 /end MEASUREMENT
/begin MEASUREMENT cpud_vref1_diag_cnt "vref1 diag counts" UWORD u_cnts 0 0 0 65535 ECU_ADDRESS 0x40004EA0 FORMAT "%5.0" SYMBOL_LINK "cpud_vref_info" 2 /end MEASUREMENT
/begin MEASUREMENT cpud_vref1_diag_en "vref1 diag enable conditions met" UBYTE b_true 0 0 0.00 1.00 BIT_MASK 0x20 ECU_ADDRESS 0x40004EA0 FORMAT "%5.0" SYMBOL_LINK "cpud_vref_info" 4 /end MEASUREMENT
/begin MEASUREMENT cpud_vref1_fl_met "vref1 fail conditions met" UBYTE b_true 0 0 0.00 1.00 BIT_MASK 0x10 ECU_ADDRESS 0x40004EA0 FORMAT "%5.0" SYMBOL_LINK "cpud_vref_info" 4 /end MEASUREMENT
/begin MEASUREMENT cpud_vref1_fn "vref1 diag finish" UBYTE b_true 0 0 0.00 1.00 BIT_MASK 0x08 ECU_ADDRESS 0x40004EA0 FORMAT "%5.0" SYMBOL_LINK "cpud_vref_info" 4 /end MEASUREMENT
/begin MEASUREMENT cpud_vref1_fl "vref1 diag fail" UBYTE b_true 0 0 0.00 1.00 BIT_MASK 0x04 ECU_ADDRESS 0x40004EA0 FORMAT "%5.0" SYMBOL_LINK "cpud_vref_info" 4 /end MEASUREMENT
/begin MEASUREMENT cpud_vref1_rpt_st "vref1 diag report state" UBYTE u_rpt_st 0 0 0.00 2.00 BIT_MASK 0x03 ECU_ADDRESS 0x40004EA0 SYMBOL_LINK "cpud_vref_info" 4 /end MEASUREMENT
/begin MEASUREMENT cpud_vref2_fl_cnt "vref2 fail counts" UWORD u_cnts 0 0 0 65535 ECU_ADDRESS 0x40004EA0 FORMAT "%5.0" SYMBOL_LINK "cpud_vref_info" 6 /end MEASUREMENT
/begin MEASUREMENT cpud_vref2_diag_cnt "vref2 diag counts" UWORD u_cnts 0 0 0 65535 ECU_ADDRESS 0x40004EA0 FORMAT "%5.0" SYMBOL_LINK "cpud_vref_info" 8 /end MEASUREMENT
/begin MEASUREMENT cpud_vref2_diag_en "vref2 diag enable conditions met" UBYTE b_true 0 0 0.00 1.00 BIT_MASK 0x20 ECU_ADDRESS 0x40004EA0 FORMAT "%5.0" SYMBOL_LINK "cpud_vref_info" 10 /end MEASUREMENT
/begin MEASUREMENT cpud_vref2_fl_met "vref2 fail conditions met" UBYTE b_true 0 0 0.00 1.00 BIT_MASK 0x10 ECU_ADDRESS 0x40004EA0 FORMAT "%5.0" SYMBOL_LINK "cpud_vref_info" 10 /end MEASUREMENT
/begin MEASUREMENT cpud_vref2_fn "vref2 diag finish" UBYTE b_true 0 0 0.00 1.00 BIT_MASK 0x08 ECU_ADDRESS 0x40004EA0 FORMAT "%5.0" SYMBOL_LINK "cpud_vref_info" 10 /end MEASUREMENT
/begin MEASUREMENT cpud_vref2_fl "vref2 diag fail" UBYTE b_true 0 0 0.00 1.00 BIT_MASK 0x04 ECU_ADDRESS 0x40004EA0 FORMAT "%5.0" SYMBOL_LINK "cpud_vref_info" 10 /end MEASUREMENT
/begin MEASUREMENT cpud_vref2_rpt_st "vref2 diag report state" UBYTE u_rpt_st 0 0 0.00 2.00 BIT_MASK 0x03 ECU_ADDRESS 0x40004EA0 SYMBOL_LINK "cpud_vref_info" 10 /end MEASUREMENT
/begin MEASUREMENT cpud_vref3_fl_cnt "vref3 fail counts" UWORD u_cnts 0 0 0 65535 ECU_ADDRESS 0x40004EA0 FORMAT "%5.0" SYMBOL_LINK "cpud_vref_info" 12 /end MEASUREMENT
/begin MEASUREMENT cpud_vref3_diag_cnt "vref3 diag counts" UWORD u_cnts 0 0 0 65535 ECU_ADDRESS 0x40004EA0 FORMAT "%5.0" SYMBOL_LINK "cpud_vref_info" 14 /end MEASUREMENT
/begin MEASUREMENT cpud_vref3_diag_en "vref3 diag enable conditions met" UBYTE b_true 0 0 0.00 1.00 BIT_MASK 0x20 ECU_ADDRESS 0x40004EA0 FORMAT "%5.0" SYMBOL_LINK "cpud_vref_info" 16 /end MEASUREMENT
/begin MEASUREMENT cpud_vref3_fl_met "vref3 fail conditions met" UBYTE b_true 0 0 0.00 1.00 BIT_MASK 0x10 ECU_ADDRESS 0x40004EA0 FORMAT "%5.0" SYMBOL_LINK "cpud_vref_info" 16 /end MEASUREMENT
/begin MEASUREMENT cpud_vref3_fn "vref3 diag finish" UBYTE b_true 0 0 0.00 1.00 BIT_MASK 0x08 ECU_ADDRESS 0x40004EA0 FORMAT "%5.0" SYMBOL_LINK "cpud_vref_info" 16 /end MEASUREMENT
/begin MEASUREMENT cpud_vref3_fl "vref3 diag fail" UBYTE b_true 0 0 0.00 1.00 BIT_MASK 0x04 ECU_ADDRESS 0x40004EA0 FORMAT "%5.0" SYMBOL_LINK "cpud_vref_info" 16 /end MEASUREMENT
/begin MEASUREMENT cpud_vref3_rpt_st "vref3 diag report state" UBYTE u_rpt_st 0 0 0.00 2.00 BIT_MASK 0x03 ECU_ADDRESS 0x40004EA0 SYMBOL_LINK "cpud_vref_info" 16 /end MEASUREMENT
/begin MEASUREMENT cpud_vref1_vlt_pct "vref1 voltage percent" UWORD u_pct 0 0 0.0 199.996948242187 ECU_ADDRESS 0x4000DA4E SYMBOL_LINK "cpud_vref_vlt_pct" 0 /end MEASUREMENT
/begin MEASUREMENT cpud_vref2_vlt_pct "vref1 voltage percent" UWORD u_pct 0 0 0.0 199.996948242187 ECU_ADDRESS 0x4000DA4E SYMBOL_LINK "cpud_vref_vlt_pct" 4 /end MEASUREMENT
/begin MEASUREMENT cpud_vref3_vlt_pct "vref1 voltage percent" UWORD u_pct 0 0 0.0 199.996948242187 ECU_ADDRESS 0x4000DA4E SYMBOL_LINK "cpud_vref_vlt_pct" 8 /end MEASUREMENT
/begin MEASUREMENT cpud_clk_fl_cnt "clock fail counts" UWORD u_cnts 0 0 0 65535 ECU_ADDRESS 0x40004EA0 FORMAT "%5.0" SYMBOL_LINK "cpud_clk_info" 0 /end MEASUREMENT
/begin MEASUREMENT cpud_clk_diag_cnt "clock diag counts" UWORD u_cnts 0 0 0 65535 ECU_ADDRESS 0x40004EA0 FORMAT "%5.0" SYMBOL_LINK "cpud_clk_info" 2 /end MEASUREMENT
/begin MEASUREMENT cpud_clk_diag_en "clock diag enable conditions met" UBYTE b_true 0 0 0.00 1.00 BIT_MASK 0x20 ECU_ADDRESS 0x40004EA0 FORMAT "%5.0" SYMBOL_LINK "cpud_clk_info" 4 /end MEASUREMENT
/begin MEASUREMENT cpud_clk_fl_met "clock fail conditions met" UBYTE b_true 0 0 0.00 1.00 BIT_MASK 0x10 ECU_ADDRESS 0x40004EA0 FORMAT "%5.0" SYMBOL_LINK "cpud_clk_info" 4 /end MEASUREMENT
/begin MEASUREMENT cpud_clk_fn "clock diag finish" UBYTE b_true 0 0 0.00 1.00 BIT_MASK 0x08 ECU_ADDRESS 0x40004EA0 FORMAT "%5.0" SYMBOL_LINK "cpud_clk_info" 4 /end MEASUREMENT
/begin MEASUREMENT cpud_clk_fl "clock diag fail" UBYTE b_true 0 0 0.00 1.00 BIT_MASK 0x04 ECU_ADDRESS 0x40004EA0 FORMAT "%5.0" SYMBOL_LINK "cpud_clk_info" 4 /end MEASUREMENT
/begin MEASUREMENT cpud_ram_fl "ram fail" UBYTE b_true 0 0 0.00 1.00 ECU_ADDRESS 0x40004EA0 FORMAT "%5.0" /end MEASUREMENT
/begin MEASUREMENT cpud_stck_fl "stack fail" UBYTE b_true 0 0 0.00 1.00 ECU_ADDRESS 0x40004EA0 FORMAT "%5.0" /end MEASUREMENT
/begin MEASUREMENT cpud_rom_fl "rom fail" UBYTE b_true 0 0 0.00 1.00 ECU_ADDRESS 0x40004EA0 FORMAT "%5.0" /end MEASUREMENT
/begin MEASUREMENT cpud_sw_err "software error" UBYTE b_true 0 0 0.00 1.00 ECU_ADDRESS 0x40004EA0 FORMAT "%5.0" /end MEASUREMENT
/begin MEASUREMENT cpud_cop_fl_cnt "cop fail counts" UWORD u_cnts 0 0 0 65535 ECU_ADDRESS 0x40004EA0 FORMAT "%5.0" SYMBOL_LINK "cpud_cop_info" 0 /end MEASUREMENT
/begin MEASUREMENT cpud_cop_diag_cnt "cop diag counts" UWORD u_cnts 0 0 0 65535 ECU_ADDRESS 0x40004EA0 FORMAT "%5.0" SYMBOL_LINK "cpud_cop_info" 2 /end MEASUREMENT
/begin MEASUREMENT cpud_cop_diag_en "cop diag enable conditions met" UBYTE b_true 0 0 0.00 1.00 BIT_MASK 0x20 ECU_ADDRESS 0x40004EA0 FORMAT "%5.0" SYMBOL_LINK "cpud_cop_info" 4 /end MEASUREMENT
/begin MEASUREMENT cpud_cop_fl_met "cop fail conditions met" UBYTE b_true 0 0 0.00 1.00 BIT_MASK 0x10 ECU_ADDRESS 0x40004EA0 FORMAT "%5.0" SYMBOL_LINK "cpud_cop_info" 4 /end MEASUREMENT
/begin MEASUREMENT cpud_cop_fn "cop diag finish" UBYTE b_true 0 0 0.00 1.00 BIT_MASK 0x08 ECU_ADDRESS 0x40004EA0 FORMAT "%5.0" SYMBOL_LINK "cpud_cop_info" 4 /end MEASUREMENT
/begin MEASUREMENT cpud_cop_fl "cop diag fail" UBYTE b_true 0 0 0.00 1.00 BIT_MASK 0x04 ECU_ADDRESS 0x40004EA0 FORMAT "%5.0" SYMBOL_LINK "cpud_cop_info" 4 /end MEASUREMENT
/begin MEASUREMENT cpud_gpr_fl_cnt "gpr fail counts" UWORD u_cnts 0 0 0 65535 ECU_ADDRESS 0x40004EA0 FORMAT "%5.0" SYMBOL_LINK "cpud_gpr_info" 0 /end MEASUREMENT
/begin MEASUREMENT cpud_gpr_diag_cnt "gpr diag counts" UWORD u_cnts 0 0 0 65535 ECU_ADDRESS 0x40004EA0 FORMAT "%5.0" SYMBOL_LINK "cpud_gpr_info" 2 /end MEASUREMENT
/begin MEASUREMENT cpud_gpr_diag_en "gpr diag enable conditions met" UBYTE b_true 0 0 0.00 1.00 BIT_MASK 0x20 ECU_ADDRESS 0x40004EA0 FORMAT "%5.0" SYMBOL_LINK "cpud_gpr_info" 4 /end MEASUREMENT
/begin MEASUREMENT cpud_gpr_fl_met "gpr fail conditions met" UBYTE b_true 0 0 0.00 1.00 BIT_MASK 0x10 ECU_ADDRESS 0x40004EA0 FORMAT "%5.0" SYMBOL_LINK "cpud_gpr_info" 4 /end MEASUREMENT
/begin MEASUREMENT cpud_gpr_fn "gpr diag finish" UBYTE b_true 0 0 0.00 1.00 BIT_MASK 0x08 ECU_ADDRESS 0x40004EA0 FORMAT "%5.0" SYMBOL_LINK "cpud_gpr_info" 4 /end MEASUREMENT
/begin MEASUREMENT cpud_gpr_fl "gpr diag fail" UBYTE b_true 0 0 0.00 1.00 BIT_MASK 0x04 ECU_ADDRESS 0x40004EA0 FORMAT "%5.0" SYMBOL_LINK "cpud_gpr_info" 4 /end MEASUREMENT
/begin MEASUREMENT cpud_adc_fl_cnt "adc fail counts" UWORD u_cnts 0 0 0 65535 ECU_ADDRESS 0x40004EA0 FORMAT "%5.0" SYMBOL_LINK "cpud_adc_info" 0 /end MEASUREMENT
/begin MEASUREMENT cpud_adc_diag_cnt "adc diag counts" UWORD u_cnts 0 0 0 65535 ECU_ADDRESS 0x40004EA0 FORMAT "%5.0" SYMBOL_LINK "cpud_adc_info" 2 /end MEASUREMENT
/begin MEASUREMENT cpud_adc_diag_en "adc diag enable conditions met" UBYTE b_true 0 0 0.00 1.00 BIT_MASK 0x20 ECU_ADDRESS 0x40004EA0 FORMAT "%5.0" SYMBOL_LINK "cpud_adc_info" 4 /end MEASUREMENT
/begin MEASUREMENT cpud_adc_fl_met "adc fail conditions met" UBYTE b_true 0 0 0.00 1.00 BIT_MASK 0x10 ECU_ADDRESS 0x40004EA0 FORMAT "%5.0" SYMBOL_LINK "cpud_adc_info" 4 /end MEASUREMENT
/begin MEASUREMENT cpud_adc_fn "adc diag finish" UBYTE b_true 0 0 0.00 1.00 BIT_MASK 0x08 ECU_ADDRESS 0x40004EA0 FORMAT "%5.0" SYMBOL_LINK "cpud_adc_info" 4 /end MEASUREMENT
/begin MEASUREMENT cpud_adc_fl "adc diag fail" UBYTE b_true 0 0 0.00 1.00 BIT_MASK 0x04 ECU_ADDRESS 0x40004EA0 FORMAT "%5.0" SYMBOL_LINK "cpud_adc_info" 4 /end MEASUREMENT
/begin MEASUREMENT cpud_ig_espd_grd "engine speed gradient" SWORD u_espd_grd 0 0 -32768 32767 ECU_ADDRESS 0x40004EA0 /end MEASUREMENT
/begin MEASUREMENT cpud_ig_en_dly "ignition enable delay" UWORD u_cnts 0 0 0 65535 ECU_ADDRESS 0x40004EA0 FORMAT "%5.0" /end MEASUREMENT
/begin MEASUREMENT cpud_ig_ang_sp "ignition angle" SWORD u_iga 0 0 -256.0 255.9921875 ECU_ADDRESS 0x40004686 FORMAT "%4.2" /end MEASUREMENT
/begin MEASUREMENT cpud_ig_ang_act "ignition actual angle" SWORD u_iga 0 0 -256.0 255.9921875 ECU_ADDRESS 0x40004686 FORMAT "%4.2" /end MEASUREMENT
/begin MEASUREMENT cpud_ig_fl_cnt "ignition fail counts" UWORD u_cnts 0 0 0 65535 ECU_ADDRESS 0x40004EA0 FORMAT "%5.0" SYMBOL_LINK "cpud_ig_info" 0 /end MEASUREMENT
/begin MEASUREMENT cpud_ig_diag_cnt "ignition diag counts" UWORD u_cnts 0 0 0 65535 ECU_ADDRESS 0x40004EA0 FORMAT "%5.0" SYMBOL_LINK "cpud_ig_info" 2 /end MEASUREMENT
/begin MEASUREMENT cpud_ig_diag_en "ignition diag enable conditions met" UBYTE b_true 0 0 0.00 1.00 BIT_MASK 0x20 ECU_ADDRESS 0x40004EA0 FORMAT "%5.0" SYMBOL_LINK "cpud_ig_info" 4 /end MEASUREMENT
/begin MEASUREMENT cpud_ig_fl_met "ignition fail conditions met" UBYTE b_true 0 0 0.00 1.00 BIT_MASK 0x10 ECU_ADDRESS 0x40004EA0 FORMAT "%5.0" SYMBOL_LINK "cpud_ig_info" 4 /end MEASUREMENT
/begin MEASUREMENT cpud_ig_fn "ignition diag finish" UBYTE b_true 0 0 0.00 1.00 BIT_MASK 0x08 ECU_ADDRESS 0x40004EA0 FORMAT "%5.0" SYMBOL_LINK "cpud_ig_info" 4 /end MEASUREMENT
/begin MEASUREMENT cpud_ig_fl "ignition diag fail" UBYTE b_true 0 0 0.00 1.00 BIT_MASK 0x04 ECU_ADDRESS 0x40004EA0 FORMAT "%5.0" SYMBOL_LINK "cpud_ig_info" 4 /end MEASUREMENT
/begin MEASUREMENT cpud_ig_ang_rtd "ignition retard angle" SWORD u_iga_256 0 0 0 255.99609375 ECU_ADDRESS 0x40004686 /end MEASUREMENT
/begin MEASUREMENT cpud_ig_ang_adv "ignition advance angle" SWORD u_iga_256 0 0 0 255.99609375 ECU_ADDRESS 0x40004686 /end MEASUREMENT
/*-----------------GPF NV --------------------*/
/begin MEASUREMENT gpf_a1_ofst_nv "a1 coefficient offset stored in nvv." SWORD p_t_GPF_COUNT_N32768_32767 0 0 -32768 32767 ECU_ADDRESS 0x40001B61 /end MEASUREMENT
/begin MEASUREMENT gpf_soot_ash_std_dp_nv "dp due to ash +soot under std.visc and flw" SWORD p_t_GPF_SI_N512_512 0 0 -512.000000 511.984375 ECU_ADDRESS 0x40001B61 /end MEASUREMENT
/begin MEASUREMENT gpf_soot_std_dp_nv "" SWORD p_t_GPF_SI_N512_512 0 0 -512.000000 511.984375 ECU_ADDRESS 0x40001B61 /end MEASUREMENT
/begin MEASUREMENT gpf_soot_mas_nv "" SLONG p_t_GPF_SOOT_PRDT_N16_16 0 0 -16.000000 16.000000 ECU_ADDRESS 0x40001B61 /end MEASUREMENT
/*------------GPF NV-----------------*/ /*-----------GPF Delta Pressure------*/
/begin MEASUREMENT gpf_soot_mas "" UWORD p_t_GPF_SM_0_128 0 0.000000 0.000000 127.998047 ECU_ADDRESS 0x40001B61 /end MEASUREMENT
/begin MEASUREMENT gpf_dp_mod_en "" UBYTE b_true 0 0 0.00 1.00 ECU_ADDRESS 0x40001B61 FORMAT "%1.0" /end MEASUREMENT
/begin MEASUREMENT gpf_prs_out_esti "gpf out press" UWORD p_t_GPF_PRES_0_512 0 0.000000 0.000000 511.992188 ECU_ADDRESS 0x40001B61 /end MEASUREMENT
/begin MEASUREMENT gpf_prs_in_esti "gpf in press" UWORD p_t_GPF_PRES_0_512 0 0.000000 0.000000 511.992188 ECU_ADDRESS 0x40001B61 /end MEASUREMENT
/begin MEASUREMENT gpf_exh_gas_dyn_visc "" UWORD p_t_GPF_VISC 0 0.000000 0.000000 0.000061 ECU_ADDRESS 0x40001B61 /end MEASUREMENT
/begin MEASUREMENT gpf_exh_gas_dens "" UWORD p_t_GPF_DENS 0 0.000000 0.000000 3.999938964844 ECU_ADDRESS 0x40001B61 /end MEASUREMENT
/begin MEASUREMENT gpf_exh_flw "" UWORD p_t_GPF_FLW 0 0.000000 0.000000 4095.9375 ECU_ADDRESS 0x40001B61 /end MEASUREMENT
/begin MEASUREMENT gpf_a1_cln "" UWORD p_t_GPF_COUNT_0_65535 0 0.000000 0.000000 65535 ECU_ADDRESS 0x40001B61 /end MEASUREMENT
/begin MEASUREMENT gpf_a2_cln "" UWORD p_t_GPF_COUNT_0_65535 0 0.000000 0.000000 65535 ECU_ADDRESS 0x40001B61 /end MEASUREMENT
/begin MEASUREMENT gpf_dp_cln_trm1 "" ULONG p_t_GPF_TRM_LONG 0 0.000000 0.000000 2048.000000 ECU_ADDRESS 0x40001B61 /end MEASUREMENT
/begin MEASUREMENT gpf_dp_cln_trm2 "" ULONG p_t_GPF_TRM_LONG 0 0.000000 0.000000 2048.000000 ECU_ADDRESS 0x40001B61 /end MEASUREMENT
/begin MEASUREMENT gpf_dp_cln "" SWORD p_t_GPF_SI_N512_512 0 0.000000 -512.000000 511.984375 ECU_ADDRESS 0x40001B61 /end MEASUREMENT
/begin MEASUREMENT gpf_soot_ash_dp "" SWORD p_t_GPF_SI_N512_512 0 0.000000 -512.000000 511.984375 ECU_ADDRESS 0x40001B61 /end MEASUREMENT
/begin MEASUREMENT gpf_soot_ash_dp_flt "" SWORD p_t_GPF_SI_N512_512 0 0.000000 -512.000000 511.984375 ECU_ADDRESS 0x40001B61 /end MEASUREMENT
/begin MEASUREMENT gpf_soot_ash_ld "" SWORD p_t_GPF_SI_N512_512 0 0.000000 -512.000000 511.984375 ECU_ADDRESS 0x40001B61 /end MEASUREMENT
/begin MEASUREMENT gpf_soot_cake_dp "" SWORD p_t_GPF_SI_N512_512 0 0.000000 -512.000000 511.984375 ECU_ADDRESS 0x40001B61 /end MEASUREMENT
/begin MEASUREMENT gpf_soot_ld "" SWORD p_t_GPF_SI_N512_512 0 0.000000 -512.000000 511.984375 ECU_ADDRESS 0x40001B61 /end MEASUREMENT
/*-----------GPF Delta Pressure------*/ /*-----------GPF Engine Out----------*/
/begin MEASUREMENT gpf_eo_soot_mas "" UWORD p_t_GPF_SM_0_128 0 0.000000 0.000000 127.998047 ECU_ADDRESS 0x40001B61 /end MEASUREMENT
/begin MEASUREMENT gpf_soot_rt_in_temp "" SWORD p_t_GPF_TEMP_N2048_2048 0 0.000000 -2048 2047.937500 ECU_ADDRESS 0x40001B61 /end MEASUREMENT
/begin MEASUREMENT gpf_soot_rt_out_temp "" SWORD p_t_GPF_TEMP_N2048_2048 0 0.000000 -2048 2047.937500 ECU_ADDRESS 0x40001B61 /end MEASUREMENT
/begin MEASUREMENT gpf_soot_rt_bed_temp "" SWORD p_t_GPF_TEMP_N2048_2048 0 0.000000 -2048 2047.937500 ECU_ADDRESS 0x40001B61 /end MEASUREMENT
/begin MEASUREMENT gpf_co2_burn_rt "" SLONG p_t_GPF_SM_BURN_N2048_2048_LONG 0 0.000000 -2048 2047.999999 ECU_ADDRESS 0x40001B61 /end MEASUREMENT
/begin MEASUREMENT gpf_o2_burn_rt "" SLONG p_t_GPF_SM_BURN_N2048_2048_LONG 0 0.000000 -2048 2047.999999 ECU_ADDRESS 0x40001B61 /end MEASUREMENT
/begin MEASUREMENT gpf_soot_burn_rt "" SLONG p_t_GPF_SM_BURN_N2048_2048_LONG 0 0.000000 -2048 2047.999999 ECU_ADDRESS 0x40001B61 /end MEASUREMENT
/begin MEASUREMENT gpf_fuel_flt "fuel mass." UWORD u_g_per_sec_2048 0 0 0.0 2047.96875 ECU_ADDRESS 0x40004D90 /end MEASUREMENT
/begin MEASUREMENT gpf_fuel_flw_diff "" SWORD p_t_GPF_FUEL_FLW_DIF_N256_256 0 0.000000 -256 255.992188 ECU_ADDRESS 0x40001B61 /end MEASUREMENT
/begin MEASUREMENT gpf_fuel_flw_diff_flt "" SWORD p_t_GPF_FUEL_FLW_DIF_N256_256 0 0.000000 -256 255.992188 ECU_ADDRESS 0x40001B61 /end MEASUREMENT
/begin MEASUREMENT gpf_soot_prdt_rt "" SLONG p_t_GPF_SM_BURN_N2048_2048_LONG 0 0.000000 -2048 2047.999999 ECU_ADDRESS 0x40001B61 /end MEASUREMENT
/begin MEASUREMENT gpf_test "ratio" ULONG u_fac_256_l 0 0 0 255.99999994 ECU_ADDRESS 0x4000561A /end MEASUREMENT
/begin MEASUREMENT gpf_test_1 "ratio" ULONG u_fac_256_l 0 0 0 255.99999994 ECU_ADDRESS 0x4000561A /end MEASUREMENT
/begin MEASUREMENT gpf_test_2 "ratio" ULONG u_fac_64_l 0 0 0 63.99999998 ECU_ADDRESS 0x4000561A /end MEASUREMENT
/begin MEASUREMENT gpf_test_3 "ratio" ULONG u_fac_256_l 0 0 0 255.99999994 ECU_ADDRESS 0x4000561A /end MEASUREMENT
/begin MEASUREMENT gpf_mdl_rst_req "" UBYTE b_true 0 0 0.00 1.00 ECU_ADDRESS 0x40001B61 FORMAT "%1.0" /end MEASUREMENT
/begin MEASUREMENT gpf_ash_lrn_req "" UBYTE b_true 0 0 0.00 1.00 ECU_ADDRESS 0x40001B61 FORMAT "%1.0" /end MEASUREMENT
/begin MEASUREMENT gpf_soot_prdt "" SLONG p_t_GPF_SOOT_PRDT_N16_16 0 0 -16.000000 16.000000 ECU_ADDRESS 0x40001B61 /end MEASUREMENT
/begin MEASUREMENT gpf_soot_burn "" SLONG p_t_GPF_SOOT_PRDT_N16_16 0 0 -16.000000 16.000000 ECU_ADDRESS 0x40001B61 /end MEASUREMENT
/begin MEASUREMENT gpf_soot_mas_dt_hi "" SLONG p_t_GPF_SOOT_PRDT_N16_16 0 0 -16.000000 16.000000 ECU_ADDRESS 0x40001B61 /end MEASUREMENT
/begin AXIS_PTS IG_X_ESPD_E "engine speed breakpoint" 0x0002006C sys_eng_spd SSV__UWORD_S 0 u_espd 12 0 8191.875 FORMAT "%6.2" DEPOSIT ABSOLUTE SYMBOL_LINK "IG_X_ESPD_E" 2 /end AXIS_PTS
/begin AXIS_PTS VVT_X_OIL_T_A "oil temp breakpoint" 0x0002006C sys_oil_t SSV__SWORD_S 0 u_deg_C 5 -256.000000 255.9921875 DEPOSIT ABSOLUTE SYMBOL_LINK "VVT_X_OIL_T_A" 2 /end AXIS_PTS
/begin CHARACTERISTIC CAN_V_RX_00_ID "can rx msg ID" VALUE 0x0002038C __UWORD_S 0 u_cnts 0 65535 FORMAT "%5.0" SYMBOL_LINK "CAN_RX_MSG_CFG" 0 /end CHARACTERISTIC
/begin CHARACTERISTIC CAN_V_RX_00_DLC "can rx msg DLC" VALUE 0x0002038C __UBYTE_S 0 u_cnts 0 255 SYMBOL_LINK "CAN_RX_MSG_CFG" 2 /end CHARACTERISTIC
/begin CHARACTERISTIC CAN_V_RX_00_TYP "can rx msg type" VALUE 0x0002038C __UBYTE_S 0 u_can_rx_typ 0 13 FORMAT "%1.0" SYMBOL_LINK "CAN_RX_MSG_CFG" 3 /end CHARACTERISTIC
/begin CHARACTERISTIC CAN_V_RX_00_FL_TM "can rx msg fail time" VALUE 0x0002038C __UWORD_S 0 u_millisec_8192 0 8191.875 FORMAT "%5.1" SYMBOL_LINK "CAN_RX_MSG_CFG" 4 /end CHARACTERISTIC
/begin CHARACTERISTIC CAN_V_RX_00_ROLL_THR "can rx msg rolling count thr" VALUE 0x0002038C __UBYTE_S 0 u_cnts 0 255 SYMBOL_LINK "CAN_RX_MSG_CFG" 6 /end CHARACTERISTIC
/begin CHARACTERISTIC CAN_V_RX_00_CHN "can rx msg channel" VALUE 0x0002038C __UBYTE_S 0 u_can_chn 0 2 FORMAT "%1.0" SYMBOL_LINK "CAN_RX_MSG_CFG" 7 /end CHARACTERISTIC
/begin CHARACTERISTIC CAN_V_RX_01_ID "can rx msg ID" VALUE 0x0002038C __UWORD_S 0 u_cnts 0 65535 FORMAT "%5.0" SYMBOL_LINK "CAN_RX_MSG_CFG" 8 /end CHARACTERISTIC
/begin CHARACTERISTIC CAN_V_RX_01_DLC "can rx msg DLC" VALUE 0x0002038C __UBYTE_S 0 u_cnts 0 255 SYMBOL_LINK "CAN_RX_MSG_CFG" 10 /end CHARACTERISTIC
/begin CHARACTERISTIC CAN_V_RX_01_TYP "can rx msg type" VALUE 0x0002038C __UBYTE_S 0 u_can_rx_typ 0 13 FORMAT "%1.0" SYMBOL_LINK "CAN_RX_MSG_CFG" 11 /end CHARACTERISTIC
/begin CHARACTERISTIC CAN_V_RX_01_FL_TM "can rx msg fail time" VALUE 0x0002038C __UWORD_S 0 u_millisec_8192 0 8191.875 FORMAT "%5.1" SYMBOL_LINK "CAN_RX_MSG_CFG" 12 /end CHARACTERISTIC
/begin CHARACTERISTIC CAN_V_RX_01_ROLL_THR "can rx msg rolling count thr" VALUE 0x0002038C __UBYTE_S 0 u_cnts 0 255 SYMBOL_LINK "CAN_RX_MSG_CFG" 14 /end CHARACTERISTIC
/begin CHARACTERISTIC CAN_V_RX_01_CHN "can rx msg channel" VALUE 0x0002038C __UBYTE_S 0 u_can_chn 0 2 FORMAT "%1.0" SYMBOL_LINK "CAN_RX_MSG_CFG" 15 /end CHARACTERISTIC
/begin CHARACTERISTIC CAN_V_RX_02_ID "can rx msg ID" VALUE 0x0002038C __UWORD_S 0 u_cnts 0 65535 FORMAT "%5.0" SYMBOL_LINK "CAN_RX_MSG_CFG" 16 /end CHARACTERISTIC
/begin CHARACTERISTIC CAN_V_RX_02_DLC "can rx msg DLC" VALUE 0x0002038C __UBYTE_S 0 u_cnts 0 255 SYMBOL_LINK "CAN_RX_MSG_CFG" 18 /end CHARACTERISTIC
/begin CHARACTERISTIC CAN_V_RX_02_TYP "can rx msg type" VALUE 0x0002038C __UBYTE_S 0 u_can_rx_typ 0 13 FORMAT "%1.0" SYMBOL_LINK "CAN_RX_MSG_CFG" 19 /end CHARACTERISTIC
/begin CHARACTERISTIC CAN_V_RX_02_FL_TM "can rx msg fail time" VALUE 0x0002038C __UWORD_S 0 u_millisec_8192 0 8191.875 FORMAT "%5.1" SYMBOL_LINK "CAN_RX_MSG_CFG" 20 /end CHARACTERISTIC
/begin CHARACTERISTIC CAN_V_RX_02_ROLL_THR "can rx msg rolling count thr" VALUE 0x0002038C __UBYTE_S 0 u_cnts 0 255 SYMBOL_LINK "CAN_RX_MSG_CFG" 22 /end CHARACTERISTIC
/begin CHARACTERISTIC CAN_V_RX_02_CHN "can rx msg channel" VALUE 0x0002038C __UBYTE_S 0 u_can_chn 0 2 FORMAT "%1.0" SYMBOL_LINK "CAN_RX_MSG_CFG" 23 /end CHARACTERISTIC
/begin CHARACTERISTIC CAN_V_RX_03_ID "can rx msg ID" VALUE 0x0002038C __UWORD_S 0 u_cnts 0 65535 FORMAT "%5.0" SYMBOL_LINK "CAN_RX_MSG_CFG" 24 /end CHARACTERISTIC
/begin CHARACTERISTIC CAN_V_RX_03_DLC "can rx msg DLC" VALUE 0x0002038C __UBYTE_S 0 u_cnts 0 255 SYMBOL_LINK "CAN_RX_MSG_CFG" 26 /end CHARACTERISTIC
/begin CHARACTERISTIC CAN_V_RX_03_TYP "can rx msg type" VALUE 0x0002038C __UBYTE_S 0 u_can_rx_typ 0 13 FORMAT "%1.0" SYMBOL_LINK "CAN_RX_MSG_CFG" 27 /end CHARACTERISTIC
/begin CHARACTERISTIC CAN_V_RX_03_FL_TM "can rx msg fail time" VALUE 0x0002038C __UWORD_S 0 u_millisec_8192 0 8191.875 FORMAT "%5.1" SYMBOL_LINK "CAN_RX_MSG_CFG" 28 /end CHARACTERISTIC
/begin CHARACTERISTIC CAN_V_RX_03_ROLL_THR "can rx msg rolling count thr" VALUE 0x0002038C __UBYTE_S 0 u_cnts 0 255 SYMBOL_LINK "CAN_RX_MSG_CFG" 30 /end CHARACTERISTIC
/begin CHARACTERISTIC CAN_V_RX_03_CHN "can rx msg channel" VALUE 0x0002038C __UBYTE_S 0 u_can_chn 0 2 FORMAT "%1.0" SYMBOL_LINK "CAN_RX_MSG_CFG" 31 /end CHARACTERISTIC
/begin CHARACTERISTIC CAN_V_RX_04_ID "can rx msg ID" VALUE 0x0002038C __UWORD_S 0 u_cnts 0 65535 FORMAT "%5.0" SYMBOL_LINK "CAN_RX_MSG_CFG" 32 /end CHARACTERISTIC
/begin CHARACTERISTIC CAN_V_RX_04_DLC "can rx msg DLC" VALUE 0x0002038C __UBYTE_S 0 u_cnts 0 255 SYMBOL_LINK "CAN_RX_MSG_CFG" 34 /end CHARACTERISTIC
/begin CHARACTERISTIC CAN_V_RX_04_TYP "can rx msg type" VALUE 0x0002038C __UBYTE_S 0 u_can_rx_typ 0 13 FORMAT "%1.0" SYMBOL_LINK "CAN_RX_MSG_CFG" 35 /end CHARACTERISTIC
/begin CHARACTERISTIC CAN_V_RX_04_FL_TM "can rx msg fail time" VALUE 0x0002038C __UWORD_S 0 u_millisec_8192 0 8191.875 FORMAT "%5.1" SYMBOL_LINK "CAN_RX_MSG_CFG" 36 /end CHARACTERISTIC
/begin CHARACTERISTIC CAN_V_RX_04_ROLL_THR "can rx msg rolling count thr" VALUE 0x0002038C __UBYTE_S 0 u_cnts 0 255 SYMBOL_LINK "CAN_RX_MSG_CFG" 38 /end CHARACTERISTIC
/begin CHARACTERISTIC CAN_V_RX_04_CHN "can rx msg channel" VALUE 0x0002038C __UBYTE_S 0 u_can_chn 0 2 FORMAT "%1.0" SYMBOL_LINK "CAN_RX_MSG_CFG" 39 /end CHARACTERISTIC
/begin CHARACTERISTIC CAN_V_RX_05_ID "can rx msg ID" VALUE 0x0002038C __UWORD_S 0 u_cnts 0 65535 FORMAT "%5.0" SYMBOL_LINK "CAN_RX_MSG_CFG" 40 /end CHARACTERISTIC
/begin CHARACTERISTIC CAN_V_RX_05_DLC "can rx msg DLC" VALUE 0x0002038C __UBYTE_S 0 u_cnts 0 255 SYMBOL_LINK "CAN_RX_MSG_CFG" 42 /end CHARACTERISTIC
/begin CHARACTERISTIC CAN_V_RX_05_TYP "can rx msg type" VALUE 0x0002038C __UBYTE_S 0 u_can_rx_typ 0 13 FORMAT "%1.0" SYMBOL_LINK "CAN_RX_MSG_CFG" 43 /end CHARACTERISTIC
/begin CHARACTERISTIC CAN_V_RX_05_FL_TM "can rx msg fail time" VALUE 0x0002038C __UWORD_S 0 u_millisec_8192 0 8191.875 FORMAT "%5.1" SYMBOL_LINK "CAN_RX_MSG_CFG" 44 /end CHARACTERISTIC
/begin CHARACTERISTIC CAN_V_RX_05_ROLL_THR "can rx msg rolling count thr" VALUE 0x0002038C __UBYTE_S 0 u_cnts 0 255 SYMBOL_LINK "CAN_RX_MSG_CFG" 46 /end CHARACTERISTIC
/begin CHARACTERISTIC CAN_V_RX_05_CHN "can rx msg channel" VALUE 0x0002038C __UBYTE_S 0 u_can_chn 0 2 FORMAT "%1.0" SYMBOL_LINK "CAN_RX_MSG_CFG" 47 /end CHARACTERISTIC
/begin CHARACTERISTIC CAN_V_RX_06_ID "can rx msg ID" VALUE 0x0002038C __UWORD_S 0 u_cnts 0 65535 FORMAT "%5.0" SYMBOL_LINK "CAN_RX_MSG_CFG" 48 /end CHARACTERISTIC
/begin CHARACTERISTIC CAN_V_RX_06_DLC "can rx msg DLC" VALUE 0x0002038C __UBYTE_S 0 u_cnts 0 255 SYMBOL_LINK "CAN_RX_MSG_CFG" 50 /end CHARACTERISTIC
/begin CHARACTERISTIC CAN_V_RX_06_TYP "can rx msg type" VALUE 0x0002038C __UBYTE_S 0 u_can_rx_typ 0 13 FORMAT "%1.0" SYMBOL_LINK "CAN_RX_MSG_CFG" 51 /end CHARACTERISTIC
/begin CHARACTERISTIC CAN_V_RX_06_FL_TM "can rx msg fail time" VALUE 0x0002038C __UWORD_S 0 u_millisec_8192 0 8191.875 FORMAT "%5.1" SYMBOL_LINK "CAN_RX_MSG_CFG" 52 /end CHARACTERISTIC
/begin CHARACTERISTIC CAN_V_RX_06_ROLL_THR "can rx msg rolling count thr" VALUE 0x0002038C __UBYTE_S 0 u_cnts 0 255 SYMBOL_LINK "CAN_RX_MSG_CFG" 54 /end CHARACTERISTIC
/begin CHARACTERISTIC CAN_V_RX_06_CHN "can rx msg channel" VALUE 0x0002038C __UBYTE_S 0 u_can_chn 0 2 FORMAT "%1.0" SYMBOL_LINK "CAN_RX_MSG_CFG" 55 /end CHARACTERISTIC
/begin CHARACTERISTIC CAN_V_RX_07_ID "can rx msg ID" VALUE 0x0002038C __UWORD_S 0 u_cnts 0 65535 FORMAT "%5.0" SYMBOL_LINK "CAN_RX_MSG_CFG" 56 /end CHARACTERISTIC
/begin CHARACTERISTIC CAN_V_RX_07_DLC "can rx msg DLC" VALUE 0x0002038C __UBYTE_S 0 u_cnts 0 255 SYMBOL_LINK "CAN_RX_MSG_CFG" 58 /end CHARACTERISTIC
/begin CHARACTERISTIC CAN_V_RX_07_TYP "can rx msg type" VALUE 0x0002038C __UBYTE_S 0 u_can_rx_typ 0 13 FORMAT "%1.0" SYMBOL_LINK "CAN_RX_MSG_CFG" 59 /end CHARACTERISTIC
/begin CHARACTERISTIC CAN_V_RX_07_FL_TM "can rx msg fail time" VALUE 0x0002038C __UWORD_S 0 u_millisec_8192 0 8191.875 FORMAT "%5.1" SYMBOL_LINK "CAN_RX_MSG_CFG" 60 /end CHARACTERISTIC
/begin CHARACTERISTIC CAN_V_RX_07_ROLL_THR "can rx msg rolling count thr" VALUE 0x0002038C __UBYTE_S 0 u_cnts 0 255 SYMBOL_LINK "CAN_RX_MSG_CFG" 62 /end CHARACTERISTIC
/begin CHARACTERISTIC CAN_V_RX_07_CHN "can rx msg channel" VALUE 0x0002038C __UBYTE_S 0 u_can_chn 0 2 FORMAT "%1.0" SYMBOL_LINK "CAN_RX_MSG_CFG" 63 /end CHARACTERISTIC
/begin CHARACTERISTIC CAN_V_RX_08_ID "can rx msg ID" VALUE 0x0002038C __UWORD_S 0 u_cnts 0 65535 FORMAT "%5.0" SYMBOL_LINK "CAN_RX_MSG_CFG" 64 /end CHARACTERISTIC
/begin CHARACTERISTIC CAN_V_RX_08_DLC "can rx msg DLC" VALUE 0x0002038C __UBYTE_S 0 u_cnts 0 255 SYMBOL_LINK "CAN_RX_MSG_CFG" 66 /end CHARACTERISTIC
/begin CHARACTERISTIC CAN_V_RX_08_TYP "can rx msg type" VALUE 0x0002038C __UBYTE_S 0 u_can_rx_typ 0 13 FORMAT "%1.0" SYMBOL_LINK "CAN_RX_MSG_CFG" 67 /end CHARACTERISTIC
/begin CHARACTERISTIC CAN_V_RX_08_FL_TM "can rx msg fail time" VALUE 0x0002038C __UWORD_S 0 u_millisec_8192 0 8191.875 FORMAT "%5.1" SYMBOL_LINK "CAN_RX_MSG_CFG" 68 /end CHARACTERISTIC
/begin CHARACTERISTIC CAN_V_RX_08_ROLL_THR "can rx msg rolling count thr" VALUE 0x0002038C __UBYTE_S 0 u_cnts 0 255 SYMBOL_LINK "CAN_RX_MSG_CFG" 70 /end CHARACTERISTIC
/begin CHARACTERISTIC CAN_V_RX_08_CHN "can rx msg channel" VALUE 0x0002038C __UBYTE_S 0 u_can_chn 0 2 FORMAT "%1.0" SYMBOL_LINK "CAN_RX_MSG_CFG" 71 /end CHARACTERISTIC
/begin CHARACTERISTIC CAN_V_RX_09_ID "can rx msg ID" VALUE 0x0002038C __UWORD_S 0 u_cnts 0 65535 FORMAT "%5.0" SYMBOL_LINK "CAN_RX_MSG_CFG" 72 /end CHARACTERISTIC
/begin CHARACTERISTIC CAN_V_RX_09_DLC "can rx msg DLC" VALUE 0x0002038C __UBYTE_S 0 u_cnts 0 255 SYMBOL_LINK "CAN_RX_MSG_CFG" 74 /end CHARACTERISTIC
/begin CHARACTERISTIC CAN_V_RX_09_TYP "can rx msg type" VALUE 0x0002038C __UBYTE_S 0 u_can_rx_typ 0 13 FORMAT "%1.0" SYMBOL_LINK "CAN_RX_MSG_CFG" 75 /end CHARACTERISTIC
/begin CHARACTERISTIC CAN_V_RX_09_FL_TM "can rx msg fail time" VALUE 0x0002038C __UWORD_S 0 u_millisec_8192 0 8191.875 FORMAT "%5.1" SYMBOL_LINK "CAN_RX_MSG_CFG" 76 /end CHARACTERISTIC
/begin CHARACTERISTIC CAN_V_RX_09_ROLL_THR "can rx msg rolling count thr" VALUE 0x0002038C __UBYTE_S 0 u_cnts 0 255 SYMBOL_LINK "CAN_RX_MSG_CFG" 78 /end CHARACTERISTIC
/begin CHARACTERISTIC CAN_V_RX_09_CHN "can rx msg channel" VALUE 0x0002038C __UBYTE_S 0 u_can_chn 0 2 FORMAT "%1.0" SYMBOL_LINK "CAN_RX_MSG_CFG" 79 /end CHARACTERISTIC
/begin CHARACTERISTIC CAN_V_RX_10_ID "can rx msg ID" VALUE 0x0002038C __UWORD_S 0 u_cnts 0 65535 FORMAT "%5.0" SYMBOL_LINK "CAN_RX_MSG_CFG" 80 /end CHARACTERISTIC
/begin CHARACTERISTIC CAN_V_RX_10_DLC "can rx msg DLC" VALUE 0x0002038C __UBYTE_S 0 u_cnts 0 255 SYMBOL_LINK "CAN_RX_MSG_CFG" 82 /end CHARACTERISTIC
/begin CHARACTERISTIC CAN_V_RX_10_TYP "can rx msg type" VALUE 0x0002038C __UBYTE_S 0 u_can_rx_typ 0 13 FORMAT "%1.0" SYMBOL_LINK "CAN_RX_MSG_CFG" 83 /end CHARACTERISTIC
/begin CHARACTERISTIC CAN_V_RX_10_FL_TM "can rx msg fail time" VALUE 0x0002038C __UWORD_S 0 u_millisec_8192 0 8191.875 FORMAT "%5.1" SYMBOL_LINK "CAN_RX_MSG_CFG" 84 /end CHARACTERISTIC
/begin CHARACTERISTIC CAN_V_RX_10_ROLL_THR "can rx msg rolling count thr" VALUE 0x0002038C __UBYTE_S 0 u_cnts 0 255 SYMBOL_LINK "CAN_RX_MSG_CFG" 86 /end CHARACTERISTIC
/begin CHARACTERISTIC CAN_V_RX_10_CHN "can rx msg channel" VALUE 0x0002038C __UBYTE_S 0 u_can_chn 0 2 FORMAT "%1.0" SYMBOL_LINK "CAN_RX_MSG_CFG" 87 /end CHARACTERISTIC
/begin CHARACTERISTIC CAN_V_RX_11_ID "can rx msg ID" VALUE 0x0002038C __UWORD_S 0 u_cnts 0 65535 FORMAT "%5.0" SYMBOL_LINK "CAN_RX_MSG_CFG" 88 /end CHARACTERISTIC
/begin CHARACTERISTIC CAN_V_RX_11_DLC "can rx msg DLC" VALUE 0x0002038C __UBYTE_S 0 u_cnts 0 255 SYMBOL_LINK "CAN_RX_MSG_CFG" 90 /end CHARACTERISTIC
/begin CHARACTERISTIC CAN_V_RX_11_TYP "can rx msg type" VALUE 0x0002038C __UBYTE_S 0 u_can_rx_typ 0 13 FORMAT "%1.0" SYMBOL_LINK "CAN_RX_MSG_CFG" 91 /end CHARACTERISTIC
/begin CHARACTERISTIC CAN_V_RX_11_FL_TM "can rx msg fail time" VALUE 0x0002038C __UWORD_S 0 u_millisec_8192 0 8191.875 FORMAT "%5.1" SYMBOL_LINK "CAN_RX_MSG_CFG" 92 /end CHARACTERISTIC
/begin CHARACTERISTIC CAN_V_RX_11_ROLL_THR "can rx msg rolling count thr" VALUE 0x0002038C __UBYTE_S 0 u_cnts 0 255 SYMBOL_LINK "CAN_RX_MSG_CFG" 94 /end CHARACTERISTIC
/begin CHARACTERISTIC CAN_V_RX_11_CHN "can rx msg channel" VALUE 0x0002038C __UBYTE_S 0 u_can_chn 0 2 FORMAT "%1.0" SYMBOL_LINK "CAN_RX_MSG_CFG" 95 /end CHARACTERISTIC
/begin CHARACTERISTIC CAN_V_RX_12_ID "can rx msg ID" VALUE 0x0002038C __UWORD_S 0 u_cnts 0 65535 FORMAT "%5.0" SYMBOL_LINK "CAN_RX_MSG_CFG" 96 /end CHARACTERISTIC
/begin CHARACTERISTIC CAN_V_RX_12_DLC "can rx msg DLC" VALUE 0x0002038C __UBYTE_S 0 u_cnts 0 255 SYMBOL_LINK "CAN_RX_MSG_CFG" 98 /end CHARACTERISTIC
/begin CHARACTERISTIC CAN_V_RX_12_TYP "can rx msg type" VALUE 0x0002038C __UBYTE_S 0 u_can_rx_typ 0 13 FORMAT "%1.0" SYMBOL_LINK "CAN_RX_MSG_CFG" 99 /end CHARACTERISTIC
/begin CHARACTERISTIC CAN_V_RX_12_FL_TM "can rx msg fail time" VALUE 0x0002038C __UWORD_S 0 u_millisec_8192 0 8191.875 FORMAT "%5.1" SYMBOL_LINK "CAN_RX_MSG_CFG" 100 /end CHARACTERISTIC
/begin CHARACTERISTIC CAN_V_RX_12_ROLL_THR "can rx msg rolling count thr" VALUE 0x0002038C __UBYTE_S 0 u_cnts 0 255 SYMBOL_LINK "CAN_RX_MSG_CFG" 102 /end CHARACTERISTIC
/begin CHARACTERISTIC CAN_V_RX_12_CHN "can rx msg channel" VALUE 0x0002038C __UBYTE_S 0 u_can_chn 0 2 FORMAT "%1.0" SYMBOL_LINK "CAN_RX_MSG_CFG" 103 /end CHARACTERISTIC
/begin CHARACTERISTIC CAN_V_RX_13_ID "can rx msg ID" VALUE 0x0002038C __UWORD_S 0 u_cnts 0 65535 FORMAT "%5.0" SYMBOL_LINK "CAN_RX_MSG_CFG" 104 /end CHARACTERISTIC
/begin CHARACTERISTIC CAN_V_RX_13_DLC "can rx msg DLC" VALUE 0x0002038C __UBYTE_S 0 u_cnts 0 255 SYMBOL_LINK "CAN_RX_MSG_CFG" 106 /end CHARACTERISTIC
/begin CHARACTERISTIC CAN_V_RX_13_TYP "can rx msg type" VALUE 0x0002038C __UBYTE_S 0 u_can_rx_typ 0 13 FORMAT "%1.0" SYMBOL_LINK "CAN_RX_MSG_CFG" 107 /end CHARACTERISTIC
/begin CHARACTERISTIC CAN_V_RX_13_FL_TM "can rx msg fail time" VALUE 0x0002038C __UWORD_S 0 u_millisec_8192 0 8191.875 FORMAT "%5.1" SYMBOL_LINK "CAN_RX_MSG_CFG" 108 /end CHARACTERISTIC
/begin CHARACTERISTIC CAN_V_RX_13_ROLL_THR "can rx msg rolling count thr" VALUE 0x0002038C __UBYTE_S 0 u_cnts 0 255 SYMBOL_LINK "CAN_RX_MSG_CFG" 110 /end CHARACTERISTIC
/begin CHARACTERISTIC CAN_V_RX_13_CHN "can rx msg channel" VALUE 0x0002038C __UBYTE_S 0 u_can_chn 0 2 FORMAT "%1.0" SYMBOL_LINK "CAN_RX_MSG_CFG" 111 /end CHARACTERISTIC
/begin CHARACTERISTIC CAN_V_RX_14_ID "can rx msg ID" VALUE 0x0002038C __UWORD_S 0 u_cnts 0 65535 FORMAT "%5.0" SYMBOL_LINK "CAN_RX_MSG_CFG" 112 /end CHARACTERISTIC
/begin CHARACTERISTIC CAN_V_RX_14_DLC "can rx msg DLC" VALUE 0x0002038C __UBYTE_S 0 u_cnts 0 255 SYMBOL_LINK "CAN_RX_MSG_CFG" 114 /end CHARACTERISTIC
/begin CHARACTERISTIC CAN_V_RX_14_TYP "can rx msg type" VALUE 0x0002038C __UBYTE_S 0 u_can_rx_typ 0 13 FORMAT "%1.0" SYMBOL_LINK "CAN_RX_MSG_CFG" 115 /end CHARACTERISTIC
/begin CHARACTERISTIC CAN_V_RX_14_FL_TM "can rx msg fail time" VALUE 0x0002038C __UWORD_S 0 u_millisec_8192 0 8191.875 FORMAT "%5.1" SYMBOL_LINK "CAN_RX_MSG_CFG" 116 /end CHARACTERISTIC
/begin CHARACTERISTIC CAN_V_RX_14_ROLL_THR "can rx msg rolling count thr" VALUE 0x0002038C __UBYTE_S 0 u_cnts 0 255 SYMBOL_LINK "CAN_RX_MSG_CFG" 118 /end CHARACTERISTIC
/begin CHARACTERISTIC CAN_V_RX_14_CHN "can rx msg channel" VALUE 0x0002038C __UBYTE_S 0 u_can_chn 0 2 FORMAT "%1.0" SYMBOL_LINK "CAN_RX_MSG_CFG" 119 /end CHARACTERISTIC
/begin CHARACTERISTIC CAN_V_RX_15_ID "can rx msg ID" VALUE 0x0002038C __UWORD_S 0 u_cnts 0 65535 FORMAT "%5.0" SYMBOL_LINK "CAN_RX_MSG_CFG" 120 /end CHARACTERISTIC
/begin CHARACTERISTIC CAN_V_RX_15_DLC "can rx msg DLC" VALUE 0x0002038C __UBYTE_S 0 u_cnts 0 255 SYMBOL_LINK "CAN_RX_MSG_CFG" 122 /end CHARACTERISTIC
/begin CHARACTERISTIC CAN_V_RX_15_TYP "can rx msg type" VALUE 0x0002038C __UBYTE_S 0 u_can_rx_typ 0 13 FORMAT "%1.0" SYMBOL_LINK "CAN_RX_MSG_CFG" 123 /end CHARACTERISTIC
/begin CHARACTERISTIC CAN_V_RX_15_FL_TM "can rx msg fail time" VALUE 0x0002038C __UWORD_S 0 u_millisec_8192 0 8191.875 FORMAT "%5.1" SYMBOL_LINK "CAN_RX_MSG_CFG" 124 /end CHARACTERISTIC
/begin CHARACTERISTIC CAN_V_RX_15_ROLL_THR "can rx msg rolling count thr" VALUE 0x0002038C __UBYTE_S 0 u_cnts 0 255 SYMBOL_LINK "CAN_RX_MSG_CFG" 126 /end CHARACTERISTIC
/begin CHARACTERISTIC CAN_V_RX_15_CHN "can rx msg channel" VALUE 0x0002038C __UBYTE_S 0 u_can_chn 0 2 FORMAT "%1.0" SYMBOL_LINK "CAN_RX_MSG_CFG" 127 /end CHARACTERISTIC
/begin CHARACTERISTIC CAN_V_RX_16_ID "can rx msg ID" VALUE 0x0002038C __UWORD_S 0 u_cnts 0 65535 FORMAT "%5.0" SYMBOL_LINK "CAN_RX_MSG_CFG" 128 /end CHARACTERISTIC
/begin CHARACTERISTIC CAN_V_RX_16_DLC "can rx msg DLC" VALUE 0x0002038C __UBYTE_S 0 u_cnts 0 255 SYMBOL_LINK "CAN_RX_MSG_CFG" 130 /end CHARACTERISTIC
/begin CHARACTERISTIC CAN_V_RX_16_TYP "can rx msg type" VALUE 0x0002038C __UBYTE_S 0 u_can_rx_typ 0 13 FORMAT "%1.0" SYMBOL_LINK "CAN_RX_MSG_CFG" 131 /end CHARACTERISTIC
/begin CHARACTERISTIC CAN_V_RX_16_FL_TM "can rx msg fail time" VALUE 0x0002038C __UWORD_S 0 u_millisec_8192 0 8191.875 FORMAT "%5.1" SYMBOL_LINK "CAN_RX_MSG_CFG" 132 /end CHARACTERISTIC
/begin CHARACTERISTIC CAN_V_RX_16_ROLL_THR "can rx msg rolling count thr" VALUE 0x0002038C __UBYTE_S 0 u_cnts 0 255 SYMBOL_LINK "CAN_RX_MSG_CFG" 134 /end CHARACTERISTIC
/begin CHARACTERISTIC CAN_V_RX_16_CHN "can rx msg channel" VALUE 0x0002038C __UBYTE_S 0 u_can_chn 0 2 FORMAT "%1.0" SYMBOL_LINK "CAN_RX_MSG_CFG" 135 /end CHARACTERISTIC
/begin CHARACTERISTIC CAN_V_RX_17_ID "can rx msg ID" VALUE 0x0002038C __UWORD_S 0 u_cnts 0 65535 FORMAT "%5.0" SYMBOL_LINK "CAN_RX_MSG_CFG" 136 /end CHARACTERISTIC
/begin CHARACTERISTIC CAN_V_RX_17_DLC "can rx msg DLC" VALUE 0x0002038C __UBYTE_S 0 u_cnts 0 255 SYMBOL_LINK "CAN_RX_MSG_CFG" 138 /end CHARACTERISTIC
/begin CHARACTERISTIC CAN_V_RX_17_TYP "can rx msg type" VALUE 0x0002038C __UBYTE_S 0 u_can_rx_typ 0 13 FORMAT "%1.0" SYMBOL_LINK "CAN_RX_MSG_CFG" 139 /end CHARACTERISTIC
/begin CHARACTERISTIC CAN_V_RX_17_FL_TM "can rx msg fail time" VALUE 0x0002038C __UWORD_S 0 u_millisec_8192 0 8191.875 FORMAT "%5.1" SYMBOL_LINK "CAN_RX_MSG_CFG" 140 /end CHARACTERISTIC
/begin CHARACTERISTIC CAN_V_RX_17_ROLL_THR "can rx msg rolling count thr" VALUE 0x0002038C __UBYTE_S 0 u_cnts 0 255 SYMBOL_LINK "CAN_RX_MSG_CFG" 142 /end CHARACTERISTIC
/begin CHARACTERISTIC CAN_V_RX_17_CHN "can rx msg channel" VALUE 0x0002038C __UBYTE_S 0 u_can_chn 0 2 FORMAT "%1.0" SYMBOL_LINK "CAN_RX_MSG_CFG" 143 /end CHARACTERISTIC
/begin CHARACTERISTIC CAN_V_RX_18_ID "can rx msg ID" VALUE 0x0002038C __UWORD_S 0 u_cnts 0 65535 FORMAT "%5.0" SYMBOL_LINK "CAN_RX_MSG_CFG" 144 /end CHARACTERISTIC
/begin CHARACTERISTIC CAN_V_RX_18_DLC "can rx msg DLC" VALUE 0x0002038C __UBYTE_S 0 u_cnts 0 255 SYMBOL_LINK "CAN_RX_MSG_CFG" 146 /end CHARACTERISTIC
/begin CHARACTERISTIC CAN_V_RX_18_TYP "can rx msg type" VALUE 0x0002038C __UBYTE_S 0 u_can_rx_typ 0 13 FORMAT "%1.0" SYMBOL_LINK "CAN_RX_MSG_CFG" 147 /end CHARACTERISTIC
/begin CHARACTERISTIC CAN_V_RX_18_FL_TM "can rx msg fail time" VALUE 0x0002038C __UWORD_S 0 u_millisec_8192 0 8191.875 FORMAT "%5.1" SYMBOL_LINK "CAN_RX_MSG_CFG" 148 /end CHARACTERISTIC
/begin CHARACTERISTIC CAN_V_RX_18_ROLL_THR "can rx msg rolling count thr" VALUE 0x0002038C __UBYTE_S 0 u_cnts 0 255 SYMBOL_LINK "CAN_RX_MSG_CFG" 150 /end CHARACTERISTIC
/begin CHARACTERISTIC CAN_V_RX_18_CHN "can rx msg channel" VALUE 0x0002038C __UBYTE_S 0 u_can_chn 0 2 FORMAT "%1.0" SYMBOL_LINK "CAN_RX_MSG_CFG" 151 /end CHARACTERISTIC
/begin CHARACTERISTIC CAN_RX_ABS_ACTV_ID "ABS active msg number" VALUE 0x0002038C __UBYTE_S 0 u_can_rxmsg_num 0 255 FORMAT "%3.0" SYMBOL_LINK "CAN_RX_ABS_ACTV" 0 /end CHARACTERISTIC
/begin CHARACTERISTIC CAN_RX_ABS_ACTV_BYTE_LOC "abs active msg location number" VALUE 0x0002038C __UBYTE_S 0 u_can_byte_num 0 7 FORMAT "%1.0" SYMBOL_LINK "CAN_RX_ABS_ACTV" 1 /end CHARACTERISTIC
/begin CHARACTERISTIC CAN_RX_ABS_ACTV_BIT_LOC "abs active msg bit location" VALUE 0x0002038C __UBYTE_S 0 u_can_bit_loc 0 7 FORMAT "%1.0" SYMBOL_LINK "CAN_RX_ABS_ACTV" 2 /end CHARACTERISTIC
/begin CHARACTERISTIC CAN_RX_ABS_ACTV_BIT_LEN "abs active msg bit length" VALUE 0x0002038C __UBYTE_S 0 u_cnts 0 255 SYMBOL_LINK "CAN_RX_ABS_ACTV" 3 /end CHARACTERISTIC
/begin CHARACTERISTIC CAN_RX_ABS_ACTV_TABLE "abs active msg table" VAL_BLK 0x0002038C __UBYTE_S 0 u_cnts 0 255 NUMBER 2 SYMBOL_LINK "CAN_RX_ABS_ACTV" 4 /end CHARACTERISTIC
/begin CHARACTERISTIC CAN_RX_ABS_FL_ID "ABS fail msg number" VALUE 0x0002038C __UBYTE_S 0 u_can_rxmsg_num 0 255 FORMAT "%3.0" SYMBOL_LINK "CAN_RX_ABS_FL" 0 /end CHARACTERISTIC
/begin CHARACTERISTIC CAN_RX_ABS_FL_BYTE_LOC "abs fail msg location number" VALUE 0x0002038C __UBYTE_S 0 u_can_byte_num 0 7 FORMAT "%1.0" SYMBOL_LINK "CAN_RX_ABS_FL" 1 /end CHARACTERISTIC
/begin CHARACTERISTIC CAN_RX_ABS_FL_BIT_LOC "abs fail msg bit location" VALUE 0x0002038C __UBYTE_S 0 u_can_bit_loc 0 7 FORMAT "%1.0" SYMBOL_LINK "CAN_RX_ABS_FL" 2 /end CHARACTERISTIC
/begin CHARACTERISTIC CAN_RX_ABS_FL_BIT_LEN "abs fail msg bit length" VALUE 0x0002038C __UBYTE_S 0 u_cnts 0 255 SYMBOL_LINK "CAN_RX_ABS_FL" 3 /end CHARACTERISTIC
/begin CHARACTERISTIC CAN_RX_ABS_FL_TABLE "abs fail msg table" VAL_BLK 0x0002038C __UBYTE_S 0 u_cnts 0 255 NUMBER 2 SYMBOL_LINK "CAN_RX_ABS_FL" 4 /end CHARACTERISTIC
/begin CHARACTERISTIC CAN_RX_VEH_SPD_ID "vehicle speed msg number" VALUE 0x0002038C __UBYTE_S 0 u_can_rxmsg_num 0 255 FORMAT "%3.0" SYMBOL_LINK "CAN_RX_VEH_SPD" 0 /end CHARACTERISTIC
/begin CHARACTERISTIC CAN_RX_VEH_SPD_BYTE_LOC "vehicle speed msg location number" VALUE 0x0002038C __UBYTE_S 0 u_can_byte_num 0 7 FORMAT "%1.0" SYMBOL_LINK "CAN_RX_VEH_SPD" 1 /end CHARACTERISTIC
/begin CHARACTERISTIC CAN_RX_VEH_SPD_BIT_LOC "vehicle speed msg bit location" VALUE 0x0002038C __UBYTE_S 0 u_can_bit_loc 0 7 FORMAT "%1.0" SYMBOL_LINK "CAN_RX_VEH_SPD" 2 /end CHARACTERISTIC
/begin CHARACTERISTIC CAN_RX_VEH_SPD_BIT_LEN "vehicle speed msg bit length" VALUE 0x0002038C __UBYTE_S 0 u_cnts 0 255 SYMBOL_LINK "CAN_RX_VEH_SPD" 3 /end CHARACTERISTIC
/begin CHARACTERISTIC CAN_RX_VEH_SPD_A "vehicle speed msg scaling A" VALUE 0x0002038C __ULONG_S 0 u_fac_65536L 0 65535.9999847412109375 FORMAT "%8.3" SYMBOL_LINK "CAN_RX_VEH_SPD" 4 /end CHARACTERISTIC
/begin CHARACTERISTIC CAN_RX_VEH_SPD_B "vehicle speed msg scaling B" VALUE 0x0002038C __SWORD_S 0 u_cnt_n3277_p3277 -3276.8 3276.7 FORMAT "%5.1" SYMBOL_LINK "CAN_RX_VEH_SPD" 8 /end CHARACTERISTIC
/begin CHARACTERISTIC CAN_RX_VEH_SPD_INVALID "vehicle speed msg invalid value" VALUE 0x0002038C __UWORD_S 0 u_cnts 0 65535 FORMAT "%5.0" SYMBOL_LINK "CAN_RX_VEH_SPD" 10 /end CHARACTERISTIC
/begin CHARACTERISTIC CAN_RX_VEH_SPD_DFLT "vehicle speed msg default value when can fail" VALUE 0x0002038C __UWORD_S 0 u_vspd 0 511.9921875 FORMAT "%4.1" SYMBOL_LINK "CAN_RX_VEH_SPD" 12 /end CHARACTERISTIC
/begin CHARACTERISTIC CAN_RX_CHKSUM00_ID "checksum msg number" VALUE 0x0002038C __UBYTE_S 0 u_can_rxmsg_num 0 255 FORMAT "%3.0" SYMBOL_LINK "CAN_RX_CHKSUM00" 0 /end CHARACTERISTIC
/begin CHARACTERISTIC CAN_RX_CHKSUM00_BYTE_LOC "checksum msg location number" VALUE 0x0002038C __UBYTE_S 0 u_can_byte_num 0 7 FORMAT "%1.0" SYMBOL_LINK "CAN_RX_CHKSUM00" 1 /end CHARACTERISTIC
/begin CHARACTERISTIC CAN_RX_CHKSUM00_BIT_LOC "checksum msg bit location" VALUE 0x0002038C __UBYTE_S 0 u_can_bit_loc 0 7 FORMAT "%1.0" SYMBOL_LINK "CAN_RX_CHKSUM00" 2 /end CHARACTERISTIC
/begin CHARACTERISTIC CAN_RX_CHKSUM00_BIT_LEN "checksum msg bit length" VALUE 0x0002038C __UBYTE_S 0 u_cnts 0 255 SYMBOL_LINK "CAN_RX_CHKSUM00" 3 /end CHARACTERISTIC
/begin CHARACTERISTIC CAN_RX_CHKSUM00_METHOD "checksum calculated method" VALUE 0x0002038C __UBYTE_S 0 u_can_chk_sum 0 19 FORMAT "%2.0" SYMBOL_LINK "CAN_RX_CHKSUM00" 4 /end CHARACTERISTIC
/begin CHARACTERISTIC CAN_RX_CHKSUM01_ID "checksum msg number" VALUE 0x0002038C __UBYTE_S 0 u_can_rxmsg_num 0 255 FORMAT "%3.0" SYMBOL_LINK "CAN_RX_CHKSUM01" 0 /end CHARACTERISTIC
/begin CHARACTERISTIC CAN_RX_CHKSUM01_BYTE_LOC "checksum msg location number" VALUE 0x0002038C __UBYTE_S 0 u_can_byte_num 0 7 FORMAT "%1.0" SYMBOL_LINK "CAN_RX_CHKSUM01" 1 /end CHARACTERISTIC
/begin CHARACTERISTIC CAN_RX_CHKSUM01_BIT_LOC "checksum msg bit location" VALUE 0x0002038C __UBYTE_S 0 u_can_bit_loc 0 7 FORMAT "%1.0" SYMBOL_LINK "CAN_RX_CHKSUM01" 2 /end CHARACTERISTIC
/begin CHARACTERISTIC CAN_RX_CHKSUM01_BIT_LEN "checksum msg bit length" VALUE 0x0002038C __UBYTE_S 0 u_cnts 0 255 SYMBOL_LINK "CAN_RX_CHKSUM01" 3 /end CHARACTERISTIC
/begin CHARACTERISTIC CAN_RX_CHKSUM01_METHOD "checksum calculated method" VALUE 0x0002038C __UBYTE_S 0 u_can_chk_sum 0 19 FORMAT "%2.0" SYMBOL_LINK "CAN_RX_CHKSUM01" 4 /end CHARACTERISTIC
/begin CHARACTERISTIC CAN_RX_CHKSUM02_ID "checksum msg number" VALUE 0x0002038C __UBYTE_S 0 u_can_rxmsg_num 0 255 FORMAT "%3.0" SYMBOL_LINK "CAN_RX_CHKSUM02" 0 /end CHARACTERISTIC
/begin CHARACTERISTIC CAN_RX_CHKSUM02_BYTE_LOC "checksum msg location number" VALUE 0x0002038C __UBYTE_S 0 u_can_byte_num 0 7 FORMAT "%1.0" SYMBOL_LINK "CAN_RX_CHKSUM02" 1 /end CHARACTERISTIC
/begin CHARACTERISTIC CAN_RX_CHKSUM02_BIT_LOC "checksum msg bit location" VALUE 0x0002038C __UBYTE_S 0 u_can_bit_loc 0 7 FORMAT "%1.0" SYMBOL_LINK "CAN_RX_CHKSUM02" 2 /end CHARACTERISTIC
/begin CHARACTERISTIC CAN_RX_CHKSUM02_BIT_LEN "checksum msg bit length" VALUE 0x0002038C __UBYTE_S 0 u_cnts 0 255 SYMBOL_LINK "CAN_RX_CHKSUM02" 3 /end CHARACTERISTIC
/begin CHARACTERISTIC CAN_RX_CHKSUM02_METHOD "checksum calculated method" VALUE 0x0002038C __UBYTE_S 0 u_can_chk_sum 0 19 FORMAT "%2.0" SYMBOL_LINK "CAN_RX_CHKSUM02" 4 /end CHARACTERISTIC
/begin CHARACTERISTIC CAN_RX_CHKSUM03_ID "checksum msg number" VALUE 0x0002038C __UBYTE_S 0 u_can_rxmsg_num 0 255 FORMAT "%3.0" SYMBOL_LINK "CAN_RX_CHKSUM03" 0 /end CHARACTERISTIC
/begin CHARACTERISTIC CAN_RX_CHKSUM03_BYTE_LOC "checksum msg location number" VALUE 0x0002038C __UBYTE_S 0 u_can_byte_num 0 7 FORMAT "%1.0" SYMBOL_LINK "CAN_RX_CHKSUM03" 1 /end CHARACTERISTIC
/begin CHARACTERISTIC CAN_RX_CHKSUM03_BIT_LOC "checksum msg bit location" VALUE 0x0002038C __UBYTE_S 0 u_can_bit_loc 0 7 FORMAT "%1.0" SYMBOL_LINK "CAN_RX_CHKSUM03" 2 /end CHARACTERISTIC
/begin CHARACTERISTIC CAN_RX_CHKSUM03_BIT_LEN "checksum msg bit length" VALUE 0x0002038C __UBYTE_S 0 u_cnts 0 255 SYMBOL_LINK "CAN_RX_CHKSUM03" 3 /end CHARACTERISTIC
/begin CHARACTERISTIC CAN_RX_CHKSUM03_METHOD "checksum calculated method" VALUE 0x0002038C __UBYTE_S 0 u_can_chk_sum 0 19 FORMAT "%2.0" SYMBOL_LINK "CAN_RX_CHKSUM03" 4 /end CHARACTERISTIC
/begin CHARACTERISTIC CAN_RX_CHKSUM04_ID "checksum msg number" VALUE 0x0002038C __UBYTE_S 0 u_can_rxmsg_num 0 255 FORMAT "%3.0" SYMBOL_LINK "CAN_RX_CHKSUM04" 0 /end CHARACTERISTIC
/begin CHARACTERISTIC CAN_RX_CHKSUM04_BYTE_LOC "checksum msg location number" VALUE 0x0002038C __UBYTE_S 0 u_can_byte_num 0 7 FORMAT "%1.0" SYMBOL_LINK "CAN_RX_CHKSUM04" 1 /end CHARACTERISTIC
/begin CHARACTERISTIC CAN_RX_CHKSUM04_BIT_LOC "checksum msg bit location" VALUE 0x0002038C __UBYTE_S 0 u_can_bit_loc 0 7 FORMAT "%1.0" SYMBOL_LINK "CAN_RX_CHKSUM04" 2 /end CHARACTERISTIC
/begin CHARACTERISTIC CAN_RX_CHKSUM04_BIT_LEN "checksum msg bit length" VALUE 0x0002038C __UBYTE_S 0 u_cnts 0 255 SYMBOL_LINK "CAN_RX_CHKSUM04" 3 /end CHARACTERISTIC
/begin CHARACTERISTIC CAN_RX_CHKSUM04_METHOD "checksum calculated method" VALUE 0x0002038C __UBYTE_S 0 u_can_chk_sum 0 19 FORMAT "%2.0" SYMBOL_LINK "CAN_RX_CHKSUM04" 4 /end CHARACTERISTIC
/begin CHARACTERISTIC CAN_RX_CHKSUM05_ID "checksum msg number" VALUE 0x0002038C __UBYTE_S 0 u_can_rxmsg_num 0 255 FORMAT "%3.0" SYMBOL_LINK "CAN_RX_CHKSUM05" 0 /end CHARACTERISTIC
/begin CHARACTERISTIC CAN_RX_CHKSUM05_BYTE_LOC "checksum msg location number" VALUE 0x0002038C __UBYTE_S 0 u_can_byte_num 0 7 FORMAT "%1.0" SYMBOL_LINK "CAN_RX_CHKSUM05" 1 /end CHARACTERISTIC
/begin CHARACTERISTIC CAN_RX_CHKSUM05_BIT_LOC "checksum msg bit location" VALUE 0x0002038C __UBYTE_S 0 u_can_bit_loc 0 7 FORMAT "%1.0" SYMBOL_LINK "CAN_RX_CHKSUM05" 2 /end CHARACTERISTIC
/begin CHARACTERISTIC CAN_RX_CHKSUM05_BIT_LEN "checksum msg bit length" VALUE 0x0002038C __UBYTE_S 0 u_cnts 0 255 SYMBOL_LINK "CAN_RX_CHKSUM05" 3 /end CHARACTERISTIC
/begin CHARACTERISTIC CAN_RX_CHKSUM05_METHOD "checksum calculated method" VALUE 0x0002038C __UBYTE_S 0 u_can_chk_sum 0 19 FORMAT "%2.0" SYMBOL_LINK "CAN_RX_CHKSUM05" 4 /end CHARACTERISTIC
/begin CHARACTERISTIC CAN_RX_CHKSUM06_ID "checksum msg number" VALUE 0x0002038C __UBYTE_S 0 u_can_rxmsg_num 0 255 FORMAT "%3.0" SYMBOL_LINK "CAN_RX_CHKSUM06" 0 /end CHARACTERISTIC
/begin CHARACTERISTIC CAN_RX_CHKSUM06_BYTE_LOC "checksum msg location number" VALUE 0x0002038C __UBYTE_S 0 u_can_byte_num 0 7 FORMAT "%1.0" SYMBOL_LINK "CAN_RX_CHKSUM06" 1 /end CHARACTERISTIC
/begin CHARACTERISTIC CAN_RX_CHKSUM06_BIT_LOC "checksum msg bit location" VALUE 0x0002038C __UBYTE_S 0 u_can_bit_loc 0 7 FORMAT "%1.0" SYMBOL_LINK "CAN_RX_CHKSUM06" 2 /end CHARACTERISTIC
/begin CHARACTERISTIC CAN_RX_CHKSUM06_BIT_LEN "checksum msg bit length" VALUE 0x0002038C __UBYTE_S 0 u_cnts 0 255 SYMBOL_LINK "CAN_RX_CHKSUM06" 3 /end CHARACTERISTIC
/begin CHARACTERISTIC CAN_RX_CHKSUM06_METHOD "checksum calculated method" VALUE 0x0002038C __UBYTE_S 0 u_can_chk_sum 0 19 FORMAT "%2.0" SYMBOL_LINK "CAN_RX_CHKSUM06" 4 /end CHARACTERISTIC
/begin CHARACTERISTIC CAN_RX_CHKSUM07_ID "checksum msg number" VALUE 0x0002038C __UBYTE_S 0 u_can_rxmsg_num 0 255 FORMAT "%3.0" SYMBOL_LINK "CAN_RX_CHKSUM07" 0 /end CHARACTERISTIC
/begin CHARACTERISTIC CAN_RX_CHKSUM07_BYTE_LOC "checksum msg location number" VALUE 0x0002038C __UBYTE_S 0 u_can_byte_num 0 7 FORMAT "%1.0" SYMBOL_LINK "CAN_RX_CHKSUM07" 1 /end CHARACTERISTIC
/begin CHARACTERISTIC CAN_RX_CHKSUM07_BIT_LOC "checksum msg bit location" VALUE 0x0002038C __UBYTE_S 0 u_can_bit_loc 0 7 FORMAT "%1.0" SYMBOL_LINK "CAN_RX_CHKSUM07" 2 /end CHARACTERISTIC
/begin CHARACTERISTIC CAN_RX_CHKSUM07_BIT_LEN "checksum msg bit length" VALUE 0x0002038C __UBYTE_S 0 u_cnts 0 255 SYMBOL_LINK "CAN_RX_CHKSUM07" 3 /end CHARACTERISTIC
/begin CHARACTERISTIC CAN_RX_CHKSUM07_METHOD "checksum calculated method" VALUE 0x0002038C __UBYTE_S 0 u_can_chk_sum 0 19 FORMAT "%2.0" SYMBOL_LINK "CAN_RX_CHKSUM07" 4 /end CHARACTERISTIC
/begin CHARACTERISTIC CAN_RX_CHKSUM08_ID "checksum msg number" VALUE 0x0002038C __UBYTE_S 0 u_can_rxmsg_num 0 255 FORMAT "%3.0" SYMBOL_LINK "CAN_RX_CHKSUM08" 0 /end CHARACTERISTIC
/begin CHARACTERISTIC CAN_RX_CHKSUM08_BYTE_LOC "checksum msg location number" VALUE 0x0002038C __UBYTE_S 0 u_can_byte_num 0 7 FORMAT "%1.0" SYMBOL_LINK "CAN_RX_CHKSUM08" 1 /end CHARACTERISTIC
/begin CHARACTERISTIC CAN_RX_CHKSUM08_BIT_LOC "checksum msg bit location" VALUE 0x0002038C __UBYTE_S 0 u_can_bit_loc 0 7 FORMAT "%1.0" SYMBOL_LINK "CAN_RX_CHKSUM08" 2 /end CHARACTERISTIC
/begin CHARACTERISTIC CAN_RX_CHKSUM08_BIT_LEN "checksum msg bit length" VALUE 0x0002038C __UBYTE_S 0 u_cnts 0 255 SYMBOL_LINK "CAN_RX_CHKSUM08" 3 /end CHARACTERISTIC
/begin CHARACTERISTIC CAN_RX_CHKSUM08_METHOD "checksum calculated method" VALUE 0x0002038C __UBYTE_S 0 u_can_chk_sum 0 19 FORMAT "%2.0" SYMBOL_LINK "CAN_RX_CHKSUM08" 4 /end CHARACTERISTIC
/begin CHARACTERISTIC CAN_RX_CHKSUM09_ID "checksum msg number" VALUE 0x0002038C __UBYTE_S 0 u_can_rxmsg_num 0 255 FORMAT "%3.0" SYMBOL_LINK "CAN_RX_CHKSUM09" 0 /end CHARACTERISTIC
/begin CHARACTERISTIC CAN_RX_CHKSUM09_BYTE_LOC "checksum msg location number" VALUE 0x0002038C __UBYTE_S 0 u_can_byte_num 0 7 FORMAT "%1.0" SYMBOL_LINK "CAN_RX_CHKSUM09" 1 /end CHARACTERISTIC
/begin CHARACTERISTIC CAN_RX_CHKSUM09_BIT_LOC "checksum msg bit location" VALUE 0x0002038C __UBYTE_S 0 u_can_bit_loc 0 7 FORMAT "%1.0" SYMBOL_LINK "CAN_RX_CHKSUM09" 2 /end CHARACTERISTIC
/begin CHARACTERISTIC CAN_RX_CHKSUM09_BIT_LEN "checksum msg bit length" VALUE 0x0002038C __UBYTE_S 0 u_cnts 0 255 SYMBOL_LINK "CAN_RX_CHKSUM09" 3 /end CHARACTERISTIC
/begin CHARACTERISTIC CAN_RX_CHKSUM09_METHOD "checksum calculated method" VALUE 0x0002038C __UBYTE_S 0 u_can_chk_sum 0 19 FORMAT "%2.0" SYMBOL_LINK "CAN_RX_CHKSUM09" 4 /end CHARACTERISTIC
/begin CHARACTERISTIC CAN_RX_CHKSUM10_ID "checksum msg number" VALUE 0x0002038C __UBYTE_S 0 u_can_rxmsg_num 0 255 FORMAT "%3.0" SYMBOL_LINK "CAN_RX_CHKSUM10" 0 /end CHARACTERISTIC
/begin CHARACTERISTIC CAN_RX_CHKSUM10_BYTE_LOC "checksum msg location number" VALUE 0x0002038C __UBYTE_S 0 u_can_byte_num 0 7 FORMAT "%1.0" SYMBOL_LINK "CAN_RX_CHKSUM10" 1 /end CHARACTERISTIC
/begin CHARACTERISTIC CAN_RX_CHKSUM10_BIT_LOC "checksum msg bit location" VALUE 0x0002038C __UBYTE_S 0 u_can_bit_loc 0 7 FORMAT "%1.0" SYMBOL_LINK "CAN_RX_CHKSUM10" 2 /end CHARACTERISTIC
/begin CHARACTERISTIC CAN_RX_CHKSUM10_BIT_LEN "checksum msg bit length" VALUE 0x0002038C __UBYTE_S 0 u_cnts 0 255 SYMBOL_LINK "CAN_RX_CHKSUM10" 3 /end CHARACTERISTIC
/begin CHARACTERISTIC CAN_RX_CHKSUM10_METHOD "checksum calculated method" VALUE 0x0002038C __UBYTE_S 0 u_can_chk_sum 0 19 FORMAT "%2.0" SYMBOL_LINK "CAN_RX_CHKSUM10" 4 /end CHARACTERISTIC
/begin CHARACTERISTIC CAN_RX_CHKSUM11_ID "checksum msg number" VALUE 0x0002038C __UBYTE_S 0 u_can_rxmsg_num 0 255 FORMAT "%3.0" SYMBOL_LINK "CAN_RX_CHKSUM11" 0 /end CHARACTERISTIC
/begin CHARACTERISTIC CAN_RX_CHKSUM11_BYTE_LOC "checksum msg location number" VALUE 0x0002038C __UBYTE_S 0 u_can_byte_num 0 7 FORMAT "%1.0" SYMBOL_LINK "CAN_RX_CHKSUM11" 1 /end CHARACTERISTIC
/begin CHARACTERISTIC CAN_RX_CHKSUM11_BIT_LOC "checksum msg bit location" VALUE 0x0002038C __UBYTE_S 0 u_can_bit_loc 0 7 FORMAT "%1.0" SYMBOL_LINK "CAN_RX_CHKSUM11" 2 /end CHARACTERISTIC
/begin CHARACTERISTIC CAN_RX_CHKSUM11_BIT_LEN "checksum msg bit length" VALUE 0x0002038C __UBYTE_S 0 u_cnts 0 255 SYMBOL_LINK "CAN_RX_CHKSUM11" 3 /end CHARACTERISTIC
/begin CHARACTERISTIC CAN_RX_CHKSUM11_METHOD "checksum calculated method" VALUE 0x0002038C __UBYTE_S 0 u_can_chk_sum 0 19 FORMAT "%2.0" SYMBOL_LINK "CAN_RX_CHKSUM11" 4 /end CHARACTERISTIC
/begin CHARACTERISTIC CAN_RX_CHKSUM12_ID "checksum msg number" VALUE 0x0002038C __UBYTE_S 0 u_can_rxmsg_num 0 255 FORMAT "%3.0" SYMBOL_LINK "CAN_RX_CHKSUM12" 0 /end CHARACTERISTIC
/begin CHARACTERISTIC CAN_RX_CHKSUM12_BYTE_LOC "checksum msg location number" VALUE 0x0002038C __UBYTE_S 0 u_can_byte_num 0 7 FORMAT "%1.0" SYMBOL_LINK "CAN_RX_CHKSUM12" 1 /end CHARACTERISTIC
/begin CHARACTERISTIC CAN_RX_CHKSUM12_BIT_LOC "checksum msg bit location" VALUE 0x0002038C __UBYTE_S 0 u_can_bit_loc 0 7 FORMAT "%1.0" SYMBOL_LINK "CAN_RX_CHKSUM12" 2 /end CHARACTERISTIC
/begin CHARACTERISTIC CAN_RX_CHKSUM12_BIT_LEN "checksum msg bit length" VALUE 0x0002038C __UBYTE_S 0 u_cnts 0 255 SYMBOL_LINK "CAN_RX_CHKSUM12" 3 /end CHARACTERISTIC
/begin CHARACTERISTIC CAN_RX_CHKSUM12_METHOD "checksum calculated method" VALUE 0x0002038C __UBYTE_S 0 u_can_chk_sum 0 19 FORMAT "%2.0" SYMBOL_LINK "CAN_RX_CHKSUM12" 4 /end CHARACTERISTIC
/begin CHARACTERISTIC CAN_RX_ROLL_CNT00_ID "rolling counter msg number" VALUE 0x0002038C __UBYTE_S 0 u_can_rxmsg_num 0 255 FORMAT "%3.0" SYMBOL_LINK "CAN_RX_ROLL_CNT00" 0 /end CHARACTERISTIC
/begin CHARACTERISTIC CAN_RX_ROLL_CNT00_BYTE_LOC "rolling counter msg location number" VALUE 0x0002038C __UBYTE_S 0 u_can_byte_num 0 7 FORMAT "%1.0" SYMBOL_LINK "CAN_RX_ROLL_CNT00" 1 /end CHARACTERISTIC
/begin CHARACTERISTIC CAN_RX_ROLL_CNT00_BIT_LOC "rolling counter msg bit location" VALUE 0x0002038C __UBYTE_S 0 u_can_bit_loc 0 7 FORMAT "%1.0" SYMBOL_LINK "CAN_RX_ROLL_CNT00" 2 /end CHARACTERISTIC
/begin CHARACTERISTIC CAN_RX_ROLL_CNT00_BIT_LEN "rolling counter msg bit length" VALUE 0x0002038C __UBYTE_S 0 u_cnts 0 255 SYMBOL_LINK "CAN_RX_ROLL_CNT00" 3 /end CHARACTERISTIC
/begin CHARACTERISTIC CAN_RX_ROLL_CNT01_ID "rolling counter msg number" VALUE 0x0002038C __UBYTE_S 0 u_can_rxmsg_num 0 255 FORMAT "%3.0" SYMBOL_LINK "CAN_RX_ROLL_CNT01" 0 /end CHARACTERISTIC
/begin CHARACTERISTIC CAN_RX_ROLL_CNT01_BYTE_LOC "rolling counter msg location number" VALUE 0x0002038C __UBYTE_S 0 u_can_byte_num 0 7 FORMAT "%1.0" SYMBOL_LINK "CAN_RX_ROLL_CNT01" 1 /end CHARACTERISTIC
/begin CHARACTERISTIC CAN_RX_ROLL_CNT01_BIT_LOC "rolling counter msg bit location" VALUE 0x0002038C __UBYTE_S 0 u_can_bit_loc 0 7 FORMAT "%1.0" SYMBOL_LINK "CAN_RX_ROLL_CNT01" 2 /end CHARACTERISTIC
/begin CHARACTERISTIC CAN_RX_ROLL_CNT01_BIT_LEN "rolling counter msg bit length" VALUE 0x0002038C __UBYTE_S 0 u_cnts 0 255 SYMBOL_LINK "CAN_RX_ROLL_CNT01" 3 /end CHARACTERISTIC
/begin CHARACTERISTIC CAN_RX_ROLL_CNT02_ID "rolling counter msg number" VALUE 0x0002038C __UBYTE_S 0 u_can_rxmsg_num 0 255 FORMAT "%3.0" SYMBOL_LINK "CAN_RX_ROLL_CNT02" 0 /end CHARACTERISTIC
/begin CHARACTERISTIC CAN_RX_ROLL_CNT02_BYTE_LOC "rolling counter msg location number" VALUE 0x0002038C __UBYTE_S 0 u_can_byte_num 0 7 FORMAT "%1.0" SYMBOL_LINK "CAN_RX_ROLL_CNT02" 1 /end CHARACTERISTIC
/begin CHARACTERISTIC CAN_RX_ROLL_CNT02_BIT_LOC "rolling counter msg bit location" VALUE 0x0002038C __UBYTE_S 0 u_can_bit_loc 0 7 FORMAT "%1.0" SYMBOL_LINK "CAN_RX_ROLL_CNT02" 2 /end CHARACTERISTIC
/begin CHARACTERISTIC CAN_RX_ROLL_CNT02_BIT_LEN "rolling counter msg bit length" VALUE 0x0002038C __UBYTE_S 0 u_cnts 0 255 SYMBOL_LINK "CAN_RX_ROLL_CNT02" 3 /end CHARACTERISTIC
/begin CHARACTERISTIC CAN_RX_ROLL_CNT03_ID "rolling counter msg number" VALUE 0x0002038C __UBYTE_S 0 u_can_rxmsg_num 0 255 FORMAT "%3.0" SYMBOL_LINK "CAN_RX_ROLL_CNT03" 0 /end CHARACTERISTIC
/begin CHARACTERISTIC CAN_RX_ROLL_CNT03_BYTE_LOC "rolling counter msg location number" VALUE 0x0002038C __UBYTE_S 0 u_can_byte_num 0 7 FORMAT "%1.0" SYMBOL_LINK "CAN_RX_ROLL_CNT03" 1 /end CHARACTERISTIC
/begin CHARACTERISTIC CAN_RX_ROLL_CNT03_BIT_LOC "rolling counter msg bit location" VALUE 0x0002038C __UBYTE_S 0 u_can_bit_loc 0 7 FORMAT "%1.0" SYMBOL_LINK "CAN_RX_ROLL_CNT03" 2 /end CHARACTERISTIC
/begin CHARACTERISTIC CAN_RX_ROLL_CNT03_BIT_LEN "rolling counter msg bit length" VALUE 0x0002038C __UBYTE_S 0 u_cnts 0 255 SYMBOL_LINK "CAN_RX_ROLL_CNT03" 3 /end CHARACTERISTIC
/begin CHARACTERISTIC CAN_RX_ROLL_CNT04_ID "rolling counter msg number" VALUE 0x0002038C __UBYTE_S 0 u_can_rxmsg_num 0 255 FORMAT "%3.0" SYMBOL_LINK "CAN_RX_ROLL_CNT04" 0 /end CHARACTERISTIC
/begin CHARACTERISTIC CAN_RX_ROLL_CNT04_BYTE_LOC "rolling counter msg location number" VALUE 0x0002038C __UBYTE_S 0 u_can_byte_num 0 7 FORMAT "%1.0" SYMBOL_LINK "CAN_RX_ROLL_CNT04" 1 /end CHARACTERISTIC
/begin CHARACTERISTIC CAN_RX_ROLL_CNT04_BIT_LOC "rolling counter msg bit location" VALUE 0x0002038C __UBYTE_S 0 u_can_bit_loc 0 7 FORMAT "%1.0" SYMBOL_LINK "CAN_RX_ROLL_CNT04" 2 /end CHARACTERISTIC
/begin CHARACTERISTIC CAN_RX_ROLL_CNT04_BIT_LEN "rolling counter msg bit length" VALUE 0x0002038C __UBYTE_S 0 u_cnts 0 255 SYMBOL_LINK "CAN_RX_ROLL_CNT04" 3 /end CHARACTERISTIC
/begin CHARACTERISTIC CAN_RX_ROLL_CNT05_ID "rolling counter msg number" VALUE 0x0002038C __UBYTE_S 0 u_can_rxmsg_num 0 255 FORMAT "%3.0" SYMBOL_LINK "CAN_RX_ROLL_CNT05" 0 /end CHARACTERISTIC
/begin CHARACTERISTIC CAN_RX_ROLL_CNT05_BYTE_LOC "rolling counter msg location number" VALUE 0x0002038C __UBYTE_S 0 u_can_byte_num 0 7 FORMAT "%1.0" SYMBOL_LINK "CAN_RX_ROLL_CNT05" 1 /end CHARACTERISTIC
/begin CHARACTERISTIC CAN_RX_ROLL_CNT05_BIT_LOC "rolling counter msg bit location" VALUE 0x0002038C __UBYTE_S 0 u_can_bit_loc 0 7 FORMAT "%1.0" SYMBOL_LINK "CAN_RX_ROLL_CNT05" 2 /end CHARACTERISTIC
/begin CHARACTERISTIC CAN_RX_ROLL_CNT05_BIT_LEN "rolling counter msg bit length" VALUE 0x0002038C __UBYTE_S 0 u_cnts 0 255 SYMBOL_LINK "CAN_RX_ROLL_CNT05" 3 /end CHARACTERISTIC
/begin CHARACTERISTIC CAN_RX_ROLL_CNT06_ID "rolling counter msg number" VALUE 0x0002038C __UBYTE_S 0 u_can_rxmsg_num 0 255 FORMAT "%3.0" SYMBOL_LINK "CAN_RX_ROLL_CNT06" 0 /end CHARACTERISTIC
/begin CHARACTERISTIC CAN_RX_ROLL_CNT06_BYTE_LOC "rolling counter msg location number" VALUE 0x0002038C __UBYTE_S 0 u_can_byte_num 0 7 FORMAT "%1.0" SYMBOL_LINK "CAN_RX_ROLL_CNT06" 1 /end CHARACTERISTIC
/begin CHARACTERISTIC CAN_RX_ROLL_CNT06_BIT_LOC "rolling counter msg bit location" VALUE 0x0002038C __UBYTE_S 0 u_can_bit_loc 0 7 FORMAT "%1.0" SYMBOL_LINK "CAN_RX_ROLL_CNT06" 2 /end CHARACTERISTIC
/begin CHARACTERISTIC CAN_RX_ROLL_CNT06_BIT_LEN "rolling counter msg bit length" VALUE 0x0002038C __UBYTE_S 0 u_cnts 0 255 SYMBOL_LINK "CAN_RX_ROLL_CNT06" 3 /end CHARACTERISTIC
/begin CHARACTERISTIC CAN_RX_ROLL_CNT07_ID "rolling counter msg number" VALUE 0x0002038C __UBYTE_S 0 u_can_rxmsg_num 0 255 FORMAT "%3.0" SYMBOL_LINK "CAN_RX_ROLL_CNT07" 0 /end CHARACTERISTIC
/begin CHARACTERISTIC CAN_RX_ROLL_CNT07_BYTE_LOC "rolling counter msg location number" VALUE 0x0002038C __UBYTE_S 0 u_can_byte_num 0 7 FORMAT "%1.0" SYMBOL_LINK "CAN_RX_ROLL_CNT07" 1 /end CHARACTERISTIC
/begin CHARACTERISTIC CAN_RX_ROLL_CNT07_BIT_LOC "rolling counter msg bit location" VALUE 0x0002038C __UBYTE_S 0 u_can_bit_loc 0 7 FORMAT "%1.0" SYMBOL_LINK "CAN_RX_ROLL_CNT07" 2 /end CHARACTERISTIC
/begin CHARACTERISTIC CAN_RX_ROLL_CNT07_BIT_LEN "rolling counter msg bit length" VALUE 0x0002038C __UBYTE_S 0 u_cnts 0 255 SYMBOL_LINK "CAN_RX_ROLL_CNT07" 3 /end CHARACTERISTIC
/begin CHARACTERISTIC CAN_RX_ROLL_CNT08_ID "rolling counter msg number" VALUE 0x0002038C __UBYTE_S 0 u_can_rxmsg_num 0 255 FORMAT "%3.0" SYMBOL_LINK "CAN_RX_ROLL_CNT08" 0 /end CHARACTERISTIC
/begin CHARACTERISTIC CAN_RX_ROLL_CNT08_BYTE_LOC "rolling counter msg location number" VALUE 0x0002038C __UBYTE_S 0 u_can_byte_num 0 7 FORMAT "%1.0" SYMBOL_LINK "CAN_RX_ROLL_CNT08" 1 /end CHARACTERISTIC
/begin CHARACTERISTIC CAN_RX_ROLL_CNT08_BIT_LOC "rolling counter msg bit location" VALUE 0x0002038C __UBYTE_S 0 u_can_bit_loc 0 7 FORMAT "%1.0" SYMBOL_LINK "CAN_RX_ROLL_CNT08" 2 /end CHARACTERISTIC
/begin CHARACTERISTIC CAN_RX_ROLL_CNT08_BIT_LEN "rolling counter msg bit length" VALUE 0x0002038C __UBYTE_S 0 u_cnts 0 255 SYMBOL_LINK "CAN_RX_ROLL_CNT08" 3 /end CHARACTERISTIC
/begin CHARACTERISTIC CAN_RX_ROLL_CNT09_ID "rolling counter msg number" VALUE 0x0002038C __UBYTE_S 0 u_can_rxmsg_num 0 255 FORMAT "%3.0" SYMBOL_LINK "CAN_RX_ROLL_CNT09" 0 /end CHARACTERISTIC
/begin CHARACTERISTIC CAN_RX_ROLL_CNT09_BYTE_LOC "rolling counter msg location number" VALUE 0x0002038C __UBYTE_S 0 u_can_byte_num 0 7 FORMAT "%1.0" SYMBOL_LINK "CAN_RX_ROLL_CNT09" 1 /end CHARACTERISTIC
/begin CHARACTERISTIC CAN_RX_ROLL_CNT09_BIT_LOC "rolling counter msg bit location" VALUE 0x0002038C __UBYTE_S 0 u_can_bit_loc 0 7 FORMAT "%1.0" SYMBOL_LINK "CAN_RX_ROLL_CNT09" 2 /end CHARACTERISTIC
/begin CHARACTERISTIC CAN_RX_ROLL_CNT09_BIT_LEN "rolling counter msg bit length" VALUE 0x0002038C __UBYTE_S 0 u_cnts 0 255 SYMBOL_LINK "CAN_RX_ROLL_CNT09" 3 /end CHARACTERISTIC
/begin CHARACTERISTIC CAN_RX_ROLL_CNT10_ID "rolling counter msg number" VALUE 0x0002038C __UBYTE_S 0 u_can_rxmsg_num 0 255 FORMAT "%3.0" SYMBOL_LINK "CAN_RX_ROLL_CNT10" 0 /end CHARACTERISTIC
/begin CHARACTERISTIC CAN_RX_ROLL_CNT10_BYTE_LOC "rolling counter msg location number" VALUE 0x0002038C __UBYTE_S 0 u_can_byte_num 0 7 FORMAT "%1.0" SYMBOL_LINK "CAN_RX_ROLL_CNT10" 1 /end CHARACTERISTIC
/begin CHARACTERISTIC CAN_RX_ROLL_CNT10_BIT_LOC "rolling counter msg bit location" VALUE 0x0002038C __UBYTE_S 0 u_can_bit_loc 0 7 FORMAT "%1.0" SYMBOL_LINK "CAN_RX_ROLL_CNT10" 2 /end CHARACTERISTIC
/begin CHARACTERISTIC CAN_RX_ROLL_CNT10_BIT_LEN "rolling counter msg bit length" VALUE 0x0002038C __UBYTE_S 0 u_cnts 0 255 SYMBOL_LINK "CAN_RX_ROLL_CNT10" 3 /end CHARACTERISTIC
/begin CHARACTERISTIC CAN_RX_ROLL_CNT11_ID "rolling counter msg number" VALUE 0x0002038C __UBYTE_S 0 u_can_rxmsg_num 0 255 FORMAT "%3.0" SYMBOL_LINK "CAN_RX_ROLL_CNT11" 0 /end CHARACTERISTIC
/begin CHARACTERISTIC CAN_RX_ROLL_CNT11_BYTE_LOC "rolling counter msg location number" VALUE 0x0002038C __UBYTE_S 0 u_can_byte_num 0 7 FORMAT "%1.0" SYMBOL_LINK "CAN_RX_ROLL_CNT11" 1 /end CHARACTERISTIC
/begin CHARACTERISTIC CAN_RX_ROLL_CNT11_BIT_LOC "rolling counter msg bit location" VALUE 0x0002038C __UBYTE_S 0 u_can_bit_loc 0 7 FORMAT "%1.0" SYMBOL_LINK "CAN_RX_ROLL_CNT11" 2 /end CHARACTERISTIC
/begin CHARACTERISTIC CAN_RX_ROLL_CNT11_BIT_LEN "rolling counter msg bit length" VALUE 0x0002038C __UBYTE_S 0 u_cnts 0 255 SYMBOL_LINK "CAN_RX_ROLL_CNT11" 3 /end CHARACTERISTIC
/begin CHARACTERISTIC CAN_RX_ROLL_CNT12_ID "rolling counter msg number" VALUE 0x0002038C __UBYTE_S 0 u_can_rxmsg_num 0 255 FORMAT "%3.0" SYMBOL_LINK "CAN_RX_ROLL_CNT12" 0 /end CHARACTERISTIC
/begin CHARACTERISTIC CAN_RX_ROLL_CNT12_BYTE_LOC "rolling counter msg location number" VALUE 0x0002038C __UBYTE_S 0 u_can_byte_num 0 7 FORMAT "%1.0" SYMBOL_LINK "CAN_RX_ROLL_CNT12" 1 /end CHARACTERISTIC
/begin CHARACTERISTIC CAN_RX_ROLL_CNT12_BIT_LOC "rolling counter msg bit location" VALUE 0x0002038C __UBYTE_S 0 u_can_bit_loc 0 7 FORMAT "%1.0" SYMBOL_LINK "CAN_RX_ROLL_CNT12" 2 /end CHARACTERISTIC
/begin CHARACTERISTIC CAN_RX_ROLL_CNT12_BIT_LEN "rolling counter msg bit length" VALUE 0x0002038C __UBYTE_S 0 u_cnts 0 255 SYMBOL_LINK "CAN_RX_ROLL_CNT12" 3 /end CHARACTERISTIC
/begin CHARACTERISTIC CAN_RX_FRNT_BLW_ST_ID "front blower state msg number" VALUE 0x0002038C __UBYTE_S 0 u_can_rxmsg_num 0 255 FORMAT "%3.0" SYMBOL_LINK "CAN_RX_FRNT_BLW_ST" 0 /end CHARACTERISTIC
/begin CHARACTERISTIC CAN_RX_FRNT_BLW_ST_BYTE_LOC "front blower state location number" VALUE 0x0002038C __UBYTE_S 0 u_can_byte_num 0 7 FORMAT "%1.0" SYMBOL_LINK "CAN_RX_FRNT_BLW_ST" 1 /end CHARACTERISTIC
/begin CHARACTERISTIC CAN_RX_FRNT_BLW_ST_BIT_LOC "front blower state msg bit location" VALUE 0x0002038C __UBYTE_S 0 u_can_bit_loc 0 7 FORMAT "%1.0" SYMBOL_LINK "CAN_RX_FRNT_BLW_ST" 2 /end CHARACTERISTIC
/begin CHARACTERISTIC CAN_RX_FRNT_BLW_ST_BIT_LEN "front blower state msg bit length" VALUE 0x0002038C __UBYTE_S 0 u_cnts 0 255 SYMBOL_LINK "CAN_RX_FRNT_BLW_ST" 3 /end CHARACTERISTIC
/begin CHARACTERISTIC CAN_RX_FRNT_BLW_ST_TABLE "front blower state msg table" VAL_BLK 0x0002038C __UBYTE_S 0 u_blwr_st 0 4 NUMBER 16 FORMAT "%3.0" SYMBOL_LINK "CAN_RX_FRNT_BLW_ST" 4 /end CHARACTERISTIC
/begin CHARACTERISTIC CAN_RX_CRSH_ST_ID "front blower state msg number" VALUE 0x0002038C __UBYTE_S 0 u_can_rxmsg_num 0 255 FORMAT "%3.0" SYMBOL_LINK "CAN_RX_CRSH_ST" 0 /end CHARACTERISTIC
/begin CHARACTERISTIC CAN_RX_CRSH_ST_BYTE_LOC "front blower state location number" VALUE 0x0002038C __UBYTE_S 0 u_can_byte_num 0 7 FORMAT "%1.0" SYMBOL_LINK "CAN_RX_CRSH_ST" 1 /end CHARACTERISTIC
/begin CHARACTERISTIC CAN_RX_CRSH_ST_BIT_LOC "front blower state msg bit location" VALUE 0x0002038C __UBYTE_S 0 u_can_bit_loc 0 7 FORMAT "%1.0" SYMBOL_LINK "CAN_RX_CRSH_ST" 2 /end CHARACTERISTIC
/begin CHARACTERISTIC CAN_RX_CRSH_ST_BIT_LEN "front blower state msg bit length" VALUE 0x0002038C __UBYTE_S 0 u_cnts 0 255 SYMBOL_LINK "CAN_RX_CRSH_ST" 3 /end CHARACTERISTIC
/begin CHARACTERISTIC CAN_RX_CRSH_ST_DFLT "front blower state msg bit length" VALUE 0x0002038C __UBYTE_S 0 u_cnts 0 255 SYMBOL_LINK "CAN_RX_CRSH_ST" 4 /end CHARACTERISTIC
/begin CHARACTERISTIC CAN_RX_CRSH_ST_TABLE "front blower state msg table" VAL_BLK 0x0002038C __UBYTE_S 0 b_true 0 1 NUMBER 18 FORMAT "%1.0" SYMBOL_LINK "CAN_RX_CRSH_ST" 5 /end CHARACTERISTIC
/begin CHARACTERISTIC CAN_RX_HIGH_BEAM_ST_ID "high beam state msg number" VALUE 0x0002038C __UBYTE_S 0 u_can_rxmsg_num 0 255 FORMAT "%3.0" SYMBOL_LINK "CAN_RX_HIGH_BEAM_ST" 0 /end CHARACTERISTIC
/begin CHARACTERISTIC CAN_RX_HIGH_BEAM_ST_BYTE_LOC "high beam state location number" VALUE 0x0002038C __UBYTE_S 0 u_can_byte_num 0 7 FORMAT "%1.0" SYMBOL_LINK "CAN_RX_HIGH_BEAM_ST" 1 /end CHARACTERISTIC
/begin CHARACTERISTIC CAN_RX_HIGH_BEAM_ST_BIT_LOC "high beam state msg bit location" VALUE 0x0002038C __UBYTE_S 0 u_can_bit_loc 0 7 FORMAT "%1.0" SYMBOL_LINK "CAN_RX_HIGH_BEAM_ST" 2 /end CHARACTERISTIC
/begin CHARACTERISTIC CAN_RX_HIGH_BEAM_ST_BIT_LEN "high beam state msg bit length" VALUE 0x0002038C __UBYTE_S 0 u_cnts 0 255 SYMBOL_LINK "CAN_RX_HIGH_BEAM_ST" 3 /end CHARACTERISTIC
/begin CHARACTERISTIC CAN_RX_HIGH_BEAM_ST_TABLE "high beam state msg table" VAL_BLK 0x0002038C __UBYTE_S 0 b_true 0 1 NUMBER 4 FORMAT "%3.0" SYMBOL_LINK "CAN_RX_HIGH_BEAM_ST" 4 /end CHARACTERISTIC
/begin CHARACTERISTIC CAN_RX_LOW_BEAM_ST_ID "low beam state msg number" VALUE 0x0002038C __UBYTE_S 0 u_can_rxmsg_num 0 255 FORMAT "%3.0" SYMBOL_LINK "CAN_RX_LOW_BEAM_ST" 0 /end CHARACTERISTIC
/begin CHARACTERISTIC CAN_RX_LOW_BEAM_ST_BYTE_LOC "low beam state location number" VALUE 0x0002038C __UBYTE_S 0 u_can_byte_num 0 7 FORMAT "%1.0" SYMBOL_LINK "CAN_RX_LOW_BEAM_ST" 1 /end CHARACTERISTIC
/begin CHARACTERISTIC CAN_RX_LOW_BEAM_ST_BIT_LOC "low beam state msg bit location" VALUE 0x0002038C __UBYTE_S 0 u_can_bit_loc 0 7 FORMAT "%1.0" SYMBOL_LINK "CAN_RX_LOW_BEAM_ST" 2 /end CHARACTERISTIC
/begin CHARACTERISTIC CAN_RX_LOW_BEAM_ST_BIT_LEN "low beam state msg bit length" VALUE 0x0002038C __UBYTE_S 0 u_cnts 0 255 SYMBOL_LINK "CAN_RX_LOW_BEAM_ST" 3 /end CHARACTERISTIC
/begin CHARACTERISTIC CAN_RX_LOW_BEAM_ST_TABLE "low beam state msg table" VAL_BLK 0x0002038C __UBYTE_S 0 b_true 0 1 NUMBER 4 FORMAT "%3.0" SYMBOL_LINK "CAN_RX_LOW_BEAM_ST" 4 /end CHARACTERISTIC
/begin CHARACTERISTIC CAN_RX_DRVR_DR_OPN_ST_ID "driver door open msg number" VALUE 0x0002038C __UBYTE_S 0 u_can_rxmsg_num 0 255 FORMAT "%3.0" SYMBOL_LINK "CAN_RX_DRVR_DR_OPN" 0 /end CHARACTERISTIC
/begin CHARACTERISTIC CAN_RX_DRVR_DR_OPN_BYTE_LOC "driver door open location number" VALUE 0x0002038C __UBYTE_S 0 u_can_byte_num 0 7 FORMAT "%1.0" SYMBOL_LINK "CAN_RX_DRVR_DR_OPN" 1 /end CHARACTERISTIC
/begin CHARACTERISTIC CAN_RX_DRVR_DR_OPN_BIT_LOC "driver door open msg bit location" VALUE 0x0002038C __UBYTE_S 0 u_can_bit_loc 0 7 FORMAT "%1.0" SYMBOL_LINK "CAN_RX_DRVR_DR_OPN" 2 /end CHARACTERISTIC
/begin CHARACTERISTIC CAN_RX_DRVR_DR_OPN_BIT_LEN "driver door open msg bit length" VALUE 0x0002038C __UBYTE_S 0 u_cnts 0 255 SYMBOL_LINK "CAN_RX_DRVR_DR_OPN" 3 /end CHARACTERISTIC
/begin CHARACTERISTIC CAN_RX_DRVR_DR_OPN_TABLE "driver door open msg table" VAL_BLK 0x0002038C __UBYTE_S 0 b_true 0 1 NUMBER 4 FORMAT "%3.0" SYMBOL_LINK "CAN_RX_DRVR_DR_OPN" 4 /end CHARACTERISTIC
/begin CHARACTERISTIC CAN_RX_REAR_DEFOG_ID "rear defog msg number" VALUE 0x0002038C __UBYTE_S 0 u_can_rxmsg_num 0 255 FORMAT "%3.0" SYMBOL_LINK "CAN_RX_REAR_DEFOG" 0 /end CHARACTERISTIC
/begin CHARACTERISTIC CAN_RX_REAR_DEFOG_BYTE_LOC "rear defog location number" VALUE 0x0002038C __UBYTE_S 0 u_can_byte_num 0 7 FORMAT "%1.0" SYMBOL_LINK "CAN_RX_REAR_DEFOG" 1 /end CHARACTERISTIC
/begin CHARACTERISTIC CAN_RX_REAR_DEFOG_BIT_LOC "rear defog msg bit location" VALUE 0x0002038C __UBYTE_S 0 u_can_bit_loc 0 7 FORMAT "%1.0" SYMBOL_LINK "CAN_RX_REAR_DEFOG" 2 /end CHARACTERISTIC
/begin CHARACTERISTIC CAN_RX_REAR_DEFOG_BIT_LEN "rear defog msg bit length" VALUE 0x0002038C __UBYTE_S 0 u_cnts 0 255 SYMBOL_LINK "CAN_RX_REAR_DEFOG" 3 /end CHARACTERISTIC
/begin CHARACTERISTIC CAN_RX_REAR_DEFOG_TABLE "rear defog msg table" VAL_BLK 0x0002038C __UBYTE_S 0 b_true 0 1 NUMBER 4 FORMAT "%3.0" SYMBOL_LINK "CAN_RX_REAR_DEFOG" 4 /end CHARACTERISTIC
/begin CHARACTERISTIC CAN_RX_STRT_REQ_ID "start request msg number" VALUE 0x0002038C __UBYTE_S 0 u_can_rxmsg_num 0 255 FORMAT "%3.0" SYMBOL_LINK "CAN_RX_STRT_REQ" 0 /end CHARACTERISTIC
/begin CHARACTERISTIC CAN_RX_STRT_REQ_BYTE_LOC "start request location number" VALUE 0x0002038C __UBYTE_S 0 u_can_byte_num 0 7 FORMAT "%1.0" SYMBOL_LINK "CAN_RX_STRT_REQ" 1 /end CHARACTERISTIC
/begin CHARACTERISTIC CAN_RX_STRT_REQ_BIT_LOC "start request msg bit location" VALUE 0x0002038C __UBYTE_S 0 u_can_bit_loc 0 7 FORMAT "%1.0" SYMBOL_LINK "CAN_RX_STRT_REQ" 2 /end CHARACTERISTIC
/begin CHARACTERISTIC CAN_RX_STRT_REQ_BIT_LEN "start request msg bit length" VALUE 0x0002038C __UBYTE_S 0 u_cnts 0 255 SYMBOL_LINK "CAN_RX_STRT_REQ" 3 /end CHARACTERISTIC
/begin CHARACTERISTIC CAN_RX_STRT_REQ_TABLE "start request msg table" VAL_BLK 0x0002038C __UBYTE_S 0 b_true 0 1 NUMBER 8 FORMAT "%3.0" SYMBOL_LINK "CAN_RX_STRT_REQ" 4 /end CHARACTERISTIC
/begin CHARACTERISTIC CAN_RX_FUEL_LVL_ID "fuel level msg number" VALUE 0x0002038C __UBYTE_S 0 u_can_rxmsg_num 0 255 FORMAT "%3.0" SYMBOL_LINK "CAN_RX_FUEL_LVL" 0 /end CHARACTERISTIC
/begin CHARACTERISTIC CAN_RX_FUEL_LVL_BYTE_LOC "fuel level msg location number" VALUE 0x0002038C __UBYTE_S 0 u_can_byte_num 0 7 FORMAT "%1.0" SYMBOL_LINK "CAN_RX_FUEL_LVL" 1 /end CHARACTERISTIC
/begin CHARACTERISTIC CAN_RX_FUEL_LVL_BIT_LOC "fuel level msg bit location" VALUE 0x0002038C __UBYTE_S 0 u_can_bit_loc 0 7 FORMAT "%1.0" SYMBOL_LINK "CAN_RX_FUEL_LVL" 2 /end CHARACTERISTIC
/begin CHARACTERISTIC CAN_RX_FUEL_LVL_BIT_LEN "fuel level msg bit length" VALUE 0x0002038C __UBYTE_S 0 u_cnts 0 255 SYMBOL_LINK "CAN_RX_FUEL_LVL" 3 /end CHARACTERISTIC
/begin CHARACTERISTIC CAN_RX_FUEL_LVL_A "fuel level msg scaling A" VALUE 0x0002038C __ULONG_S 0 u_fac_65536L 0 65535.9999847412109375 FORMAT "%8.3" SYMBOL_LINK "CAN_RX_FUEL_LVL" 4 /end CHARACTERISTIC
/begin CHARACTERISTIC CAN_RX_FUEL_LVL_B "fuel level msg scaling B" VALUE 0x0002038C __SWORD_S 0 u_cnt_n3277_p3277 -3276.8 3276.7 FORMAT "%5.1" SYMBOL_LINK "CAN_RX_FUEL_LVL" 8 /end CHARACTERISTIC
/begin CHARACTERISTIC CAN_RX_FUEL_LVL_INVALID "fuel level msg invalid value" VALUE 0x0002038C __UWORD_S 0 u_cnts 0 65535 FORMAT "%5.0" SYMBOL_LINK "CAN_RX_FUEL_LVL" 10 /end CHARACTERISTIC
/begin CHARACTERISTIC CAN_RX_FUEL_LVL_DFLT "fuel level msg default value when can fail" VALUE 0x0002038C __UWORD_S 0 u_pct_1 0 99.9984741210937 FORMAT "%4.2" SYMBOL_LINK "CAN_RX_FUEL_LVL" 12 /end CHARACTERISTIC
/begin CHARACTERISTIC CAN_RX_FUEL_LVL_WARN_ID "fuel level warning msg number" VALUE 0x0002038C __UBYTE_S 0 u_can_rxmsg_num 0 255 FORMAT "%3.0" SYMBOL_LINK "CAN_RX_FUEL_LVL_WARN" 0 /end CHARACTERISTIC
/begin CHARACTERISTIC CAN_RX_FUEL_LVL_WARN_BYTE_LOC "fuel level warning location number" VALUE 0x0002038C __UBYTE_S 0 u_can_byte_num 0 7 FORMAT "%1.0" SYMBOL_LINK "CAN_RX_FUEL_LVL_WARN" 1 /end CHARACTERISTIC
/begin CHARACTERISTIC CAN_RX_FUEL_LVL_WARN_BIT_LOC "fuel level warning msg bit location" VALUE 0x0002038C __UBYTE_S 0 u_can_bit_loc 0 7 FORMAT "%1.0" SYMBOL_LINK "CAN_RX_FUEL_LVL_WARN" 2 /end CHARACTERISTIC
/begin CHARACTERISTIC CAN_RX_FUEL_LVL_WARN_BIT_LEN "fuel level warning msg bit length" VALUE 0x0002038C __UBYTE_S 0 u_cnts 0 255 SYMBOL_LINK "CAN_RX_FUEL_LVL_WARN" 3 /end CHARACTERISTIC
/begin CHARACTERISTIC CAN_RX_FUEL_LVL_WARN_TABLE "fuel level warning msg table" VAL_BLK 0x0002038C __UBYTE_S 0 b_true 0 1 NUMBER 4 FORMAT "%3.0" SYMBOL_LINK "CAN_RX_FUEL_LVL_WARN" 4 /end CHARACTERISTIC
/begin CHARACTERISTIC CAN_RX_LDRV_WSS_ID "left driven wheel speed msg number" VALUE 0x0002038C __UBYTE_S 0 u_can_rxmsg_num 0 255 FORMAT "%3.0" SYMBOL_LINK "CAN_RX_LDRV_WSS" 0 /end CHARACTERISTIC
/begin CHARACTERISTIC CAN_RX_LDRV_WSS_BYTE_LOC "left driven wheel speed msg location number" VALUE 0x0002038C __UBYTE_S 0 u_can_byte_num 0 7 FORMAT "%1.0" SYMBOL_LINK "CAN_RX_LDRV_WSS" 1 /end CHARACTERISTIC
/begin CHARACTERISTIC CAN_RX_LDRV_WSS_BIT_LOC "left driven wheel speed msg bit location" VALUE 0x0002038C __UBYTE_S 0 u_can_bit_loc 0 7 FORMAT "%1.0" SYMBOL_LINK "CAN_RX_LDRV_WSS" 2 /end CHARACTERISTIC
/begin CHARACTERISTIC CAN_RX_LDRV_WSS_BIT_LEN "left driven wheel speed msg bit length" VALUE 0x0002038C __UBYTE_S 0 u_cnts 0 255 SYMBOL_LINK "CAN_RX_LDRV_WSS" 3 /end CHARACTERISTIC
/begin CHARACTERISTIC CAN_RX_LDRV_WSS_A "left driven wheel speed msg scaling A" VALUE 0x0002038C __ULONG_S 0 u_fac_65536L 0 65535.9999847412109375 FORMAT "%8.3" SYMBOL_LINK "CAN_RX_LDRV_WSS" 4 /end CHARACTERISTIC
/begin CHARACTERISTIC CAN_RX_LDRV_WSS_B "left driven wheel speed msg scaling B" VALUE 0x0002038C __SWORD_S 0 u_cnt_n3277_p3277 -3276.8 3276.7 FORMAT "%5.1" SYMBOL_LINK "CAN_RX_LDRV_WSS" 8 /end CHARACTERISTIC
/begin CHARACTERISTIC CAN_RX_LDRV_WSS_INVALID "left driven wheel speed msg invalid value" VALUE 0x0002038C __UWORD_S 0 u_cnts 0 65535 FORMAT "%5.0" SYMBOL_LINK "CAN_RX_LDRV_WSS" 10 /end CHARACTERISTIC
/begin CHARACTERISTIC CAN_RX_LDRV_WSS_DFLT "left driven wheel speed msg default value when can fail" VALUE 0x0002038C __UWORD_S 0 u_vspd 0 511.9921875 FORMAT "%4.1" SYMBOL_LINK "CAN_RX_LDRV_WSS" 12 /end CHARACTERISTIC
/begin CHARACTERISTIC CAN_RX_LDRV_WSS_VLD_ID "left driven wheel speed valid msg number" VALUE 0x0002038C __UBYTE_S 0 u_can_rxmsg_num 0 255 FORMAT "%3.0" SYMBOL_LINK "CAN_RX_LDRV_WSS_VLD" 0 /end CHARACTERISTIC
/begin CHARACTERISTIC CAN_RX_LDRV_WSS_VLD_BYTE_LOC "left driven wheel speed valid location number" VALUE 0x0002038C __UBYTE_S 0 u_can_byte_num 0 7 FORMAT "%1.0" SYMBOL_LINK "CAN_RX_LDRV_WSS_VLD" 1 /end CHARACTERISTIC
/begin CHARACTERISTIC CAN_RX_LDRV_WSS_VLD_BIT_LOC "left driven wheel speed valid msg bit location" VALUE 0x0002038C __UBYTE_S 0 u_can_bit_loc 0 7 FORMAT "%1.0" SYMBOL_LINK "CAN_RX_LDRV_WSS_VLD" 2 /end CHARACTERISTIC
/begin CHARACTERISTIC CAN_RX_LDRV_WSS_VLD_BIT_LEN "left driven wheel speed valid msg bit length" VALUE 0x0002038C __UBYTE_S 0 u_cnts 0 255 SYMBOL_LINK "CAN_RX_LDRV_WSS_VLD" 3 /end CHARACTERISTIC
/begin CHARACTERISTIC CAN_RX_LDRV_WSS_VLD_TABLE "left driven wheel speed valid msg table" VAL_BLK 0x0002038C __UBYTE_S 0 b_true 0 1 NUMBER 2 FORMAT "%3.0" SYMBOL_LINK "CAN_RX_LDRV_WSS_VLD" 4 /end CHARACTERISTIC
/begin CHARACTERISTIC CAN_RX_LNDRV_WSS_ID "left non-driven wheel speed msg number" VALUE 0x0002038C __UBYTE_S 0 u_can_rxmsg_num 0 255 FORMAT "%3.0" SYMBOL_LINK "CAN_RX_LNDRV_WSS" 0 /end CHARACTERISTIC
/begin CHARACTERISTIC CAN_RX_LNDRV_WSS_BYTE_LOC "left non-driven wheel speed msg location number" VALUE 0x0002038C __UBYTE_S 0 u_can_byte_num 0 7 FORMAT "%1.0" SYMBOL_LINK "CAN_RX_LNDRV_WSS" 1 /end CHARACTERISTIC
/begin CHARACTERISTIC CAN_RX_LNDRV_WSS_BIT_LOC "left non-driven wheel speed msg bit location" VALUE 0x0002038C __UBYTE_S 0 u_can_bit_loc 0 7 FORMAT "%1.0" SYMBOL_LINK "CAN_RX_LNDRV_WSS" 2 /end CHARACTERISTIC
/begin CHARACTERISTIC CAN_RX_LNDRV_WSS_BIT_LEN "left non-driven wheel speed msg bit length" VALUE 0x0002038C __UBYTE_S 0 u_cnts 0 255 SYMBOL_LINK "CAN_RX_LNDRV_WSS" 3 /end CHARACTERISTIC
/begin CHARACTERISTIC CAN_RX_LNDRV_WSS_A "left non-driven wheel speed msg scaling A" VALUE 0x0002038C __ULONG_S 0 u_fac_65536L 0 65535.9999847412109375 FORMAT "%8.3" SYMBOL_LINK "CAN_RX_LNDRV_WSS" 4 /end CHARACTERISTIC
/begin CHARACTERISTIC CAN_RX_LNDRV_WSS_B "left non-driven wheel speed msg scaling B" VALUE 0x0002038C __SWORD_S 0 u_cnt_n3277_p3277 -3276.8 3276.7 FORMAT "%5.1" SYMBOL_LINK "CAN_RX_LNDRV_WSS" 8 /end CHARACTERISTIC
/begin CHARACTERISTIC CAN_RX_LNDRV_WSS_INVALID "left non-driven wheel speed msg invalid value" VALUE 0x0002038C __UWORD_S 0 u_cnts 0 65535 FORMAT "%5.0" SYMBOL_LINK "CAN_RX_LNDRV_WSS" 10 /end CHARACTERISTIC
/begin CHARACTERISTIC CAN_RX_LNDRV_WSS_DFLT "left non-driven wheel speed msg default value when can fail" VALUE 0x0002038C __UWORD_S 0 u_vspd 0 511.9921875 FORMAT "%4.1" SYMBOL_LINK "CAN_RX_LNDRV_WSS" 12 /end CHARACTERISTIC
/begin CHARACTERISTIC CAN_RX_LNDRV_WSS_VLD_ID "left non-driven wheel speed valid msg number" VALUE 0x0002038C __UBYTE_S 0 u_can_rxmsg_num 0 255 FORMAT "%3.0" SYMBOL_LINK "CAN_RX_LNDRV_WSS_VLD" 0 /end CHARACTERISTIC
/begin CHARACTERISTIC CAN_RX_LNDRV_WSS_VLD_BYTE_LOC "left non-driven wheel speed valid location number" VALUE 0x0002038C __UBYTE_S 0 u_can_byte_num 0 7 FORMAT "%1.0" SYMBOL_LINK "CAN_RX_LNDRV_WSS_VLD" 1 /end CHARACTERISTIC
/begin CHARACTERISTIC CAN_RX_LNDRV_WSS_VLD_BIT_LOC "left non-driven wheel speed valid msg bit location" VALUE 0x0002038C __UBYTE_S 0 u_can_bit_loc 0 7 FORMAT "%1.0" SYMBOL_LINK "CAN_RX_LNDRV_WSS_VLD" 2 /end CHARACTERISTIC
/begin CHARACTERISTIC CAN_RX_LNDRV_WSS_VLD_BIT_LEN "left non-driven wheel speed valid msg bit length" VALUE 0x0002038C __UBYTE_S 0 u_cnts 0 255 SYMBOL_LINK "CAN_RX_LNDRV_WSS_VLD" 3 /end CHARACTERISTIC
/begin CHARACTERISTIC CAN_RX_LNDRV_WSS_VLD_TABLE "left non-driven wheel speed valid msg table" VAL_BLK 0x0002038C __UBYTE_S 0 b_true 0 1 NUMBER 2 FORMAT "%3.0" SYMBOL_LINK "CAN_RX_LNDRV_WSS_VLD" 4 /end CHARACTERISTIC
/begin CHARACTERISTIC CAN_RX_RDRV_WSS_ID "right driven wheel speed msg number" VALUE 0x0002038C __UBYTE_S 0 u_can_rxmsg_num 0 255 FORMAT "%3.0" SYMBOL_LINK "CAN_RX_RDRV_WSS" 0 /end CHARACTERISTIC
/begin CHARACTERISTIC CAN_RX_RDRV_WSS_BYTE_LOC "right driven wheel speed msg location number" VALUE 0x0002038C __UBYTE_S 0 u_can_byte_num 0 7 FORMAT "%1.0" SYMBOL_LINK "CAN_RX_RDRV_WSS" 1 /end CHARACTERISTIC
/begin CHARACTERISTIC CAN_RX_RDRV_WSS_BIT_LOC "right driven wheel speed msg bit location" VALUE 0x0002038C __UBYTE_S 0 u_can_bit_loc 0 7 FORMAT "%1.0" SYMBOL_LINK "CAN_RX_RDRV_WSS" 2 /end CHARACTERISTIC
/begin CHARACTERISTIC CAN_RX_RDRV_WSS_BIT_LEN "right driven wheel speed msg bit length" VALUE 0x0002038C __UBYTE_S 0 u_cnts 0 255 SYMBOL_LINK "CAN_RX_RDRV_WSS" 3 /end CHARACTERISTIC
/begin CHARACTERISTIC CAN_RX_RDRV_WSS_A "right driven wheel speed msg scaling A" VALUE 0x0002038C __ULONG_S 0 u_fac_65536L 0 65535.9999847412109375 FORMAT "%8.3" SYMBOL_LINK "CAN_RX_RDRV_WSS" 4 /end CHARACTERISTIC
/begin CHARACTERISTIC CAN_RX_RDRV_WSS_B "right driven wheel speed msg scaling B" VALUE 0x0002038C __SWORD_S 0 u_cnt_n3277_p3277 -3276.8 3276.7 FORMAT "%5.1" SYMBOL_LINK "CAN_RX_RDRV_WSS" 8 /end CHARACTERISTIC
/begin CHARACTERISTIC CAN_RX_RDRV_WSS_INVALID "right driven wheel speed msg invalid value" VALUE 0x0002038C __UWORD_S 0 u_cnts 0 65535 FORMAT "%5.0" SYMBOL_LINK "CAN_RX_RDRV_WSS" 10 /end CHARACTERISTIC
/begin CHARACTERISTIC CAN_RX_RDRV_WSS_DFLT "right driven wheel speed msg default value when can fail" VALUE 0x0002038C __UWORD_S 0 u_vspd 0 511.9921875 FORMAT "%4.1" SYMBOL_LINK "CAN_RX_RDRV_WSS" 12 /end CHARACTERISTIC
/begin CHARACTERISTIC CAN_RX_RDRV_WSS_VLD_ID "right driven wheel speed valid msg number" VALUE 0x0002038C __UBYTE_S 0 u_can_rxmsg_num 0 255 FORMAT "%3.0" SYMBOL_LINK "CAN_RX_RDRV_WSS_VLD" 0 /end CHARACTERISTIC
/begin CHARACTERISTIC CAN_RX_RDRV_WSS_VLD_BYTE_LOC "right driven wheel speed valid location number" VALUE 0x0002038C __UBYTE_S 0 u_can_byte_num 0 7 FORMAT "%1.0" SYMBOL_LINK "CAN_RX_RDRV_WSS_VLD" 1 /end CHARACTERISTIC
/begin CHARACTERISTIC CAN_RX_RDRV_WSS_VLD_BIT_LOC "right driven wheel speed valid msg bit location" VALUE 0x0002038C __UBYTE_S 0 u_can_bit_loc 0 7 FORMAT "%1.0" SYMBOL_LINK "CAN_RX_RDRV_WSS_VLD" 2 /end CHARACTERISTIC
/begin CHARACTERISTIC CAN_RX_RDRV_WSS_VLD_BIT_LEN "right driven wheel speed valid msg bit length" VALUE 0x0002038C __UBYTE_S 0 u_cnts 0 255 SYMBOL_LINK "CAN_RX_RDRV_WSS_VLD" 3 /end CHARACTERISTIC
/begin CHARACTERISTIC CAN_RX_RDRV_WSS_VLD_TABLE "right driven wheel speed valid msg table" VAL_BLK 0x0002038C __UBYTE_S 0 b_true 0 1 NUMBER 2 FORMAT "%3.0" SYMBOL_LINK "CAN_RX_RDRV_WSS_VLD" 4 /end CHARACTERISTIC
/begin CHARACTERISTIC CAN_RX_RNDRV_WSS_ID "right non-driven wheel speed msg number" VALUE 0x0002038C __UBYTE_S 0 u_can_txmsg_num 0 255 FORMAT "%3.0" SYMBOL_LINK "CAN_RX_RNDRV_WSS" 0 /end CHARACTERISTIC
/begin CHARACTERISTIC CAN_RX_RNDRV_WSS_BYTE_LOC "right non-driven wheel speed msg location number" VALUE 0x0002038C __UBYTE_S 0 u_can_byte_num 0 7 FORMAT "%1.0" SYMBOL_LINK "CAN_RX_RNDRV_WSS" 1 /end CHARACTERISTIC
/begin CHARACTERISTIC CAN_RX_RNDRV_WSS_BIT_LOC "right non-driven wheel speed msg bit location" VALUE 0x0002038C __UBYTE_S 0 u_can_bit_loc 0 7 FORMAT "%1.0" SYMBOL_LINK "CAN_RX_RNDRV_WSS" 2 /end CHARACTERISTIC
/begin CHARACTERISTIC CAN_RX_RNDRV_WSS_BIT_LEN "right non-driven wheel speed msg bit length" VALUE 0x0002038C __UBYTE_S 0 u_cnts 0 255 SYMBOL_LINK "CAN_RX_RNDRV_WSS" 3 /end CHARACTERISTIC
/begin CHARACTERISTIC CAN_RX_RNDRV_WSS_A "right non-driven wheel speed msg scaling A" VALUE 0x0002038C __ULONG_S 0 u_fac_65536L 0 65535.9999847412109375 FORMAT "%8.3" SYMBOL_LINK "CAN_RX_RNDRV_WSS" 4 /end CHARACTERISTIC
/begin CHARACTERISTIC CAN_RX_RNDRV_WSS_B "right non-driven wheel speed msg scaling B" VALUE 0x0002038C __SWORD_S 0 u_cnt_n3277_p3277 -3276.8 3276.7 FORMAT "%5.1" SYMBOL_LINK "CAN_RX_RNDRV_WSS" 8 /end CHARACTERISTIC
/begin CHARACTERISTIC CAN_RX_RNDRV_WSS_INVALID "right non-driven wheel speed msg invalid value" VALUE 0x0002038C __UWORD_S 0 u_cnts 0 65535 FORMAT "%5.0" SYMBOL_LINK "CAN_RX_RNDRV_WSS" 10 /end CHARACTERISTIC
/begin CHARACTERISTIC CAN_RX_RNDRV_WSS_DFLT "right non-driven wheel speed msg default value when can fail" VALUE 0x0002038C __UWORD_S 0 u_vspd 0 511.9921875 FORMAT "%4.1" SYMBOL_LINK "CAN_RX_RNDRV_WSS" 12 /end CHARACTERISTIC
/begin CHARACTERISTIC CAN_RX_RNDRV_WSS_VLD_ID "right non-driven wheel speed valid msg number" VALUE 0x0002038C __UBYTE_S 0 u_can_rxmsg_num 0 255 FORMAT "%3.0" SYMBOL_LINK "CAN_RX_RNDRV_WSS_VLD" 0 /end CHARACTERISTIC
/begin CHARACTERISTIC CAN_RX_RNDRV_WSS_VLD_BYTE_LOC "right non-driven wheel speed valid location number" VALUE 0x0002038C __UBYTE_S 0 u_can_byte_num 0 7 FORMAT "%1.0" SYMBOL_LINK "CAN_RX_RNDRV_WSS_VLD" 1 /end CHARACTERISTIC
/begin CHARACTERISTIC CAN_RX_RNDRV_WSS_VLD_BIT_LOC "right non-driven wheel speed valid msg bit location" VALUE 0x0002038C __UBYTE_S 0 u_can_bit_loc 0 7 FORMAT "%1.0" SYMBOL_LINK "CAN_RX_RNDRV_WSS_VLD" 2 /end CHARACTERISTIC
/begin CHARACTERISTIC CAN_RX_RNDRV_WSS_VLD_BIT_LEN "right non-driven wheel speed valid msg bit length" VALUE 0x0002038C __UBYTE_S 0 u_cnts 0 255 SYMBOL_LINK "CAN_RX_RNDRV_WSS_VLD" 3 /end CHARACTERISTIC
/begin CHARACTERISTIC CAN_RX_RNDRV_WSS_VLD_TABLE "right non-driven wheel speed valid msg table" VAL_BLK 0x0002038C __UBYTE_S 0 b_true 0 1 NUMBER 2 FORMAT "%3.0" SYMBOL_LINK "CAN_RX_RNDRV_WSS_VLD" 4 /end CHARACTERISTIC
/begin CHARACTERISTIC CAN_RX_TQ_RED_ACTV_TCS_ID "Torque reduction active from Traction control system msg number" VALUE 0x0002038C __UBYTE_S 0 u_can_rxmsg_num 0 255 FORMAT "%3.0" SYMBOL_LINK "CAN_RX_TQ_RED_ACTV_TCS" 0 /end CHARACTERISTIC
/begin CHARACTERISTIC CAN_RX_TQ_RED_ACTV_TCS_BYTE_LOC "Torque reduction active from Traction control system msg location number" VALUE 0x0002038C __UBYTE_S 0 u_can_byte_num 0 7 FORMAT "%1.0" SYMBOL_LINK "CAN_RX_TQ_RED_ACTV_TCS" 1 /end CHARACTERISTIC
/begin CHARACTERISTIC CAN_RX_TQ_RED_ACTV_TCS_BIT_LOC "Torque reduction active from Traction control system msg bit location" VALUE 0x0002038C __UBYTE_S 0 u_can_bit_loc 0 7 FORMAT "%1.0" SYMBOL_LINK "CAN_RX_TQ_RED_ACTV_TCS" 2 /end CHARACTERISTIC
/begin CHARACTERISTIC CAN_RX_TQ_RED_ACTV_TCS_BIT_LEN "Torque reduction active from Traction control system msg bit length" VALUE 0x0002038C __UBYTE_S 0 u_cnts 0 255 SYMBOL_LINK "CAN_RX_TQ_RED_ACTV_TCS" 3 /end CHARACTERISTIC
/begin CHARACTERISTIC CAN_RX_TQ_RED_ACTV_TCS_TABLE "Torque reduction active from Traction control system msg table" VAL_BLK 0x0002038C __UBYTE_S 0 u_cnts 0 255 NUMBER 8 SYMBOL_LINK "CAN_RX_TQ_RED_ACTV_TCS" 4 /end CHARACTERISTIC
/begin CHARACTERISTIC CAN_RX_TQ_RED_TCS_ID "Torque reduction setpoint from Traction control system msg number" VALUE 0x0002038C __UBYTE_S 0 u_can_txmsg_num 0 255 FORMAT "%3.0" SYMBOL_LINK "CAN_RX_TQ_RED_TCS" 0 /end CHARACTERISTIC
/begin CHARACTERISTIC CAN_RX_TQ_RED_TCS_BYTE_LOC "Torque reduction setpoint from Traction control system msg location number" VALUE 0x0002038C __UBYTE_S 0 u_can_byte_num 0 7 FORMAT "%1.0" SYMBOL_LINK "CAN_RX_TQ_RED_TCS" 1 /end CHARACTERISTIC
/begin CHARACTERISTIC CAN_RX_TQ_RED_TCS_BIT_LOC "Torque reduction setpoint from Traction control system msg bit location" VALUE 0x0002038C __UBYTE_S 0 u_can_bit_loc 0 7 FORMAT "%1.0" SYMBOL_LINK "CAN_RX_TQ_RED_TCS" 2 /end CHARACTERISTIC
/begin CHARACTERISTIC CAN_RX_TQ_RED_TCS_BIT_LEN "Torque reduction setpoint from Traction control system msg bit length" VALUE 0x0002038C __UBYTE_S 0 u_cnts 0 255 SYMBOL_LINK "CAN_RX_TQ_RED_TCS" 3 /end CHARACTERISTIC
/begin CHARACTERISTIC CAN_RX_TQ_RED_TCS_A "Torque reduction setpoint from Traction control system msg scaling A" VALUE 0x0002038C __ULONG_S 0 u_fac_65536L 0 65535.9999847412109375 FORMAT "%8.3" SYMBOL_LINK "CAN_RX_TQ_RED_TCS" 4 /end CHARACTERISTIC
/begin CHARACTERISTIC CAN_RX_TQ_RED_TCS_B "Torque reduction setpoint from Traction control system msg scaling B" VALUE 0x0002038C __SWORD_S 0 u_cnt_n3277_p3277 -3276.8 3276.7 FORMAT "%5.1" SYMBOL_LINK "CAN_RX_TQ_RED_TCS" 8 /end CHARACTERISTIC
/begin CHARACTERISTIC CAN_RX_TQ_RED_TCS_INVALID "Torque reduction setpoint from Traction control system msg invalid value" VALUE 0x0002038C __UWORD_S 0 u_cnts 0 65535 FORMAT "%5.0" SYMBOL_LINK "CAN_RX_TQ_RED_TCS" 10 /end CHARACTERISTIC
/begin CHARACTERISTIC CAN_RX_TQ_RED_TCS_DFLT "Torque reduction setpoint from Traction control system msg default value when can fail" VALUE 0x0002038C __SWORD_S 0 u_nm_s -2048 2047.9375 SYMBOL_LINK "CAN_RX_TQ_RED_TCS" 12 /end CHARACTERISTIC
/begin CHARACTERISTIC CAN_RX_TQ_RED_TCS_TYP "Torque reduction setpoint from Traction control system msg type" VALUE 0x0002038C __UBYTE_S 0 u_can_tq_unit 0 1 FORMAT "%1.0" SYMBOL_LINK "CAN_RX_TQ_RED_TCS" 14 /end CHARACTERISTIC
/begin CHARACTERISTIC CAN_RX_TQ_INC_ACTV_TCS_ID "Torque increase active from Traction control system msg number" VALUE 0x0002038C __UBYTE_S 0 u_can_rxmsg_num 0 255 FORMAT "%3.0" SYMBOL_LINK "CAN_RX_TQ_INC_ACTV_TCS" 0 /end CHARACTERISTIC
/begin CHARACTERISTIC CAN_RX_TQ_INC_ACTV_TCS_BYTE_LOC "Torque increase active from Traction control system msg location number" VALUE 0x0002038C __UBYTE_S 0 u_can_byte_num 0 7 FORMAT "%1.0" SYMBOL_LINK "CAN_RX_TQ_INC_ACTV_TCS" 1 /end CHARACTERISTIC
/begin CHARACTERISTIC CAN_RX_TQ_INC_ACTV_TCS_BIT_LOC "Torque increase active from Traction control system msg bit location" VALUE 0x0002038C __UBYTE_S 0 u_can_bit_loc 0 7 FORMAT "%1.0" SYMBOL_LINK "CAN_RX_TQ_INC_ACTV_TCS" 2 /end CHARACTERISTIC
/begin CHARACTERISTIC CAN_RX_TQ_INC_ACTV_TCS_BIT_LEN "Torque increase active from Traction control system msg bit length" VALUE 0x0002038C __UBYTE_S 0 u_cnts 0 255 SYMBOL_LINK "CAN_RX_TQ_INC_ACTV_TCS" 3 /end CHARACTERISTIC
/begin CHARACTERISTIC CAN_RX_TQ_INC_ACTV_TCS_TABLE "Torque increase active from Traction control system msg table" VAL_BLK 0x0002038C __UBYTE_S 0 u_cnts 0 255 NUMBER 8 SYMBOL_LINK "CAN_RX_TQ_INC_ACTV_TCS" 4 /end CHARACTERISTIC
/begin CHARACTERISTIC CAN_RX_TQ_INC_TCS_ID "Torque increase setpoint from Traction control system msg number" VALUE 0x0002038C __UBYTE_S 0 u_can_txmsg_num 0 255 FORMAT "%3.0" SYMBOL_LINK "CAN_RX_TQ_INC_TCS" 0 /end CHARACTERISTIC
/begin CHARACTERISTIC CAN_RX_TQ_INC_TCS_BYTE_LOC "Torque increase setpoint from Traction control system msg location number" VALUE 0x0002038C __UBYTE_S 0 u_can_byte_num 0 7 FORMAT "%1.0" SYMBOL_LINK "CAN_RX_TQ_INC_TCS" 1 /end CHARACTERISTIC
/begin CHARACTERISTIC CAN_RX_TQ_INC_TCS_BIT_LOC "Torque increase setpoint from Traction control system msg bit location" VALUE 0x0002038C __UBYTE_S 0 u_can_bit_loc 0 7 FORMAT "%1.0" SYMBOL_LINK "CAN_RX_TQ_INC_TCS" 2 /end CHARACTERISTIC
/begin CHARACTERISTIC CAN_RX_TQ_INC_TCS_BIT_LEN "Torque increase setpoint from Traction control system msg bit length" VALUE 0x0002038C __UBYTE_S 0 u_cnts 0 255 SYMBOL_LINK "CAN_RX_TQ_INC_TCS" 3 /end CHARACTERISTIC
/begin CHARACTERISTIC CAN_RX_TQ_INC_TCS_A "Torque increase setpoint from Traction control system msg scaling A" VALUE 0x0002038C __ULONG_S 0 u_fac_65536L 0 65535.9999847412109375 FORMAT "%8.3" SYMBOL_LINK "CAN_RX_TQ_INC_TCS" 4 /end CHARACTERISTIC
/begin CHARACTERISTIC CAN_RX_TQ_INC_TCS_B "Torque increase setpoint from Traction control system msg scaling B" VALUE 0x0002038C __SWORD_S 0 u_cnt_n3277_p3277 -3276.8 3276.7 FORMAT "%5.1" SYMBOL_LINK "CAN_RX_TQ_INC_TCS" 8 /end CHARACTERISTIC
/begin CHARACTERISTIC CAN_RX_TQ_INC_TCS_INVALID "Torque increase setpoint from Traction control system msg invalid value" VALUE 0x0002038C __UWORD_S 0 u_cnts 0 65535 FORMAT "%5.0" SYMBOL_LINK "CAN_RX_TQ_INC_TCS" 10 /end CHARACTERISTIC
/begin CHARACTERISTIC CAN_RX_TQ_INC_TCS_DFLT "Torque increase setpoint from Traction control system msg default value when can fail" VALUE 0x0002038C __SWORD_S 0 u_nm_s -2048 2047.9375 SYMBOL_LINK "CAN_RX_TQ_INC_TCS" 12 /end CHARACTERISTIC
/begin CHARACTERISTIC CAN_RX_TQ_INC_TCS_TYP "Torque increase setpoint from Traction control system msg type" VALUE 0x0002038C __UBYTE_S 0 u_can_tq_unit 0 1 FORMAT "%1.0" SYMBOL_LINK "CAN_RX_TQ_INC_TCS" 14 /end CHARACTERISTIC
/begin CHARACTERISTIC CAN_RX_TQ_LMT_ACTV_TCS_ID "Torque limitation active from Traction control system msg number" VALUE 0x0002038C __UBYTE_S 0 u_can_rxmsg_num 0 255 FORMAT "%3.0" SYMBOL_LINK "CAN_RX_TQ_LMT_ACTV_TCS" 0 /end CHARACTERISTIC
/begin CHARACTERISTIC CAN_RX_TQ_LMT_ACTV_TCS_BYTE_LOC "Torque limitation active from Traction control system msg location number" VALUE 0x0002038C __UBYTE_S 0 u_can_byte_num 0 7 FORMAT "%1.0" SYMBOL_LINK "CAN_RX_TQ_LMT_ACTV_TCS" 1 /end CHARACTERISTIC
/begin CHARACTERISTIC CAN_RX_TQ_LMT_ACTV_TCS_BIT_LOC "Torque limitation active from Traction control system msg bit location" VALUE 0x0002038C __UBYTE_S 0 u_can_bit_loc 0 7 FORMAT "%1.0" SYMBOL_LINK "CAN_RX_TQ_LMT_ACTV_TCS" 2 /end CHARACTERISTIC
/begin CHARACTERISTIC CAN_RX_TQ_LMT_ACTV_TCS_BIT_LEN "Torque limitation active from Traction control system msg bit length" VALUE 0x0002038C __UBYTE_S 0 u_cnts 0 255 SYMBOL_LINK "CAN_RX_TQ_LMT_ACTV_TCS" 3 /end CHARACTERISTIC
/begin CHARACTERISTIC CAN_RX_TQ_LMT_ACTV_TCS_TABLE "Torque limitation active from Traction control system msg table" VAL_BLK 0x0002038C __UBYTE_S 0 u_cnts 0 255 NUMBER 8 SYMBOL_LINK "CAN_RX_TQ_LMT_ACTV_TCS" 4 /end CHARACTERISTIC
/begin CHARACTERISTIC CAN_RX_TQ_LMT_TCS_ID "Torque limitation setpoint from Traction control system msg number" VALUE 0x0002038C __UBYTE_S 0 u_can_txmsg_num 0 255 FORMAT "%3.0" SYMBOL_LINK "CAN_RX_TQ_LMT_TCS" 0 /end CHARACTERISTIC
/begin CHARACTERISTIC CAN_RX_TQ_LMT_TCS_BYTE_LOC "Torque limitation setpoint from Traction control system msg location number" VALUE 0x0002038C __UBYTE_S 0 u_can_byte_num 0 7 FORMAT "%1.0" SYMBOL_LINK "CAN_RX_TQ_LMT_TCS" 1 /end CHARACTERISTIC
/begin CHARACTERISTIC CAN_RX_TQ_LMT_TCS_BIT_LOC "Torque limitation setpoint from Traction control system msg bit location" VALUE 0x0002038C __UBYTE_S 0 u_can_bit_loc 0 7 FORMAT "%1.0" SYMBOL_LINK "CAN_RX_TQ_LMT_TCS" 2 /end CHARACTERISTIC
/begin CHARACTERISTIC CAN_RX_TQ_LMT_TCS_BIT_LEN "Torque limitation setpoint from Traction control system msg bit length" VALUE 0x0002038C __UBYTE_S 0 u_cnts 0 255 SYMBOL_LINK "CAN_RX_TQ_LMT_TCS" 3 /end CHARACTERISTIC
/begin CHARACTERISTIC CAN_RX_TQ_LMT_TCS_A "Torque limitation setpoint from Traction control system msg scaling A" VALUE 0x0002038C __ULONG_S 0 u_fac_65536L 0 65535.9999847412109375 FORMAT "%8.3" SYMBOL_LINK "CAN_RX_TQ_LMT_TCS" 4 /end CHARACTERISTIC
/begin CHARACTERISTIC CAN_RX_TQ_LMT_TCS_B "Torque limitation setpoint from Traction control system msg scaling B" VALUE 0x0002038C __SWORD_S 0 u_cnt_n3277_p3277 -3276.8 3276.7 FORMAT "%5.1" SYMBOL_LINK "CAN_RX_TQ_LMT_TCS" 8 /end CHARACTERISTIC
/begin CHARACTERISTIC CAN_RX_TQ_LMT_TCS_INVALID "Torque limitation setpoint from Traction control system msg invalid value" VALUE 0x0002038C __UWORD_S 0 u_cnts 0 65535 FORMAT "%5.0" SYMBOL_LINK "CAN_RX_TQ_LMT_TCS" 10 /end CHARACTERISTIC
/begin CHARACTERISTIC CAN_RX_TQ_LMT_TCS_DFLT "Torque limitation setpoint from Traction control system msg default value when can fail" VALUE 0x0002038C __SWORD_S 0 u_nm_s -2048 2047.9375 SYMBOL_LINK "CAN_RX_TQ_LMT_TCS" 12 /end CHARACTERISTIC
/begin CHARACTERISTIC CAN_RX_TQ_LMT_TCS_TYP "Torque limitation setpoint from Traction control system msg type" VALUE 0x0002038C __UBYTE_S 0 u_can_tq_unit 0 1 FORMAT "%1.0" SYMBOL_LINK "CAN_RX_TQ_LMT_TCS" 14 /end CHARACTERISTIC
/begin CHARACTERISTIC CAN_V_OFF_DLY "This calibration determines the delay time threshold to shut off ECM sending message. If the timer is larger than this calibration amount of time, then the ECM stop sending any message out." VALUE 0x0002038C __UWORD_S 0 u_10m_tmr 0 655.35 /end CHARACTERISTIC
/begin CHARACTERISTIC CAN_V_VOLT_THRSH1 "Low battery voltage threshold to stop sending and receiving message." VALUE 0x0002038C __UWORD_S 0 u_volt_32 0 31.99951171875 FORMAT "%4.2" /end CHARACTERISTIC
/begin CHARACTERISTIC CAN_V_VOLT_THRSH2 "Low voltage threshold to stop sending message." VALUE 0x0002038C __UWORD_S 0 u_volt_32 0 31.99951171875 FORMAT "%4.2" /end CHARACTERISTIC
/begin CHARACTERISTIC CAN_V_VOLT_THRSH3 "High voltage threshold to stop sending message." VALUE 0x0002038C __UWORD_S 0 u_volt_32 0 31.99951171875 FORMAT "%4.2" /end CHARACTERISTIC
/begin CHARACTERISTIC CAN_V_VOLT_THRSH4 "High voltage threshold to stop sending and receiving message." VALUE 0x0002038C __UWORD_S 0 u_volt_32 0 31.99951171875 FORMAT "%4.2" /end CHARACTERISTIC
/begin CHARACTERISTIC CAN_V_MSG_ERR_THRSH "The max rolling counter message error is allowed." VALUE 0x0002038C __UBYTE_S 0 u_cnts 0 255 /end CHARACTERISTIC
/begin CHARACTERISTIC CAN_V_RLL_CNT_ERR "The max rolling counter error between 2 loops is allowed." VALUE 0x0002038C __UBYTE_S 0 u_cnts 0 255 /end CHARACTERISTIC
/begin CHARACTERISTIC CAN_V_CAN_CFG "False:Intel mode. True:Motorola mode." VALUE 0x0002038C __UBYTE_S 0 b_true 0 1 FORMAT "%1.0" /end CHARACTERISTIC
/begin CHARACTERISTIC CAN_V_TORQ_UNIT "Torque unit on CAN messages." VALUE 0x0002038C __UBYTE_S 0 u_can_tq_unit 0 2 FORMAT "%1.0" /end CHARACTERISTIC
/begin CHARACTERISTIC CAN_V_PPS_HI_THRSH "High pedal position threshold to enable full acceleration." VALUE 0x0002038C __UWORD_S 0 u_pct 0 199.996948 FORMAT "%4.1" /end CHARACTERISTIC
/begin CHARACTERISTIC CAN_V_PPS_LO_THRSH "Low pedal position threshold to disable full acceleration." VALUE 0x0002038C __UWORD_S 0 u_pct 0 199.996948 FORMAT "%4.1" /end CHARACTERISTIC
/begin CHARACTERISTIC VVTD_V_B1_EXH_TH_COR_FL_CNTS "b1 exh tooth base fail counts" VALUE 0x0002038C __UWORD_S 0 u_cnts 0 65535 FORMAT "%5.0" /end CHARACTERISTIC
/begin CHARACTERISTIC VVTD_V_B1_EXH_TH_COR_DIAG_CNTS "b1 exh tooth base diag counts" VALUE 0x0002038C __UWORD_S 0 u_cnts 0 65535 FORMAT "%5.0" /end CHARACTERISTIC
/begin CHARACTERISTIC VVTD_V_B1_EXH_TH_NUM "b1 exh tooth number" VALUE 0x0002038C __UBYTE_S 0 u_cnts 0 255 /end CHARACTERISTIC
/begin CHARACTERISTIC VVTD_V_B1_INTK_TH_COR_FL_CNTS "b1 intake tooth base fail counts" VALUE 0x0002038C __UWORD_S 0 u_cnts 0 65535 FORMAT "%5.0" /end CHARACTERISTIC
/begin CHARACTERISTIC VVTD_V_B1_INTK_TH_COR_DIAG_CNTS "b1 intake tooth base diag counts" VALUE 0x0002038C __UWORD_S 0 u_cnts 0 65535 FORMAT "%5.0" /end CHARACTERISTIC
/begin CHARACTERISTIC VVTD_V_B1_INTK_TH_NUM "b1 intake tooth number" VALUE 0x0002038C __UBYTE_S 0 u_cnts 0 255 /end CHARACTERISTIC
/begin CHARACTERISTIC VVTD_C_B1_EXH_TH_LRN_MIN "b1 exh tooth base min" VAL_BLK 0x0002038C __UWORD_S 0 u_fac_1 0 0.999984741210937 NUMBER 6 /end CHARACTERISTIC
/begin CHARACTERISTIC VVTD_C_B1_EXH_TH_LRN_MAX "b1 exh tooth base max" VAL_BLK 0x0002038C __UWORD_S 0 u_fac_1 0 0.999984741210937 NUMBER 6 /end CHARACTERISTIC
/begin CHARACTERISTIC VVTD_C_B1_INTK_TH_LRN_MIN "b1 intk tooth base min" VAL_BLK 0x0002038C __UWORD_S 0 u_fac_1 0 0.999984741210937 NUMBER 6 /end CHARACTERISTIC
/begin CHARACTERISTIC VVTD_C_B1_INTK_TH_LRN_MAX "b1 intk tooth base max" VAL_BLK 0x0002038C __UWORD_S 0 u_fac_1 0 0.999984741210937 NUMBER 6 /end CHARACTERISTIC
/begin CHARACTERISTIC VVTD_V_VLV_STCK_POS_DLT "vvt valve stuck fail position delta" VALUE 0x0002038C __SWORD_S 0 u_iga -256.000000 255.9921875 FORMAT "%4.1" /end CHARACTERISTIC
/begin CHARACTERISTIC VVTD_V_VLV_EXH_STCK_POS_LO "exh vvt valve stuck fail position low" VALUE 0x0002038C __SWORD_S 0 u_iga -256.000000 255.9921875 FORMAT "%4.1" /end CHARACTERISTIC
/begin CHARACTERISTIC VVTD_V_VLV_EXH_STCK_POS_HI "exh vvt valve stuck fail position high" VALUE 0x0002038C __SWORD_S 0 u_iga -256.000000 255.9921875 FORMAT "%4.1" /end CHARACTERISTIC
/begin CHARACTERISTIC VVTD_V_VLV_STCK_KP_CNTS "vvt valve stuck fail condition keep counts min" VALUE 0x0002038C __UWORD_S 0 u_cnts 0 65535 FORMAT "%5.0" /end CHARACTERISTIC
/begin CHARACTERISTIC VVTD_V_VLV_INTK_STCK_POS_LO "intake vvt valve stuck fail position low" VALUE 0x0002038C __SWORD_S 0 u_iga -256.000000 255.9921875 FORMAT "%4.1" /end CHARACTERISTIC
/begin CHARACTERISTIC VVTD_V_VLV_INTK_STCK_POS_HI "intake vvt valve stuck fail position high" VALUE 0x0002038C __SWORD_S 0 u_iga -256.000000 255.9921875 FORMAT "%4.1" /end CHARACTERISTIC
/begin CHARACTERISTIC VVTD_V_B1_EXH_STCK_FL_CNTS "exh vvt valve stuck fail counts" VALUE 0x0002038C __UWORD_S 0 u_cnts 0 65535 FORMAT "%5.0" /end CHARACTERISTIC
/begin CHARACTERISTIC VVTD_V_B1_EXH_STCK_FL_DIAG_CNTS "exh vvt valve stuck diag counts when previous failed" VALUE 0x0002038C __UWORD_S 0 u_cnts 0 65535 FORMAT "%5.0" /end CHARACTERISTIC
/begin CHARACTERISTIC VVTD_V_B1_EXH_STCK_DIAG_CNTS "exh vvt valve stuck diag counts" VALUE 0x0002038C __UWORD_S 0 u_cnts 0 65535 FORMAT "%5.0" /end CHARACTERISTIC
/begin CHARACTERISTIC VVTD_V_B1_INTK_STCK_FL_CNTS "intake vvt valve stuck fail counts" VALUE 0x0002038C __UWORD_S 0 u_cnts 0 65535 FORMAT "%5.0" /end CHARACTERISTIC
/begin CHARACTERISTIC VVTD_V_B1_INTK_STCK_FL_DIAG_CNTS "intake vvt valve stuck diag counts when previous failed" VALUE 0x0002038C __UWORD_S 0 u_cnts 0 65535 FORMAT "%5.0" /end CHARACTERISTIC
/begin CHARACTERISTIC VVTD_V_B1_INTK_STCK_DIAG_CNTS "intake vvt valve stuck diag counts" VALUE 0x0002038C __UWORD_S 0 u_cnts 0 65535 FORMAT "%5.0" /end CHARACTERISTIC
/begin CHARACTERISTIC VVTD_V_CAM_EXH_SLW_POS_MIN "exh vvt position slow response diag position min" VALUE 0x0002038C __SWORD_S 0 u_iga -256.000000 255.9921875 FORMAT "%4.1" /end CHARACTERISTIC
/begin CHARACTERISTIC VVTD_V_CAM_EXH_SLW_POS_MAX "exh vvt position slow response diag position max" VALUE 0x0002038C __SWORD_S 0 u_iga -256.000000 255.9921875 FORMAT "%4.1" /end CHARACTERISTIC
/begin CHARACTERISTIC VVTD_V_CAM_EXH_SLW_DTY_MIN "exh vvt position slow response fail duty min" VALUE 0x0002038C __UWORD_S 0 u_pct 0 199.996948 FORMAT "%4.1" /end CHARACTERISTIC
/begin CHARACTERISTIC VVTD_V_CAM_EXH_SLW_DTY_MAX "exh vvt position slow response fail duty max" VALUE 0x0002038C __UWORD_S 0 u_pct 0 199.996948 FORMAT "%4.1" /end CHARACTERISTIC
/begin CHARACTERISTIC VVTD_V_CAM_SLW_POS_KP_CNTS "vvt position slow response fail position condition keep counts" VALUE 0x0002038C __UWORD_S 0 u_cnts 0 65535 FORMAT "%5.0" /end CHARACTERISTIC
/begin CHARACTERISTIC VVTD_V_CAM_EXH_ACT_SP_DLT_THR "exh vvt position actual and sp position delta thr" VALUE 0x0002038C __SWORD_S 0 u_iga -256.000000 255.9921875 FORMAT "%4.1" /end CHARACTERISTIC
/begin CHARACTERISTIC VVTD_V_CAM_SLW_DLT_KP_CNTS "vvt position slow response fail delta high condition keep counts" VALUE 0x0002038C __UWORD_S 0 u_cnts 0 65535 FORMAT "%5.0" /end CHARACTERISTIC
/begin CHARACTERISTIC VVTD_V_B1_EXH_CAM_SLW_FL_CNTS "exh vvt position slow response fail counts" VALUE 0x0002038C __UWORD_S 0 u_cnts 0 65535 FORMAT "%5.0" /end CHARACTERISTIC
/begin CHARACTERISTIC VVTD_V_B1_EXH_CAM_SLW_DIAG_CNTS "exh vvt position slow response fail counts" VALUE 0x0002038C __UWORD_S 0 u_cnts 0 65535 FORMAT "%5.0" /end CHARACTERISTIC
/begin CHARACTERISTIC VVTD_V_CAM_INTK_SLW_POS_MIN "intake vvt position slow response diag position min" VALUE 0x0002038C __SWORD_S 0 u_iga -256.000000 255.9921875 FORMAT "%4.1" /end CHARACTERISTIC
/begin CHARACTERISTIC VVTD_V_CAM_INTK_SLW_POS_MAX "intake vvt position slow response diag position max" VALUE 0x0002038C __SWORD_S 0 u_iga -256.000000 255.9921875 FORMAT "%4.1" /end CHARACTERISTIC
/begin CHARACTERISTIC VVTD_V_CAM_INTK_SLW_DTY_MIN "intake vvt position slow response fail duty min" VALUE 0x0002038C __UWORD_S 0 u_pct 0 199.996948 FORMAT "%4.1" /end CHARACTERISTIC
/begin CHARACTERISTIC VVTD_V_CAM_INTK_SLW_DTY_MAX "intake vvt position slow response fail duty max" VALUE 0x0002038C __UWORD_S 0 u_pct 0 199.996948 FORMAT "%4.1" /end CHARACTERISTIC
/begin CHARACTERISTIC VVTD_V_CAM_INTK_SLW_DLT_MIN "intake vvt position slow response position delta min" VALUE 0x0002038C __SWORD_S 0 u_iga -256.000000 255.9921875 FORMAT "%4.1" /end CHARACTERISTIC
/begin CHARACTERISTIC VVTD_V_B1_INTK_CAM_SLW_FL_CNTS "intake vvt position slow response fail counts" VALUE 0x0002038C __UWORD_S 0 u_cnts 0 65535 FORMAT "%5.0" /end CHARACTERISTIC
/begin CHARACTERISTIC VVTD_V_B1_INTK_CAM_SLW_DIAG_CNTS "intake vvt position slow response fail counts" VALUE 0x0002038C __UWORD_S 0 u_cnts 0 65535 FORMAT "%5.0" /end CHARACTERISTIC
/begin CHARACTERISTIC VVTD_V_B1_EXH_CAM_TH_NUM_FL_CNTS "exh vvt tooth number fail counts" VALUE 0x0002038C __UWORD_S 0 u_cnts 0 65535 FORMAT "%5.0" /end CHARACTERISTIC
/begin CHARACTERISTIC VVTD_V_B1_EXH_CAM_TH_NUM_DIAG_CNTS "exh vvt tooth number diag counts" VALUE 0x0002038C __UWORD_S 0 u_cnts 0 65535 FORMAT "%5.0" /end CHARACTERISTIC
/begin CHARACTERISTIC VVTD_V_B1_INTK_CAM_TH_NUM_FL_CNTS "intake vvt tooth number fail counts" VALUE 0x0002038C __UWORD_S 0 u_cnts 0 65535 FORMAT "%5.0" /end CHARACTERISTIC
/begin CHARACTERISTIC VVTD_V_B1_INTK_CAM_TH_NUM_DIAG_CNTS "intake vvt tooth number diag counts" VALUE 0x0002038C __UWORD_S 0 u_cnts 0 65535 FORMAT "%5.0" /end CHARACTERISTIC
/begin CHARACTERISTIC VVTD_V_EXH_PERF_TRG_SP_V "exh vvt performance diag trigged setpoint velocity" VALUE 0x0002038C __UWORD_S 0 u_cam_v 0 1023.984375 FORMAT "%5.1" /end CHARACTERISTIC
/begin CHARACTERISTIC VVTD_V_EXH_PERF_SUM_SP_CHG_MIN "exh vvt performance diag setpoint change sum enable setpoint change min" VALUE 0x0002038C __UWORD_S 0 u_cam_ang_hi 0 63.9990234375 /end CHARACTERISTIC
/begin CHARACTERISTIC VVTD_V_EXH_PERF_TRG_CHG_SUM_MIN "exh vvt performance diag trig sp change sum min" VALUE 0x0002038C __UWORD_S 0 u_cam_ang_hi 0 63.9990234375 /end CHARACTERISTIC
/begin CHARACTERISTIC VVTD_V_EXH_PERF_MEAS_DUR_MIN "exh vvt performance diag measure duration min" VALUE 0x0002038C __UWORD_S 0 u_sec_16 0 15.999755859375 FORMAT "%4.2" /end CHARACTERISTIC
/begin CHARACTERISTIC VVTD_V_EXH_PERF_TRG_ACT_SP_DLT_MAX "exh vvt performance diag trig actual and sp delta max" VALUE 0x0002038C __UWORD_S 0 u_cam_ang_hi 0 63.9990234375 /end CHARACTERISTIC
/begin CHARACTERISTIC VVTD_V_EXH_PERF_END_ACT_SP_DLT_MAX "exh vvt performance diag trig actual and sp delta max" VALUE 0x0002038C __UWORD_S 0 u_cam_ang_hi 0 63.9990234375 /end CHARACTERISTIC
/begin CHARACTERISTIC VVTD_V_PERF_END_LOG_CNTS_MIN "vvt performance diag log counts min" VALUE 0x0002038C __UWORD_S 0 u_cnts 0 65535 FORMAT "%5.0" /end CHARACTERISTIC
/begin CHARACTERISTIC VVTD_V_PERF_VEL_NEG_HYS "vvt performance neg velocity hys" VALUE 0x0002038C __UWORD_S 0 u_cam_v 0 1023.984375 FORMAT "%5.1" /end CHARACTERISTIC
/begin CHARACTERISTIC VVTD_V_PERF_VEL_POS_HYS "vvt performance pos velocity hys" VALUE 0x0002038C __UWORD_S 0 u_cam_v 0 1023.984375 FORMAT "%5.1" /end CHARACTERISTIC
/begin CHARACTERISTIC VVTD_V_EXH_CAM_SLW_EN_VEL "exh slow diag enable velocity" VALUE 0x0002038C __UWORD_S 0 u_cam_v 0 1023.984375 FORMAT "%5.1" /end CHARACTERISTIC
/begin CHARACTERISTIC VVTD_V_INTK_CAM_SLW_EN_VEL "intake slow diag enable velocity" VALUE 0x0002038C __UWORD_S 0 u_cam_v 0 1023.984375 FORMAT "%5.1" /end CHARACTERISTIC
/begin CHARACTERISTIC VVTD_M_EXH_PERF_VEL_NEG_THR "exh vvt performance fail neg vel thr" MAP 0x27686 __UBYTE_S 0 u_cam_v_b 0.0 1020 FORMAT "%4.0" SYMBOL_LINK "VVTD_M_EXH_PERF_VEL_NEG_THR" 3
 /begin AXIS_DESCR COM_AXIS vvtd_b1_exh_sp_neg_vel u_cam_v 5 0 1023.984375 AXIS_PTS_REF VVTD_X_EXH_SP_ABS_VEL /end AXIS_DESCR
 /begin AXIS_DESCR COM_AXIS NO_INPUT_QUANTITY u_deg_C 5 -256.000000 255.9921875 AXIS_PTS_REF VVT_X_OIL_T_A /end AXIS_DESCR
/end CHARACTERISTIC
/begin CHARACTERISTIC VVTD_M_EXH_PERF_VEL_POS_THR "exh vvt performance fail pos vel thr" MAP 0x27686 __UBYTE_S 0 u_cam_v_b 0.0 1020 FORMAT "%4.0" SYMBOL_LINK "VVTD_M_EXH_PERF_VEL_POS_THR" 3
 /begin AXIS_DESCR COM_AXIS vvtd_b1_exh_sp_neg_vel u_cam_v 5 0 1023.984375 AXIS_PTS_REF VVTD_X_EXH_SP_ABS_VEL /end AXIS_DESCR
 /begin AXIS_DESCR COM_AXIS NO_INPUT_QUANTITY u_deg_C 5 -256.000000 255.9921875 AXIS_PTS_REF VVT_X_OIL_T_A /end AXIS_DESCR
/end CHARACTERISTIC
/begin AXIS_PTS VVTD_X_EXH_SP_ABS_VEL "exh vvt sp abs vel" 0x0002006C NO_INPUT_QUANTITY SSV__UWORD_S 0 u_cam_v 5 0 1023.984375 FORMAT "%5.1" DEPOSIT ABSOLUTE SYMBOL_LINK "VVTD_X_EXH_SP_ABS_VEL" 2 /end AXIS_PTS
/begin CHARACTERISTIC VVTD_V_INTK_PERF_TRG_SP_V "intake vvt performance diag trigged setpoint velocity" VALUE 0x0002038C __UWORD_S 0 u_cam_v 0 1023.984375 FORMAT "%5.1" /end CHARACTERISTIC
/begin CHARACTERISTIC VVTD_V_INTK_PERF_SUM_SP_CHG_MIN "intake vvt performance diag setpoint change sum enable setpoint change min" VALUE 0x0002038C __UWORD_S 0 u_cam_ang_hi 0 63.9990234375 /end CHARACTERISTIC
/begin CHARACTERISTIC VVTD_V_INTK_PERF_TRG_CHG_SUM_MIN "intake vvt performance diag trig sp change sum min" VALUE 0x0002038C __UWORD_S 0 u_cam_ang_hi 0 63.9990234375 /end CHARACTERISTIC
/begin CHARACTERISTIC VVTD_V_INTK_PERF_TRG_ACT_SP_DLT_MAX "intake vvt performance diag trig actual and sp delta max" VALUE 0x0002038C __UWORD_S 0 u_cam_ang_hi 0 63.9990234375 /end CHARACTERISTIC
/begin CHARACTERISTIC VVTD_V_INTK_PERF_END_ACT_SP_DLT_MAX "intake vvt performance diag trig actual and sp delta max" VALUE 0x0002038C __UWORD_S 0 u_cam_ang_hi 0 63.9990234375 /end CHARACTERISTIC
/begin CHARACTERISTIC VVTD_V_INTK_PERF_MEAS_DUR_MIN "intake vvt performance diag measure duration min" VALUE 0x0002038C __UWORD_S 0 u_sec_16 0 15.999755859375 FORMAT "%4.2" /end CHARACTERISTIC
/begin CHARACTERISTIC VVTD_M_INTK_PERF_VEL_NEG_THR "intake vvt performance fail neg vel thr" MAP 0x27686 __UBYTE_S 0 u_cam_v_b 0.0 1020 FORMAT "%4.0" SYMBOL_LINK "VVTD_M_INTK_PERF_VEL_NEG_THR" 3
 /begin AXIS_DESCR COM_AXIS vvtd_b1_intk_sp_pos_vel u_cam_v 5 0 1023.984375 AXIS_PTS_REF VVTD_X_INTK_SP_ABS_VEL /end AXIS_DESCR
 /begin AXIS_DESCR COM_AXIS NO_INPUT_QUANTITY u_deg_C 5 -256.000000 255.9921875 AXIS_PTS_REF VVT_X_OIL_T_A /end AXIS_DESCR
/end CHARACTERISTIC
/begin CHARACTERISTIC VVTD_M_INTK_PERF_VEL_POS_THR "intake vvt performance fail pos vel thr" MAP 0x27686 __UBYTE_S 0 u_cam_v_b 0.0 1020 FORMAT "%4.0" SYMBOL_LINK "VVTD_M_INTK_PERF_VEL_POS_THR" 3
 /begin AXIS_DESCR COM_AXIS vvtd_b1_intk_sp_pos_vel u_cam_v 5 0 1023.984375 AXIS_PTS_REF VVTD_X_INTK_SP_ABS_VEL /end AXIS_DESCR
 /begin AXIS_DESCR COM_AXIS NO_INPUT_QUANTITY u_deg_C 5 -256.000000 255.9921875 AXIS_PTS_REF VVT_X_OIL_T_A /end AXIS_DESCR
/end CHARACTERISTIC
/begin AXIS_PTS VVTD_X_INTK_SP_ABS_VEL "intake vvt sp abs vel" 0x0002006C NO_INPUT_QUANTITY SSV__UWORD_S 0 u_cam_v 5 0 1023.984375 FORMAT "%5.1" DEPOSIT ABSOLUTE SYMBOL_LINK "VVTD_X_INTK_SP_ABS_VEL" 2 /end AXIS_PTS
/begin CHARACTERISTIC VVTD_V_VLV_B1_INTK_EN_VLT "b1 intake vvt valve diag enable voltage min" VALUE 0x0002038C __UWORD_S 0 u_volt_32 0 31.99951171875 FORMAT "%4.2" SYMBOL_LINK "VVTD_C_VLV_EN_VLT_MIN" 0 /end CHARACTERISTIC
/begin CHARACTERISTIC VVTD_V_VLV_B1_EXH_EN_VLT "b1 exh vvt valve diag enable voltage min" VALUE 0x0002038C __UWORD_S 0 u_volt_32 0 31.99951171875 FORMAT "%4.2" SYMBOL_LINK "VVTD_C_VLV_EN_VLT_MIN" 2 /end CHARACTERISTIC
/begin CHARACTERISTIC VVTD_V_VLV_B1_INTK_EN_MPR_ON_MIN "b1 intake vvt valve diag enable main relay on min" VALUE 0x0002038C __UWORD_S 0 u_1x_tmr 0 511.9921875 FORMAT "%4.1" SYMBOL_LINK "VVTD_C_VLV_EN_MPR_ON_MIN" 0 /end CHARACTERISTIC
/begin CHARACTERISTIC VVTD_V_VLV_B1_EXH_EN_MPR_ON_MIN "b1 exh vvt valve diag enable main relay on min" VALUE 0x0002038C __UWORD_S 0 u_1x_tmr 0 511.9921875 FORMAT "%4.1" SYMBOL_LINK "VVTD_C_VLV_EN_MPR_ON_MIN" 2 /end CHARACTERISTIC
/begin CHARACTERISTIC VVTD_V_VLV_B1_INTK_EN_RUN_MIN "b1 intake vvt valve diag enable run min" VALUE 0x0002038C __UWORD_S 0 u_1x_tmr 0 511.9921875 FORMAT "%4.1" SYMBOL_LINK "VVTD_C_VLV_EN_RUN_MIN" 0 /end CHARACTERISTIC
/begin CHARACTERISTIC VVTD_V_VLV_B1_EXH_EN_RUN_MIN "b1 exh vvt valve diag enable run min" VALUE 0x0002038C __UWORD_S 0 u_1x_tmr 0 511.9921875 FORMAT "%4.1" SYMBOL_LINK "VVTD_C_VLV_EN_RUN_MIN" 2 /end CHARACTERISTIC
/begin CHARACTERISTIC VVTD_V_VLV_B1_INTK_HI_FL_CNTS "b1 intake vvt valve short high fail counts" VALUE 0x0002038C __UWORD_S 0 u_cnts 0 65535 FORMAT "%5.0" SYMBOL_LINK "VVTD_C_VLV_DIAG_CNTS" 0 /end CHARACTERISTIC
/begin CHARACTERISTIC VVTD_V_VLV_B1_INTK_HI_DIAG_CNTS "b1 intake vvt valve short high diag counts" VALUE 0x0002038C __UWORD_S 0 u_cnts 0 65535 FORMAT "%5.0" SYMBOL_LINK "VVTD_C_VLV_DIAG_CNTS" 2 /end CHARACTERISTIC
/begin CHARACTERISTIC VVTD_V_VLV_B1_INTK_LO_FL_CNTS "b1 intake vvt valve short low fail counts" VALUE 0x0002038C __UWORD_S 0 u_cnts 0 65535 FORMAT "%5.0" SYMBOL_LINK "VVTD_C_VLV_DIAG_CNTS" 4 /end CHARACTERISTIC
/begin CHARACTERISTIC VVTD_V_VLV_B1_INTK_LO_DIAG_CNTS "b1 intake vvt valve short low diag counts" VALUE 0x0002038C __UWORD_S 0 u_cnts 0 65535 FORMAT "%5.0" SYMBOL_LINK "VVTD_C_VLV_DIAG_CNTS" 6 /end CHARACTERISTIC
/begin CHARACTERISTIC VVTD_V_VLV_B1_INTK_OPN_FL_CNTS "b1 intake vvt valve open fail counts" VALUE 0x0002038C __UWORD_S 0 u_cnts 0 65535 FORMAT "%5.0" SYMBOL_LINK "VVTD_C_VLV_DIAG_CNTS" 8 /end CHARACTERISTIC
/begin CHARACTERISTIC VVTD_V_VLV_B1_INTK_OPN_DIAG_CNTS "b1 intake vvt valve open diag counts" VALUE 0x0002038C __UWORD_S 0 u_cnts 0 65535 FORMAT "%5.0" SYMBOL_LINK "VVTD_C_VLV_DIAG_CNTS" 10 /end CHARACTERISTIC
/begin CHARACTERISTIC VVTD_V_VLV_B1_EXH_HI_FL_CNTS "b1 exh vvt valve short high fail counts" VALUE 0x0002038C __UWORD_S 0 u_cnts 0 65535 FORMAT "%5.0" SYMBOL_LINK "VVTD_C_VLV_DIAG_CNTS" 12 /end CHARACTERISTIC
/begin CHARACTERISTIC VVTD_V_VLV_B1_EXH_HI_DIAG_CNTS "b1 exh vvt valve short high diag counts" VALUE 0x0002038C __UWORD_S 0 u_cnts 0 65535 FORMAT "%5.0" SYMBOL_LINK "VVTD_C_VLV_DIAG_CNTS" 14 /end CHARACTERISTIC
/begin CHARACTERISTIC VVTD_V_VLV_B1_EXH_LO_FL_CNTS "b1 exh vvt valve short low fail counts" VALUE 0x0002038C __UWORD_S 0 u_cnts 0 65535 FORMAT "%5.0" SYMBOL_LINK "VVTD_C_VLV_DIAG_CNTS" 16 /end CHARACTERISTIC
/begin CHARACTERISTIC VVTD_V_VLV_B1_EXH_LO_DIAG_CNTS "b1 exh vvt valve short low diag counts" VALUE 0x0002038C __UWORD_S 0 u_cnts 0 65535 FORMAT "%5.0" SYMBOL_LINK "VVTD_C_VLV_DIAG_CNTS" 18 /end CHARACTERISTIC
/begin CHARACTERISTIC VVTD_V_VLV_B1_EXH_OPN_FL_CNTS "b1 exh vvt valve open fail counts" VALUE 0x0002038C __UWORD_S 0 u_cnts 0 65535 FORMAT "%5.0" SYMBOL_LINK "VVTD_C_VLV_DIAG_CNTS" 20 /end CHARACTERISTIC
/begin CHARACTERISTIC VVTD_V_VLV_B1_EXH_OPN_DIAG_CNTS "b1 exh vvt valve open diag counts" VALUE 0x0002038C __UWORD_S 0 u_cnts 0 65535 FORMAT "%5.0" SYMBOL_LINK "VVTD_C_VLV_DIAG_CNTS" 22 /end CHARACTERISTIC
/begin CHARACTERISTIC PWSD_V_SOC_MIN "SOC fail thr" VALUE 0x0002038C __UWORD_S 0 u_pct 0 199.996948 FORMAT "%4.1" /end CHARACTERISTIC
/begin CHARACTERISTIC PWSD_V_BAT_T_MAX "battery temp fail thr" VALUE 0x0002038C __SWORD_S 0 u_deg_C -256 255.9921875 FORMAT "%4.1" /end CHARACTERISTIC
/begin CHARACTERISTIC PWSD_V_BAT_CURR_MIN "battery current fail thr" VALUE 0x0002038C __SWORD_S 0 u_curr_amp -2048 2047.9375 FORMAT "%5.1" /end CHARACTERISTIC
/begin CHARACTERISTIC PWSD_V_CHRG_OFF_ALT_DTY_MAX "no charge diag enable duty max" VALUE 0x0002038C __UWORD_S 0 u_pct_1 0 99.9984741210937 FORMAT "%4.2" /end CHARACTERISTIC
/begin CHARACTERISTIC PWSD_V_CHRG_OFF_SOC_MAX "no charge diag enable soc max" VALUE 0x0002038C __UWORD_S 0 u_pct 0 199.996948 FORMAT "%4.1" /end CHARACTERISTIC
/begin CHARACTERISTIC PWSD_V_SOC_LO_ALT_DTY_MAX "soc low diag enable duty max" VALUE 0x0002038C __UWORD_S 0 u_pct_1 0 99.9984741210937 FORMAT "%4.2" /end CHARACTERISTIC
/begin CHARACTERISTIC PWSD_V_VLT_LO_ALT_DTY_MAX "voltage low diag enable duty max" VALUE 0x0002038C __UWORD_S 0 u_pct_1 0 99.9984741210937 FORMAT "%4.2" /end CHARACTERISTIC
/begin CHARACTERISTIC PWSD_V_VLT_LO_SOC_MAX "voltage low diag enable soc max" VALUE 0x0002038C __UWORD_S 0 u_pct 0 199.996948 FORMAT "%4.1" /end CHARACTERISTIC
/begin CHARACTERISTIC PWSD_V_VLT_LO_DLT_THR "voltage low diag enable soc max" VALUE 0x0002038C __UWORD_S 0 u_volt_32 0 31.99951171875 FORMAT "%4.2" /end CHARACTERISTIC
/begin CHARACTERISTIC PWSD_V_VLT_RAT_DTY_MAX "voltage rat diag enable duty max" VALUE 0x0002038C __UWORD_S 0 u_pct_1 0 99.9984741210937 FORMAT "%4.2" /end CHARACTERISTIC
/begin CHARACTERISTIC PWSD_V_VLT_RAT_SOC_MAX "voltage rat diag enable soc max" VALUE 0x0002038C __UWORD_S 0 u_pct 0 199.996948 FORMAT "%4.1" /end CHARACTERISTIC
/begin CHARACTERISTIC PWSD_V_BAT_T_FL_TM "battery temp fail time" VALUE 0x0002038C __UWORD_S 0 u_16x_tmr 0 8191.875 /end CHARACTERISTIC
/begin CHARACTERISTIC PWSD_V_BAT_T_DIAG_TM "battery temp diag time" VALUE 0x0002038C __UWORD_S 0 u_16x_tmr 0 8191.875 /end CHARACTERISTIC
/begin CHARACTERISTIC PWSD_V_CHRG_OFF_FL_TM "battery charge off fail time" VALUE 0x0002038C __UWORD_S 0 u_16x_tmr 0 8191.875 /end CHARACTERISTIC
/begin CHARACTERISTIC PWSD_V_CHRG_OFF_DIAG_TM "battery charge off diag time" VALUE 0x0002038C __UWORD_S 0 u_16x_tmr 0 8191.875 /end CHARACTERISTIC
/begin CHARACTERISTIC PWSD_V_SOC_LO_FL_TM "soc low fail time" VALUE 0x0002038C __UWORD_S 0 u_16x_tmr 0 8191.875 /end CHARACTERISTIC
/begin CHARACTERISTIC PWSD_V_SOC_LO_DIAG_TM "soc low diag time" VALUE 0x0002038C __UWORD_S 0 u_16x_tmr 0 8191.875 /end CHARACTERISTIC
/begin CHARACTERISTIC PWSD_V_VLT_LO_FL_TM "voltage low fail time" VALUE 0x0002038C __UWORD_S 0 u_16x_tmr 0 8191.875 /end CHARACTERISTIC
/begin CHARACTERISTIC PWSD_V_VLT_LO_DIAG_TM "voltage low diag time" VALUE 0x0002038C __UWORD_S 0 u_16x_tmr 0 8191.875 /end CHARACTERISTIC
/begin CHARACTERISTIC PWSD_V_VLT_RAT_FL_TM "voltage rat fail time" VALUE 0x0002038C __UWORD_S 0 u_16x_tmr 0 8191.875 /end CHARACTERISTIC
/begin CHARACTERISTIC PWSD_V_VLT_RAT_DIAG_TM "voltage rat diag time" VALUE 0x0002038C __UWORD_S 0 u_16x_tmr 0 8191.875 /end CHARACTERISTIC
/begin CHARACTERISTIC PWSD_V_VLT_RAT_DLT_THR "voltage rat delta thr" VALUE 0x0002038C __UWORD_S 0 u_volt_32 0 31.99951171875 FORMAT "%4.2" /end CHARACTERISTIC
/begin CHARACTERISTIC PWSD_V_ALT_EN_VLT "alt diag enable voltage" VALUE 0x0002038C __UWORD_S 0 u_volt_32 0 31.99951171875 FORMAT "%4.2" /end CHARACTERISTIC
/begin CHARACTERISTIC PWSD_V_ALT_EN_ESPD "alt diag enable engine speed" VALUE 0x0002038C __UWORD_S 0 u_espd 0 8191.875 FORMAT "%5.1" /end CHARACTERISTIC
/begin CHARACTERISTIC PWSD_V_ALT_EN_RUN "alt diag enable run time" VALUE 0x0002038C __UWORD_S 0 u_cnts 0 65535 FORMAT "%5.0" /end CHARACTERISTIC
/begin CHARACTERISTIC PWSD_V_ALT_ELEC_FL_TM "alt electric fail time" VALUE 0x0002038C __UWORD_S 0 u_16x_tmr 0 8191.875 /end CHARACTERISTIC
/begin CHARACTERISTIC PWSD_V_ALT_ELEC_DIAG_TM "alt electric diag time" VALUE 0x0002038C __UWORD_S 0 u_16x_tmr 0 8191.875 /end CHARACTERISTIC
/begin CHARACTERISTIC PWSD_V_ALT_MECH_FL_TM "alt mech fail time" VALUE 0x0002038C __UWORD_S 0 u_16x_tmr 0 8191.875 /end CHARACTERISTIC
/begin CHARACTERISTIC PWSD_V_ALT_MECH_DIAG_TM "alt mech diag time" VALUE 0x0002038C __UWORD_S 0 u_16x_tmr 0 8191.875 /end CHARACTERISTIC
/begin CHARACTERISTIC PWSD_V_ALT_T_HI_FL_TM "alt temp high fail time" VALUE 0x0002038C __UWORD_S 0 u_16x_tmr 0 8191.875 /end CHARACTERISTIC
/begin CHARACTERISTIC PWSD_V_ALT_T_HI_DIAG_TM "alt temp high diag time" VALUE 0x0002038C __UWORD_S 0 u_16x_tmr 0 8191.875 /end CHARACTERISTIC
/begin CHARACTERISTIC IDLD_V_EN_PURGE_MAX "idle diag enable purge duty max" VALUE 0x0002038C __UWORD_S 0 u_pct 0 199.996948 FORMAT "%4.1" /end CHARACTERISTIC
/begin CHARACTERISTIC IDLD_V_EN_AMP_MIN "idle diag enable amp min" VALUE 0x0002038C __UWORD_S 0 u_kPa_0_256 0 255.99609375 FORMAT "%4.1" /end CHARACTERISTIC
/begin CHARACTERISTIC IDLD_V_EN_RUN_MIN "idle diag enable run min" VALUE 0x0002038C __UWORD_S 0 u_1s_tmr 0 65535 /end CHARACTERISTIC
/begin CHARACTERISTIC IDLD_V_EN_IAT_MIN "idle diag enable iat min" VALUE 0x0002038C __SWORD_S 0 u_deg_C -256 255.9921875 FORMAT "%5.0" /end CHARACTERISTIC
/begin CHARACTERISTIC IDLD_V_EN_VLT_MIN "idle diag enable voltage min" VALUE 0x0002038C __UWORD_S 0 u_volt_32 0 31.99951171875 FORMAT "%4.2" /end CHARACTERISTIC
/begin CHARACTERISTIC IDLD_V_EN_VLT_MAX "idle diag enable voltage max" VALUE 0x0002038C __UWORD_S 0 u_volt_32 0 31.99951171875 FORMAT "%4.2" /end CHARACTERISTIC
/begin CHARACTERISTIC IDLD_V_EN_ECT_MIN "idle diag enable ect min" VALUE 0x0002038C __SWORD_S 0 u_deg_C -256 255.9921875 FORMAT "%5.0" /end CHARACTERISTIC
/begin CHARACTERISTIC IDLD_V_SPD_DLT_FIL "idle speed delta filter coefficient" VALUE 0x0002038C __UWORD_S 0 u_filter 0 0.9999847412109375 FORMAT "%10.9" /end CHARACTERISTIC
/begin CHARACTERISTIC IDLD_V_EN_DLY "idle speed enable delay" VALUE 0x0002038C __UWORD_S 0 u_16x_tmr 0 8191.875 /end CHARACTERISTIC
/begin CHARACTERISTIC IDLD_V_CHT_EN_SPD_INC_MIN "cat heat diag enable engine speed increase min" VALUE 0x0002038C __UWORD_S 0 u_espd 0 8191.875 FORMAT "%5.1" /end CHARACTERISTIC
/begin CHARACTERISTIC IDLD_V_CAT_HT_SPD_DLT "cat heat diag fail speed delta thr" VALUE 0x0002038C __UWORD_S 0 u_espd 0 8191.875 FORMAT "%5.1" /end CHARACTERISTIC
/begin CHARACTERISTIC IDLD_V_IDL_FLW_HI_THR "idle air flow high thr" VALUE 0x0002038C __SWORD_S 0 u_pct -100 99.9969482421875 FORMAT "%4.1" /end CHARACTERISTIC
/begin CHARACTERISTIC IDLD_V_CHT_EN_AMP_MAP_MAX "cat heat diag enable amp map max" VALUE 0x0002038C __UWORD_S 0 u_kPa_0_256 0 255.99609375 FORMAT "%4.1" /end CHARACTERISTIC
/begin CHARACTERISTIC IDLD_V_CAT_HT_FL_DUR "idle speed low fail duration" VALUE 0x0002038C __UWORD_S 0 u_16x_tmr 0 8191.875 /end CHARACTERISTIC
/begin CHARACTERISTIC IDLD_V_CAT_HT_PS_DUR "idle speed low pass duration" VALUE 0x0002038C __UWORD_S 0 u_16x_tmr 0 8191.875 /end CHARACTERISTIC
/begin CHARACTERISTIC IDLD_V_LO_EN_AMP_MAP_MAX "speed low diag enable amp map max" VALUE 0x0002038C __UWORD_S 0 u_kPa_0_256 0 255.99609375 FORMAT "%4.1" /end CHARACTERISTIC
/begin CHARACTERISTIC IDLD_V_LO_DLT_FL_THR "speed low diag fail speed delta thr" VALUE 0x0002038C __UWORD_S 0 u_espd 0 8191.875 FORMAT "%5.1" /end CHARACTERISTIC
/begin CHARACTERISTIC IDLD_V_SPD_LO_FL_DUR "idle speed low fail duration" VALUE 0x0002038C __UWORD_S 0 u_16x_tmr 0 8191.875 /end CHARACTERISTIC
/begin CHARACTERISTIC IDLD_V_SPD_LO_PS_DUR "idle speed low pass duration" VALUE 0x0002038C __UWORD_S 0 u_16x_tmr 0 8191.875 /end CHARACTERISTIC
/begin CHARACTERISTIC IDLD_V_HI_DLT_FL_THR "speed high diag fail speed delta thr" VALUE 0x0002038C __UWORD_S 0 u_espd 0 8191.875 FORMAT "%5.1" /end CHARACTERISTIC
/begin CHARACTERISTIC IDLD_V_HI_EN_AMP_MAP_MIN "speed high diag enable amp map max" VALUE 0x0002038C __UWORD_S 0 u_kPa_0_256 0 255.99609375 FORMAT "%4.1" /end CHARACTERISTIC
/begin CHARACTERISTIC IDLD_V_SPD_HI_FL_DUR "idle speed high fail duration" VALUE 0x0002038C __UWORD_S 0 u_16x_tmr 0 8191.875 /end CHARACTERISTIC
/begin CHARACTERISTIC IDLD_V_SPD_HI_PS_DUR "idle speed high pass duration" VALUE 0x0002038C __UWORD_S 0 u_16x_tmr 0 8191.875 /end CHARACTERISTIC
/begin CHARACTERISTIC EFD_V_VSPD_MIN "EGR flow diag enable vehicle speed min" VALUE 0x0002038C __UWORD_S 0 u_vspd 0 511.9921875 FORMAT "%4.1" /end CHARACTERISTIC
/begin CHARACTERISTIC EFD_V_TPS_MAX "EGR flow diag enable tps max" VALUE 0x0002038C __UWORD_S 0 u_pct 0 199.996948 FORMAT "%4.1" /end CHARACTERISTIC
/begin CHARACTERISTIC EFD_V_AMP_MIN "EGR flow diag enable amp min" VALUE 0x0002038C __UWORD_S 0 u_kPa_0_256 0 255.99609375 FORMAT "%4.1" /end CHARACTERISTIC
/begin CHARACTERISTIC EFD_V_ESPD_MIN "EGR flow diag enable engine speed min" VALUE 0x0002038C __UWORD_S 0 u_espd 0 8191.875 FORMAT "%5.1" /end CHARACTERISTIC
/begin CHARACTERISTIC EFD_V_STBL_IDL_FLW_DLT "EGR flow diag stable idle flow delta max" VALUE 0x0002038C __UWORD_S 0 u_pct_1 0 99.9984741210937 FORMAT "%4.2" /end CHARACTERISTIC
/begin CHARACTERISTIC EFD_V_EN_EGR_POS_MAX "EGR flow diag enable position max" VALUE 0x0002038C __UWORD_S 0 u_pct 0 199.996948 FORMAT "%4.1" /end CHARACTERISTIC
/begin CHARACTERISTIC EFD_V_EN_AMP_MAP_MIN "EGR flow diag enable amp map min" VALUE 0x0002038C __UWORD_S 0 u_kPa_0_256 0 255.99609375 FORMAT "%4.1" /end CHARACTERISTIC
/begin CHARACTERISTIC EFD_V_EN_AMP_MAP_MAX "EGR flow diag enable amp map max" VALUE 0x0002038C __UWORD_S 0 u_kPa_0_256 0 255.99609375 FORMAT "%4.1" /end CHARACTERISTIC
/begin CHARACTERISTIC EFD_V_EN_ESPD_MIN "EGR flow diag stable engine speed min" VALUE 0x0002038C __UWORD_S 0 u_espd 0 8191.875 FORMAT "%5.1" /end CHARACTERISTIC
/begin CHARACTERISTIC EFD_V_EN_ESPD_MAX "EGR flow diag stable engine speed max" VALUE 0x0002038C __UWORD_S 0 u_espd 0 8191.875 FORMAT "%5.1" /end CHARACTERISTIC
/begin CHARACTERISTIC EFD_V_STBL_MAP_DLT "EGR flow diag stable map delta" VALUE 0x0002038C __UWORD_S 0 u_kPa_0_256 0 255.99609375 FORMAT "%4.1" /end CHARACTERISTIC
/begin CHARACTERISTIC EFD_V_EN_DLY "EGR flow stable delay" VALUE 0x0002038C __UWORD_S 0 u_16x_tmr 0 8191.875 /end CHARACTERISTIC
/begin CHARACTERISTIC EFD_V_DIAG_ESPD_BIAS "EGR flow engine speed bias" VALUE 0x0002038C __UWORD_S 0 u_espd 0 8191.875 FORMAT "%5.1" /end CHARACTERISTIC
/begin CHARACTERISTIC EFD_M_VLV_OPN_SP "EGR flow diag open setpoint" MAP 0x00020320 __UWORD_S 0 u_pct 0 199.996948 FORMAT "%4.1" SYMBOL_LINK "EFD_M_VLV_OPN_SP" 4
 /begin AXIS_DESCR FIX_AXIS sys_amp u_kPa_0_256 3 65 105 /begin FIX_AXIS_PAR_LIST 16640 21760 26880 /end FIX_AXIS_PAR_LIST /end AXIS_DESCR
 /begin AXIS_DESCR FIX_AXIS NO_INPUT_QUANTITY u_espd 17 0 1600
  /begin FIX_AXIS_PAR_LIST 0 800 1600 2400 3200 4000 4800 5600 6400 7200 8000 8800 9600 10400 11200 12000 12800 /end FIX_AXIS_PAR_LIST
 /end AXIS_DESCR
/end CHARACTERISTIC
/begin CHARACTERISTIC EFD_V_VLV_OPN_DUR "EGR flow open request duration" VALUE 0x0002038C __UWORD_S 0 u_16x_tmr 0 8191.875 /end CHARACTERISTIC
/begin CHARACTERISTIC EFD_V_VLV_CLS_DUR "EGR flow close request duration" VALUE 0x0002038C __UWORD_S 0 u_16x_tmr 0 8191.875 /end CHARACTERISTIC
/begin CHARACTERISTIC EFD_V_VLV_OPN_FAC "EGR flow open finish factor" VALUE 0x0002038C __UWORD_S 0 u_fac_2 0 1.999969482421875 FORMAT "%4.3" /end CHARACTERISTIC
/begin CHARACTERISTIC EFD_V_EXT_VSPD_DLT "EGR flow diag exit vehicle speed change delta" VALUE 0x0002038C __UWORD_S 0 u_vspd 0 511.9921875 FORMAT "%4.1" /end CHARACTERISTIC
/begin CHARACTERISTIC EFD_V_EXT_ESPD_DLT "EGR flow diag exit engine speed change delta" VALUE 0x0002038C __UWORD_S 0 u_espd 0 8191.875 FORMAT "%5.1" /end CHARACTERISTIC
/begin CHARACTERISTIC EFD_V_EXT_DUR_MIN "EGR flow exit keep duration min" VALUE 0x0002038C __UWORD_S 0 u_16x_tmr 0 8191.875 /end CHARACTERISTIC
/begin CHARACTERISTIC EFD_V_MAP_LOG_DUR "EGR flow MAP log duration" VALUE 0x0002038C __UWORD_S 0 u_16x_tmr 0 8191.875 /end CHARACTERISTIC
/begin CHARACTERISTIC EFD_M_MAP_DLT_MIN "EGR flow diag pass map change min" MAP 0x00020320 __UWORD_S 0 u_kPa_0_256 0 255.99609375 FORMAT "%4.1" SYMBOL_LINK "EFD_M_MAP_DLT_MIN" 4
 /begin AXIS_DESCR FIX_AXIS sys_amp u_kPa_0_256 3 65 105 /begin FIX_AXIS_PAR_LIST 16640 21760 26880 /end FIX_AXIS_PAR_LIST /end AXIS_DESCR
 /begin AXIS_DESCR FIX_AXIS NO_INPUT_QUANTITY u_espd 17 0 1600
  /begin FIX_AXIS_PAR_LIST 0 800 1600 2400 3200 4000 4800 5600 6400 7200 8000 8800 9600 10400 11200 12000 12800 /end FIX_AXIS_PAR_LIST
 /end AXIS_DESCR
/end CHARACTERISTIC
/begin CHARACTERISTIC EFD_V_VLV_FAC_INC_FAC "EGR flow fail increase counts" VALUE 0x0002038C __UBYTE_S 0 u_cnts 0 255 /end CHARACTERISTIC
/begin CHARACTERISTIC EFD_V_INIT_PASS_LOG_CNTS "EGR flow log counts" VALUE 0x0002038C __UBYTE_S 0 u_cnts 0 255 /end CHARACTERISTIC
/begin CHARACTERISTIC EFD_V_VLV_OPN_SP_FAC_MIN "EGR flow position setpoint factor min" VALUE 0x0002038C __UWORD_S 0 u_pct 0 199.996948 FORMAT "%4.1" /end CHARACTERISTIC
/begin CHARACTERISTIC EFD_V_MAP_DLT_MMV_INIT "EGR flow diag map delta init" VALUE 0x0002038C __SWORD_S 0 u_kPa_0_512 -256 255.9921875 FORMAT "%4.1" /end CHARACTERISTIC
/begin CHARACTERISTIC EFD_V_CURR_FL_THR "EGR flow diag current fail thr" VALUE 0x0002038C __SWORD_S 0 u_kPa_0_512 -256 255.9921875 FORMAT "%4.1" /end CHARACTERISTIC
/begin CHARACTERISTIC EFD_V_CURR_FL_FIL "EGR flow diag current fail filter" VALUE 0x0002038C __UWORD_S 0 u_filter 0 0.9999847412109375 FORMAT "%4.3" /end CHARACTERISTIC
/begin CHARACTERISTIC EFD_V_CURR_PS_THR "EGR flow diag current pass thr" VALUE 0x0002038C __SWORD_S 0 u_kPa_0_512 -256 255.9921875 FORMAT "%4.1" /end CHARACTERISTIC
/begin CHARACTERISTIC EFD_V_CURR_PS_FIL "EGR flow diag current pass filter" VALUE 0x0002038C __UWORD_S 0 u_filter 0 0.9999847412109375 FORMAT "%4.3" /end CHARACTERISTIC
/begin CHARACTERISTIC EFD_V_TST_CNTS "EGR flow test counts" VALUE 0x0002038C __UBYTE_S 0 u_cnts 0 255 /end CHARACTERISTIC
/begin CHARACTERISTIC EFD_V_RPT_EN_TST_CNTS "EGR flow report enable test counts" VALUE 0x0002038C __UBYTE_S 0 u_cnts 0 255 /end CHARACTERISTIC
/begin CHARACTERISTIC EFD_V_TST_DLY "EGR flow test enable delay" VALUE 0x0002038C __UWORD_S 0 u_16x_tmr 0 8191.875 /end CHARACTERISTIC
/begin CHARACTERISTIC EFD_V_TRP_TST_CNTS "EGR flow free test counts" VALUE 0x0002038C __UBYTE_S 0 u_cnts 0 255 /end CHARACTERISTIC
/begin CHARACTERISTIC EFD_V_FAC_DEC_PS_CNTS "EGR flow free test pass counts" VALUE 0x0002038C __UBYTE_S 0 u_cnts 0 255 /end CHARACTERISTIC
/begin CHARACTERISTIC EFD_V_TRIP_TST_CNTS "EGR flow free trip test counts" VALUE 0x0002038C __UBYTE_S 0 u_cnts 0 255 /end CHARACTERISTIC
/begin CHARACTERISTIC EFD_V_VLV_FAC_INC_STP "EGR flow free trip counts increase step" VALUE 0x0002038C __UBYTE_S 0 u_cnts 0 255 /end CHARACTERISTIC
/begin CHARACTERISTIC EFD_V_PUC_EN "EGR flow diag enable in puc state" VALUE 0x2886C __UBYTE_S 0 b_true 0 1 FORMAT "%1.0" /end CHARACTERISTIC
/begin CHARACTERISTIC EFD_V_NOT_PUC_EN "EGR flow diag enable not in puc state" VALUE 0x2886C __UBYTE_S 0 b_true 0 1 FORMAT "%1.0" /end CHARACTERISTIC
/begin CHARACTERISTIC CPUD_V_EXE_SEQ_FL_INC_CNTS "execute sequence fail increase counts" VALUE 0x0002038C __UWORD_S 0 u_cnts 0 65535 FORMAT "%5.0" /end CHARACTERISTIC
/begin CHARACTERISTIC CPUD_V_EXE_SEQ_FL_DEC_DLY "execute sequence fail counts decrease delay" VALUE 0x0002038C __UWORD_S 0 u_16x_tmr 0 8191.875 /end CHARACTERISTIC
/begin CHARACTERISTIC CPUD_V_EXE_SEQ_FL_CNTS "execute sequence fail counts" VALUE 0x0002038C __UWORD_S 0 u_cnts 0 65535 FORMAT "%5.0" /end CHARACTERISTIC
/begin CHARACTERISTIC CPUD_V_AD_RSP_DIAG_INTVL "AD response diag interval" VALUE 0x0002038C __UWORD_S 0 u_sec_16 0 15.999755859375 FORMAT "%4.2" /end CHARACTERISTIC
/begin CHARACTERISTIC CPUD_V_AD_RSP_EN_VLT_MIN "AD response diag enable voltage min" VALUE 0x0002038C __UWORD_S 0 u_volt_32 0 31.99951171875 FORMAT "%4.2" /end CHARACTERISTIC
/begin CHARACTERISTIC CPUD_V_AD_RSP_EN_VLT_MAX "AD response diag enable voltage max" VALUE 0x0002038C __UWORD_S 0 u_volt_32 0 31.99951171875 FORMAT "%4.2" /end CHARACTERISTIC
/begin CHARACTERISTIC CPUD_V_AD_RSP_EN_PPS_PCT "AD response diag enable pps percent" VALUE 0x0002038C __UWORD_S 0 u_pct 0 199.996948 FORMAT "%4.1" /end CHARACTERISTIC
/begin CHARACTERISTIC CPUD_V_AD_RSP_GRND_PCT_MAX "AD response diag ground stage percent max" VALUE 0x0002038C __UWORD_S 0 u_pct 0 199.996948 FORMAT "%4.1" /end CHARACTERISTIC
/begin CHARACTERISTIC CPUD_V_AD_RSP_GRND_ACTV_TM "AD response diag ground AD active time" VALUE 0x0002038C __UWORD_S 0 u_sec_16 0 15.999755859375 FORMAT "%4.2" /end CHARACTERISTIC
/begin CHARACTERISTIC CPUD_V_AD_RSP_PPS1_DLT_MAX "AD response diag pps1 change delta max" VALUE 0x0002038C __UWORD_S 0 u_pct 0 199.996948 FORMAT "%4.1" /end CHARACTERISTIC
/begin CHARACTERISTIC CPUD_V_AD_RSP_PPS2_DLT_MAX "AD response diag pps2 change delta max" VALUE 0x0002038C __UWORD_S 0 u_pct 0 199.996948 FORMAT "%4.1" /end CHARACTERISTIC
/begin CHARACTERISTIC CPUD_V_AD_RSP_INC_CNTS "AD response diag increase counts" VALUE 0x0002038C __UWORD_S 0 u_cnts 0 65535 FORMAT "%5.0" SYMBOL_LINK "CPUD_C_AD_RSP_CNTS" 0 /end CHARACTERISTIC
/begin CHARACTERISTIC CPUD_V_AD_RSP_DEC_CNTS "AD response diag decrease counts" VALUE 0x0002038C __UWORD_S 0 u_cnts 0 65535 FORMAT "%5.0" SYMBOL_LINK "CPUD_C_AD_RSP_CNTS" 2 /end CHARACTERISTIC
/begin CHARACTERISTIC CPUD_V_AD_RSP_FL_CNTS "AD response diag fail counts" VALUE 0x0002038C __UWORD_S 0 u_cnts 0 65535 FORMAT "%5.0" SYMBOL_LINK "CPUD_C_AD_RSP_CNTS" 4 /end CHARACTERISTIC
/begin CHARACTERISTIC CPUD_V_AD_RSP_DIAG_CNTS "AD response diag diag counts" VALUE 0x0002038C __UWORD_S 0 u_cnts 0 65535 FORMAT "%5.0" SYMBOL_LINK "CPUD_C_AD_RSP_CNTS" 6 /end CHARACTERISTIC
/begin CHARACTERISTIC CPUD_V_AD_RSP_PPS2_SHRT_DLT "AD response diag pps2 short pps1 fail delta" VALUE 0x0002038C __UWORD_S 0 u_pct 0 199.996948 FORMAT "%4.1" /end CHARACTERISTIC
/begin CHARACTERISTIC CPUD_V_AD_RSP_RECVR_ACTV_TM "AD response diag recover AD active time" VALUE 0x0002038C __UWORD_S 0 u_sec_16 0 15.999755859375 FORMAT "%4.2" /end CHARACTERISTIC
/begin CHARACTERISTIC CPUD_V_VREF_EN_VLT_MIN "vref diag enable voltage min" VALUE 0x0002038C __UWORD_S 0 u_volt_32 0 31.99951171875 FORMAT "%4.2" /end CHARACTERISTIC
/begin CHARACTERISTIC CPUD_V_VREF1_HI_THR "VREF1 fail high thr" VALUE 0x0002038C __UWORD_S 0 u_pct 0 199.996948 SYMBOL_LINK "CPUD_C_VREF_FL_THR" 2 /end CHARACTERISTIC
/begin CHARACTERISTIC CPUD_V_VREF1_LO_THR "VREF1 fail low thr" VALUE 0x0002038C __UWORD_S 0 u_pct 0 199.996948 SYMBOL_LINK "CPUD_C_VREF_FL_THR" 4 /end CHARACTERISTIC
/begin CHARACTERISTIC CPUD_V_VREF2_HI_THR "VREF2 fail high thr" VALUE 0x0002038C __UWORD_S 0 u_pct 0 199.996948 SYMBOL_LINK "CPUD_C_VREF_FL_THR" 8 /end CHARACTERISTIC
/begin CHARACTERISTIC CPUD_V_VREF2_LO_THR "VREF2 fail low thr" VALUE 0x0002038C __UWORD_S 0 u_pct 0 199.996948 SYMBOL_LINK "CPUD_C_VREF_FL_THR" 10 /end CHARACTERISTIC
/begin CHARACTERISTIC CPUD_V_VREF3_HI_THR "VREF3 fail high thr" VALUE 0x0002038C __UWORD_S 0 u_pct 0 199.996948 SYMBOL_LINK "CPUD_C_VREF_FL_THR" 14 /end CHARACTERISTIC
/begin CHARACTERISTIC CPUD_V_VREF3_LO_THR "VREF3 fail low thr" VALUE 0x0002038C __UWORD_S 0 u_pct 0 199.996948 SYMBOL_LINK "CPUD_C_VREF_FL_THR" 16 /end CHARACTERISTIC
/begin CHARACTERISTIC CPUD_V_VREF_FL_CNTS_MAX "vref fail counts max" VALUE 0x0002038C __UWORD_S 0 u_cnts 0 65535 FORMAT "%5.0" SYMBOL_LINK "CPUD_C_VREF_CNTS" 2 /end CHARACTERISTIC
/begin CHARACTERISTIC CPUD_V_VREF_PS_CNTS "vref pass counts" VALUE 0x0002038C __UWORD_S 0 u_cnts 0 65535 FORMAT "%5.0" SYMBOL_LINK "CPUD_C_VREF_CNTS" 4 /end CHARACTERISTIC
/begin CHARACTERISTIC CPUD_V_VREF_FL_CNTS "vref fail counts" VALUE 0x0002038C __UWORD_S 0 u_cnts 0 65535 FORMAT "%5.0" SYMBOL_LINK "CPUD_C_VREF_CNTS" 6 /end CHARACTERISTIC
/begin CHARACTERISTIC CPUD_V_VREF_FL_INC_CNTS "vref fail increase counts" VALUE 0x0002038C __UWORD_S 0 u_cnts 0 65535 FORMAT "%5.0" SYMBOL_LINK "CPUD_C_VREF_CNTS" 8 /end CHARACTERISTIC
/begin CHARACTERISTIC CPUD_V_VREF_FL_DEC_CNTS "vref fail decrease counts" VALUE 0x0002038C __UWORD_S 0 u_cnts 0 65535 FORMAT "%5.0" SYMBOL_LINK "CPUD_C_VREF_CNTS" 10 /end CHARACTERISTIC
/begin CHARACTERISTIC CPUD_V_CLK_EN_DLY "clock diag enable delay" VALUE 0x0002038C __UWORD_S 0 u_16x_tmr 0 8191.875 FORMAT "%4.2" /end CHARACTERISTIC
/begin CHARACTERISTIC CPUD_V_CLK_FL_CNTS "clock diag fail counts" VALUE 0x0002038C __UWORD_S 0 u_cnts 0 65535 FORMAT "%5.0" SYMBOL_LINK "CPUD_C_CLK_CNTS" 0 /end CHARACTERISTIC
/begin CHARACTERISTIC CPUD_V_CLK_DIAG_CNTS "clock diag counts" VALUE 0x0002038C __UWORD_S 0 u_cnts 0 65535 FORMAT "%5.0" SYMBOL_LINK "CPUD_C_CLK_CNTS" 2 /end CHARACTERISTIC
/begin CHARACTERISTIC CPUD_V_COP_EN_DLY "cop diag enable delay" VALUE 0x0002038C __UWORD_S 0 u_16x_tmr 0 8191.875 FORMAT "%4.2" /end CHARACTERISTIC
/begin CHARACTERISTIC CPUD_V_COP_FL_CNTS "cop diag fail counts" VALUE 0x0002038C __UWORD_S 0 u_cnts 0 65535 FORMAT "%5.0" SYMBOL_LINK "CPUD_C_COP_CNTS" 0 /end CHARACTERISTIC
/begin CHARACTERISTIC CPUD_V_COP_DIAG_CNTS "cop diag counts" VALUE 0x0002038C __UWORD_S 0 u_cnts 0 65535 FORMAT "%5.0" SYMBOL_LINK "CPUD_C_COP_CNTS" 2 /end CHARACTERISTIC
/begin CHARACTERISTIC CPUD_V_GPR_EN_DLY "gpr diag enable delay" VALUE 0x0002038C __UWORD_S 0 u_16x_tmr 0 8191.875 FORMAT "%4.2" /end CHARACTERISTIC
/begin CHARACTERISTIC CPUD_V_GPR_FL_CNTS "gpr diag fail counts" VALUE 0x0002038C __UWORD_S 0 u_cnts 0 65535 FORMAT "%5.0" SYMBOL_LINK "CPUD_C_GPR_CNTS" 0 /end CHARACTERISTIC
/begin CHARACTERISTIC CPUD_V_GPR_DIAG_CNTS "gpr diag counts" VALUE 0x0002038C __UWORD_S 0 u_cnts 0 65535 FORMAT "%5.0" SYMBOL_LINK "CPUD_C_GPR_CNTS" 2 /end CHARACTERISTIC
/begin CHARACTERISTIC CPUD_V_ADC_EN_DLY "adc diag enable delay" VALUE 0x0002038C __UWORD_S 0 u_16x_tmr 0 8191.875 FORMAT "%4.2" /end CHARACTERISTIC
/begin CHARACTERISTIC CPUD_V_ADC_FL_CNTS "adc diag fail counts" VALUE 0x0002038C __UWORD_S 0 u_cnts 0 65535 FORMAT "%5.0" SYMBOL_LINK "CPUD_C_ADC_CNTS" 0 /end CHARACTERISTIC
/begin CHARACTERISTIC CPUD_V_ADC_DIAG_CNTS "adc diag counts" VALUE 0x0002038C __UWORD_S 0 u_cnts 0 65535 FORMAT "%5.0" SYMBOL_LINK "CPUD_C_ADC_CNTS" 2 /end CHARACTERISTIC
/begin CHARACTERISTIC CPUD_V_IG_EN_VLT_MIN "ignition timing diag enable voltage min" VALUE 0x0002038C __UWORD_S 0 u_volt_32 0 31.99951171875 FORMAT "%4.2" /end CHARACTERISTIC
/begin CHARACTERISTIC CPUD_V_IG_EN_VLT_MAX "ignition timing diag enable voltage max" VALUE 0x0002038C __UWORD_S 0 u_volt_32 0 31.99951171875 FORMAT "%4.2" /end CHARACTERISTIC
/begin CHARACTERISTIC CPUD_V_IG_ESPD_GRD_MIN "ignition timing diag enable engine speed min" VALUE 0x0002038C __SWORD_S 0 u_espd_grd -32768 32767 /end CHARACTERISTIC
/begin CHARACTERISTIC CPUD_V_IG_ESPD_GRD_MAX "ignition timing diag enable engine speed max" VALUE 0x0002038C __SWORD_S 0 u_espd_grd -32768 32767 /end CHARACTERISTIC
/begin CHARACTERISTIC CPUD_V_IG_EN_DLY "ignition enable delay" VALUE 0x0002038C __UWORD_S 0 u_cnts 0 65535 FORMAT "%5.0" /end CHARACTERISTIC
/begin CHARACTERISTIC CPUD_V_IG_EN_ANG_DLT "ignition enable angle delta" VALUE 0x0002038C __UWORD_S 0 u_iga_256 0 255.99609375 FORMAT "%5.0" /end CHARACTERISTIC
/begin CHARACTERISTIC CPUD_C_IG_ADV_FL_THR "ignition advance fail thr" CURVE 0x375CE __UWORD_S 0 u_iga_256 0 255.99609375 SYMBOL_LINK "CPUD_C_IG_ADV_FL_THR" 2
 /begin AXIS_DESCR COM_AXIS sys_eng_spd u_espd 12 0.000000 8191.875000 FORMAT "%6.2" AXIS_PTS_REF IG_X_ESPD_E /end AXIS_DESCR
/end CHARACTERISTIC
/begin CHARACTERISTIC CPUD_C_IG_RTD_FL_THR "ignition retard fail thr" CURVE 0x375CE __UWORD_S 0 u_iga_256 0 255.99609375 SYMBOL_LINK "CPUD_C_IG_RTD_FL_THR" 2
 /begin AXIS_DESCR COM_AXIS sys_eng_spd u_espd 12 0.000000 8191.875000 FORMAT "%6.2" AXIS_PTS_REF IG_X_ESPD_E /end AXIS_DESCR
/end CHARACTERISTIC
/begin CHARACTERISTIC CPUD_V_IG_FL_CNTS "ig diag fail counts" VALUE 0x0002038C __UWORD_S 0 u_cnts 0 65535 FORMAT "%5.0" SYMBOL_LINK "CPUD_C_IG_CNTS" 0 /end CHARACTERISTIC
/begin CHARACTERISTIC CPUD_V_IG_DIAG_CNTS "ig diag diag counts" VALUE 0x0002038C __UWORD_S 0 u_cnts 0 65535 FORMAT "%5.0" SYMBOL_LINK "CPUD_C_IG_CNTS" 2 /end CHARACTERISTIC
/begin CHARACTERISTIC COMD_V_CAN_COM_FL_CNTS "can fail counts" VALUE 0x0002038C __UWORD_S 0 u_cnts 0 65535 FORMAT "%5.0" /end CHARACTERISTIC
/begin CHARACTERISTIC COMD_V_CAN_COM_DIAG_CNTS "can diag counts" VALUE 0x0002038C __UWORD_S 0 u_cnts 0 65535 FORMAT "%5.0" /end CHARACTERISTIC
/begin CHARACTERISTIC COMD_V_CAN_BUS_OFF_FL_CNTS "can bus off fail counts" VALUE 0x0002038C __UBYTE_S 0 u_cnts 0 255 /end CHARACTERISTIC
/begin CHARACTERISTIC COMD_V_CAN_BUS_OFF_PS_CNTS "can bus off pass counts" VALUE 0x0002038C __UWORD_S 0 u_cnts 0 65535 /end CHARACTERISTIC
/begin CHARACTERISTIC COMD_V_CAN_CHK_FL_CNTS "can check fail counts" VALUE 0x0002038C __UWORD_S 0 u_cnts 0 65535 FORMAT "%5.0" SYMBOL_LINK "COMD_C_CAN_CHK_CNTS" 0 /end CHARACTERISTIC
/begin CHARACTERISTIC COMD_V_CAN_CHK_DIAG_CNTS "can check fail counts" VALUE 0x0002038C __UWORD_S 0 u_cnts 0 65535 FORMAT "%5.0" SYMBOL_LINK "COMD_C_CAN_CHK_CNTS" 2 /end CHARACTERISTIC
/begin CHARACTERISTIC COMD_V_LIN_COM_FL_CNTS "lin fail counts" VALUE 0x0002038C __UBYTE_S 0 u_cnts 0 255 /end CHARACTERISTIC
/begin CHARACTERISTIC COMD_V_LIN_COM_DIAG_CNTS "lin diag counts" VALUE 0x0002038C __UBYTE_S 0 u_cnts 0 255 /end CHARACTERISTIC
/begin CHARACTERISTIC COMD_V_LIN_ALT_FL_CNTS "lin alternator fail counts" VALUE 0x0002038C __UBYTE_S 0 u_cnts 0 255 /end CHARACTERISTIC
/begin CHARACTERISTIC COMD_V_LIN_ALT_DIAG_CNTS "lin alternator diag counts" VALUE 0x0002038C __UBYTE_S 0 u_cnts 0 255 /end CHARACTERISTIC
/begin CHARACTERISTIC COMD_V_BAT_SNSR_COM_FL_CNTS "battery sensor comm fail counts" VALUE 0x0002038C __UBYTE_S 0 u_cnts 0 255 /end CHARACTERISTIC
/begin CHARACTERISTIC COMD_V_BAT_SNSR_COM_DIAG_CNTS "battery sensor comm diag counts" VALUE 0x0002038C __UBYTE_S 0 u_cnts 0 255 /end CHARACTERISTIC
/begin CHARACTERISTIC COMD_V_BAT_SNSR_FL_CNTS "battery sensor fail counts" VALUE 0x0002038C __UBYTE_S 0 u_cnts 0 255 /end CHARACTERISTIC
/begin CHARACTERISTIC COMD_V_BAT_SNSR_DIAG_CNTS "battery sensor diag counts" VALUE 0x0002038C __UBYTE_S 0 u_cnts 0 255 /end CHARACTERISTIC
/*--------------GPF Delta Pressure-------------*/
/begin CHARACTERISTIC GPF_V_FORC_DP_MOD_EN "use model based soot mass calc" VALUE 0x67264 __UBYTE_S 0 b_true 0 1 FORMAT "%1.0" /end CHARACTERISTIC
/begin CHARACTERISTIC GPF_V_DP_EN_DP_MIN "" VALUE 0x67264 __SWORD_S 0 p_t_GPF_DP_N128_128 -128 127.996094 /end CHARACTERISTIC
/begin CHARACTERISTIC GPF_V_DP_EN_FLW_MIN "" VALUE 0x67D40 __UWORD_S 0 u_g_per_sec 0 511.9921875 /end CHARACTERISTIC
/begin CHARACTERISTIC GPF_V_SOOT_MASS_EN_TM "" VALUE 0x67D40 __UWORD_S 0 p_t_GPF_COUNT_0_65535 0 65535 /end CHARACTERISTIC
/begin CHARACTERISTIC GPF_C_MUF_DP "" CURVE 0x65840 __UWORD_S 0 p_t_GPF_DP_0_128 0 127.998047 SYMBOL_LINK "GPF_C_MUF_DP" 2
 /begin AXIS_DESCR COM_AXIS afm_exh_flw u_g_per_sec 8 0 511.9921875 AXIS_PTS_REF GPF_X_MUF_DP /end AXIS_DESCR
/end CHARACTERISTIC
/begin AXIS_PTS GPF_X_MUF_DP "" 0x65834 afm_exh_flw SSV__UWORD_S 0 u_g_per_sec 8 0.000000 511.9921875 DEPOSIT ABSOLUTE SYMBOL_LINK "GPF_X_MUF_DP" 2 /end AXIS_PTS
/begin CHARACTERISTIC GPF_C_EXH_GAS_VISC "" CURVE 0x65840 __UWORD_S 0 p_t_GPF_VISC 0 0.000061 SYMBOL_LINK "GPF_C_EXH_GAS_VISC" 2
 /begin AXIS_DESCR COM_AXIS gpf_temp_in_flt p_t_GPF_TEMP_N2048_2048 8 -2048 2047.93750 AXIS_PTS_REF GPF_X_EXH_GAS_VISC /end AXIS_DESCR
/end CHARACTERISTIC
/begin AXIS_PTS GPF_X_EXH_GAS_VISC "" 0x65834 gpf_temp_in_flt SSV__SWORD_S 0 p_t_GPF_TEMP_N2048_2048 8 -2048 2047.937500 DEPOSIT ABSOLUTE SYMBOL_LINK "GPF_X_EXH_GAS_VISC" 2 /end AXIS_PTS
/begin CHARACTERISTIC GPF_V_A1_CLN_NRM "" VALUE 0x67D40 __UWORD_S 0 p_t_GPF_COUNT_0_65535 0 65535 /end CHARACTERISTIC
/begin CHARACTERISTIC GPF_V_A2_CLN_NRM "" VALUE 0x67D40 __UWORD_S 0 p_t_GPF_COUNT_0_65535 0 65535 /end CHARACTERISTIC
/begin CHARACTERISTIC GPF_V_SOOT_ASH_DP_FLT "filter" VALUE 0x6509C __UWORD_S 0 u_filter 0 0.9999847412109375 FORMAT "%10.9" /end CHARACTERISTIC
/begin CHARACTERISTIC GPF_C_SI_FLT "" CURVE 0x65840 __UWORD_S 0 u_filter 0 0.9999847412109375 FORMAT "%10.9" SYMBOL_LINK "GPF_C_SI_FLT" 2
 /begin AXIS_DESCR COM_AXIS gpf_temp_in_flt p_t_GPF_TEMP_N2048_2048 8 -2048 2047.93750 AXIS_PTS_REF GPF_X_SI_FLT /end AXIS_DESCR
/end CHARACTERISTIC
/begin AXIS_PTS GPF_X_SI_FLT "" 0x65834 gpf_temp_in_flt SSV__SWORD_S 0 p_t_GPF_TEMP_N2048_2048 8 -2048 2047.937500 DEPOSIT ABSOLUTE SYMBOL_LINK "GPF_X_SI_FLT" 2 /end AXIS_PTS
/begin CHARACTERISTIC GPF_M_SOOT_MASS "" MAP 0x341D4 __UWORD_S 0 p_t_GPF_SM_0_128 0 127.998047 SYMBOL_LINK "GPF_M_SOOT_MASS" 4
 /begin AXIS_DESCR COM_AXIS gpf_a1_ofst_nv p_t_GPF_COUNT_N32768_32767 8 -32768 32767 AXIS_PTS_REF GPF_X_SOOT_MASS_A1 /end AXIS_DESCR
 /begin AXIS_DESCR COM_AXIS gpf_soot_std_dp_nv p_t_GPF_SI_N512_512 16 -512.000000 511.984375 AXIS_PTS_REF GPF_X_SOOT_MASS_SI /end AXIS_DESCR
/end CHARACTERISTIC
/begin AXIS_PTS GPF_X_SOOT_MASS_A1 "axis of a1" 0x341C6 gpf_a1_ofst_nv SSV__SWORD_S 0 p_t_GPF_COUNT_N32768_32767 8 -32768 32767 DEPOSIT ABSOLUTE SYMBOL_LINK "GPF_X_SOOT_MASS_A1" 2 /end AXIS_PTS
/begin AXIS_PTS GPF_X_SOOT_MASS_SI "axis of SI" 0x341BA gpf_soot_std_dp_nv SSV__SWORD_S 0 p_t_GPF_SI_N512_512 16 -512.000000 511.984375 DEPOSIT ABSOLUTE SYMBOL_LINK "GPF_X_SOOT_MASS_SI" 2 /end AXIS_PTS
/*--------------GPF Delta Pressure-------------*/ /*--------------GPF EO-------------------------*/
/begin CHARACTERISTIC GPF_V_IN_TEMP_SEL "" VALUE 0x67264 __UBYTE_S 0 b_true 0 1 FORMAT "%1.0" /end CHARACTERISTIC
/begin CHARACTERISTIC GPF_V_OUT_TEMP_SEL "" VALUE 0x67264 __UBYTE_S 0 b_true 0 1 FORMAT "%1.0" /end CHARACTERISTIC
/begin CHARACTERISTIC GPF_V_BED_TEMP_SEL "" VALUE 0x67264 __UBYTE_S 0 b_true 0 1 FORMAT "%1.0" /end CHARACTERISTIC
/begin CHARACTERISTIC GPF_M_CO2_BURN_RT "" MAP 0x341D4 __UWORD_S 0 p_t_GPF_BURN_RT_0_0P5 0 0.499992370605469 SYMBOL_LINK "GPF_M_CO2_BURN_RT" 4
 /begin AXIS_DESCR COM_AXIS gpf_afr u_afr 8 0.0 31.99951171875 AXIS_PTS_REF GPF_X_CO2_BURN_RT_LMBD /end AXIS_DESCR
 /begin AXIS_DESCR COM_AXIS gpf_soot_rt_in_temp p_t_GPF_TEMP_N2048_2048 8 -2048 2047.937500 AXIS_PTS_REF GPF_X_CO2_BURN_RT_TEMP /end AXIS_DESCR
/end CHARACTERISTIC
/begin AXIS_PTS GPF_X_CO2_BURN_RT_TEMP "axis of" 0x341C6 gpf_soot_rt_in_temp SSV__SWORD_S 0 p_t_GPF_TEMP_N2048_2048 8 -2048 2047.937500 DEPOSIT ABSOLUTE SYMBOL_LINK "GPF_X_CO2_BURN_RT_TEMP" 2 /end AXIS_PTS
/begin AXIS_PTS GPF_X_CO2_BURN_RT_LMBD "axis of" 0x341BA gpf_afr SSV__UWORD_S 0 u_afr 8 0.0 31.99951171875 DEPOSIT ABSOLUTE SYMBOL_LINK "GPF_X_CO2_BURN_RT_LMBD" 2 /end AXIS_PTS
/begin CHARACTERISTIC GPF_M_O2_BURN_RT "" MAP 0x341D4 __UWORD_S 0 p_t_GPF_BURN_RT_0_0P5 0 0.499992370605469 SYMBOL_LINK "GPF_M_O2_BURN_RT" 4
 /begin AXIS_DESCR COM_AXIS gpf_afr u_afr 8 0.0 31.99951171875 AXIS_PTS_REF GPF_X_O2_BURN_RT_LMBD /end AXIS_DESCR
 /begin AXIS_DESCR COM_AXIS gpf_soot_rt_in_temp p_t_GPF_TEMP_N2048_2048 8 -2048 2047.937500 AXIS_PTS_REF GPF_X_O2_BURN_RT_TEMP /end AXIS_DESCR
/end CHARACTERISTIC
/begin AXIS_PTS GPF_X_O2_BURN_RT_TEMP "axis of" 0x341C6 gpf_soot_rt_in_temp SSV__SWORD_S 0 p_t_GPF_TEMP_N2048_2048 8 -2048 2047.937500 DEPOSIT ABSOLUTE SYMBOL_LINK "GPF_X_O2_BURN_RT_TEMP" 2 /end AXIS_PTS
/begin AXIS_PTS GPF_X_O2_BURN_RT_LMBD "axis of" 0x341BA gpf_afr SSV__UWORD_S 0 u_afr 8 0.0 31.99951171875 DEPOSIT ABSOLUTE SYMBOL_LINK "GPF_X_O2_BURN_RT_LMBD" 2 /end AXIS_PTS
/begin CHARACTERISTIC GPF_V_FUEL_FLW_FLT "filter" VALUE 0x6509C __UWORD_S 0 u_filter 0 0.9999847412109375 FORMAT "%10.9" /end CHARACTERISTIC
/begin CHARACTERISTIC GPF_C_FUEL_COR_FAC "" CURVE 0x65840 __UWORD_S 0 u_fac_2 0 1.999969482421875 FORMAT "%4.3" SYMBOL_LINK "GPF_C_FUEL_COR_FAC" 2
 /begin AXIS_DESCR COM_AXIS gpf_fuel_flw_diff_flt p_t_GPF_FUEL_FLW_DIF_N256_256 6 -256 255.992188 AXIS_PTS_REF GPF_X_FUEL_COR_FAC /end AXIS_DESCR
/end CHARACTERISTIC
/begin AXIS_PTS GPF_X_FUEL_COR_FAC "" 0x65834 gpf_fuel_flw_diff_flt SSV__SWORD_S 0 p_t_GPF_FUEL_FLW_DIF_N256_256 6 -256 255.992188 DEPOSIT ABSOLUTE SYMBOL_LINK "GPF_X_FUEL_COR_FAC" 2 /end AXIS_PTS
/begin CHARACTERISTIC GPF_C_CRK_COR_FAC "" CURVE 0x65840 __UWORD_S 0 u_fac_256 0 255.99609375 FORMAT "%6.3" SYMBOL_LINK "GPF_C_CRK_COR_FAC" 2
 /begin AXIS_DESCR COM_AXIS sys_keyon_ect u_deg_C 5 -256 255.9921875 AXIS_PTS_REF GPF_X_CRK_COR_FAC /end AXIS_DESCR
/end CHARACTERISTIC
/begin AXIS_PTS GPF_X_CRK_COR_FAC "" 0x65834 sys_keyon_ect SSV__SWORD_S 0 u_deg_C 5 -256 255.9921875 FORMAT "%4.1" DEPOSIT ABSOLUTE SYMBOL_LINK "GPF_X_CRK_COR_FAC" 2 /end AXIS_PTS
/begin CHARACTERISTIC GPF_C_CAT_LGT_OFF_FAC "" CURVE 0x65840 __UWORD_S 0 u_fac_256 0 255.99609375 FORMAT "%6.3" SYMBOL_LINK "GPF_C_CAT_LGT_OFF_FAC" 2
 /begin AXIS_DESCR COM_AXIS extc_cat_t_nv u_deg_C_n2048_p2048 6 -2048 2047.9375 AXIS_PTS_REF GPF_X_CAT_LGT_OFF_FAC /end AXIS_DESCR
/end CHARACTERISTIC
/begin AXIS_PTS GPF_X_CAT_LGT_OFF_FAC "" 0x65834 extc_cat_t_nv SSV__SWORD_S 0 u_deg_C_n2048_p2048 6 -2048 2047.9375 DEPOSIT ABSOLUTE SYMBOL_LINK "GPF_X_CAT_LGT_OFF_FAC" 2 /end AXIS_PTS
/begin CHARACTERISTIC GPF_V_COR_FAC "fac" VALUE 0x6509C __UWORD_S 0 p_t_GPF_FAC_0_0P125 0 0.124998092651367 /end CHARACTERISTIC
/begin CHARACTERISTIC GPF_C_LMBD_COR_FAC "" CURVE 0x65840 __UWORD_S 0 u_fac_16 0 15.999756 FORMAT "%4.2" SYMBOL_LINK "GPF_C_LMBD_COR_FAC" 2
 /begin AXIS_DESCR COM_AXIS gpf_afr u_afr 5 0.0 31.99951171875 AXIS_PTS_REF GPF_X_LMBD_COR_FAC /end AXIS_DESCR
/end CHARACTERISTIC
/begin AXIS_PTS GPF_X_LMBD_COR_FAC "" 0x65834 gpf_afr SSV__UWORD_S 0 u_afr 5 0.0 31.99951171875 DEPOSIT ABSOLUTE SYMBOL_LINK "GPF_X_LMBD_COR_FAC" 2 /end AXIS_PTS
/begin COMPU_METHOD u_volt_32 "voltage" RAT_FUNC "%6.4" "V" COEFFS 0.0 1.0 0.000000 0.0 0.0 0.00048828125 /end COMPU_METHOD
/begin COMPU_METHOD u_kPa_0_256 "press" RAT_FUNC "%5.2" "kPa" COEFFS 0.0 1.0 0.000000 0.0 0.0 0.00390625 /end COMPU_METHOD
/begin COMPU_METHOD u_kPa_0_512 "press" RAT_FUNC "%5.2" "kPa" COEFFS 0.0 1.0 0.000000 0.0 0.0 0.0078125 /end COMPU_METHOD
/begin COMPU_METHOD u_kPa_256n_256p "press" RAT_FUNC "%5.2" "kPa" COEFFS 0.0 1.0 0.000000 0.0 0.0 0.0078125 /end COMPU_METHOD
/begin COMPU_METHOD u_fac_16 "factor" RAT_FUNC "%5.3" "fac" COEFFS 0.0 1.0 0.000000 0.0 0.0 0.000244140625 /end COMPU_METHOD
/begin COMPU_METHOD u_fac_2 "factor" RAT_FUNC "%3.2" "fac" COEFFS 0.0 1.0 0.000000 0.0 0.0 0.000030517578125 /end COMPU_METHOD
/begin COMPU_METHOD u_fac_1 "factor" RAT_FUNC "%4.3" "fac" COEFFS 0.0 1.0 0.000000 0.0 0.0 0.0000152587890625 /end COMPU_METHOD
/begin COMPU_METHOD u_deg_C "degC" RAT_FUNC "%5.2" "¡æ" COEFFS 0.0 1.0 0.0 0.0 0.0 0.0078125 /end COMPU_METHOD
/begin COMPU_METHOD u_deg_C_n2048_p2048 "degC" RAT_FUNC "%5.1" "¡æ" COEFFS 0.0 1.0 0.0 0.0 0.0 0.0625 /end COMPU_METHOD
/begin COMPU_METHOD u_filter "filter" RAT_FUNC "%11.10" "coef" COEFFS 0.0 1.0 0.0 0.0 0.0 0.0000152587890625 /end COMPU_METHOD
/begin COMPU_METHOD u_cnts "counts" RAT_FUNC "%3.0" "cnts" COEFFS 0.0 1.0 0.0 0.0 0.0 1.0 /end COMPU_METHOD
/begin COMPU_METHOD u_1x_tmr "7.81 timer" RAT_FUNC "%4.3" "s" COEFFS 0.0 1.0 0.0 0.0 0.0 0.0078125 /end COMPU_METHOD
/begin COMPU_METHOD u_16x_tmr "125 timer" RAT_FUNC "%5.1" "s" COEFFS 0.0 1.0 0.0 0.0 0.0 0.125 /end COMPU_METHOD
/begin COMPU_METHOD u_1s_tmr "1 sec timer" RAT_FUNC "%5.0" "s" COEFFS 0.0 1.0 0.0 0.0 0.0 1.0 /end COMPU_METHOD
/begin COMPU_METHOD u_sec_16 "sec" RAT_FUNC "%5.3" "s" COEFFS 0.0 1.0 0.0 0.0 0.0 0.000244140625 /end COMPU_METHOD
/begin COMPU_METHOD u_nm_s "torque" RAT_FUNC "%6.2" "Nm" COEFFS 0.0 1.0 0.0 0.0 0.0 0.0625 /end COMPU_METHOD
/begin COMPU_METHOD b_true "" TAB_VERB "%6.3" "" COMPU_TAB_REF b_true /end COMPU_METHOD
/begin COMPU_VTAB b_true "" TAB_VERB 2 0 "FALSE" 1 "TRUE" /end COMPU_VTAB
/begin COMPU_METHOD u_espd "engine speed" RAT_FUNC "%5.2" "rpm" COEFFS 0.0 1.0 0.000000 0.0 0.0 0.125 /end COMPU_METHOD
/begin COMPU_METHOD u_vspd "vehicle speed" RAT_FUNC "%5.2" "kph" COEFFS 0.0 1.0 0.000000 0.0 0.0 0.0078125 /end COMPU_METHOD
/begin COMPU_METHOD u_pct "percentage" RAT_FUNC "%5.2" "%" COEFFS 0.0 1.0 0.000000 0.0 0.0 0.0030517578125 /end COMPU_METHOD
/begin COMPU_METHOD u_pct_1 "percentage" RAT_FUNC "%5.2" "%" COEFFS 0.0 1.0 0.000000 0.0 0.0 0.00152587890625 /end COMPU_METHOD
/begin COMPU_METHOD u_g_per_sec "g per second" RAT_FUNC "%5.2" "g/s" COEFFS 0.0 1.0 0.000000 0.0 0.0 0.0078125 /end COMPU_METHOD
/begin COMPU_METHOD u_afr "airfuel" RAT_FUNC "%3.1" "Ratio" COEFFS 0.0 1.0 0.000000 0.0 0.0 0.00048828125 /end COMPU_METHOD
/begin COMPU_METHOD u_iga "ignition angle" RAT_FUNC "%3.1" "Deg" COEFFS 0.0 1.0 0.000000 0.0 0.0 0.0078125 /end COMPU_METHOD
/begin COMPU_METHOD u_cam_ang_hi "cam angle high res" RAT_FUNC "%4.2" "Deg" COEFFS 0.0 1.0 0.000000 0.0 0.0 0.0009765625 /end COMPU_METHOD
/begin COMPU_METHOD u_blwr_st "" TAB_VERB "%5.0" "" COMPU_TAB_REF u_blwr_st /end COMPU_METHOD
/begin COMPU_VTAB u_blwr_st "" TAB_VERB 5 0 "OFF" 1 "LOW" 2 "MID" 3 "MID_HI" 4 "HIGH" /end COMPU_VTAB
/begin COMPU_METHOD u_rpt_st "" TAB_VERB "%5.0" "" COMPU_TAB_REF u_rpt_st /end COMPU_METHOD
/begin COMPU_VTAB u_rpt_st "" TAB_VERB 3 0 "NO_REPORT" 1 "PASS" 2 "FAIL" /end COMPU_VTAB
/begin COMPU_METHOD u_cfd_fail "" TAB_VERB "%5.0" "" COMPU_TAB_REF u_cfd_fail /end COMPU_METHOD
/begin COMPU_VTAB u_cfd_fail "" TAB_VERB 2 0 "FAIL" 1 "PASS" /end COMPU_VTAB
/begin COMPU_METHOD u_fac_65536L "factor" RAT_FUNC "%10.5" "fac" COEFFS 0.0 1.0 0.000000 0.0 0.0 0.0000152587890625 /end COMPU_METHOD
/begin COMPU_METHOD u_cnt_n3277_p3277 "counts" RAT_FUNC "%10.5" "cnt" COEFFS 0.0 1.0 0.000000 0.0 0.0 0.1 /end COMPU_METHOD
/begin COMPU_METHOD u_curr_amp "amp" RAT_FUNC "%5.2" "A" COEFFS 0.0 1.0 0.000000 0.0 0.0 0.0625 /end COMPU_METHOD
/begin COMPU_METHOD u_can_chn "" TAB_VERB "%6.3" "" COMPU_TAB_REF u_can_chn /end COMPU_METHOD
/begin COMPU_VTAB u_can_chn "" TAB_VERB 3 0 "CAN0" 1 "CAN1" 2 "CAN2" /end COMPU_VTAB
/begin COMPU_METHOD u_can_txmsg_num "" TAB_VERB "%6.3" "" COMPU_TAB_REF u_can_txmsg_num /end COMPU_METHOD
/begin COMPU_VTAB u_can_txmsg_num "" TAB_VERB 17 0 "MSG0" 1 "MSG1" 2 "MSG2" 3 "MSG3" 4 "MSG4" 5 "MSG5" 6 "MSG6" 7 "MSG7" 8 "MSG8" 9 "MSG9" 10 "MSG10" 11 "MSG11" 12 "MSG12" 13 "MSG13" 14 "MSG14" 15 "MSG15" 255 "OFF" /end COMPU_VTAB
/begin COMPU_METHOD u_can_byte_num "" TAB_VERB "%6.3" "" COMPU_TAB_REF u_can_byte_num /end COMPU_METHOD
/begin COMPU_VTAB u_can_byte_num "" TAB_VERB 8 0 "BYTE0" 1 "BYTE1" 2 "BYTE2" 3 "BYTE3" 4 "BYTE4" 5 "BYTE5" 6 "BYTE6" 7 "BYTE7" /end COMPU_VTAB
/begin COMPU_METHOD u_can_bit_loc "" TAB_VERB "%6.3" "" COMPU_TAB_REF u_can_bit_loc /end COMPU_METHOD
/begin COMPU_VTAB u_can_bit_loc "" TAB_VERB 8 0 "BIT0" 1 "BIT1" 2 "BIT2" 3 "BIT3" 4 "BIT4" 5 "BIT5" 6 "BIT6" 7 "BIT7" /end COMPU_VTAB
/begin COMPU_METHOD u_can_tq_unit "" TAB_VERB "%6.3" "" COMPU_TAB_REF u_can_tq_unit /end COMPU_METHOD
/begin COMPU_VTAB u_can_tq_unit "" TAB_VERB 2 0 "Nm" 1 "Pct" /end COMPU_VTAB
/begin COMPU_METHOD u_fac_256 "ratio" RAT_FUNC "%5.2" "ratio" COEFFS 0.0 1.0 0.000000 0.0 0.0 0.00390625 /end COMPU_METHOD
/begin COMPU_METHOD u_can_chk_sum "" TAB_VERB "%10.4" "" COMPU_TAB_REF u_can_chk_sum /end COMPU_METHOD
/begin COMPU_VTAB u_can_chk_sum "" TAB_VERB 20 0 "SUM_XOR_FF" 1 "XOR_BY_BYTE_WITH_ID" 2 "CRASHOUT_XOR_HALF_BYTE" 3 "SUM_ALL_XOR_FF" 4 "SUM_TWO_COMPLEMENT" 5 "XOR_IN_7_BYTES" 6 "CRC8" 7 "XOR_7_BYTES_4_BITS" 8 "SUM_7_BYTES_XOR_FF" 9 "XOR_FIRST_4_BYTES_4_BITS" 10 "DFLZM_SRS" 11 "UPPER_NIBBLE_BYTE_SUM_XOR_F0" 12 "CRC32" 13 "SUM_AND_FF" 14 "7_BYTES_XOR" 15 "HALF_BYTE_INVERT" 16 "SUM_7_BYTES_ADD_UNCHKSUM_4_BIT_AND_0F" 17 "CRC8_GW" 18 "CRC8_COMMON" 19 "7_BYTES_XOR_ROLLING_CNTS_4_BITS" /end COMPU_VTAB
/begin COMPU_METHOD u_cam_v "cam angle vel" RAT_FUNC "%6.4" "Deg/s" COEFFS 0.0 1.0 0.000000 0.0 0.0 0.015625 /end COMPU_METHOD
/begin COMPU_METHOD u_cam_v_b "cam angle vel" RAT_FUNC "%6.4" "Deg/s" COEFFS 0.0 1.0 0.000000 0.0 0.0 4.0 /end COMPU_METHOD
/begin COMPU_METHOD u_millisec_8192 "millisec" RAT_FUNC "%6.2" "ms" COEFFS 0.0 1.0 0.0 0.0 0.0 0.125 /end COMPU_METHOD
/begin COMPU_METHOD u_can_rx_typ "" TAB_VERB "%10.4" "" COMPU_TAB_REF u_can_rx_typ /end COMPU_METHOD
/begin COMPU_VTAB u_can_rx_typ "" TAB_VERB 47 0 "TCS1" 1 "TCS2" 2 "TCS3" 3 "ABS1" 4 "ABS2" 5 "ESP1" 6 "ESP2" 7 "ESP3" 8 "LPI1" 9 "ACC1" 10 "ASG1" 11 "TCU1" 12 "TCU2" 13 "TCU3" 14 "ACU" 15 "4WD1" 16 "4WD2" 17 "SAS1" 18 "FATC" 19 "CLU1" 20 "BCM" 21 "EPS" 22 "PEPS1" 23 "PEPS2" 24 "PEPS3" 25 "BPM" 26 "AC" 27 "TCU4" 28 "BCM2" 29 "GW1" 30 "GW2" 31 "GW3" 32 "GW4" 33 "GW5" 34 "GW6" 35 "SAS2" 36 "EPB1" 37 "EPB2" 38 "TCU5" 39 "TCU6" 40 "ACU1" 41 "HCU1" 42 "HCU2" 43 "HCU3" 44 "HCU4" 45 "APA" 255 "UNUSE" /end COMPU_VTAB
/begin COMPU_METHOD u_can_rxmsg_num "" TAB_VERB "%10.4" "" COMPU_TAB_REF u_can_rxmsg_num /end COMPU_METHOD
/begin COMPU_VTAB u_can_rxmsg_num "" TAB_VERB 20 0 "MSG0" 1 "MSG1" 2 "MSG2" 3 "MSG3" 4 "MSG4" 5 "MSG5" 6 "MSG6" 7 "MSG7" 8 "MSG8" 9 "MSG9" 10 "MSG10" 11 "MSG11" 12 "MSG12" 13 "MSG13" 14 "MSG14" 15 "MSG15" 16 "MSG16" 17 "MSG17" 18 "MSG18" 255 "OFF" /end COMPU_VTAB
/begin COMPU_METHOD u_g_per_sec_2048 "g per second" RAT_FUNC "%6.2" "g/s" COEFFS 0.0 1.0 0.000000 0.0 0.0 0.03125 /end COMPU_METHOD
/begin COMPU_METHOD u_srv_evam_vlv_st "" TAB_VERB "%6.3" "" COMPU_TAB_REF u_srv_evam_vlv_st /end COMPU_METHOD
/begin COMPU_VTAB u_srv_evam_vlv_st "" TAB_VERB 3 0 "INACTIVE" 1 "OPEN" 2 "CLOSE" /end COMPU_VTAB
/begin COMPU_METHOD u_10m_tmr "10ms timer" RAT_FUNC "%5.2" "10ms" COEFFS 0.0 1.0 0.000000 0.0 0.0 0.01 /end COMPU_METHOD
/begin COMPU_METHOD u_iga_256 "ig angle" RAT_FUNC "%4.2" "Deg" COEFFS 0.0 1.0 0.000000 0.0 0.0 0.00390625 /end COMPU_METHOD
/begin COMPU_METHOD u_espd_grd "rpm_per_second" RAT_FUNC "%5.0" "rpm/s" COEFFS 0.0 1.0 0.000000 0.0 0.0 1.0 /end COMPU_METHOD
/begin COMPU_METHOD p_t_GPF_DP_N128_128 "Ax + B" RAT_FUNC "%4.4" "KPa" COEFFS 0.0 1.0 0.000000 0.0 0.0 0.003906250000 /end COMPU_METHOD
/begin COMPU_METHOD p_t_GPF_COUNT_0_65535 "Ax + B" RAT_FUNC "%4.0" "count" COEFFS 0.0 1.0 0.000000 0.0 0.0 1.000000000000 /end COMPU_METHOD
/begin COMPU_METHOD p_t_GPF_TEMP_N2048_2048 "" RAT_FUNC "%7.3" "degC" COEFFS 0.0 1.0 0.0 0.0 0.0 0.0625 /end COMPU_METHOD
/begin COMPU_METHOD p_t_GPF_COUNT_N32768_32767 "Ax + B" RAT_FUNC "%4.0" "1/ml" COEFFS 0.0 1.0 0.000000 0.0 0.0 1.000000000000 /end COMPU_METHOD
/begin COMPU_METHOD p_t_GPF_SM_0_128 "" RAT_FUNC "%7.4" "g" COEFFS 0.0 1.0 0.0 0.0 0.0 0.001953125 /end COMPU_METHOD
/begin COMPU_METHOD p_t_GPF_SI_N512_512 "" RAT_FUNC "%6.3" "kPa" COEFFS 0.0 1.0 0.0 0.0 0.0 0.015625 /end COMPU_METHOD
/begin COMPU_METHOD p_t_GPF_TRM_LONG "Ax + B" RAT_FUNC "%10.6" "kPa" COEFFS 0.0 1.0 0.000000 0.0 0.0 0.000000476837 /end COMPU_METHOD
/begin COMPU_METHOD p_t_GPF_CODE_N4096_4096_LONG "Ax + B" RAT_FUNC "%10.6" "Pa.s/ml" COEFFS 0.0 1.0 0.000000 0.0 0.0 0.000001907348 /end COMPU_METHOD
/begin COMPU_METHOD p_t_GPF_TEMP_N8192_8192 "" RAT_FUNC "%6.2" "DegC" COEFFS 0.0 1.0 0.0 0.0 0.0 0.25 /end COMPU_METHOD
/begin COMPU_METHOD p_t_GPF_FLT2_0_1 "" RAT_FUNC "%5.4" "N/A" COEFFS 0.0 1.0 0.0 0.0 0.0 0.0078125 /end COMPU_METHOD
/begin COMPU_METHOD p_t_GPF_FLW "Ax + B" RAT_FUNC "%10.6" "l/s" COEFFS 0.0 1.0 0.000000 0.0 0.0 0.062500000000 /end COMPU_METHOD
/begin COMPU_METHOD p_t_GPF_FLT_0_2 "" RAT_FUNC "%7.6" "N/A" COEFFS 0.0 1.0 0.0 0.0 0.0 0.000030517578125 /end COMPU_METHOD
/begin COMPU_METHOD p_t_GPF_FAC_0_512 "" RAT_FUNC "%5.4" "N/A" COEFFS 0.0 1.0 0.0 0.0 0.0 0.0078125 /end COMPU_METHOD
/begin COMPU_METHOD p_t_GPF_DENS "Ax + B" RAT_FUNC "%10.6" "g/L" COEFFS 0.0 1.0 0.000000 0.0 0.0 0.000061035156 /end COMPU_METHOD
/begin COMPU_METHOD p_t_GPF_BURN_RT_0_0P5 "" RAT_FUNC "%8.7" "1/s" COEFFS 0.0 1.0 0.0 0.0 0.0 0.00000762939453125 /end COMPU_METHOD
/begin COMPU_METHOD p_t_GPF_FAC_0_0P125 "" RAT_FUNC "%8.7" "ratio" COEFFS 0.0 1.0 0.0 0.0 0.0 0.000001907348633 /end COMPU_METHOD
/begin COMPU_METHOD p_t_GPF_SM_BURN_N2048_2048_LONG "Ax + B" RAT_FUNC "%10.6" "g/s" COEFFS 0.0 1.0 0.000000 0.0 0.0 0.000000953674 /end COMPU_METHOD
/begin COMPU_METHOD p_t_GPF_SOOT_PRDT_N16_16 "Ax + B" RAT_FUNC "%10.6" "g" COEFFS 0.0 1.0 0.000000 0.0 0.0 0.000000007450 /end COMPU_METHOD
/begin COMPU_METHOD p_t_GPF_VISC "Ax + B" RAT_FUNC "%12.10" "Pa.s" COEFFS 0.0 1.0 0.000000 0.0 0.0 0.000000000931 /end COMPU_METHOD
/begin COMPU_METHOD p_t_GPF_PRES_0_512 "Ax + B" RAT_FUNC "%10.6" "kPa" COEFFS 0.0 1.0 0.000000 0.0 0.0 0.007812500000 /end COMPU_METHOD
/begin COMPU_METHOD p_t_GPF_FUEL_FLW_DIF_N256_256 "Ax + B" RAT_FUNC "%10.6" "mg/str" COEFFS 0.0 1.0 0.000000 0.0 0.0 0.007812500000 /end COMPU_METHOD
/begin COMPU_METHOD p_t_GPF_DP_0_128 "Ax + B" RAT_FUNC "%10.6" "kPa" COEFFS 0.0 1.0 0.000000 0.0 0.0 0.001953125000 /end COMPU_METHOD
/begin COMPU_METHOD u_fac_64_l "" RAT_FUNC "%8.7" "ratio" COEFFS 0.0 1.0 0.0 0.0 0.0 0.00000001490116119384765625 /end COMPU_METHOD
/begin COMPU_METHOD u_fac_256_l "" RAT_FUNC "%9.6" "ratio" COEFFS 0.0 1.0 0.0 0.0 0.0 0.000000059604644775390625 /end COMPU_METHOD
/begin FUNCTION can_rx "rx"
 /begin DEF_CHARACTERISTIC CAN_V_RX_00_ID CAN_V_RX_00_DLC CAN_V_RX_00_TYP CAN_V_RX_00_FL_TM CAN_V_RX_00_ROLL_THR CAN_V_RX_00_CHN CAN_V_RX_01_ID CAN_V_RX_01_DLC CAN_V_RX_01_TYP CAN_V_RX_01_FL_TM CAN_V_RX_01_ROLL_THR CAN_V_RX_01_CHN CAN_V_RX_02_ID CAN_V_RX_02_DLC CAN_V_RX_02_TYP CAN_V_RX_02_FL_TM CAN_V_RX_02_ROLL_THR CAN_V_RX_02_CHN CAN_V_RX_03_ID CAN_V_RX_03_DLC CAN_V_RX_03_TYP CAN_V_RX_03_FL_TM CAN_V_RX_03_ROLL_THR CAN_V_RX_03_CHN CAN_V_RX_04_ID CAN_V_RX_04_DLC CAN_V_RX_04_TYP CAN_V_RX_04_FL_TM CAN_V_RX_04_ROLL_THR CAN_V_RX_04_CHN CAN_V_RX_05_ID CAN_V_RX_05_DLC CAN_V_RX_05_TYP CAN_V_RX_05_FL_TM CAN_V_RX_05_ROLL_THR CAN_V_RX_05_CHN CAN_V_RX_06_ID CAN_V_RX_06_DLC CAN_V_RX_06_TYP CAN_V_RX_06_FL_TM CAN_V_RX_06_ROLL_THR CAN_V_RX_06_CHN CAN_V_RX_07_ID CAN_V_RX_07_DLC CAN_V_RX_07_TYP CAN_V_RX_07_FL_TM CAN_V_RX_07_ROLL_THR CAN_V_RX_07_CHN CAN_V_RX_08_ID CAN_V_RX_08_DLC CAN_V_RX_08_TYP CAN_V_RX_08_FL_TM CAN_V_RX_08_ROLL_THR CAN_V_RX_08_CHN CAN_V_RX_09_ID CAN_V_RX_09_DLC CAN_V_RX_09_TYP CAN_V_RX_09_FL_TM CAN_V_RX_09_ROLL_THR CAN_V_RX_09_CHN CAN_V_RX_10_ID CAN_V_RX_10_DLC CAN_V_RX_10_TYP CAN_V_RX_10_FL_TM CAN_V_RX_10_ROLL_THR CAN_V_RX_10_CHN CAN_V_RX_11_ID CAN_V_RX_11_DLC CAN_V_RX_11_TYP CAN_V_RX_11_FL_TM CAN_V_RX_11_ROLL_THR CAN_V_RX_11_CHN CAN_V_RX_12_ID CAN_V_RX_12_DLC CAN_V_RX_12_TYP CAN_V_RX_12_FL_TM CAN_V_RX_12_ROLL_THR CAN_V_RX_12_CHN CAN_V_RX_13_ID CAN_V_RX_13_DLC CAN_V_RX_13_TYP CAN_V_RX_13_FL_TM CAN_V_RX_13_ROLL_THR CAN_V_RX_13_CHN CAN_V_RX_14_ID CAN_V_RX_14_DLC CAN_V_RX_14_TYP CAN_V_RX_14_FL_TM CAN_V_RX_14_ROLL_THR CAN_V_RX_14_CHN CAN_V_RX_15_ID CAN_V_RX_15_DLC CAN_V_RX_15_TYP CAN_V_RX_15_FL_TM CAN_V_RX_15_ROLL_THR CAN_V_RX_15_CHN CAN_V_RX_16_ID CAN_V_RX_16_DLC CAN_V_RX_16_TYP CAN_V_RX_16_FL_TM CAN_V_RX_16_ROLL_THR CAN_V_RX_16_CHN CAN_V_RX_17_ID CAN_V_RX_17_DLC CAN_V_RX_17_TYP CAN_V_RX_17_FL_TM CAN_V_RX_17_ROLL_THR CAN_V_RX_17_CHN CAN_V_RX_18_ID CAN_V_RX_18_DLC CAN_V_RX_18_TYP CAN_V_RX_18_FL_TM CAN_V_RX_18_ROLL_THR CAN_V_RX_18_CHN CAN_RX_CHKSUM00_ID CAN_RX_CHKSUM00_BYTE_LOC CAN_RX_CHKSUM00_BIT_LOC CAN_RX_CHKSUM00_BIT_LEN CAN_RX_CHKSUM00_METHOD CAN_RX_CHKSUM01_ID CAN_RX_CHKSUM01_BYTE_LOC CAN_RX_CHKSUM01_BIT_LOC CAN_RX_CHKSUM01_BIT_LEN CAN_RX_CHKSUM01_METHOD CAN_RX_CHKSUM02_ID CAN_RX_CHKSUM02_BYTE_LOC CAN_RX_CHKSUM02_BIT_LOC CAN_RX_CHKSUM02_BIT_LEN CAN_RX_CHKSUM02_METHOD CAN_RX_CHKSUM03_ID CAN_RX_CHKSUM03_BYTE_LOC CAN_RX_CHKSUM03_BIT_LOC CAN_RX_CHKSUM03_BIT_LEN CAN_RX_CHKSUM03_METHOD CAN_RX_CHKSUM04_ID CAN_RX_CHKSUM04_BYTE_LOC CAN_RX_CHKSUM04_BIT_LOC CAN_RX_CHKSUM04_BIT_LEN CAN_RX_CHKSUM04_METHOD CAN_RX_CHKSUM05_ID CAN_RX_CHKSUM05_BYTE_LOC CAN_RX_CHKSUM05_BIT_LOC CAN_RX_CHKSUM05_BIT_LEN CAN_RX_CHKSUM05_METHOD CAN_RX_CHKSUM06_ID CAN_RX_CHKSUM06_BYTE_LOC CAN_RX_CHKSUM06_BIT_LOC CAN_RX_CHKSUM06_BIT_LEN CAN_RX_CHKSUM06_METHOD CAN_RX_CHKSUM07_ID CAN_RX_CHKSUM07_BYTE_LOC CAN_RX_CHKSUM07_BIT_LOC CAN_RX_CHKSUM07_BIT_LEN CAN_RX_CHKSUM07_METHOD CAN_RX_CHKSUM08_ID CAN_RX_CHKSUM08_BYTE_LOC CAN_RX_CHKSUM08_BIT_LOC CAN_RX_CHKSUM08_BIT_LEN CAN_RX_CHKSUM08_METHOD CAN_RX_CHKSUM09_ID CAN_RX_CHKSUM09_BYTE_LOC CAN_RX_CHKSUM09_BIT_LOC CAN_RX_CHKSUM09_BIT_LEN CAN_RX_CHKSUM09_METHOD CAN_RX_CHKSUM10_ID CAN_RX_CHKSUM10_BYTE_LOC CAN_RX_CHKSUM10_BIT_LOC CAN_RX_CHKSUM10_BIT_LEN CAN_RX_CHKSUM10_METHOD CAN_RX_CHKSUM11_ID CAN_RX_CHKSUM11_BYTE_LOC CAN_RX_CHKSUM11_BIT_LOC CAN_RX_CHKSUM11_BIT_LEN CAN_RX_CHKSUM11_METHOD CAN_RX_CHKSUM12_ID CAN_RX_CHKSUM12_BYTE_LOC CAN_RX_CHKSUM12_BIT_LOC CAN_RX_CHKSUM12_BIT_LEN CAN_RX_CHKSUM12_METHOD CAN_RX_ROLL_CNT00_ID CAN_RX_ROLL_CNT00_BYTE_LOC CAN_RX_ROLL_CNT00_BIT_LOC CAN_RX_ROLL_CNT00_BIT_LEN CAN_RX_ROLL_CNT01_ID CAN_RX_ROLL_CNT01_BYTE_LOC CAN_RX_ROLL_CNT01_BIT_LOC CAN_RX_ROLL_CNT01_BIT_LEN CAN_RX_ROLL_CNT02_ID CAN_RX_ROLL_CNT02_BYTE_LOC CAN_RX_ROLL_CNT02_BIT_LOC CAN_RX_ROLL_CNT02_BIT_LEN CAN_RX_ROLL_CNT03_ID CAN_RX_ROLL_CNT03_BYTE_LOC CAN_RX_ROLL_CNT03_BIT_LOC CAN_RX_ROLL_CNT03_BIT_LEN CAN_RX_ROLL_CNT04_ID CAN_RX_ROLL_CNT04_BYTE_LOC CAN_RX_ROLL_CNT04_BIT_LOC CAN_RX_ROLL_CNT04_BIT_LEN CAN_RX_ROLL_CNT05_ID CAN_RX_ROLL_CNT05_BYTE_LOC CAN_RX_ROLL_CNT05_BIT_LOC CAN_RX_ROLL_CNT05_BIT_LEN CAN_RX_ROLL_CNT06_ID CAN_RX_ROLL_CNT06_BYTE_LOC CAN_RX_ROLL_CNT06_BIT_LOC CAN_RX_ROLL_CNT06_BIT_LEN CAN_RX_ROLL_CNT07_ID CAN_RX_ROLL_CNT07_BYTE_LOC CAN_RX_ROLL_CNT07_BIT_LOC CAN_RX_ROLL_CNT07_BIT_LEN CAN_RX_ROLL_CNT08_ID CAN_RX_ROLL_CNT08_BYTE_LOC CAN_RX_ROLL_CNT08_BIT_LOC CAN_RX_ROLL_CNT08_BIT_LEN CAN_RX_ROLL_CNT09_ID CAN_RX_ROLL_CNT09_BYTE_LOC CAN_RX_ROLL_CNT09_BIT_LOC CAN_RX_ROLL_CNT09_BIT_LEN CAN_RX_ROLL_CNT10_ID CAN_RX_ROLL_CNT10_BYTE_LOC CAN_RX_ROLL_CNT10_BIT_LOC CAN_RX_ROLL_CNT10_BIT_LEN CAN_RX_ROLL_CNT11_ID CAN_RX_ROLL_CNT11_BYTE_LOC CAN_RX_ROLL_CNT11_BIT_LOC CAN_RX_ROLL_CNT11_BIT_LEN CAN_RX_ROLL_CNT12_ID CAN_RX_ROLL_CNT12_BYTE_LOC CAN_RX_ROLL_CNT12_BIT_LOC CAN_RX_ROLL_CNT12_BIT_LEN CAN_RX_ABS_ACTV_ID CAN_RX_ABS_ACTV_BYTE_LOC CAN_RX_ABS_ACTV_BIT_LOC CAN_RX_ABS_ACTV_BIT_LEN CAN_RX_ABS_ACTV_TABLE CAN_RX_ABS_FL_ID CAN_RX_ABS_FL_BYTE_LOC CAN_RX_ABS_FL_BIT_LOC CAN_RX_ABS_FL_BIT_LEN CAN_RX_ABS_FL_TABLE CAN_RX_VEH_SPD_ID CAN_RX_VEH_SPD_BYTE_LOC CAN_RX_VEH_SPD_BIT_LOC CAN_RX_VEH_SPD_BIT_LEN CAN_RX_VEH_SPD_A CAN_RX_VEH_SPD_B CAN_RX_VEH_SPD_INVALID CAN_RX_VEH_SPD_DFLT CAN_RX_FRNT_BLW_ST_ID CAN_RX_FRNT_BLW_ST_BYTE_LOC CAN_RX_FRNT_BLW_ST_BIT_LOC CAN_RX_FRNT_BLW_ST_BIT_LEN CAN_RX_FRNT_BLW_ST_TABLE CAN_RX_CRSH_ST_ID CAN_RX_CRSH_ST_BYTE_LOC CAN_RX_CRSH_ST_BIT_LOC CAN_RX_CRSH_ST_BIT_LEN CAN_RX_CRSH_ST_DFLT CAN_RX_CRSH_ST_TABLE CAN_RX_HIGH_BEAM_ST_ID CAN_RX_HIGH_BEAM_ST_BYTE_LOC CAN_RX_HIGH_BEAM_ST_BIT_LOC CAN_RX_HIGH_BEAM_ST_BIT_LEN CAN_RX_HIGH_BEAM_ST_TABLE CAN_RX_LOW_BEAM_ST_ID CAN_RX_LOW_BEAM_ST_BYTE_LOC CAN_RX_LOW_BEAM_ST_BIT_LOC CAN_RX_LOW_BEAM_ST_BIT_LEN CAN_RX_LOW_BEAM_ST_TABLE CAN_RX_DRVR_DR_OPN_ST_ID CAN_RX_DRVR_DR_OPN_BYTE_LOC CAN_RX_DRVR_DR_OPN_BIT_LOC CAN_RX_DRVR_DR_OPN_BIT_LEN CAN_RX_DRVR_DR_OPN_TABLE CAN_RX_REAR_DEFOG_ID CAN_RX_REAR_DEFOG_BYTE_LOC CAN_RX_REAR_DEFOG_BIT_LOC CAN_RX_REAR_DEFOG_BIT_LEN CAN_RX_REAR_DEFOG_TABLE CAN_RX_STRT_REQ_ID CAN_RX_STRT_REQ_BYTE_LOC CAN_RX_STRT_REQ_BIT_LOC CAN_RX_STRT_REQ_BIT_LEN CAN_RX_STRT_REQ_TABLE CAN_RX_FUEL_LVL_ID CAN_RX_FUEL_LVL_BYTE_LOC CAN_RX_FUEL_LVL_BIT_LOC CAN_RX_FUEL_LVL_BIT_LEN CAN_RX_FUEL_LVL_A CAN_RX_FUEL_LVL_B CAN_RX_FUEL_LVL_INVALID CAN_RX_FUEL_LVL_DFLT CAN_RX_FUEL_LVL_WARN_ID CAN_RX_FUEL_LVL_WARN_BYTE_LOC CAN_RX_FUEL_LVL_WARN_BIT_LOC CAN_RX_FUEL_LVL_WARN_BIT_LEN CAN_RX_FUEL_LVL_WARN_TABLE CAN_RX_LDRV_WSS_ID CAN_RX_LDRV_WSS_BYTE_LOC CAN_RX_LDRV_WSS_BIT_LOC CAN_RX_LDRV_WSS_BIT_LEN CAN_RX_LDRV_WSS_A CAN_RX_LDRV_WSS_B CAN_RX_LDRV_WSS_INVALID CAN_RX_LDRV_WSS_DFLT CAN_RX_LDRV_WSS_VLD_ID CAN_RX_LDRV_WSS_VLD_BYTE_LOC CAN_RX_LDRV_WSS_VLD_BIT_LOC CAN_RX_LDRV_WSS_VLD_BIT_LEN CAN_RX_LDRV_WSS_VLD_TABLE CAN_RX_LNDRV_WSS_ID CAN_RX_LNDRV_WSS_BYTE_LOC CAN_RX_LNDRV_WSS_BIT_LOC CAN_RX_LNDRV_WSS_BIT_LEN CAN_RX_LNDRV_WSS_A CAN_RX_LNDRV_WSS_B CAN_RX_LNDRV_WSS_INVALID CAN_RX_LNDRV_WSS_DFLT CAN_RX_LNDRV_WSS_VLD_ID CAN_RX_LNDRV_WSS_VLD_BYTE_LOC CAN_RX_LNDRV_WSS_VLD_BIT_LOC CAN_RX_LNDRV_WSS_VLD_BIT_LEN CAN_RX_LNDRV_WSS_VLD_TABLE CAN_RX_RDRV_WSS_ID CAN_RX_RDRV_WSS_BYTE_LOC CAN_RX_RDRV_WSS_BIT_LOC CAN_RX_RDRV_WSS_BIT_LEN CAN_RX_RDRV_WSS_A CAN_RX_RDRV_WSS_B CAN_RX_RDRV_WSS_INVALID CAN_RX_RDRV_WSS_DFLT CAN_RX_RDRV_WSS_VLD_ID CAN_RX_RDRV_WSS_VLD_BYTE_LOC CAN_RX_RDRV_WSS_VLD_BIT_LOC CAN_RX_RDRV_WSS_VLD_BIT_LEN CAN_RX_RDRV_WSS_VLD_TABLE CAN_RX_RNDRV_WSS_ID CAN_RX_RNDRV_WSS_BYTE_LOC CAN_RX_RNDRV_WSS_BIT_LOC CAN_RX_RNDRV_WSS_BIT_LEN CAN_RX_RNDRV_WSS_A CAN_RX_RNDRV_WSS_B CAN_RX_RNDRV_WSS_INVALID CAN_RX_RNDRV_WSS_DFLT CAN_RX_RNDRV_WSS_VLD_ID CAN_RX_RNDRV_WSS_VLD_BYTE_LOC CAN_RX_RNDRV_WSS_VLD_BIT_LOC CAN_RX_RNDRV_WSS_VLD_BIT_LEN CAN_RX_RNDRV_WSS_VLD_TABLE CAN_RX_TQ_RED_ACTV_TCS_ID CAN_RX_TQ_RED_ACTV_TCS_BYTE_LOC CAN_RX_TQ_RED_ACTV_TCS_BIT_LOC CAN_RX_TQ_RED_ACTV_TCS_BIT_LEN CAN_RX_TQ_RED_ACTV_TCS_TABLE CAN_RX_TQ_RED_TCS_ID CAN_RX_TQ_RED_TCS_BYTE_LOC CAN_RX_TQ_RED_TCS_BIT_LOC CAN_RX_TQ_RED_TCS_BIT_LEN CAN_RX_TQ_RED_TCS_A CAN_RX_TQ_RED_TCS_B CAN_RX_TQ_RED_TCS_INVALID CAN_RX_TQ_RED_TCS_DFLT CAN_RX_TQ_RED_TCS_TYP CAN_RX_TQ_INC_ACTV_TCS_ID CAN_RX_TQ_INC_ACTV_TCS_BYTE_LOC CAN_RX_TQ_INC_ACTV_TCS_BIT_LOC CAN_RX_TQ_INC_ACTV_TCS_BIT_LEN CAN_RX_TQ_INC_ACTV_TCS_TABLE CAN_RX_TQ_INC_TCS_ID CAN_RX_TQ_INC_TCS_BYTE_LOC CAN_RX_TQ_INC_TCS_BIT_LOC CAN_RX_TQ_INC_TCS_BIT_LEN CAN_RX_TQ_INC_TCS_A CAN_RX_TQ_INC_TCS_B CAN_RX_TQ_INC_TCS_INVALID CAN_RX_TQ_INC_TCS_DFLT CAN_RX_TQ_INC_TCS_TYP CAN_RX_TQ_LMT_ACTV_TCS_ID CAN_RX_TQ_LMT_ACTV_TCS_BYTE_LOC CAN_RX_TQ_LMT_ACTV_TCS_BIT_LOC CAN_RX_TQ_LMT_ACTV_TCS_BIT_LEN CAN_RX_TQ_LMT_ACTV_TCS_TABLE CAN_RX_TQ_LMT_TCS_ID CAN_RX_TQ_LMT_TCS_BYTE_LOC CAN_RX_TQ_LMT_TCS_BIT_LOC CAN_RX_TQ_LMT_TCS_BIT_LEN CAN_RX_TQ_LMT_TCS_A CAN_RX_TQ_LMT_TCS_B CAN_RX_TQ_LMT_TCS_INVALID CAN_RX_TQ_LMT_TCS_DFLT CAN_RX_TQ_LMT_TCS_TYP /end DEF_CHARACTERISTIC
/end FUNCTION
/begin FUNCTION can_calcu "can calculation"
 /begin DEF_CHARACTERISTIC CAN_V_OFF_DLY CAN_V_VOLT_THRSH1 CAN_V_VOLT_THRSH2 CAN_V_VOLT_THRSH3 CAN_V_VOLT_THRSH4 CAN_V_MSG_ERR_THRSH CAN_V_RLL_CNT_ERR CAN_V_CAN_CFG CAN_V_TORQ_UNIT CAN_V_PPS_HI_THRSH CAN_V_PPS_LO_THRSH /end DEF_CHARACTERISTIC
 /begin OUT_MEASUREMENT /end OUT_MEASUREMENT
/end FUNCTION
/begin FUNCTION can "can" /begin SUB_FUNCTION can_tx can_rx can_calcu /end SUB_FUNCTION /end FUNCTION
/begin FUNCTION vvtd "vvt related diag"
 /begin DEF_CHARACTERISTIC VVTD_V_B1_EXH_TH_COR_FL_CNTS VVTD_V_B1_EXH_TH_COR_DIAG_CNTS VVTD_V_B1_EXH_TH_NUM VVTD_V_B1_INTK_TH_COR_FL_CNTS VVTD_V_B1_INTK_TH_COR_DIAG_CNTS VVTD_V_B1_INTK_TH_NUM VVTD_C_B1_EXH_TH_LRN_MIN VVTD_C_B1_EXH_TH_LRN_MAX VVTD_C_B1_INTK_TH_LRN_MIN VVTD_C_B1_INTK_TH_LRN_MAX VVTD_V_VLV_STCK_POS_DLT VVTD_V_VLV_EXH_STCK_POS_LO VVTD_V_VLV_EXH_STCK_POS_HI VVTD_V_VLV_STCK_KP_CNTS VVTD_V_VLV_INTK_STCK_POS_LO VVTD_V_VLV_INTK_STCK_POS_HI VVTD_V_B1_EXH_STCK_FL_CNTS VVTD_V_B1_EXH_STCK_FL_DIAG_CNTS VVTD_V_B1_EXH_STCK_DIAG_CNTS VVTD_V_B1_INTK_STCK_FL_CNTS VVTD_V_B1_INTK_STCK_FL_DIAG_CNTS VVTD_V_B1_INTK_STCK_DIAG_CNTS VVTD_V_CAM_EXH_SLW_POS_MIN VVTD_V_CAM_EXH_SLW_POS_MAX VVTD_V_CAM_EXH_SLW_DTY_MIN VVTD_V_CAM_EXH_SLW_DTY_MAX VVTD_V_CAM_SLW_POS_KP_CNTS VVTD_V_CAM_EXH_ACT_SP_DLT_THR VVTD_V_CAM_SLW_DLT_KP_CNTS VVTD_V_B1_EXH_CAM_SLW_FL_CNTS VVTD_V_B1_EXH_CAM_SLW_DIAG_CNTS VVTD_V_CAM_INTK_SLW_POS_MIN VVTD_V_CAM_INTK_SLW_POS_MAX VVTD_V_CAM_INTK_SLW_DTY_MIN VVTD_V_CAM_INTK_SLW_DTY_MAX VVTD_V_CAM_INTK_SLW_DLT_MIN VVTD_V_B1_INTK_CAM_SLW_FL_CNTS VVTD_V_B1_INTK_CAM_SLW_DIAG_CNTS VVTD_V_B1_EXH_CAM_TH_NUM_FL_CNTS VVTD_V_B1_EXH_CAM_TH_NUM_DIAG_CNTS VVTD_V_B1_INTK_CAM_TH_NUM_FL_CNTS VVTD_V_B1_INTK_CAM_TH_NUM_DIAG_CNTS VVTD_V_EXH_PERF_TRG_SP_V VVTD_V_EXH_PERF_SUM_SP_CHG_MIN VVTD_V_EXH_PERF_TRG_CHG_SUM_MIN VVTD_V_EXH_PERF_MEAS_DUR_MIN VVTD_V_EXH_PERF_TRG_ACT_SP_DLT_MAX VVTD_V_EXH_PERF_END_ACT_SP_DLT_MAX VVTD_V_PERF_END_LOG_CNTS_MIN VVTD_V_PERF_VEL_NEG_HYS VVTD_V_PERF_VEL_POS_HYS VVTD_V_EXH_CAM_SLW_EN_VEL VVTD_V_INTK_CAM_SLW_EN_VEL VVTD_M_EXH_PERF_VEL_NEG_THR VVTD_M_EXH_PERF_VEL_POS_THR VVTD_X_EXH_SP_ABS_VEL VVTD_V_INTK_PERF_TRG_SP_V VVTD_V_INTK_PERF_SUM_SP_CHG_MIN VVTD_V_INTK_PERF_TRG_CHG_SUM_MIN VVTD_V_INTK_PERF_TRG_ACT_SP_DLT_MAX VVTD_V_INTK_PERF_END_ACT_SP_DLT_MAX VVTD_V_INTK_PERF_MEAS_DUR_MIN VVTD_M_INTK_PERF_VEL_NEG_THR VVTD_M_INTK_PERF_VEL_POS_THR VVTD_X_INTK_SP_ABS_VEL VVTD_V_VLV_B1_INTK_EN_VLT VVTD_V_VLV_B1_EXH_EN_VLT VVTD_V_VLV_B1_INTK_EN_MPR_ON_MIN VVTD_V_VLV_B1_EXH_EN_MPR_ON_MIN VVTD_V_VLV_B1_INTK_EN_RUN_MIN VVTD_V_VLV_B1_EXH_EN_RUN_MIN VVTD_V_VLV_B1_INTK_HI_FL_CNTS VVTD_V_VLV_B1_INTK_HI_DIAG_CNTS VVTD_V_VLV_B1_INTK_LO_FL_CNTS VVTD_V_VLV_B1_INTK_LO_DIAG_CNTS VVTD_V_VLV_B1_INTK_OPN_FL_CNTS VVTD_V_VLV_B1_INTK_OPN_DIAG_CNTS VVTD_V_VLV_B1_EXH_HI_FL_CNTS VVTD_V_VLV_B1_EXH_HI_DIAG_CNTS VVTD_V_VLV_B1_EXH_LO_FL_CNTS VVTD_V_VLV_B1_EXH_LO_DIAG_CNTS VVTD_V_VLV_B1_EXH_OPN_FL_CNTS VVTD_V_VLV_B1_EXH_OPN_DIAG_CNTS /end DEF_CHARACTERISTIC
 /begin OUT_MEASUREMENT vvtd_b1_exh_sp_neg_vel vvtd_b1_exh_sp_pos_vel vvtd_b1_intk_sp_neg_vel vvtd_b1_intk_sp_pos_vel /end OUT_MEASUREMENT
/end FUNCTION
/begin FUNCTION pwsd "power system diag"
 /begin DEF_CHARACTERISTIC PWSD_V_SOC_MIN PWSD_V_BAT_T_MAX PWSD_V_BAT_CURR_MIN PWSD_V_CHRG_OFF_ALT_DTY_MAX PWSD_V_CHRG_OFF_SOC_MAX PWSD_V_SOC_LO_ALT_DTY_MAX PWSD_V_VLT_LO_ALT_DTY_MAX PWSD_V_VLT_LO_SOC_MAX PWSD_V_VLT_LO_DLT_THR PWSD_V_VLT_RAT_DTY_MAX PWSD_V_VLT_RAT_SOC_MAX PWSD_V_BAT_T_FL_TM PWSD_V_BAT_T_DIAG_TM PWSD_V_CHRG_OFF_FL_TM PWSD_V_CHRG_OFF_DIAG_TM PWSD_V_SOC_LO_FL_TM PWSD_V_SOC_LO_DIAG_TM PWSD_V_VLT_LO_FL_TM PWSD_V_VLT_LO_DIAG_TM PWSD_V_VLT_RAT_FL_TM PWSD_V_VLT_RAT_DIAG_TM PWSD_V_VLT_RAT_DLT_THR PWSD_V_ALT_EN_VLT PWSD_V_ALT_EN_ESPD PWSD_V_ALT_EN_RUN PWSD_V_ALT_ELEC_FL_TM PWSD_V_ALT_ELEC_DIAG_TM PWSD_V_ALT_MECH_FL_TM PWSD_V_ALT_MECH_DIAG_TM PWSD_V_ALT_T_HI_FL_TM PWSD_V_ALT_T_HI_DIAG_TM /end DEF_CHARACTERISTIC
 /begin OUT_MEASUREMENT /end OUT_MEASUREMENT
/end FUNCTION
/begin FUNCTION idld "idle system diag"
 /begin DEF_CHARACTERISTIC IDLD_V_EN_PURGE_MAX IDLD_V_EN_AMP_MIN IDLD_V_EN_RUN_MIN IDLD_V_EN_IAT_MIN IDLD_V_EN_VLT_MIN IDLD_V_EN_VLT_MAX IDLD_V_EN_ECT_MIN IDLD_V_SPD_DLT_FIL IDLD_V_EN_DLY IDLD_V_CHT_EN_SPD_INC_MIN IDLD_V_CAT_HT_SPD_DLT IDLD_V_IDL_FLW_HI_THR IDLD_V_CHT_EN_AMP_MAP_MAX IDLD_V_CAT_HT_FL_DUR IDLD_V_CAT_HT_PS_DUR IDLD_V_LO_EN_AMP_MAP_MAX IDLD_V_LO_DLT_FL_THR IDLD_V_SPD_LO_FL_DUR IDLD_V_SPD_LO_PS_DUR IDLD_V_HI_DLT_FL_THR IDLD_V_HI_EN_AMP_MAP_MIN IDLD_V_SPD_HI_FL_DUR IDLD_V_SPD_HI_PS_DUR /end DEF_CHARACTERISTIC
 /begin OUT_MEASUREMENT idld_en_dly idld_lo_ps_tmr idld_lo_fl_tmr idld_hi_ps_tmr idld_hi_fl_tmr idld_cat_ht_ps_tmr idld_cat_ht_fl_tmr idld_comn_conds_met idld_cat_ht_spd_inc idld_cat_ht_en idld_cat_ht_fl_met idld_cat_ht_fl idld_cat_ht_fn idld_spd_lo_en idld_spd_lo_fl_met idld_spd_lo_fl idld_spd_lo_fn idld_spd_hi_en idld_spd_hi_fl_met idld_spd_hi_fl idld_spd_hi_fn /end OUT_MEASUREMENT
/end FUNCTION
/begin FUNCTION efd "egr flow diag"
 /begin DEF_CHARACTERISTIC EFD_V_VSPD_MIN EFD_V_TPS_MAX EFD_V_AMP_MIN EFD_V_ESPD_MIN EFD_V_STBL_IDL_FLW_DLT EFD_V_EN_EGR_POS_MAX EFD_V_EN_AMP_MAP_MIN EFD_V_EN_AMP_MAP_MAX EFD_V_EN_ESPD_MIN EFD_V_EN_ESPD_MAX EFD_V_STBL_MAP_DLT EFD_V_EN_DLY EFD_V_DIAG_ESPD_BIAS EFD_M_VLV_OPN_SP EFD_V_VLV_OPN_DUR EFD_V_VLV_CLS_DUR EFD_V_VLV_OPN_FAC EFD_V_EXT_VSPD_DLT EFD_V_EXT_ESPD_DLT EFD_V_EXT_DUR_MIN EFD_V_MAP_LOG_DUR EFD_M_MAP_DLT_MIN EFD_V_VLV_FAC_INC_FAC EFD_V_INIT_PASS_LOG_CNTS EFD_V_VLV_OPN_SP_FAC_MIN EFD_V_MAP_DLT_MMV_INIT EFD_V_CURR_FL_THR EFD_V_CURR_FL_FIL EFD_V_CURR_PS_THR EFD_V_CURR_PS_FIL EFD_V_TST_CNTS EFD_V_RPT_EN_TST_CNTS EFD_V_TST_DLY EFD_V_TRP_TST_CNTS EFD_V_FAC_DEC_PS_CNTS EFD_V_TRIP_TST_CNTS EFD_V_VLV_FAC_INC_STP EFD_V_PUC_EN EFD_V_NOT_PUC_EN /end DEF_CHARACTERISTIC
 /begin OUT_MEASUREMENT efd_diag_en efd_flw_diag_met efd_diag_dly_actv efd_diag_ext_req efd_eng_conds_met efd_comn_stbl_met efd_stbl_met efd_diag_fn efd_diag_ext_dly efd_vlv_cls_tmr efd_map_log_tmr efd_vlv_opn_tmr efd_en_dly efd_tst_dly efd_map_stbl_dly efd_map_stbl_dly_fn efd_egr_opn_sp efd_min_espd efd_vlv_opn_stp efd_vlv_cls_stp efd_vlv_sp efd_log_fn efd_vlv_ctrl_fn efd_vlv_max_pos efd_vlv_opn_lo efd_max_map efd_min_map efd_max_map_dlt efd_dsr_map_dlt efd_map_dlt_diff efd_tst_rslt_raw efd_pass_cnts efd_mmv_rst_req efd_vlv_sp_fac efd_vlv_sp_fac_bs efd_mmv_req efd_init_ps_cnt efd_base_tst_fn efd_mmv_fn efd_trp_ps_cnt efd_ps_rpt_req efd_base_tst_actv efd_map_diff_mmv efd_fl_thr efd_diag_fl efd_tot_tst_cnt efd_trip_tst_cnt efd_rpt_en /end OUT_MEASUREMENT
/end FUNCTION
/begin FUNCTION cpud "cpu diag"
 /begin DEF_CHARACTERISTIC CPUD_V_EXE_SEQ_FL_INC_CNTS CPUD_V_EXE_SEQ_FL_DEC_DLY CPUD_V_EXE_SEQ_FL_CNTS CPUD_V_AD_RSP_DIAG_INTVL CPUD_V_AD_RSP_EN_VLT_MIN CPUD_V_AD_RSP_EN_VLT_MAX CPUD_V_AD_RSP_EN_PPS_PCT CPUD_V_AD_RSP_GRND_PCT_MAX CPUD_V_AD_RSP_GRND_ACTV_TM CPUD_V_AD_RSP_PPS1_DLT_MAX CPUD_V_AD_RSP_PPS2_DLT_MAX CPUD_V_AD_RSP_INC_CNTS CPUD_V_AD_RSP_DEC_CNTS CPUD_V_AD_RSP_FL_CNTS CPUD_V_AD_RSP_DIAG_CNTS CPUD_V_AD_RSP_PPS2_SHRT_DLT CPUD_V_AD_RSP_RECVR_ACTV_TM CPUD_V_VREF_EN_VLT_MIN CPUD_V_VREF1_HI_THR CPUD_V_VREF1_LO_THR CPUD_V_VREF2_HI_THR CPUD_V_VREF2_LO_THR CPUD_V_VREF3_HI_THR CPUD_V_VREF3_LO_THR CPUD_V_VREF_FL_CNTS_MAX CPUD_V_VREF_PS_CNTS CPUD_V_VREF_FL_CNTS CPUD_V_VREF_FL_INC_CNTS CPUD_V_VREF_FL_DEC_CNTS CPUD_V_CLK_EN_DLY CPUD_V_CLK_FL_CNTS CPUD_V_CLK_DIAG_CNTS CPUD_V_COP_EN_DLY CPUD_V_COP_FL_CNTS CPUD_V_COP_DIAG_CNTS CPUD_V_GPR_EN_DLY CPUD_V_GPR_FL_CNTS CPUD_V_GPR_DIAG_CNTS CPUD_V_ADC_EN_DLY CPUD_V_ADC_FL_CNTS CPUD_V_ADC_DIAG_CNTS CPUD_V_IG_EN_VLT_MIN CPUD_V_IG_EN_VLT_MAX CPUD_V_IG_ESPD_GRD_MIN CPUD_V_IG_ESPD_GRD_MAX CPUD_V_IG_EN_DLY CPUD_V_IG_EN_ANG_DLT CPUD_C_IG_ADV_FL_THR CPUD_C_IG_RTD_FL_THR CPUD_V_IG_FL_CNTS CPUD_V_IG_DIAG_CNTS /end DEF_CHARACTERISTIC
 /begin OUT_MEASUREMENT cpud_ecu_seq_fl_cnt cpud_ecu_seq_err cpud_ecu_seq_fl cpud_ecu_seq_fn cpud_vref1_fl_cnt cpud_vref1_diag_cnt cpud_vref1_diag_en cpud_vref1_fl_met cpud_vref1_fn cpud_vref1_fl cpud_vref1_rpt_st cpud_vref2_fl_cnt cpud_vref2_diag_cnt cpud_vref2_diag_en cpud_vref2_fl_met cpud_vref2_fn cpud_vref2_fl cpud_vref2_rpt_st cpud_vref3_fl_cnt cpud_vref3_diag_cnt cpud_vref3_diag_en cpud_vref3_fl_met cpud_vref3_fn cpud_vref3_fl cpud_vref3_rpt_st cpud_vref1_vlt_pct cpud_vref2_vlt_pct cpud_vref3_vlt_pct cpud_clk_fl_cnt cpud_clk_diag_cnt cpud_clk_diag_en cpud_clk_fl_met cpud_clk_fn cpud_clk_fl cpud_ram_fl cpud_stck_fl cpud_rom_fl cpud_sw_err cpud_cop_fl_cnt cpud_cop_diag_cnt cpud_cop_diag_en cpud_cop_fl_met cpud_cop_fn cpud_cop_fl cpud_gpr_fl_cnt cpud_gpr_diag_cnt cpud_gpr_diag_en cpud_gpr_fl_met cpud_gpr_fn cpud_gpr_fl cpud_adc_fl_cnt cpud_adc_diag_cnt cpud_adc_diag_en cpud_adc_fl_met cpud_adc_fn cpud_adc_fl cpud_ig_espd_grd cpud_ig_en_dly cpud_ig_ang_sp cpud_ig_fl_cnt cpud_ig_diag_cnt cpud_ig_diag_en cpud_ig_fl_met cpud_ig_fn cpud_ig_fl cpud_ig_ang_act cpud_ig_ang_rtd cpud_ig_ang_adv /end OUT_MEASUREMENT
/end FUNCTION
/begin FUNCTION comd "comm diag"
 /begin DEF_CHARACTERISTIC COMD_V_CAN_COM_FL_CNTS COMD_V_CAN_COM_DIAG_CNTS COMD_V_CAN_BUS_OFF_FL_CNTS COMD_V_CAN_BUS_OFF_PS_CNTS COMD_V_CAN_CHK_FL_CNTS COMD_V_CAN_CHK_DIAG_CNTS COMD_V_LIN_COM_FL_CNTS COMD_V_LIN_COM_DIAG_CNTS COMD_V_LIN_ALT_FL_CNTS COMD_V_LIN_ALT_DIAG_CNTS COMD_V_BAT_SNSR_COM_FL_CNTS COMD_V_BAT_SNSR_COM_DIAG_CNTS COMD_V_BAT_SNSR_FL_CNTS COMD_V_BAT_SNSR_DIAG_CNTS /end DEF_CHARACTERISTIC
 /begin OUT_MEASUREMENT /end OUT_MEASUREMENT
/end FUNCTION
/begin FUNCTION service "" /begin OUT_MEASUREMENT srv_ctrl_actv srv_vnt_vlv_st srv_tel_eol_req /end OUT_MEASUREMENT /end FUNCTION
/begin FUNCTION gpf_nv "gpf nv" /begin DEF_CHARACTERISTIC /end DEF_CHARACTERISTIC
 /begin OUT_MEASUREMENT gpf_a1_ofst_nv gpf_soot_ash_std_dp_nv gpf_soot_std_dp_nv gpf_soot_mas_nv /end OUT_MEASUREMENT
/end FUNCTION
/begin FUNCTION gpf_dp "gpf delta pressure"
 /begin DEF_CHARACTERISTIC GPF_V_FORC_DP_MOD_EN GPF_V_DP_EN_DP_MIN GPF_V_DP_EN_FLW_MIN GPF_V_SOOT_MASS_EN_TM GPF_C_MUF_DP GPF_X_MUF_DP GPF_X_EXH_GAS_VISC GPF_C_EXH_GAS_VISC GPF_V_A1_CLN_NRM GPF_V_A2_CLN_NRM GPF_V_SOOT_ASH_DP_FLT GPF_X_SI_FLT GPF_C_SI_FLT GPF_X_SOOT_MASS_A1 GPF_X_SOOT_MASS_SI GPF_M_SOOT_MASS /end DEF_CHARACTERISTIC
 /begin OUT_MEASUREMENT gpf_soot_mas gpf_dp_mod_en gpf_prs_out_esti gpf_prs_in_esti gpf_exh_gas_dyn_visc gpf_exh_gas_dens gpf_exh_flw gpf_a1_cln gpf_a2_cln gpf_dp_cln_trm1 gpf_dp_cln_trm2 gpf_dp_cln gpf_soot_ash_dp gpf_soot_ash_dp_flt gpf_soot_ash_ld gpf_soot_cake_dp gpf_soot_ld /end OUT_MEASUREMENT
/end FUNCTION
/begin FUNCTION gpf_eo "gpf eo"
 /begin DEF_CHARACTERISTIC GPF_V_IN_TEMP_SEL GPF_V_OUT_TEMP_SEL GPF_V_BED_TEMP_SEL GPF_X_CO2_BURN_RT_TEMP GPF_X_CO2_BURN_RT_LMBD GPF_M_CO2_BURN_RT GPF_X_O2_BURN_RT_TEMP GPF_X_O2_BURN_RT_LMBD GPF_M_O2_BURN_RT GPF_V_FUEL_FLW_FLT GPF_X_FUEL_COR_FAC GPF_C_FUEL_COR_FAC GPF_X_CRK_COR_FAC GPF_C_CRK_COR_FAC GPF_X_CAT_LGT_OFF_FAC GPF_C_CAT_LGT_OFF_FAC GPF_V_COR_FAC GPF_X_LMBD_COR_FAC GPF_C_LMBD_COR_FAC /end DEF_CHARACTERISTIC
 /begin OUT_MEASUREMENT gpf_eo_soot_mas gpf_soot_rt_in_temp gpf_soot_rt_out_temp gpf_soot_rt_bed_temp gpf_co2_burn_rt gpf_o2_burn_rt gpf_soot_burn_rt gpf_fuel_flt gpf_fuel_flw_diff gpf_fuel_flw_diff_flt gpf_soot_prdt_rt gpf_test gpf_test_1 gpf_test_2 gpf_test_3 gpf_mdl_rst_req gpf_ash_lrn_req gpf_soot_prdt gpf_soot_burn gpf_soot_mas_dt_hi /end OUT_MEASUREMENT
/end FUNCTION
/begin RECORD_LAYOUT __UBYTE_S FNC_VALUES 1 UBYTE COLUMN_DIR DIRECT /end RECORD_LAYOUT
/begin RECORD_LAYOUT __UWORD_S FNC_VALUES 1 UWORD COLUMN_DIR DIRECT /end RECORD_LAYOUT
/begin RECORD_LAYOUT __ULONG_S FNC_VALUES 1 ULONG COLUMN_DIR DIRECT /end RECORD_LAYOUT
/begin RECORD_LAYOUT __SWORD_S FNC_VALUES 1 SWORD COLUMN_DIR DIRECT /end RECORD_LAYOUT
/begin RECORD_LAYOUT SSV__UWORD_S AXIS_PTS_X 1 UWORD INDEX_INCR DIRECT /end RECORD_LAYOUT
/begin RECORD_LAYOUT SSV__SWORD_S AXIS_PTS_X 1 SWORD INDEX_INCR DIRECT /end RECORD_LAYOUT
/end MODULE
/end PROJECT
