ASAP2_VERSION 1 60
/begin PROJECT FC33 ""
/begin HEADER "" VERSION "1.0" /end HEADER
/begin MODULE FC33 ""
/begin MOD_COMMON "" BYTE_ORDER MSB_FIRST ALIGNMENT_LONG 2 ALIGNMENT_WORD 1 /end MOD_COMMON
/begin MEASUREMENT afm_air_flw "air flow based on time calulated by predict map" UWORD u_g_per_sec 0 0 0.0 511.9921875 ECU_ADDRESS 0x4000DA4E /end MEASUREMENT
/begin MEASUREMENT afm_cyl_flw "cylinder flow based on time" UWORD u_g_per_sec 0 0 0.0 511.9921875 ECU_ADDRESS 0x4000DA4E /end MEASUREMENT
/begin MEASUREMENT afm_egr_flw "EGR flow to manifold" UWORD u_g_per_sec_64 0 0 0.0 63.9990234375 ECU_ADDRESS 0x4000DA4E /end MEASUREMENT
/begin MEASUREMENT afm_exh_flw "exhaust flow" UWORD u_g_per_sec 0 0 0.0 511.9921875 ECU_ADDRESS 0x4000DA4E /end MEASUREMENT
/begin MEASUREMENT afm_cp_flw "purge flow to manifold" UWORD u_g_per_sec_64 0 0 0.0 63.9990234375 ECU_ADDRESS 0x4000DA4E /end MEASUREMENT
/begin MEASUREMENT afm_tps_flw "throttle flow to manifold" UWORD u_g_per_sec_1024 0 0 0.0 1023.984375 ECU_ADDRESS 0x4000DA4E /end MEASUREMENT
/begin MEASUREMENT afm_im_flw "air flow based on time" SWORD u_g_per_sec_s 0 0 -512 511.984375 ECU_ADDRESS 0x4000DA4E /end MEASUREMENT
/begin MEASUREMENT afm_frsh_air_flw "fresh airflow of intakeport" UWORD u_g_per_sec 0 0 0.0 511.9921875 ECU_ADDRESS 0x4000DA4E /end MEASUREMENT
/begin MEASUREMENT afm_pred_prt_flw "predict airflow of intakeport" UWORD u_g_per_sec 0 0 0.0 511.9921875 ECU_ADDRESS 0x4000DA4E /end MEASUREMENT
/begin MEASUREMENT afm_pred_frsh_air_flw "fresh airflow of intakeport" UWORD u_g_per_sec 0 0 0.0 511.9921875 ECU_ADDRESS 0x4000DA4E /end MEASUREMENT
/begin MEASUREMENT afm_stk_flw "air flow based on stroke" UWORD u_stk_flw 0 0 0.0 1.99996948242187 ECU_ADDRESS 0x4000DA4E /end MEASUREMENT
/begin MEASUREMENT afm_exh_to_map_fac "exhaust press to map factor" UWORD u_fac_16 0 0 0.0 15.999756 ECU_ADDRESS 0x4000DA4E FORMAT "%5.2" /end MEASUREMENT
/begin MEASUREMENT afm_exh_prt_t "exhaust port temp" UWORD u_deg_K 0 0 0.0 2047.96875 ECU_ADDRESS 0x4000DA4E FORMAT "%5.1" /end MEASUREMENT
/begin MEASUREMENT afm_exh_mnfd_t "exhaust manifold temp" UWORD u_deg_K 0 0 0.0 2047.96875 ECU_ADDRESS 0x4000DA4E FORMAT "%5.1" /end MEASUREMENT
/begin MEASUREMENT afm_exh_t_ig_bias "exhaust port temp bias of ignition retard" UWORD u_deg_K 0 0 0.0 2047.96875 ECU_ADDRESS 0x4000DA4E FORMAT "%5.1" /end MEASUREMENT
/begin MEASUREMENT afm_exh_t_af_cool "exhaust port temp airfuel cool term" SWORD u_deg_K_s 0 0 -2048 2047.9375 ECU_ADDRESS 0x4000DA4E FORMAT "%5.1" /end MEASUREMENT
/begin MEASUREMENT afm_exh_t_egr_cool "exhaust port temp egr cool term" UWORD u_deg_K 0 0 0.0 2047.96875 ECU_ADDRESS 0x4000DA4E FORMAT "%5.1" /end MEASUREMENT
/begin MEASUREMENT afm_exh_t_vspd_cool "exhaust port temp vehicle speed cool term" SWORD u_deg_K_s 0 0 -2048 2047.9375 ECU_ADDRESS 0x4000DA4E FORMAT "%5.1" /end MEASUREMENT
/begin MEASUREMENT afm_thro_t "throttle inlet temp" UWORD u_deg_K 0 0 0.0 2047.96875 ECU_ADDRESS 0x4000DA4E FORMAT "%5.1" /end MEASUREMENT
/begin MEASUREMENT afm_intk_mnfd_t "intake manifold temp" UWORD u_deg_K 0 0 0.0 2047.96875 ECU_ADDRESS 0x4000DA4E FORMAT "%5.1" /end MEASUREMENT
/begin MEASUREMENT afm_intk_prt_t "intake port temp" UWORD u_deg_K 0 0 0.0 2047.96875 ECU_ADDRESS 0x4000DA4E FORMAT "%5.1" /end MEASUREMENT
/begin MEASUREMENT afm_intk_prt_t_c "intake port temp" SWORD u_deg_C 0 0 -256 255.9921875 ECU_ADDRESS 0x4000DA4E /end MEASUREMENT
/begin MEASUREMENT afm_egr_pct "egr percentage" UWORD u_pct 0 0 0.0 199.996948242187 ECU_ADDRESS 0x4000DA4E /end MEASUREMENT
/begin MEASUREMENT afm_exh_p_area_fac "exhaust press area factor" UWORD u_fac_2 0 0 0.0 1.999969482421875 ECU_ADDRESS 0x4000DA4E FORMAT "%4.3" /end MEASUREMENT
/begin MEASUREMENT afm_stk_flw_pct "stroke flow percent" UWORD u_pct_8 0 0 0.0 799.98779296875 ECU_ADDRESS 0x4000DA4E FORMAT "%4.3" /end MEASUREMENT
/begin MEASUREMENT afm_ve "ve" UWORD u_pct 0 0 0.0 199.996948242187 ECU_ADDRESS 0x4000DA4E /end MEASUREMENT
/begin MEASUREMENT afm_mdl_map "modle map" UWORD u_kPa_0_256 0 0 0.0 255.99609375 ECU_ADDRESS 0x4000DA4E /end MEASUREMENT
/begin MEASUREMENT afm_mmap_max "modle map max" UWORD u_kPa_0_256 0 0 0.0 255.99609375 ECU_ADDRESS 0x4000DA4E /end MEASUREMENT
/begin MEASUREMENT afm_mmap_raw "modle map raw" UWORD u_kPa_0_256 0 0 0.0 255.99609375 ECU_ADDRESS 0x4000DA4E /end MEASUREMENT
/begin MEASUREMENT afm_mmap_lst "modle map last loop" UWORD u_kPa_0_256 0 0 0.0 255.99609375 ECU_ADDRESS 0x4000DA4E /end MEASUREMENT
/begin MEASUREMENT afm_mmap_d "Derivative term used in model map calculation" SWORD u_kPaSec 0 0 -4096 4095.875 ECU_ADDRESS 0x4000DA4E FORMAT "%6.2" /end MEASUREMENT
/begin MEASUREMENT afm_mmap_d_bs "model map derivative calculation base " SWORD u_kPaSec 0 0 -4096 4095.875 ECU_ADDRESS 0x4000DA4E FORMAT "%6.2" /end MEASUREMENT
/begin MEASUREMENT afm_mmap_dlt "delta between model map and map sensor" SWORD u_kPa_256n_256p 0 0 -256 255.9921875 ECU_ADDRESS 0x4000DA4E /end MEASUREMENT
/begin MEASUREMENT afm_mmap_d_p "model map derivative calculation proportional term" SWORD u_kPaSec 0 0 -4096 4095.875 ECU_ADDRESS 0x4000DA4E FORMAT "%6.2" /end MEASUREMENT
/begin MEASUREMENT afm_mmap_d_i "model map derivative calculation integral term" SWORD u_kPaSec 0 0 -4096 4095.875 ECU_ADDRESS 0x4000DA4E FORMAT "%6.2" /end MEASUREMENT
/begin MEASUREMENT afm_mmap_sum_adp_nv "model map adaptive value" SWORD u_kPaSec_b 0 0 -128 127.99609375 ARRAY_SIZE 17 ECU_ADDRESS 0x4000DA4E FORMAT "%6.2" /end MEASUREMENT
/begin MEASUREMENT afm_exh_press "modle exh press" UWORD u_kPa_0_512 0 0 0.0 511.9921875 ECU_ADDRESS 0x4000DA4E /end MEASUREMENT
/begin MEASUREMENT afm_pred_map "predict modle map" UWORD u_kPa_0_256 0 0 0.0 255.99609375 ECU_ADDRESS 0x4000DA4E /end MEASUREMENT
/begin MEASUREMENT afm_ar_eff "throttle effective area" UWORD u_fac_2 0 0 0.0 1.999969482421875 ECU_ADDRESS 0x4000DA4E FORMAT "%5.4" /end MEASUREMENT
/begin MEASUREMENT afm_amp_flw_scld_rt "scaled flow ratio" UWORD u_fac_2 0 0 0.0 1.999969482421875 ECU_ADDRESS 0x4000DA4E FORMAT "%5.4" /end MEASUREMENT
/begin MEASUREMENT afm_air_flw_sum "air flow sum" ULONG u_gram_l 0 0 0.0 33554431.99 ECU_ADDRESS 0x4000DA4E /end MEASUREMENT
/begin MEASUREMENT afm_intk_vlv_t "intake valve temp" UWORD u_deg_K_512 0 0 0.0 511.9921875 ECU_ADDRESS 0x4000DA4E FORMAT "%4.1" /end MEASUREMENT
/begin MEASUREMENT afm_intk_vlv_t_raw "intake valve temp" UWORD u_deg_K_512 0 0 0.0 511.9921875 ECU_ADDRESS 0x4000DA4E FORMAT "%4.1" /end MEASUREMENT
/begin MEASUREMENT afm_cat_temp "CAT temp" UWORD u_deg_K 0 0 0.0 2047.96875 ECU_ADDRESS 0x4000DA4E FORMAT "%5.1" /end MEASUREMENT
/begin MEASUREMENT afm_egr_t_in "EGR inlet temp" UWORD u_deg_K 0 0 0.0 2047.96875 ECU_ADDRESS 0x4000DA4E FORMAT "%5.1" /end MEASUREMENT
/begin MEASUREMENT afm_iat "intake air temp" UWORD u_deg_K 0 0 0.0 2047.96875 ECU_ADDRESS 0x4000DA4E FORMAT "%5.1" /end MEASUREMENT
/begin MEASUREMENT afm_amb_t_nv "ambient temp" SWORD u_deg_C 0 0 -256 255.9921875 ECU_ADDRESS 0x4000DA4E FORMAT "%5.1" /end MEASUREMENT
/begin MEASUREMENT afm_ect "engine coolant temp, unit:K" UWORD u_deg_K 0 0 0.0 2047.96875 ECU_ADDRESS 0x4000DA4E FORMAT "%5.1" /end MEASUREMENT
/begin MEASUREMENT afm_egr_t_out "EGR outlet temp" UWORD u_deg_K 0 0 0.0 2047.96875 ECU_ADDRESS 0x4000DA4E FORMAT "%5.1" /end MEASUREMENT
/begin MEASUREMENT afm_exh_prt_t_egr_bias "EGR bias of exhaust port temp calculation" UWORD u_deg_K 0 0 0.0 2047.96875 ECU_ADDRESS 0x4000DA4E FORMAT "%5.1" /end MEASUREMENT
/begin MEASUREMENT afm_egr_p_in "EGR inlet pressure" UWORD u_kPa_0_512 0 0 0.0 511.9921875 ECU_ADDRESS 0x4000DA4E /end MEASUREMENT
/begin MEASUREMENT afm_egr_cooler_p_dlt "filtered delta pressure across EGR cooler" UWORD u_kPa_0_128 0 0 0.0 127.998046875 ECU_ADDRESS 0x40003278 /end MEASUREMENT
/begin MEASUREMENT afm_cat_p_out "outlet pressure of CAT" UWORD u_kPa_0_512 0 0 0.0 511.9921875 ECU_ADDRESS 0x40003278 /end MEASUREMENT
/begin MEASUREMENT afm_ld_pct_flw "engine load percent based on airflow gram per sec" UWORD u_pct_1 0 0 0.0 99.9984741210937 ECU_ADDRESS 0x4000DA4E FORMAT "%4.2" /end MEASUREMENT
/begin MEASUREMENT afm_intcl_out_t "Intercooler out temperature." SWORD u_deg_C 0 0 -256 255.9921875 ECU_ADDRESS 0x40004EBC /end MEASUREMENT
/begin MEASUREMENT afm_bstp2amp_rt "boost press to amp ratio" UWORD u_fac_8 0 0 0.0 7.9998779296875 ECU_ADDRESS 0x4000DA4E FORMAT "%5.4" /end MEASUREMENT
/begin MEASUREMENT afm_intcl_p_dwn_pre "pre intercooler pressure down." UWORD u_kPa_0_128 0 0 0.0 127.998046875 ECU_ADDRESS 0x4000440A FORMAT "%4.1" /end MEASUREMENT
/begin MEASUREMENT afm_intcl_p_dwn_pst "post intercooler pressure down." UWORD u_kPa_0_128 0 0 0.0 127.998046875 ECU_ADDRESS 0x4000440A FORMAT "%4.1" /end MEASUREMENT
/begin MEASUREMENT afm_intcl_p_dwn "intercooler pressure down." UWORD u_kPa_0_128 0 0 0.0 127.998046875 ECU_ADDRESS 0x4000440A FORMAT "%4.1" /end MEASUREMENT
/begin MEASUREMENT afm_cmpr_out_p "compressor out pressure." UWORD u_kPa_0_512 0 0 0.0 511.9921875 ECU_ADDRESS 0x4000440A /end MEASUREMENT
/begin MEASUREMENT afm_std_flw "Modeled compressor volume flow at standard conditions." UWORD u_m3_per_s 0 0 0 3.99993896484375 ECU_ADDRESS 0x400050DA /end MEASUREMENT
/begin MEASUREMENT afm_fiter_out_p "air filter out pressure." UWORD u_kPa_0_128 0 0 0.0 127.998046875 ECU_ADDRESS 0x4000440A FORMAT "%4.1" /end MEASUREMENT
/begin MEASUREMENT afm_stk_flw_pct_vir "estimated air flow percent based on stroke." UWORD u_pct_8 0 0 0.0 799.98779296875 ECU_ADDRESS 0x4000DA4E FORMAT "%5.4" /end MEASUREMENT
/begin MEASUREMENT afm_thro_flw_adp "adaption standard throttle flow value" ULONG u_g_per_sec_1024_l 0 0 0.0 1023.9999997615814208984375 ARRAY_SIZE 21 ECU_ADDRESS 0x4000DA4E SYMBOL_LINK "afm_thro_flw_adp" 4 /end MEASUREMENT
/begin MEASUREMENT afm_pr_map2purg "Pressure ratio of manifold pressure to purge pressure." UWORD u_fac_2 0 0 0.0 1.999969482421875 ECU_ADDRESS 0x4000DA4E FORMAT "%4.3" /end MEASUREMENT
/begin MEASUREMENT afm_mdl_map_ss "model map steady state" UBYTE b_true 0 0 0.0 1.0 ECU_ADDRESS 0x4000DA4E FORMAT "%1.0" /end MEASUREMENT
/begin MEASUREMENT afm_mdl_map_mmv "model map mmv" UWORD u_kPa_0_256 0 0 0 255.99609375 ECU_ADDRESS 0x400050DA /end MEASUREMENT
/begin MEASUREMENT afm_exh_pipe_t "exhaust pipe temp" UWORD u_deg_K 0 0 0.0 2047.96875 ECU_ADDRESS 0x4000DA4E FORMAT "%5.1" /end MEASUREMENT
/begin MEASUREMENT etcs_thr_pq_lmt "throttle pressure quotient limit." UWORD u_fac_2 0 0 0.0 1.999969482421875 ECU_ADDRESS 0x4000440A FORMAT "%4.3" /end MEASUREMENT
/begin MEASUREMENT etcs_map_sp "manifold absolute pressure setpoint from etcs module." UWORD u_kPa_0_256 0 0 0.0 255.99609375 ECU_ADDRESS 0x4000440A /end MEASUREMENT
/begin MEASUREMENT etcs_thro_flw_sp "throttle air flow setpoint." UWORD u_g_per_sec 0 0 0 511.9921875 ECU_ADDRESS 0x40004EA0 /end MEASUREMENT
/begin MEASUREMENT etcs_thro_pos_sp "etcs throttle position setpoint." UWORD u_pct_r 0 0 0.00 127.998046875 ECU_ADDRESS 0x400050DA /end MEASUREMENT
/begin MEASUREMENT etcs_thr_pq "throttle pressure quotient." UWORD u_fac_2 0 0 0.0 1.999969482421875 ECU_ADDRESS 0x4000440A FORMAT "%4.3" /end MEASUREMENT
/begin MEASUREMENT etcs_thro_pq_lmt_sp "Limited throttle pressure quotient setpoint." UWORD u_fac_2 0 0 0.0 1.999969482421875 ECU_ADDRESS 0x4000440A FORMAT "%4.3" /end MEASUREMENT
/begin MEASUREMENT fmsp_af_sp "air fuel ratio setpoint" UWORD u_afr 0 0 0.0 31.99951171875 ECU_ADDRESS 0x4000DA4E /end MEASUREMENT
/begin MEASUREMENT fmsp_uo2_rdy "up o2 ready" UBYTE b_true 0 0 0.00 1.00 BIT_MASK 0x1 ECU_ADDRESS 0x400050DA FORMAT "%1.0" /end MEASUREMENT
/begin MEASUREMENT fmsp_do2_rdy "down o2 ready" UBYTE b_true 0 0 0.00 1.00 BIT_MASK 0x1 ECU_ADDRESS 0x400050DA FORMAT "%1.0" /end MEASUREMENT
/begin MEASUREMENT fmsp_cl_diag_fl "diag fail flag used in close loop enable check" UBYTE b_true 0 0 0.00 1.00 BIT_MASK 0x1 ECU_ADDRESS 0x400050DA FORMAT "%1.0" /end MEASUREMENT
/begin MEASUREMENT fmsp_cl_en "fuel closed loop control enable" UBYTE b_true 0 0 0.00 1.00 BIT_MASK 0x1 ECU_ADDRESS 0x400050DA FORMAT "%1.0" /end MEASUREMENT
/begin MEASUREMENT fmsp_cl_fac "fuel closed loop factor" UWORD u_fac_2 0 0 0 1.999969482421875 ECU_ADDRESS 0x4000DA4E /end MEASUREMENT
/begin MEASUREMENT fmsp_cl_fac_avg "fuel closed loop factor average" UWORD u_fac_2 0 0 0 1.999969482421875 ECU_ADDRESS 0x4000DA4E /end MEASUREMENT
/begin MEASUREMENT fmsp_pow_afr_en "fuel power arf enable" UBYTE b_true 0 0 0.00 1.00 BIT_MASK 0x1 ECU_ADDRESS 0x400050DA FORMAT "%1.0" /end MEASUREMENT
/begin MEASUREMENT fmsp_pw_cyl "actual pulse width" UWORD u_millisec 0 0 0.0 1023.984375 ARRAY_SIZE 4 ECU_ADDRESS 0x4000DA4E FORMAT "%3.2" /end MEASUREMENT
/begin MEASUREMENT fmsp_pw_fnl "final pulse width" UWORD u_millisec 0 0 0.0 1023.984375 ARRAY_SIZE 4 ECU_ADDRESS 0x4000DA4E FORMAT "%3.2" /end MEASUREMENT
/begin MEASUREMENT fmsp_pw_vlt "pulse width voltage corrected" UWORD u_millisec 0 0 0.0 1023.984375 ARRAY_SIZE 4 ECU_ADDRESS 0x4000DA4E FORMAT "%3.2" /end MEASUREMENT
/begin MEASUREMENT fmsp_pw_cl "pulse close loop corrected" UWORD u_millisec 0 0 0.0 1023.984375 ARRAY_SIZE 4 ECU_ADDRESS 0x4000DA4E FORMAT "%3.2" /end MEASUREMENT
/begin MEASUREMENT fmsp_pw_adp "pulse adaption corrected" UWORD u_millisec 0 0 0.0 1023.984375 ARRAY_SIZE 4 ECU_ADDRESS 0x4000DA4E FORMAT "%3.2" /end MEASUREMENT
/begin MEASUREMENT fmsp_pw_raw "raw pulse width" UWORD u_millisec 0 0 0.0 1023.984375 ARRAY_SIZE 4 ECU_ADDRESS 0x4000DA4E FORMAT "%3.2" /end MEASUREMENT
/begin MEASUREMENT fmsp_stk_fnl "final stroke fuel quantity" UWORD u_stk_flw 0 0 0.0 1.99996948242187 ARRAY_SIZE 4 ECU_ADDRESS 0x4000DA4E FORMAT "%4.3" /end MEASUREMENT
/begin MEASUREMENT fmsp_stk_cyl_cor "cylinder correction stroke fuel quantity" UWORD u_stk_flw 0 0 0.0 1.99996948242187 ARRAY_SIZE 4 ECU_ADDRESS 0x4000DA4E FORMAT "%4.3" /end MEASUREMENT
/begin MEASUREMENT fmsp_stk_tq "torq request stroke fuel quantity" UWORD u_stk_flw 0 0 0.0 1.99996948242187 ARRAY_SIZE 4 ECU_ADDRESS 0x4000DA4E FORMAT "%4.3" /end MEASUREMENT
/begin MEASUREMENT fmsp_stk_fco "fuel cut off request stroke fuel quantity" UWORD u_stk_flw 0 0 0.0 1.99996948242187 ARRAY_SIZE 4 ECU_ADDRESS 0x4000DA4E FORMAT "%4.3" /end MEASUREMENT
/begin MEASUREMENT fmsp_stk_raw "raw stroke fuel quantity" UWORD u_stk_flw 0 0 0.0 1.99996948242187 ECU_ADDRESS 0x4000DA4E FORMAT "%4.3" /end MEASUREMENT
/begin MEASUREMENT fmsp_stk_sp "stroke fuel quantity setpoint" UWORD u_stk_flw 0 0 0.0 1.99996948242187 ECU_ADDRESS 0x4000DA4E FORMAT "%4.3" /end MEASUREMENT
/begin MEASUREMENT fmsp_pw_unlmt "final pulse width unlimit" UWORD u_millisec 0 0 0.0 1023.984375 ECU_ADDRESS 0x4000DA4E FORMAT "%3.2" /end MEASUREMENT
/begin MEASUREMENT fmsp_prm_pw "prime pulse width" UWORD u_millisec 0 0 0.0 1023.984375 ECU_ADDRESS 0x4000DA4E FORMAT "%3.2" /end MEASUREMENT
/begin MEASUREMENT fmsp_inj_bias "injector bias" UWORD u_millisec 0 0 0.0 1023.984375 ECU_ADDRESS 0x4000DA4E FORMAT "%3.2" /end MEASUREMENT
/begin MEASUREMENT fmsp_pow_dly "power enable delay" UWORD u_2x_tmr 0 0 0.0 1023.984375 ECU_ADDRESS 0x4000DA4E SYMBOL_LINK "fmsp_pow_dly" 4 /end MEASUREMENT
/begin MEASUREMENT fmsp_tq_af_dur "power enable delay" UWORD u_2x_tmr 0 0 0.0 1023.984375 ECU_ADDRESS 0x4000DA4E SYMBOL_LINK "fmsp_tq_af_dur" 74 /end MEASUREMENT
/begin MEASUREMENT fmsp_fuel_st "fuel control state" UBYTE u_fm_st 0 0 0.0 2 ECU_ADDRESS 0x4000DA4E FORMAT "%1.0" /end MEASUREMENT
/begin MEASUREMENT fmsp_adp_cp_ctrl "force control of purge for fuel adaption" UBYTE b_true 0 0 0.00 1.00 BIT_MASK 0x1 ECU_ADDRESS 0x400050DA FORMAT "%1.0" /end MEASUREMENT
/begin MEASUREMENT fmsp_adp_cp_indx "adaption purge control index" UWORD u_pct 0 0 0.0 199.996948242187 ECU_ADDRESS 0x4000DA4E FORMAT "%6.2" /end MEASUREMENT
/begin MEASUREMENT fmsp_bs_st_af "base start air fuel ratio setpoint" UWORD u_afr 0 0 0.0 31.99951171875 ECU_ADDRESS 0x4000DA4E /end MEASUREMENT
/begin MEASUREMENT fmsp_st_af "start air fuel ratio setpoint" UWORD u_afr 0 0 0.0 31.99951171875 ECU_ADDRESS 0x4000DA4E /end MEASUREMENT
/begin MEASUREMENT fmsp_st2run_af_dlt "start to run af delta" UWORD u_afr 0 0 0.0 31.99951171875 ECU_ADDRESS 0x4000DA4E /end MEASUREMENT
/begin MEASUREMENT fmsp_off_run_af_bias_nv "off run af bias" UWORD u_afr 0 0 0.0 31.99951171875 ECU_ADDRESS 0x4000DA4E /end MEASUREMENT
/begin MEASUREMENT fmsp_clr_afr_en "clear flood arf enable" UBYTE b_true 0 0 0.00 1.00 BIT_MASK 0x1 ECU_ADDRESS 0x400050DA FORMAT "%1.0" /end MEASUREMENT
/begin MEASUREMENT fmsp_cld_restrt "cold restart active" UBYTE b_true 0 0 0.00 1.00 BIT_MASK 0x1 ECU_ADDRESS 0x400050DA FORMAT "%1.0" /end MEASUREMENT
/begin MEASUREMENT fmsp_off_af_nv "power off af last trip" UWORD u_afr 0 0 0.0 31.99951171875 ECU_ADDRESS 0x4000DA4E /end MEASUREMENT
/begin MEASUREMENT fmsp_run_af_bias_nv "power off af bias last trip" UWORD u_afr 0 0 0.0 31.99951171875 ECU_ADDRESS 0x4000DA4E /end MEASUREMENT
/begin MEASUREMENT fmsp_hot_restrt "clear flood arf enable" UBYTE b_true 0 0 0.00 1.00 BIT_MASK 0x1 ECU_ADDRESS 0x400050DA FORMAT "%1.0" /end MEASUREMENT
/begin MEASUREMENT fmsp_hot_offt_sum "hot off time sum" UWORD u_min 0 0 0.0 65535 ECU_ADDRESS 0x4000DA4E /end MEASUREMENT
/begin MEASUREMENT fmsp_st_af_bias "start af bias" UWORD u_afr 0 0 0.0 31.99951171875 ECU_ADDRESS 0x4000DA4E /end MEASUREMENT
/begin MEASUREMENT fmsp_run_af_bs "run af base" UWORD u_afr 0 0 0.0 31.99951171875 ECU_ADDRESS 0x4000DA4E /end MEASUREMENT
/begin MEASUREMENT fmsp_stch_af "stoich af" UWORD u_afr 0 0 0.0 31.99951171875 ECU_ADDRESS 0x4000DA4E /end MEASUREMENT
/begin MEASUREMENT fmsp_run_af "open run af" UWORD u_afr 0 0 0.0 31.99951171875 ECU_ADDRESS 0x4000DA4E /end MEASUREMENT
/begin MEASUREMENT fmsp_st2run_af "run af base" UWORD u_afr 0 0 0.0 31.99951171875 ECU_ADDRESS 0x4000DA4E /end MEASUREMENT
/begin MEASUREMENT fmsp_adp_area "fuel adaption area" UBYTE u_cnts 0 0 0.00 255.00 ECU_ADDRESS 0x400050DA /end MEASUREMENT
/begin MEASUREMENT fmsp_adp_scp "fuel adaption scope" UBYTE u_adp_scp 0 0 0.00 2.00 ECU_ADDRESS 0x400050DA FORMAT "%3.0" /end MEASUREMENT
/begin MEASUREMENT fmsp_inj_actv_cnts "injection active counts" UBYTE u_cnts 0 0 0.00 4.00 ECU_ADDRESS 0x400050DA /end MEASUREMENT
/begin MEASUREMENT fmsp_cat_prot_af "cat protect af" UWORD u_afr 0 0 0.0 31.99951171875 ECU_ADDRESS 0x4000DA4E /end MEASUREMENT
/begin MEASUREMENT fmsp_eng_prot_en "engine overheat protect enable" UBYTE b_true 0 0 0.00 1.00 BIT_MASK 0x1 ECU_ADDRESS 0x400050DA FORMAT "%1.0" /end MEASUREMENT
/begin MEASUREMENT fmsp_tq_af_en "torq af control enable" UBYTE b_true 0 0 0.00 1.00 BIT_MASK 0x1 ECU_ADDRESS 0x400050DA FORMAT "%1.0" /end MEASUREMENT
/begin MEASUREMENT fmsp_stch_af_en "stioch af control enable" UBYTE b_true 0 0 0.00 1.00 BIT_MASK 0x1 ECU_ADDRESS 0x400050DA FORMAT "%1.0" /end MEASUREMENT
/begin MEASUREMENT fmsp_osc_af_actv "osc recover af control enable" UBYTE b_true 0 0 0.00 1.00 BIT_MASK 0x1 ECU_ADDRESS 0x400050DA FORMAT "%1.0" /end MEASUREMENT
/begin MEASUREMENT fmsp_gr_in_af_st "gear in transient af state" UBYTE u_af_trs_st 0 0 0.00 3.00 ECU_ADDRESS 0x400050DA FORMAT "%1.0" /end MEASUREMENT
/begin MEASUREMENT fmsp_ac_in_af_st "ac on transient af state" UBYTE u_af_trs_st 0 0 0.00 3.00 ECU_ADDRESS 0x400050DA FORMAT "%1.0" /end MEASUREMENT
/begin MEASUREMENT fmsp_gr_in_af_fac "gear in transient af factor" UWORD u_fac_1 0 0 0.0 0.999984741210937 ECU_ADDRESS 0x4000DA4E /end MEASUREMENT
/begin MEASUREMENT fmsp_ac_af_fac "ac on transient af factor" UWORD u_fac_1 0 0 0.0 0.999984741210937 ECU_ADDRESS 0x4000DA4E /end MEASUREMENT
/begin MEASUREMENT fmsp_af_rmp_stp "final af ramp step" UWORD u_afr 0 0 0.0 31.99951171875 ECU_ADDRESS 0x4000DA4E /end MEASUREMENT
/begin MEASUREMENT fmsp_osc_af_bias "af bias for osc recover" UWORD u_afr 0 0 0.0 31.99951171875 ECU_ADDRESS 0x4000DA4E /end MEASUREMENT
/begin MEASUREMENT fmsp_pw_port_t_fac "Factor to final pulse width to model the effect of the charge temperature." UWORD u_fac_2 0 0 0 1.999969482421875 ECU_ADDRESS 0x4000DA4E FORMAT "%4.3" /end MEASUREMENT
/begin MEASUREMENT fmsp_adp "fuel adaption value" UWORD u_fac_2 0 0 0 1.999969482421875 ECU_ADDRESS 0x4000DA4E FORMAT "%4.3" /end MEASUREMENT
/begin MEASUREMENT fmsp_adp_nv "fuel adaption value" UWORD u_fac_2 0 0 0 1.999969482421875 ARRAY_SIZE 26 ECU_ADDRESS 0x4000DA4E FORMAT "%4.3" /end MEASUREMENT
/begin MEASUREMENT fmsp_adp_chg_actv "fuel adaption change active" UBYTE b_true 0 0 0.00 1.00 BIT_MASK 0x1 ECU_ADDRESS 0x400050DA FORMAT "%1.0" /end MEASUREMENT
/begin MEASUREMENT fmsp_adp_chg_met "fuel adaption change conditions met" UBYTE b_true 0 0 0.00 1.00 BIT_MASK 0x1 ECU_ADDRESS 0x400050DA FORMAT "%1.0" /end MEASUREMENT
/begin MEASUREMENT fmsp_adp_uo2_err1 "fuel adaption error cond1" UBYTE b_true 0 0 0.00 1.00 BIT_MASK 0x1 ECU_ADDRESS 0x400050DA FORMAT "%1.0" /end MEASUREMENT
/begin MEASUREMENT fmsp_adp_chgd "fuel adaption changed" UBYTE b_true 0 0 0.00 1.00 ARRAY_SIZE 26 ECU_ADDRESS 0x400050DA FORMAT "%1.0" /end MEASUREMENT
/begin MEASUREMENT fmsp_adp_uo2_err2 "fuel adaption error cond2" UBYTE b_true 0 0 0.00 1.00 BIT_MASK 0x1 ECU_ADDRESS 0x400050DA FORMAT "%1.0" /end MEASUREMENT
/begin MEASUREMENT fmsp_misf_inj_off "injection off when misfire" UBYTE b_true 0 0 0.00 1.00 BIT_MASK 0x1 ECU_ADDRESS 0x400050DA FORMAT "%1.0" /end MEASUREMENT
/begin MEASUREMENT fmsp_pw_bat_vlt_fac "fuel pulse battery voltage factor" UWORD u_fac_2 0 0 0 1.999969482421875 ECU_ADDRESS 0x4000DA4E FORMAT "%4.3" /end MEASUREMENT
/begin MEASUREMENT fmsp_fwd_gear "forward gear ratio" UBYTE u_fwd_gear 0 0 0.00 7.00 ECU_ADDRESS 0x400050DA FORMAT "%1.0" /end MEASUREMENT
/begin MEASUREMENT fmsp_puc_espd_thr_typ "trailing fuel cut off engine speed thr type" UBYTE u_puc_espd_thr 0 0 0.00 2.00 ECU_ADDRESS 0x400050DA FORMAT "%1.0" /end MEASUREMENT
/begin MEASUREMENT fmsp_puc_en "trailing throttle fuel cut off enable" UBYTE b_true 0 0 0.00 1.00 BIT_MASK 0x1 ECU_ADDRESS 0x400050DA FORMAT "%1.0" /end MEASUREMENT
/begin MEASUREMENT fmsp_puc_met "trailing throttle fuel cut off condtions met" UBYTE b_true 0 0 0.00 1.00 BIT_MASK 0x1 ECU_ADDRESS 0x400050DA FORMAT "%1.0" /end MEASUREMENT
/begin MEASUREMENT fmsp_puc_coast_ext "trailing throttle fuel cut off exit by coast" UBYTE b_true 0 0 0.00 1.00 BIT_MASK 0x1 ECU_ADDRESS 0x400050DA FORMAT "%1.0" /end MEASUREMENT
/begin MEASUREMENT fmsp_puc_map_ext "trailing throttle fuel cut off exit by map" UBYTE b_true 0 0 0.00 1.00 BIT_MASK 0x1 ECU_ADDRESS 0x400050DA FORMAT "%1.0" /end MEASUREMENT
/begin MEASUREMENT fmsp_puc_espd_ext "trailing throttle fuel cut off exit by engine speed" UBYTE b_true 0 0 0.00 1.00 BIT_MASK 0x1 ECU_ADDRESS 0x400050DA FORMAT "%1.0" /end MEASUREMENT
/begin MEASUREMENT fmsp_puc_throt_ext "trailing throttle fuel cut off exit by throttle" UBYTE b_true 0 0 0.00 1.00 BIT_MASK 0x1 ECU_ADDRESS 0x400050DA FORMAT "%1.0" /end MEASUREMENT
/begin MEASUREMENT fmsp_puc_map_met "trailing throttle fuel cut off map conditions met" UBYTE b_true 0 0 0.00 1.00 BIT_MASK 0x1 ECU_ADDRESS 0x400050DA FORMAT "%1.0" /end MEASUREMENT
/begin MEASUREMENT fmsp_puc_espd_met "trailing throttle fuel cut off map conditions met" UBYTE b_true 0 0 0.00 1.00 BIT_MASK 0x1 ECU_ADDRESS 0x400050DA FORMAT "%1.0" /end MEASUREMENT
/begin MEASUREMENT fmsp_puc_throt_met "trailing throttle fuel cut off throttle conditions met" UBYTE b_true 0 0 0.00 1.00 BIT_MASK 0x1 ECU_ADDRESS 0x400050DA FORMAT "%1.0" /end MEASUREMENT
/begin MEASUREMENT fmsp_puc_run_met "trailing throttle fuel cut off runtime met" UBYTE b_true 0 0 0.00 1.00 BIT_MASK 0x1 ECU_ADDRESS 0x400050DA FORMAT "%1.0" /end MEASUREMENT
/begin MEASUREMENT fmsp_puc_hi_vspd_met "trailing throttle fuel cut off high vehicle met" UBYTE b_true 0 0 0.00 1.00 BIT_MASK 0x1 ECU_ADDRESS 0x400050DA FORMAT "%1.0" /end MEASUREMENT
/begin MEASUREMENT fmsp_puc_med_vspd_met "trailing throttle fuel cut off med vehicle met" UBYTE b_true 0 0 0.00 1.00 BIT_MASK 0x1 ECU_ADDRESS 0x400050DA FORMAT "%1.0" /end MEASUREMENT
/begin MEASUREMENT fmsp_puc_prk_met "trailing throttle fuel cut off med vehicle met" UBYTE b_true 0 0 0.00 1.00 BIT_MASK 0x1 ECU_ADDRESS 0x400050DA FORMAT "%1.0" /end MEASUREMENT
/begin MEASUREMENT fmsp_puc_on_dur "puc on duration" UWORD u_2x_tmr 0 0 0 1023.984375 ECU_ADDRESS 0x4000DA4E SYMBOL_LINK "fmsp_puc_on_dur" 8 /end MEASUREMENT
/begin MEASUREMENT fmsp_puc_off_dur "puc off duration" UWORD u_2x_tmr 0 0 0 1023.984375 ECU_ADDRESS 0x4000DA4E SYMBOL_LINK "fmsp_puc_off_dur" 6 /end MEASUREMENT
/begin MEASUREMENT fmsp_fco_clr_en "clear flood fuel cut off enable" UBYTE b_true 0 0 0.00 1.00 BIT_MASK 0x1 ECU_ADDRESS 0x400050DA FORMAT "%1.0" /end MEASUREMENT
/begin MEASUREMENT fmsp_fco_espd_hi "engine speed high fuel cut off enable" UBYTE b_true 0 0 0.00 1.00 BIT_MASK 0x1 ECU_ADDRESS 0x400050DA FORMAT "%1.0" /end MEASUREMENT
/begin MEASUREMENT fmsp_fco_vspd_hi "vehicle speed high fuel cut off enable" UBYTE b_true 0 0 0.00 1.00 BIT_MASK 0x1 ECU_ADDRESS 0x400050DA FORMAT "%1.0" /end MEASUREMENT
/begin MEASUREMENT fmsp_fco_pn_espd_hi "engine speed high fuel cut off enable,pn" UBYTE b_true 0 0 0.00 1.00 BIT_MASK 0x1 ECU_ADDRESS 0x400050DA FORMAT "%1.0" /end MEASUREMENT
/begin MEASUREMENT fmsp_fco_etc_en "etc engine speed fuel cut off enable" UBYTE b_true 0 0 0.00 1.00 BIT_MASK 0x1 ECU_ADDRESS 0x400050DA FORMAT "%1.0" /end MEASUREMENT
/begin MEASUREMENT fmsp_fco_st "etc engine speed fuel cut off enable" UBYTE u_fco_st 0 0 0.00 3.00 ECU_ADDRESS 0x400050DA FORMAT "%1.0" /end MEASUREMENT
/begin MEASUREMENT fmsp_fco_ext_ref "fuel cut off exit ref counts" UBYTE u_cnts 0 0 0.00 255.00 ECU_ADDRESS 0x400050DA FORMAT "%1.0" /end MEASUREMENT
/begin MEASUREMENT fmsp_fco_actv_ref "fuel cut off active ref counts" UBYTE u_cnts 0 0 0.00 255.00 ECU_ADDRESS 0x400050DA FORMAT "%1.0" /end MEASUREMENT
/begin MEASUREMENT fmsp_osc_fuel_sp "osc af fuel setpoint" UWORD u_gram_4 0 0 0.0 3.99993896484375 ECU_ADDRESS 0x4000DA4E /end MEASUREMENT
/begin MEASUREMENT fmsp_osc_af_en "osc af enable" UBYTE b_true 0 0 0.00 1.00 BIT_MASK 0x1 ECU_ADDRESS 0x400050DA FORMAT "%1.0" /end MEASUREMENT
/begin MEASUREMENT fmsp_osc_af_fn "osc af enable" UBYTE b_true 0 0 0.00 1.00 BIT_MASK 0x1 ECU_ADDRESS 0x400050DA FORMAT "%1.0" /end MEASUREMENT
/begin MEASUREMENT fmsp_osc_quality "osc o2 quality" UWORD u_gram_4 0 0 0.0 3.99993896484375 ECU_ADDRESS 0x4000DA4E /end MEASUREMENT
/begin MEASUREMENT fmsp_do2_rt "osc do2 ratio" UWORD u_fac_2 0 0 0.0 1.999969482421875 ECU_ADDRESS 0x4000DA4E FORMAT "%4.3" /end MEASUREMENT
/begin MEASUREMENT fmsp_turb_prot_en "turb protect af enable" UBYTE b_true 0 0 0.00 1.00 BIT_MASK 0x1 ECU_ADDRESS 0x400050DA FORMAT "%1.0" /end MEASUREMENT
/begin MEASUREMENT fmsp_puc_on "fuel cutoff on." UBYTE b_true 0 0 0.00 1.00 BIT_MASK 0x1 ECU_ADDRESS 0x400050DA FORMAT "%1.0" /end MEASUREMENT
/begin MEASUREMENT fmsp_cl_actv "fuel close loop active." UBYTE b_true 0 0 0.00 1.00 BIT_MASK 0x1 ECU_ADDRESS 0x400050DA FORMAT "%1.0" /end MEASUREMENT
/begin MEASUREMENT fmsp_puc_rch_met "fuel cut off rich condition met." UBYTE b_true 0 0 0.00 1.00 BIT_MASK 0x1 ECU_ADDRESS 0x400050DA FORMAT "%1.0" /end MEASUREMENT
/begin MEASUREMENT fmsp_puc_maf_int "Fuel cut off duration air flow integral." UWORD u_gram_1024 0 0 0.0 1023.984375 ECU_ADDRESS 0x4000DA4E FORMAT "%3.2" /end MEASUREMENT
/begin MEASUREMENT fmsp_puc_dcy_maf "After fuel cut off decay air flow." UWORD u_gram_1024 0 0 0.0 1023.984375 ECU_ADDRESS 0x4000DA4E FORMAT "%3.2" /end MEASUREMENT
/begin MEASUREMENT fmsp_p_puc_dly "Fuel cut off delay time." UWORD u_2x_tmr 0 0 0.0 1023.984375 ECU_ADDRESS 0x4000DA4E /end MEASUREMENT
/begin MEASUREMENT fmsp_cl_pos_p_hld "Fuel close loop positive proportional term hold time." UWORD u_2x_tmr 0 0 0.0 1023.984375 ECU_ADDRESS 0x4000DA4E /end MEASUREMENT
/begin MEASUREMENT fmsp_cl_neg_p_hld "Fuel close loop negative proportional term hold time." UWORD u_2x_tmr 0 0 0.0 1023.984375 ECU_ADDRESS 0x4000DA4E /end MEASUREMENT
/begin MEASUREMENT fmsp_prm_pw_dly_fn "True means delay of prime pulse has been finished" UBYTE b_true 0 0 0.00 1.00 BIT_MASK 0x1 ECU_ADDRESS 0x400050DA FORMAT "%1.0" /end MEASUREMENT
/begin MEASUREMENT fmsp_prm_pw_en "True means injection of prime pulse has been enabled" UBYTE b_true 0 0 0.00 1.00 BIT_MASK 0x1 ECU_ADDRESS 0x400050DA FORMAT "%1.0" /end MEASUREMENT
/begin MEASUREMENT fmsp_prm_pw_fn "True means injection of prime pulse has been finished" UBYTE b_true 0 0 0.00 1.00 BIT_MASK 0x1 ECU_ADDRESS 0x400050DA FORMAT "%1.0" /end MEASUREMENT
/begin MEASUREMENT fmsp_prm_pw_conds_met "True means prime pulse enable conditions met" UBYTE b_true 0 0 0.00 1.00 BIT_MASK 0x1 ECU_ADDRESS 0x400050DA FORMAT "%1.0" /end MEASUREMENT
/begin MEASUREMENT fmsp_pf_lrn_en "true means poor fuel learn logic is enabled" UBYTE b_true 0 0 0.00 1.00 BIT_MASK 0x1 ECU_ADDRESS 0x400050DA FORMAT "%1.0" /end MEASUREMENT
/begin MEASUREMENT fmsp_pf_lrn_conds_met "true means poor fuel learn general conditions met" UBYTE b_true 0 0 0.00 1.00 BIT_MASK 0x1 ECU_ADDRESS 0x400050DA FORMAT "%1.0" /end MEASUREMENT
/begin MEASUREMENT fmsp_pf_run_conds_met "true means poor fuel learn engine runtime conditions met" UBYTE b_true 0 0 0.00 1.00 BIT_MASK 0x1 ECU_ADDRESS 0x400050DA FORMAT "%1.0" /end MEASUREMENT
/begin MEASUREMENT fmsp_pf_det "true means poor fuel has been detected" UBYTE b_true 0 0 0.00 1.00 BIT_MASK 0x1 ECU_ADDRESS 0x400050DA FORMAT "%1.0" /end MEASUREMENT
/begin MEASUREMENT fmsp_pf_af_fac "factor used to correct AF ratio when poor fuel detected" UWORD u_fac_1 0 0 0.0 0.999984741210937 ECU_ADDRESS 0x4000DA4E /end MEASUREMENT
/begin MEASUREMENT fmsp_pf_af_fac_nv0 "poor fuel AF ratio factor stored in NV cell 0" UWORD u_fac_1 0 0 0.0 0.999984741210937 ECU_ADDRESS 0x4000DA4E /end MEASUREMENT
/begin MEASUREMENT fmsp_pf_af_fac_nv1 "poor fuel AF ratio factor stored in NV cell 1" UWORD u_fac_1 0 0 0.0 0.999984741210937 ECU_ADDRESS 0x4000DA4E SYMBOL_LINK "fmsp_pf_af_fac_nv1" 2 /end MEASUREMENT
/begin MEASUREMENT fmsp_pf_af_fac_nv2 "poor fuel AF ratio factor stored in NV cell 2" UWORD u_fac_1 0 0 0.0 0.999984741210937 ECU_ADDRESS 0x4000DA4E SYMBOL_LINK "fmsp_pf_af_fac_nv2" 4 /end MEASUREMENT
/begin MEASUREMENT fmsp_pf_af_fac_nv3 "poor fuel AF ratio factor stored in NV cell 3" UWORD u_fac_1 0 0 0.0 0.999984741210937 ECU_ADDRESS 0x4000DA4E SYMBOL_LINK "fmsp_pf_af_fac_nv3" 6 /end MEASUREMENT
/begin MEASUREMENT fmsp_pf_af_fac_nv4 "poor fuel AF ratio factor stored in NV cell 4" UWORD u_fac_1 0 0 0.0 0.999984741210937 ECU_ADDRESS 0x4000DA4E SYMBOL_LINK "fmsp_pf_af_fac_nv4" 8 /end MEASUREMENT
/begin MEASUREMENT fmsp_pf_af_fac_nv5 "poor fuel AF ratio factor stored in NV cell 5" UWORD u_fac_1 0 0 0.0 0.999984741210937 ECU_ADDRESS 0x4000DA4E SYMBOL_LINK "fmsp_pf_af_fac_nv5" 10 /end MEASUREMENT
/begin MEASUREMENT fmsp_pf_af_fac_nv6 "poor fuel AF ratio factor stored in NV cell 6" UWORD u_fac_1 0 0 0.0 0.999984741210937 ECU_ADDRESS 0x4000DA4E SYMBOL_LINK "fmsp_pf_af_fac_nv6" 12 /end MEASUREMENT
/begin MEASUREMENT fmsp_pf_idl_lrn_met "true means poor fuel idle learn conditions met" UBYTE b_true 0 0 0.00 1.00 BIT_MASK 0x1 ECU_ADDRESS 0x400050DA FORMAT "%1.0" /end MEASUREMENT
/begin MEASUREMENT fmsp_inj_mode "fuel injection mode" UBYTE u_inj_mode 0 0 0 1 ECU_ADDRESS 0x4000DA4E FORMAT "%1.0" /end MEASUREMENT
/begin MEASUREMENT fmsp_run_af_bias_init_stat "true means inhibit StartToRun run af bias update" UBYTE b_true 0 0 0.00 1.00 BIT_MASK 0x1 ECU_ADDRESS 0x400050DA FORMAT "%1.0" /end MEASUREMENT
/begin MEASUREMENT fmsp_exh_prot_af "cat protect af" UWORD u_afr 0 0 0.0 31.99951171875 ECU_ADDRESS 0x4000DA4E /end MEASUREMENT
/begin MEASUREMENT fmsp_af_sp_raw "raw RUN af setpoint" UWORD u_afr 0 0 0.0 31.99951171875 ECU_ADDRESS 0x4000DA4E /end MEASUREMENT
/begin MEASUREMENT fmsp_af_sp_rmp "RUN af setpoint after ramp control" UWORD u_afr 0 0 0.0 31.99951171875 ECU_ADDRESS 0x4000DA4E /end MEASUREMENT
/begin MEASUREMENT fmsp_af_ramp_fac "af ramp factor to calculate fmsp_af_rmp_stp" UWORD u_fac_1 0 0 0.0 0.999984741210937 ECU_ADDRESS 0x4000DA4E /end MEASUREMENT
/begin MEASUREMENT fmsp_cl_ext_stat "true means close loop fuel control exit" UBYTE b_true 0 0 0.00 1.00 BIT_MASK 0x1 ECU_ADDRESS 0x400050DA FORMAT "%1.0" /end MEASUREMENT
/begin MEASUREMENT fmsp_puc_hyb_ext "true means trailing throttle fuel cut off exit by Hybrid" UBYTE b_true 0 0 0.00 1.00 BIT_MASK 0x1 ECU_ADDRESS 0x400050DA FORMAT "%1.0" /end MEASUREMENT
/begin MEASUREMENT fmsp_puc_cyl_ext_conds_met "true means fuel cut off single cylinder exit enable conditions met" UBYTE b_true 0 0 0.00 1.00 BIT_MASK 0x1 ECU_ADDRESS 0x400050DA FORMAT "%1.0" /end MEASUREMENT
/begin MEASUREMENT fmsp_puc_en_stat "true means PUC has been enabled this trip" UBYTE b_true 0 0 0.00 1.00 BIT_MASK 0x1 ECU_ADDRESS 0x400050DA FORMAT "%1.0" /end MEASUREMENT
/begin MEASUREMENT fmsp_puc_decltch_ext "true means PUC exit due to declutch" UBYTE b_true 0 0 0.00 1.00 BIT_MASK 0x1 ECU_ADDRESS 0x400050DA FORMAT "%1.0" /end MEASUREMENT
/begin MEASUREMENT fmsp_tq_fault_cyl_en "true means fuel of cylinder is enabled after torque and fault control" UWORD b_enable 0 0 0.0 1.00 ARRAY_SIZE 4 ECU_ADDRESS 0x4000DA4E FORMAT "%1.0" /end MEASUREMENT
/begin MEASUREMENT fmsp_fault_cyl_en "true means fuel of cylinder is enabled after fault control" UWORD b_enable 0 0 0.0 1.00 ARRAY_SIZE 4 ECU_ADDRESS 0x4000DA4E FORMAT "%1.0" /end MEASUREMENT
/begin MEASUREMENT fmsp_tq_cyl_en "true means fuel of cylinder is enabled after torque control" UWORD b_enable 0 0 0.0 1.00 ARRAY_SIZE 4 ECU_ADDRESS 0x4000DA4E FORMAT "%1.0" /end MEASUREMENT
/begin MEASUREMENT fmsp_cyls_fault_dis "number of cylinders disable fueling by fault control" UBYTE u_cnts 0 0 0 255 ECU_ADDRESS 0x4000440A /end MEASUREMENT
/begin MEASUREMENT fmsp_nrm_afr "normalized air fuel ratio setpoint." UWORD u_afr 0 0 0.0 31.99951171875 ECU_ADDRESS 0x4000DA4E /end MEASUREMENT
/begin MEASUREMENT fmsp_sto_afr "StoichAF active." UBYTE b_true 0 0 0.00 1.00 BIT_MASK 0x1 ECU_ADDRESS 0x400050DA FORMAT "%1.0" /end MEASUREMENT
/begin MEASUREMENT fmsp_ln_tm "O2 lean duration" UWORD u_2x_tmr 0 0 0.0 1023.984375 ECU_ADDRESS 0x4000DA4E SYMBOL_LINK "fmsp_ln_tm" 20 /end MEASUREMENT
/begin MEASUREMENT fmsp_rch_tm "O2 rich duration" UWORD u_2x_tmr 0 0 0.0 1023.984375 ECU_ADDRESS 0x4000DA4E SYMBOL_LINK "fmsp_rch_tm" 18 /end MEASUREMENT
/begin MEASUREMENT fmsp_cp_conc_stat "Canister purge concentration learning status." UBYTE u_cp_conc_stat 0 0 0 3 ECU_ADDRESS 0x400017C8 FORMAT "%1.0" /end MEASUREMENT
/begin MEASUREMENT fmsp_cyl_tot_on "total cyls on" UBYTE b_true 0 0 0.00 1.00 ECU_ADDRESS 0x400050DA FORMAT "%1.0" /end MEASUREMENT
/begin MEASUREMENT fmsp_fuel_cut "fuel cut off" UBYTE b_true 0 0 0.00 1.00 ECU_ADDRESS 0x400050DA FORMAT "%1.0" /end MEASUREMENT
/begin CHARACTERISTIC AFM_V_VOL_CYL "volume of the single cylinder " VALUE 0x0002038C __UWORD_S 0 u_ml 0 1023.984375 /end CHARACTERISTIC
/begin CHARACTERISTIC AFM_V_VOL_IM "volume of the intake manifold" VALUE 0x0002038C __UWORD_S 0 u_ml_b 0 65535.0 /end CHARACTERISTIC
/begin CHARACTERISTIC AFM_M_EXH_T_IG_BIAS "exhaust port temp bias due to ignition retard" MAP 0x00020320 __UWORD_S 0 u_deg_K 0 2047.96875 SYMBOL_LINK "AFM_M_EXH_T_IG_BIAS" 4
 /begin AXIS_DESCR COM_AXIS afm_frsh_air_flw u_g_per_sec 5 0 511.9921875 AXIS_PTS_REF AFM_X_AIR_FLW /end AXIS_DESCR
 /begin AXIS_DESCR COM_AXIS ig_avg_rtd_ref u_iga 9 -256 255.9921875 AXIS_PTS_REF AFM_X_IGA_RTD /end AXIS_DESCR
/end CHARACTERISTIC
/begin CHARACTERISTIC AFM_C_EXH_T_AF_BIAS "exhaust temp bias based by afr" CURVE 0x000200B0 __SWORD_S 0 u_deg_K_s -2048 2047.9375 FORMAT "%5.1" SYMBOL_LINK "AFM_C_EXH_T_AF_BIAS" 2
 /begin AXIS_DESCR FIX_AXIS fmsp_af_sp u_afr 17 9.5 15.9
  /begin FIX_AXIS_PAR_LIST 19456 20275 21094 21913 22732 23552 24371 25190 26009 26828 27648 28467 29286 30105 30924 31744 32563 /end FIX_AXIS_PAR_LIST
 /end AXIS_DESCR
/end CHARACTERISTIC
/begin AXIS_PTS AFM_X_AIR_FLW "axis of air airflow" 0x0002006C afm_frsh_air_flw SSV__UWORD_S 0 u_g_per_sec 5 0 511.9921875 DEPOSIT ABSOLUTE SYMBOL_LINK "AFM_X_AIR_FLW" 2 /end AXIS_PTS
/begin AXIS_PTS AFM_X_AIR_FLW_B "axis of air airflow" 0x0002006C afm_frsh_air_flw SSV__UWORD_S 0 u_g_per_sec 17 0 511.9921875 DEPOSIT ABSOLUTE SYMBOL_LINK "AFM_X_AIR_FLW_B" 2 /end AXIS_PTS
/begin AXIS_PTS AFM_X_AIR_FLW_C "axis of air airflow" 0x0002006C afm_frsh_air_flw SSV__UWORD_S 0 u_g_per_sec 12 0 511.9921875 DEPOSIT ABSOLUTE SYMBOL_LINK "AFM_X_AIR_FLW_C" 2 /end AXIS_PTS
/begin AXIS_PTS AFM_X_AIR_FLW_D "axis of air airflow" 0x0002006C afm_frsh_air_flw SSV__UWORD_S 0 u_g_per_sec 12 0 511.9921875 DEPOSIT ABSOLUTE SYMBOL_LINK "AFM_X_AIR_FLW_D" 2 /end AXIS_PTS
/begin AXIS_PTS AFM_X_IGA_RTD "ignition retard breakpoint" 0x0002006C ig_avg_rtd_ref SSV__SWORD_S 0 u_iga 9 -256 255.9921875 FORMAT "%5.2" DEPOSIT ABSOLUTE SYMBOL_LINK "AFM_X_IGA_RTD" 2 /end AXIS_PTS
/begin CHARACTERISTIC AFM_C_THRO_FLW "throttle flow" CURVE 0x000200B0 __UWORD_S 0 u_g_per_sec_1024 0 1023.984375 FORMAT "%6.2" SYMBOL_LINK "AFM_C_THRO_FLW" 2
 /begin AXIS_DESCR COM_AXIS sys_tps_pct u_pct 21 0.000000 199.996948 AXIS_PTS_REF AFM_X_TPS_PCT /end AXIS_DESCR
/end CHARACTERISTIC
/begin AXIS_PTS AFM_X_TPS_PCT "throttle position breakpoint" 0x0002006C sys_tps_pct SSV__UWORD_S 0 u_pct 21 0.000000 199.996948 DEPOSIT ABSOLUTE SYMBOL_LINK "AFM_X_TPS_PCT" 2 /end AXIS_PTS
/begin CHARACTERISTIC AFM_V_THRO_FLW_ADP_CFG "throttle flow adaption config" VALUE 0x20054 __UBYTE_S 0 b_enable 0 1 FORMAT "%5.2" /end CHARACTERISTIC
/begin CHARACTERISTIC AFM_C_THRO_FLW_ADP_MAX "throttle flow adaption max" CURVE 0x000200B0 __UWORD_S 0 u_g_per_sec_1024 0 1023.984375 FORMAT "%6.2" SYMBOL_LINK "AFM_C_THRO_FLW_ADP_MAX" 2
 /begin AXIS_DESCR COM_AXIS sys_tps_pct u_pct 21 0.000000 199.996948 AXIS_PTS_REF AFM_X_TPS_PCT /end AXIS_DESCR
/end CHARACTERISTIC
/begin CHARACTERISTIC AFM_C_THRO_FLW_ADP_MIN "throttle flow adaption min" CURVE 0x000200B0 __UWORD_S 0 u_g_per_sec_1024 0 1023.984375 FORMAT "%6.2" SYMBOL_LINK "AFM_C_THRO_FLW_ADP_MIN" 2
 /begin AXIS_DESCR COM_AXIS sys_tps_pct u_pct 21 0.000000 199.996948 AXIS_PTS_REF AFM_X_TPS_PCT /end AXIS_DESCR
/end CHARACTERISTIC
/begin CHARACTERISTIC AFM_M_VE_MN "exhaust port temp bias due to ignition retard" MAP 0x00020320 __UWORD_S 0 u_pct 0 199.996948 SYMBOL_LINK "AFM_M_VE_MN" 4
 /begin AXIS_DESCR COM_AXIS sys_eng_spd u_espd 19 0.000000 8191.875000 AXIS_PTS_REF AFM_X_ESPD_A /end AXIS_DESCR
 /begin AXIS_DESCR COM_AXIS afm_exh_to_map_fac u_fac_16 20 0.000000 15.999756 AXIS_PTS_REF AFM_X_EXH_TO_MAP_RT /end AXIS_DESCR
/end CHARACTERISTIC
/begin AXIS_PTS AFM_X_ESPD_A "espd breakpoint" 0x0002006C sys_eng_spd SSV__UWORD_S 0 u_espd 19 0.000000 8191.875000 FORMAT "%5.1" DEPOSIT ABSOLUTE SYMBOL_LINK "AFM_X_ESPD_A" 2 /end AXIS_PTS
/begin AXIS_PTS AFM_X_ESPD_B "espd breakpoint" 0x0002006C sys_eng_spd SSV__UWORD_S 0 u_espd 12 0.000000 8191.875000 FORMAT "%5.1" DEPOSIT ABSOLUTE SYMBOL_LINK "AFM_X_ESPD_B" 2 /end AXIS_PTS
/begin AXIS_PTS AFM_X_EXH_TO_MAP_RT "exh to map breakpoint" 0x0002006C afm_exh_to_map_fac SSV__UWORD_S 0 u_fac_16 20 0.000000 15.999756 FORMAT "%4.2" DEPOSIT ABSOLUTE SYMBOL_LINK "AFM_X_EXH_TO_MAP_RT" 2 /end AXIS_PTS
/begin CHARACTERISTIC AFM_V_EXH_T_EGR_FAC "exhaust port temp factor of EGR percent" VALUE 0x0002038C __UWORD_S 0 u_fac_1024 0 1023.984375 /end CHARACTERISTIC
/begin CHARACTERISTIC AFM_M_EXH_T_VSPD_COOL "exhaust port temp vehicle speed cool term" MAP 0x00020320 __SWORD_S 0 u_deg_K_s -2048 2047.9375 FORMAT "%5.1" SYMBOL_LINK "AFM_M_EXH_T_VSPD_COOL" 4
 /begin AXIS_DESCR FIX_AXIS sys_veh_spd u_vspd 17 0 256
  /begin FIX_AXIS_PAR_LIST 0 2048 4096 6144 8192 10240 12288 14336 16384 18432 20480 22528 24576 26624 28672 30720 32768 /end FIX_AXIS_PAR_LIST
 /end AXIS_DESCR
 /begin AXIS_DESCR COM_AXIS sys_iat u_deg_C 8 -256.000000 255.9921875 AXIS_PTS_REF AFM_X_IAT_A /end AXIS_DESCR
/end CHARACTERISTIC
/begin AXIS_PTS AFM_X_IAT_A "iat breakpoint" 0x0002006C sys_iat SSV__SWORD_S 0 u_deg_C 8 -256.000000 255.9921875 DEPOSIT ABSOLUTE SYMBOL_LINK "AFM_X_IAT_A" 2 /end AXIS_PTS
/begin CHARACTERISTIC AFM_M_EXH_T_MBT "exhaust port temp at mbt" MAP 0x00020320 __UWORD_S 0 u_deg_K 0 2047.96875 FORMAT "%5.1" SYMBOL_LINK "AFM_M_EXH_T_MBT" 4
 /begin AXIS_DESCR COM_AXIS tq_imep_ref u_kPa_0_4096 17 0.000000 4095.937500 AXIS_PTS_REF AFM_X_IMEP_MBT /end AXIS_DESCR
 /begin AXIS_DESCR FIX_AXIS sys_eng_spd u_espd 19 0 7200
  /begin FIX_AXIS_PAR_LIST 0 3200 6400 9600 12800 16000 19200 22400 25600 28800 32000 35200 38400 41600 44800 48000 51200 54400 57600 /end FIX_AXIS_PAR_LIST
 /end AXIS_DESCR
/end CHARACTERISTIC
/begin AXIS_PTS AFM_X_IMEP_MBT "imep mbt breakpoint" 0x0002006C tq_imep_ref SSV__UWORD_S 0 u_kPa_0_4096 17 0 4095.937500 FORMAT "%5.1" DEPOSIT ABSOLUTE SYMBOL_LINK "AFM_X_IMEP_MBT" 2 /end AXIS_PTS
/begin CHARACTERISTIC AFM_M_EXH_MNFD_HT_FAC "exhaust manifold temp heater factor" MAP 0x00020320 __UWORD_S 0 u_fac_2 0 1.999969482421875 SYMBOL_LINK "AFM_M_EXH_MNFD_HT_FAC" 4
 /begin AXIS_DESCR COM_AXIS afm_frsh_air_flw u_g_per_sec 17 0.000000 511.992188 AXIS_PTS_REF AFM_X_AIR_FLW_B /end AXIS_DESCR
 /begin AXIS_DESCR FIX_AXIS sys_eng_spd u_espd 19 0 7200
  /begin FIX_AXIS_PAR_LIST 0 3200 6400 9600 12800 16000 19200 22400 25600 28800 32000 35200 38400 41600 44800 48000 51200 54400 57600 /end FIX_AXIS_PAR_LIST
 /end AXIS_DESCR
/end CHARACTERISTIC
/begin CHARACTERISTIC AFM_M_FCO_EXH_T_HT_BAS_FAC "fuel cutoff exhaust port temp heater factor" MAP 0x00020320 __SWORD_S 0 u_fac_n4_p4 -4 3.9998779296875 SYMBOL_LINK "AFM_M_FCO_EXH_T_HT_BAS_FAC" 4
 /begin AXIS_DESCR COM_AXIS afm_frsh_air_flw u_g_per_sec 5 0.000000 511.992188 AXIS_PTS_REF AFM_X_AIR_FLW /end AXIS_DESCR
 /begin AXIS_DESCR COM_AXIS sys_eng_spd u_espd 5 0 8191.875000 AXIS_PTS_REF AFM_X_ESPD_D /end AXIS_DESCR
/end CHARACTERISTIC
/begin CHARACTERISTIC AFM_M_FCO_EXH_T_HT_COR_FAC "fuel cutoff exhaust port temp heater factor correction" MAP 0x00020320 __UWORD_S 0 u_fac_4 0 3.99993896484375 FORMAT "%3.2" SYMBOL_LINK "AFM_M_FCO_EXH_T_HT_COR_FAC" 4
 /begin AXIS_DESCR FIX_AXIS sys_veh_spd u_vspd 5 0 256 /begin FIX_AXIS_PAR_LIST 0 8192 16384 24576 32768 /end FIX_AXIS_PAR_LIST /end AXIS_DESCR
 /begin AXIS_DESCR FIX_AXIS afm_amb_t_nv u_deg_C 6 -40 110 /begin FIX_AXIS_PAR_LIST -5120 -1280 2560 6400 10240 14080 /end FIX_AXIS_PAR_LIST /end AXIS_DESCR
/end CHARACTERISTIC
/begin CHARACTERISTIC AFM_C_FCO_EXH_T_BIAS "exhaust port temp bias added on intake port temp" CURVE 0x000200B0 __SWORD_S 0 u_deg_K -1024 1023.96875 FORMAT "%5.1" SYMBOL_LINK "AFM_C_FCO_EXH_T_BIAS" 2
 /begin AXIS_DESCR COM_AXIS sys_eng_spd u_espd 5 0.000000 8191.875000 AXIS_PTS_REF AFM_X_ESPD_D /end AXIS_DESCR
/end CHARACTERISTIC
/begin AXIS_PTS AFM_X_ESPD_D "engine speed breakpoint" 0x0002006C sys_eng_spd SSV__UWORD_S 0 u_espd 5 0.000000 8191.875000 FORMAT "%5.1" DEPOSIT ABSOLUTE SYMBOL_LINK "AFM_X_ESPD_D" 2 /end AXIS_PTS
/begin CHARACTERISTIC AFM_V_FCO_EXH_T_FLT_DUR "fuel cutoff exhaust port temp filt duration" VALUE 0x0002038C __UWORD_S 0 u_16x_tmr 0 8191.875 /end CHARACTERISTIC
/begin CHARACTERISTIC AFM_V_ASTP_EXH_T_FLT_DUR "auto stop exhaust port temp filt duration" VALUE 0x0002038C __UWORD_S 0 u_16x_tmr 0 8191.875 /end CHARACTERISTIC
/begin CHARACTERISTIC AFM_V_FCO_EXH_T_EXT_DLY "auto stop exhaust port temp filt duration" VALUE 0x0002038C __UBYTE_S 0 u_16x_tmr 0 31.875 FORMAT "%3.1" /end CHARACTERISTIC
/begin CHARACTERISTIC AFM_V_FCO_EXH_T_EXT_DLT "exhaust fuel cotoff port temp exit temp delta max" VALUE 0x0002038C __UWORD_S 0 u_deg_K 0 2047.96875 FORMAT "%5.1" /end CHARACTERISTIC
/begin CHARACTERISTIC AFM_C_FCO_EXH_T_FIL "fuel cut exhaust temp filter" CURVE 0x000200B0 __UWORD_S 0 u_filter 0 0.9999847412109375 FORMAT "%4.3" SYMBOL_LINK "AFM_C_FCO_EXH_T_FIL" 2
 /begin AXIS_DESCR COM_AXIS afm_frsh_air_flw u_g_per_sec 12 0.000000 511.992188 AXIS_PTS_REF AFM_X_AIR_FLW_H /end AXIS_DESCR
/end CHARACTERISTIC
/begin AXIS_PTS AFM_X_AIR_FLW_H "airflow breakpoint" 0x0002006C afm_frsh_air_flw SSV__UWORD_S 0 u_g_per_sec 12 0.000000 511.992188 DEPOSIT ABSOLUTE SYMBOL_LINK "AFM_X_AIR_FLW_H" 2 /end AXIS_PTS
/begin CHARACTERISTIC AFM_V_ASTP_EXH_T_EXT_FIL "exhaust auto stop port temp exit filter" VALUE 0x0002038C __UWORD_S 0 u_filter 0 0.9999847412109375 FORMAT "%4.3" /end CHARACTERISTIC
/begin CHARACTERISTIC AFM_V_FCO_EXH_T_EXT_FIL "exhaust fuel cut off port temp exit filter" VALUE 0x0002038C __UWORD_S 0 u_filter 0 0.9999847412109375 FORMAT "%4.3" /end CHARACTERISTIC
/begin CHARACTERISTIC AFM_C_INTK_MNFD_HT_FAC "intake manifold heat factor" CURVE 0x000200B0 __UWORD_S 0 u_fac_2 0 1.999969482421875 SYMBOL_LINK "AFM_C_INTK_MNFD_HT_FAC" 2
 /begin AXIS_DESCR COM_AXIS afm_frsh_air_flw u_g_per_sec 12 0.000000 511.992188 AXIS_PTS_REF AFM_X_AIR_FLW_C /end AXIS_DESCR
/end CHARACTERISTIC
/begin CHARACTERISTIC AFM_M_INTK_PRT_HT_FAC_PR "intake port temp heat factor,axis is Pressure Ratio" MAP 0x00020320 __SWORD_S 0 u_fac_n1_p1 -1 0.999969482421875 SYMBOL_LINK "AFM_M_INTK_PRT_HT_FAC" 4
 /begin AXIS_DESCR COM_AXIS sys_eng_spd u_espd 12 0.000000 8191.875000 AXIS_PTS_REF AFM_X_ESPD_B /end AXIS_DESCR
 /begin AXIS_DESCR COM_AXIS NO_INPUT_QUANTITY u_fac_16 20 0.000000 15.999756 AXIS_PTS_REF AFM_X_EXH_TO_MAP_RT /end AXIS_DESCR
/end CHARACTERISTIC
/begin CHARACTERISTIC AFM_M_INTK_PRT_HT_FAC_IMEP "intake port temp heat factor" MAP 0x00020320 __SWORD_S 0 u_fac_n1_p1 -1 0.999969482421875 SYMBOL_LINK "AFM_M_INTK_PRT_HT_FAC" 4
 /begin AXIS_DESCR COM_AXIS sys_eng_spd u_espd 12 0.000000 8191.875000 AXIS_PTS_REF AFM_X_ESPD_B /end AXIS_DESCR
 /begin AXIS_DESCR FIX_AXIS tq_imep_ref u_kPa_0_4096 20 0.000000 4095.937500
  /begin FIX_AXIS_PAR_LIST 0 1600 3200 4800 6400 8000 9600 11200 12800 14400 16000 17600 19200 20800 22400 24000 25600 27200 28800 30400 /end FIX_AXIS_PAR_LIST
 /end AXIS_DESCR
/end CHARACTERISTIC
/begin CHARACTERISTIC AFM_C_PORT_HT_ECT_FAC "ect correction of intake port heat factor" CURVE 0x000200B0 __UWORD_S 0 u_fac_2 0 1.999969482421875 SYMBOL_LINK "AFM_C_PORT_HT_ECT_FAC" 2
 /begin AXIS_DESCR COM_AXIS sys_ect u_deg_C 10 -256.000000 255.9921875 AXIS_PTS_REF AFM_X_ECT_A /end AXIS_DESCR
/end CHARACTERISTIC
/begin AXIS_PTS AFM_X_ECT_A "ect breakpoint" 0x0002006C sys_ect SSV__SWORD_S 0 u_deg_C 8 -256.000000 255.9921875 DEPOSIT ABSOLUTE SYMBOL_LINK "AFM_X_ECT_A" 2 /end AXIS_PTS
/begin CHARACTERISTIC AFM_M_PORT_T_VVT_BIAS "intake port temp valve overlap bias" MAP 0x00020320 __SWORD_S 0 u_deg_K_s_b -512 511.984375 SYMBOL_LINK "AFM_M_PORT_T_VVT_BIAS" 4
 /begin AXIS_DESCR COM_AXIS afm_frsh_air_flw u_g_per_sec 12 0.000000 511.992188 AXIS_PTS_REF AFM_X_AIR_FLW_D /end AXIS_DESCR
 /begin AXIS_DESCR COM_AXIS vvt_vlv_ovlp_ang u_iga 9 -256.000000 255.992188 AXIS_PTS_REF AFM_X_VLV_OVLP /end AXIS_DESCR
/end CHARACTERISTIC
/begin AXIS_PTS AFM_X_VLV_OVLP "axis of air airflow" 0x0002006C afm_frsh_air_flw SSV__SWORD_S 0 u_iga 9 -256.000000 255.992188 FORMAT "%5.2" DEPOSIT ABSOLUTE SYMBOL_LINK "AFM_X_VLV_OVLP" 2 /end AXIS_PTS
/begin CHARACTERISTIC AFM_V_EXH_P_AREA_FAC "exhaust port press factor" VALUE 0x0002038C __UWORD_S 0 u_fac_16384 0 16383.75 /end CHARACTERISTIC
/begin CHARACTERISTIC AFM_C_EXH_P_FAC "exhaust press estimate factor which multiply to AMP" CURVE 0x000200B0 __UWORD_S 0 u_fac_8 0 7.9998779296875 FORMAT "%3.2" SYMBOL_LINK "AFM_C_EXH_P_FAC" 2
 /begin AXIS_DESCR COM_AXIS afm_exh_p_area_fac u_fac_2 17 0 1.99996948242187 AXIS_PTS_REF AFM_X_EXH_P_AREA_FAC /end AXIS_DESCR
/end CHARACTERISTIC
/begin AXIS_PTS AFM_X_EXH_P_AREA_FAC "exhaust port press factor" 0x0002006C afm_exh_p_area_fac SSV__UWORD_S 0 u_fac_2 17 0 1.99996948242187 FORMAT "%4.3" DEPOSIT ABSOLUTE SYMBOL_LINK "AFM_X_EXH_P_AREA_FAC" 2 /end AXIS_PTS
/begin CHARACTERISTIC AFM_M_VE_BP1_FIT_C "VE bias=a*x2+b*x+c c part at intake vvt breakpoint1 x=exh vvt pos" MAP 0x00020320 __UWORD_S 0 u_pct 0 199.996948 SYMBOL_LINK "AFM_M_VE_BP1_FIT_C" 4
 /begin AXIS_DESCR COM_AXIS sys_eng_spd u_espd 19 0.000000 8191.875000 AXIS_PTS_REF AFM_X_ESPD_A /end AXIS_DESCR
 /begin AXIS_DESCR COM_AXIS afm_exh_to_map_fac u_fac_16 20 0.000000 15.999756 AXIS_PTS_REF AFM_X_EXH_TO_MAP_RT /end AXIS_DESCR
/end CHARACTERISTIC
/begin CHARACTERISTIC AFM_M_VE_BP2_FIT_C "VE bias=a*x2+b*x+c c part at intake vvt breakpoint2 x=exh vvt pos" MAP 0x00020320 __UWORD_S 0 u_pct 0 199.996948 SYMBOL_LINK "AFM_M_VE_BP2_FIT_C" 4
 /begin AXIS_DESCR COM_AXIS sys_eng_spd u_espd 19 0.000000 8191.875000 AXIS_PTS_REF AFM_X_ESPD_A /end AXIS_DESCR
 /begin AXIS_DESCR COM_AXIS afm_exh_to_map_fac u_fac_16 20 0.000000 15.999756 AXIS_PTS_REF AFM_X_EXH_TO_MAP_RT /end AXIS_DESCR
/end CHARACTERISTIC
/begin CHARACTERISTIC AFM_M_VE_BP3_FIT_C "VE bias=a*x2+b*x+c c part at intake vvt breakpoint3 x=exh vvt pos" MAP 0x00020320 __UWORD_S 0 u_pct 0 199.996948 SYMBOL_LINK "AFM_M_VE_BP3_FIT_C" 4
 /begin AXIS_DESCR COM_AXIS sys_eng_spd u_espd 19 0.000000 8191.875000 AXIS_PTS_REF AFM_X_ESPD_A /end AXIS_DESCR
 /begin AXIS_DESCR COM_AXIS afm_exh_to_map_fac u_fac_16 20 0.000000 15.999756 AXIS_PTS_REF AFM_X_EXH_TO_MAP_RT /end AXIS_DESCR
/end CHARACTERISTIC
/begin CHARACTERISTIC AFM_M_VE_BP4_FIT_C "VE bias=a*x2+b*x+c c part at intake vvt breakpoint4 x=exh vvt pos" MAP 0x00020320 __UWORD_S 0 u_pct 0 199.996948 SYMBOL_LINK "AFM_M_VE_BP4_FIT_C" 4
 /begin AXIS_DESCR COM_AXIS sys_eng_spd u_espd 19 0.000000 8191.875000 AXIS_PTS_REF AFM_X_ESPD_A /end AXIS_DESCR
 /begin AXIS_DESCR COM_AXIS afm_exh_to_map_fac u_fac_16 20 0.000000 15.999756 AXIS_PTS_REF AFM_X_EXH_TO_MAP_RT /end AXIS_DESCR
/end CHARACTERISTIC
/begin CHARACTERISTIC AFM_M_VE_BP5_FIT_C "VE bias=a*x2+b*x+c c part at intake vvt breakpoint5 x=exh vvt pos" MAP 0x00020320 __UWORD_S 0 u_pct 0 199.996948 SYMBOL_LINK "AFM_M_VE_BP5_FIT_C" 4
 /begin AXIS_DESCR COM_AXIS sys_eng_spd u_espd 19 0.000000 8191.875000 AXIS_PTS_REF AFM_X_ESPD_A /end AXIS_DESCR
 /begin AXIS_DESCR COM_AXIS afm_exh_to_map_fac u_fac_16 20 0.000000 15.999756 AXIS_PTS_REF AFM_X_EXH_TO_MAP_RT /end AXIS_DESCR
/end CHARACTERISTIC
/begin CHARACTERISTIC AFM_M_VE_BP1_FIT_B "VE bias=a*x2+b*x+c b part at intake vvt breakpoint1 x=exh vvt pos" MAP 0x00020320 __SWORD_S 0 u_milli_pct1 -3.125 3.124904632568359375 FORMAT "%5.3" SYMBOL_LINK "AFM_M_VE_BP1_FIT_B" 4
 /begin AXIS_DESCR COM_AXIS sys_eng_spd u_espd 19 0.000000 8191.875000 AXIS_PTS_REF AFM_X_ESPD_A /end AXIS_DESCR
 /begin AXIS_DESCR COM_AXIS afm_exh_to_map_fac u_fac_16 20 0.000000 15.999756 AXIS_PTS_REF AFM_X_EXH_TO_MAP_RT /end AXIS_DESCR
/end CHARACTERISTIC
/begin CHARACTERISTIC AFM_M_VE_BP2_FIT_B "VE bias=a*x2+b*x+c b part at intake vvt breakpoint2 x=exh vvt pos" MAP 0x00020320 __SWORD_S 0 u_milli_pct1 -3.125 3.124904632568359375 FORMAT "%5.3" SYMBOL_LINK "AFM_M_VE_BP2_FIT_B" 4
 /begin AXIS_DESCR COM_AXIS sys_eng_spd u_espd 19 0.000000 8191.875000 AXIS_PTS_REF AFM_X_ESPD_A /end AXIS_DESCR
 /begin AXIS_DESCR COM_AXIS afm_exh_to_map_fac u_fac_16 20 0.000000 15.999756 AXIS_PTS_REF AFM_X_EXH_TO_MAP_RT /end AXIS_DESCR
/end CHARACTERISTIC
/begin CHARACTERISTIC AFM_M_VE_BP3_FIT_B "VE bias=a*x2+b*x+c b part at intake vvt breakpoint3 x=exh vvt pos" MAP 0x00020320 __SWORD_S 0 u_milli_pct1 -3.125 3.124904632568359375 FORMAT "%5.3" SYMBOL_LINK "AFM_M_VE_BP3_FIT_B" 4
 /begin AXIS_DESCR COM_AXIS sys_eng_spd u_espd 19 0.000000 8191.875000 AXIS_PTS_REF AFM_X_ESPD_A /end AXIS_DESCR
 /begin AXIS_DESCR COM_AXIS afm_exh_to_map_fac u_fac_16 20 0.000000 15.999756 AXIS_PTS_REF AFM_X_EXH_TO_MAP_RT /end AXIS_DESCR
/end CHARACTERISTIC
/begin CHARACTERISTIC AFM_M_VE_BP4_FIT_B "VE bias=a*x2+b*x+c b part at intake vvt breakpoint4 x=exh vvt pos" MAP 0x00020320 __SWORD_S 0 u_milli_pct1 -3.125 3.124904632568359375 FORMAT "%5.3" SYMBOL_LINK "AFM_M_VE_BP4_FIT_B" 4
 /begin AXIS_DESCR COM_AXIS sys_eng_spd u_espd 19 0.000000 8191.875000 AXIS_PTS_REF AFM_X_ESPD_A /end AXIS_DESCR
 /begin AXIS_DESCR COM_AXIS afm_exh_to_map_fac u_fac_16 20 0.000000 15.999756 AXIS_PTS_REF AFM_X_EXH_TO_MAP_RT /end AXIS_DESCR
/end CHARACTERISTIC
/begin CHARACTERISTIC AFM_M_VE_BP5_FIT_B "VE bias=a*x2+b*x+c b part at intake vvt breakpoint5 x=exh vvt pos" MAP 0x00020320 __SWORD_S 0 u_milli_pct1 -3.125 3.124904632568359375 FORMAT "%5.3" SYMBOL_LINK "AFM_M_VE_BP5_FIT_B" 4
 /begin AXIS_DESCR COM_AXIS sys_eng_spd u_espd 19 0.000000 8191.875000 AXIS_PTS_REF AFM_X_ESPD_A /end AXIS_DESCR
 /begin AXIS_DESCR COM_AXIS afm_exh_to_map_fac u_fac_16 20 0.000000 15.999756 AXIS_PTS_REF AFM_X_EXH_TO_MAP_RT /end AXIS_DESCR
/end CHARACTERISTIC
/begin CHARACTERISTIC AFM_M_VE_BP1_FIT_A "VE bias=a*x2+b*x+c a part at intake vvt breakpoint1 x=exh vvt pos" MAP 0x00020320 __SWORD_S 0 u_milli_pct2 -0.390625 0.390613079071044921875 FORMAT "%11.10" SYMBOL_LINK "AFM_M_VE_BP1_FIT_A" 4
 /begin AXIS_DESCR COM_AXIS sys_eng_spd u_espd 19 0.000000 8191.875000 AXIS_PTS_REF AFM_X_ESPD_A /end AXIS_DESCR
 /begin AXIS_DESCR COM_AXIS afm_exh_to_map_fac u_fac_16 20 0.000000 15.999756 AXIS_PTS_REF AFM_X_EXH_TO_MAP_RT /end AXIS_DESCR
/end CHARACTERISTIC
/begin CHARACTERISTIC AFM_M_VE_BP2_FIT_A "VE bias=a*x2+b*x+c a part at intake vvt breakpoint2 x=exh vvt pos" MAP 0x00020320 __SWORD_S 0 u_milli_pct2 -0.390625 0.390613079071044921875 FORMAT "%11.10" SYMBOL_LINK "AFM_M_VE_BP2_FIT_A" 4
 /begin AXIS_DESCR COM_AXIS sys_eng_spd u_espd 19 0.000000 8191.875000 AXIS_PTS_REF AFM_X_ESPD_A /end AXIS_DESCR
 /begin AXIS_DESCR COM_AXIS afm_exh_to_map_fac u_fac_16 20 0.000000 15.999756 AXIS_PTS_REF AFM_X_EXH_TO_MAP_RT /end AXIS_DESCR
/end CHARACTERISTIC
/begin CHARACTERISTIC AFM_M_VE_BP3_FIT_A "VE bias=a*x2+b*x+c a part at intake vvt breakpoint3 x=exh vvt pos" MAP 0x00020320 __SWORD_S 0 u_milli_pct2 -0.390625 0.390613079071044921875 FORMAT "%11.10" SYMBOL_LINK "AFM_M_VE_BP3_FIT_A" 4
 /begin AXIS_DESCR COM_AXIS sys_eng_spd u_espd 19 0.000000 8191.875000 AXIS_PTS_REF AFM_X_ESPD_A /end AXIS_DESCR
 /begin AXIS_DESCR COM_AXIS afm_exh_to_map_fac u_fac_16 20 0.000000 15.999756 AXIS_PTS_REF AFM_X_EXH_TO_MAP_RT /end AXIS_DESCR
/end CHARACTERISTIC
/begin CHARACTERISTIC AFM_M_VE_BP4_FIT_A "VE bias=a*x2+b*x+c a part at intake vvt breakpoint4 x=exh vvt pos" MAP 0x00020320 __SWORD_S 0 u_milli_pct2 -0.390625 0.390613079071044921875 FORMAT "%11.10" SYMBOL_LINK "AFM_M_VE_BP4_FIT_A" 4
 /begin AXIS_DESCR COM_AXIS sys_eng_spd u_espd 19 0.000000 8191.875000 AXIS_PTS_REF AFM_X_ESPD_A /end AXIS_DESCR
 /begin AXIS_DESCR COM_AXIS afm_exh_to_map_fac u_fac_16 20 0.000000 15.999756 AXIS_PTS_REF AFM_X_EXH_TO_MAP_RT /end AXIS_DESCR
/end CHARACTERISTIC
/begin CHARACTERISTIC AFM_M_VE_BP5_FIT_A "VE bias=a*x2+b*x+c a part at intake vvt breakpoint5 x=exh vvt pos" MAP 0x00020320 __SWORD_S 0 u_milli_pct2 -0.390625 0.390613079071044921875 SYMBOL_LINK "AFM_M_VE_BP5_FIT_A" 4
 /begin AXIS_DESCR COM_AXIS sys_eng_spd u_espd 19 0.000000 8191.875000 AXIS_PTS_REF AFM_X_ESPD_A /end AXIS_DESCR
 /begin AXIS_DESCR COM_AXIS afm_exh_to_map_fac u_fac_16 20 0.000000 15.999756 AXIS_PTS_REF AFM_X_EXH_TO_MAP_RT /end AXIS_DESCR
/end CHARACTERISTIC
/begin CHARACTERISTIC AFM_C_VE_INTK_BP "ve table intake vvt position break point" CURVE 0x000200B0 __SWORD_S 0 u_iga -256.000000 255.992188 FORMAT "%4.1" SYMBOL_LINK "AFM_C_VE_INTK_BP" 2
 /begin AXIS_DESCR FIX_AXIS vvt_b1_intk_act x_cnts 5 0 4 /begin FIX_AXIS_PAR_LIST 0 1 2 3 4 /end FIX_AXIS_PAR_LIST /end AXIS_DESCR
/end CHARACTERISTIC
/begin CHARACTERISTIC AFM_M_VE_PORT_T_FAC "ve port temp factor" MAP 0x00020320 __UWORD_S 0 u_fac_2 0 1.99996948242187 FORMAT "%5.4" SYMBOL_LINK "AFM_M_VE_PORT_T_FAC" 4
 /begin AXIS_DESCR COM_AXIS afm_pred_frsh_air_flw u_g_per_sec 4 0.000000 511.992188 AXIS_PTS_REF AFM_X_AIR_FLW_E /end AXIS_DESCR
 /begin AXIS_DESCR COM_AXIS afm_intk_prt_t u_deg_K 10 0.000000 2047.968750 AXIS_PTS_REF AFM_X_PORT_T_A /end AXIS_DESCR
/end CHARACTERISTIC
/begin AXIS_PTS AFM_X_AIR_FLW_E "axis of air airflow" 0x0002006C afm_pred_frsh_air_flw SSV__UWORD_S 0 u_g_per_sec 4 0 511.9921875 DEPOSIT ABSOLUTE SYMBOL_LINK "AFM_X_AIR_FLW_E" 2 /end AXIS_PTS
/begin AXIS_PTS AFM_X_PORT_T_A "axis of port temp" 0x0002006C afm_intk_prt_t SSV__UWORD_S 0 u_deg_K 10 0.000000 2047.968750 FORMAT "%5.2" DEPOSIT ABSOLUTE SYMBOL_LINK "AFM_X_PORT_T_A" 2 /end AXIS_PTS
/begin CHARACTERISTIC AFM_C_EGR_PCT_FIL "intake manifold heat factor" CURVE 0x000200B0 __UWORD_S 0 u_filter 0 0.9999847412109375 FORMAT "%5.4" SYMBOL_LINK "AFM_C_EGR_PCT_FIL" 2
 /begin AXIS_DESCR FIX_AXIS afm_pred_prt_flw u_g_per_sec 17 0 128
  /begin FIX_AXIS_PAR_LIST 0 1024 2048 3072 4096 5120 6144 7168 8192 9216 10240 11264 12288 13312 14336 15360 16384 /end FIX_AXIS_PAR_LIST
 /end AXIS_DESCR
/end CHARACTERISTIC
/begin CHARACTERISTIC AFM_V_EGR_PCT_MAX "egr flow percent max" VALUE 0x0002038C __UWORD_S 0 u_pct 0 199.996948 FORMAT "%4.1" /end CHARACTERISTIC
/begin CHARACTERISTIC AFM_V_MMAP_MAX_FAC "model map max factor,mult at throttle inlet press" VALUE 0x0002038C __UWORD_S 0 u_fac_1 0 0.999984741210937 /end CHARACTERISTIC
/begin CHARACTERISTIC AFM_V_MAP_PRED_CNTS "predict model map,lead counts of seg time" VALUE 0x0002038C __UWORD_S 0 u_fac_8 0 7.9998779296875 FORMAT "%4.3" /end CHARACTERISTIC
/begin CHARACTERISTIC AFM_V_AMP_UPDT_ESPD_MIN "amp update enable engine speed min" VALUE 0x0002038C __UWORD_S 0 u_espd 0 8191.875000 FORMAT "%5.1" /end CHARACTERISTIC
/begin CHARACTERISTIC AFM_V_AMP_UPDT_ESPD_MAX "amp update enable engine speed max" VALUE 0x0002038C __UWORD_S 0 u_espd 0 8191.875000 FORMAT "%5.1" /end CHARACTERISTIC
/begin CHARACTERISTIC AFM_V_AMP_UPDT_MAP_DLT "amp update enable map steady delta thr" VALUE 0x0002038C __UWORD_S 0 u_kPa_0_256 0 255.99609375 FORMAT "%5.1" /end CHARACTERISTIC
/begin CHARACTERISTIC AFM_V_AMP_FLW_RT_MAX "air flow ratio max for normalized flow ratio,used in amp cal" VALUE 0x0002038C __UWORD_S 0 u_fac_2048 0 2047.96875 /end CHARACTERISTIC
/begin CHARACTERISTIC AFM_V_AMP_UPDT_RT_MAX "amp update enable press ratio max" VALUE 0x0002038C __UWORD_S 0 u_fac_4 0 3.99993896484375 FORMAT "%4.3" /end CHARACTERISTIC
/begin CHARACTERISTIC AFM_V_MMAP_P_GN "mmap propotional term gain" VALUE 0x0002038C __UWORD_S 0 u_fac_128 0 127.998046875 FORMAT "%4.1" /end CHARACTERISTIC
/begin CHARACTERISTIC AFM_V_MMAP_I_GN "mmap integral term gain" VALUE 0x0002038C __UWORD_S 0 u_fac_128 0 127.998046875 FORMAT "%4.1" /end CHARACTERISTIC
/begin CHARACTERISTIC AFM_V_AMP_UPDT_TPS_MIN "amp update enable tps min" VALUE 0x0002038C __UWORD_S 0 u_pct 0 199.996948 FORMAT "%4.1" /end CHARACTERISTIC
/begin CHARACTERISTIC AFM_V_AMP_DFLT "amp default value" VALUE 0x0002038C __UWORD_S 0 u_kPa_0_256 0 255.99609375 FORMAT "%5.1" /end CHARACTERISTIC
/begin CHARACTERISTIC AFM_C_THRO_AR_EFF "throttle effective area" CURVE 0x000200B0 __UWORD_S 0 u_fac_2 0 1.999969482421875 FORMAT "%4.3" SYMBOL_LINK "AFM_C_THRO_AR_EFF" 2
 /begin AXIS_DESCR FIX_AXIS sys_tps_pct u_pct 11 0 100 /begin FIX_AXIS_PAR_LIST 0 3276 6553 9830 13107 16384 19660 22937 26214 29491 32768 /end FIX_AXIS_PAR_LIST /end AXIS_DESCR
/end CHARACTERISTIC
/begin CHARACTERISTIC AFM_V_AMP_UPDT_STDY_MIN "amp update enable map steady min" VALUE 0x0002038C __UWORD_S 0 u_16x_tmr 0 8191.875 /end CHARACTERISTIC
/begin CHARACTERISTIC AFM_M_AMP_PR_RT "press ratio for amp calculation" MAP 0x00020320 __UWORD_S 0 u_fac_4 0 3.99993896484375 SYMBOL_LINK "AFM_M_AMP_PR_RT" 4
 /begin AXIS_DESCR FIX_AXIS afm_amp_flw_scld_rt u_fac_2 14 0.0625 1
  /begin FIX_AXIS_PAR_LIST 2048 4096 6144 8192 10240 12288 14336 16384 18432 20480 22528 24576 26624 28672 /end FIX_AXIS_PAR_LIST
 /end AXIS_DESCR
 /begin AXIS_DESCR FIX_AXIS afm_ar_eff u_fac_2 12 0.05 1
  /begin FIX_AXIS_PAR_LIST 1638 2457 3276 4915 6553 8192 9830 11468 13107 19660 26214 32768 /end FIX_AXIS_PAR_LIST
 /end AXIS_DESCR
/end CHARACTERISTIC
/begin CHARACTERISTIC AFM_C_EGR_FLW "EGR flow under standard condition" CURVE 0x000200B0 __UWORD_S 0 u_g_per_sec_64 0 63.9990234375 FORMAT "%5.3" SYMBOL_LINK "AFM_C_EGR_FLW" 2
 /begin AXIS_DESCR FIX_AXIS sys_egr_pos_act u_pct 21 0 100
  /begin FIX_AXIS_PAR_LIST 0 1638 3276 4915 6553 8192 9830 11468 13107 14745 16384 18022 19660 21299 22937 24576 26214 27852 29491 31129 32768 /end FIX_AXIS_PAR_LIST
 /end AXIS_DESCR
/end CHARACTERISTIC
/begin CHARACTERISTIC AFM_M_EGR_FLW_FAC "factor used to correct EGR flow base on engine speed and airflow" MAP 0x00020320 __UWORD_S 0 u_fac_4 0 3.99993896484375 FORMAT "%4.3" SYMBOL_LINK "AFM_M_EGR_FLW_FAC" 4
 /begin AXIS_DESCR COM_AXIS sys_eng_spd u_espd 9 0.000000 8191.875000 AXIS_PTS_REF AFM_X_ESPD_C /end AXIS_DESCR
 /begin AXIS_DESCR COM_AXIS afm_air_flw u_g_per_sec 15 0.000000 511.992188 AXIS_PTS_REF AFM_X_AIR_FLW_F /end AXIS_DESCR
/end CHARACTERISTIC
/begin AXIS_PTS AFM_X_ESPD_C "" 0x0002006C sys_eng_spd SSV__UWORD_S 0 u_espd 9 0.000000 8191.875000 FORMAT "%5.1" DEPOSIT ABSOLUTE SYMBOL_LINK "AFM_X_ESPD_C" 2 /end AXIS_PTS
/begin AXIS_PTS AFM_X_AIR_FLW_F "axis of air airflow" 0x0002006C afm_air_flw SSV__UWORD_S 0 u_g_per_sec 15 0 511.9921875 DEPOSIT ABSOLUTE SYMBOL_LINK "AFM_X_AIR_FLW_F" 2 /end AXIS_PTS
/begin AXIS_PTS AFM_X_EXH_T_A "exhaust temp breakpoint" 0x0002006C afm_exh_mnfd_t SSV__UWORD_S 0 u_deg_K 8 0.000000 2047.968750 FORMAT "%5.1" DEPOSIT ABSOLUTE SYMBOL_LINK "AFM_X_EXH_T_A" 2 /end AXIS_PTS
/begin AXIS_PTS AFM_X_EGR_FLW "axis of egrflow" 0x0002006C afm_egr_flw SSV__UWORD_S 0 u_g_per_sec_64 12 0 63.9990234375 FORMAT "%5.3" DEPOSIT ABSOLUTE SYMBOL_LINK "AFM_X_EGR_FLW" 2 /end AXIS_PTS
/begin CHARACTERISTIC AFM_M_EGR_IN_T_BIAS "bias to calculate EGR inlet temp" MAP 0x00020320 __SWORD_S 0 u_deg_K_s_b -512 511.984375 SYMBOL_LINK "AFM_M_EGR_IN_T_BIAS" 4
 /begin AXIS_DESCR COM_AXIS afm_exh_mnfd_t u_deg_K 8 0.000000 2047.968750 AXIS_PTS_REF AFM_X_EXH_T_A /end AXIS_DESCR
 /begin AXIS_DESCR COM_AXIS afm_egr_flw u_g_per_sec_64 12 0 63.9990234375 AXIS_PTS_REF AFM_X_EGR_FLW /end AXIS_DESCR
/end CHARACTERISTIC
/begin CHARACTERISTIC AFM_C_EGR_IN_HT_FAC "Heat factor to calculate EGR inlet temp" CURVE 0x000200B0 __UWORD_S 0 u_fac_2 0 1.999969482421875 FORMAT "%4.3" SYMBOL_LINK "AFM_C_EGR_IN_HT_FAC" 2
 /begin AXIS_DESCR COM_AXIS afm_egr_flw u_g_per_sec_64 12 0 63.9990234375 AXIS_PTS_REF AFM_X_EGR_FLW /end AXIS_DESCR
/end CHARACTERISTIC
/begin CHARACTERISTIC AFM_C_EGR_OUT_HT_FAC "Heat factor to calculate EGR outlet temp" CURVE 0x000200B0 __UWORD_S 0 u_fac_2 0 1.999969482421875 FORMAT "%4.3" SYMBOL_LINK "AFM_C_EGR_OUT_HT_FAC" 2
 /begin AXIS_DESCR COM_AXIS afm_egr_flw u_g_per_sec_64 12 0 63.9990234375 AXIS_PTS_REF AFM_X_EGR_FLW /end AXIS_DESCR
/end CHARACTERISTIC
/begin CHARACTERISTIC AFM_V_INTK_VLV_HT_FAC "intake valve heater fac" VALUE 0x0002038C __UWORD_S 0 u_fac_1 0 0.999984741210937 /end CHARACTERISTIC
/begin CHARACTERISTIC AFM_V_INTK_VLV_HT_BIAS "intake valve heater bias" VALUE 0x0002038C __UWORD_S 0 u_fac_8 0 7.9998779296875 FORMAT "%4.3" /end CHARACTERISTIC
/begin CHARACTERISTIC AFM_V_INTK_VLV_RAD_FAC "intake valve radiator fac" VALUE 0x0002038C __UWORD_S 0 u_fac_2 0 1.999969482421875 FORMAT "%4.3" /end CHARACTERISTIC
/begin CHARACTERISTIC AFM_V_INTK_VLV_RAD_BIAS "intake valve radiator bias" VALUE 0x0002038C __UWORD_S 0 u_fac_512 0 511.9921875 FORMAT "%4.1" /end CHARACTERISTIC
/begin CHARACTERISTIC AFM_V_INTK_VLV_T_STP_FIL "intake valve temp filter after stop" VALUE 0x0002038C __UWORD_S 0 u_filter 0 0.9999847412109375 FORMAT "%4.3" /end CHARACTERISTIC
/begin CHARACTERISTIC AFM_V_AMB_T_DFLT "ambient temp default" VALUE 0x0002038C __SWORD_S 0 u_deg_C -256 255.9921875 FORMAT "%4.2" /end CHARACTERISTIC
/begin CHARACTERISTIC AFM_C_AMB_T_HT_FLW_FAC "ambient temp airflow heat factor" CURVE 0x000200B0 __UWORD_S 0 u_fac_2 0 1.999969482421875 FORMAT "%4.3" SYMBOL_LINK "AFM_C_AMB_T_HT_FLW_FAC" 2
 /begin AXIS_DESCR COM_AXIS afm_frsh_air_flw u_g_per_sec 12 0.000000 511.992188 AXIS_PTS_REF AFM_X_AIR_FLW_G /end AXIS_DESCR
/end CHARACTERISTIC
/begin AXIS_PTS AFM_X_AIR_FLW_G "axis of air airflow" 0x0002006C afm_frsh_air_flw SSV__UWORD_S 0 u_g_per_sec 12 0 511.9921875 DEPOSIT ABSOLUTE SYMBOL_LINK "AFM_X_AIR_FLW_G" 2 /end AXIS_PTS
/begin CHARACTERISTIC AFM_C_AMB_T_HT_VSPD_FAC "ambient temp vehicle speed heat factor" CURVE 0x000200B0 __UWORD_S 0 u_fac_2 0 1.999969482421875 FORMAT "%4.3" SYMBOL_LINK "AFM_C_AMB_T_HT_VSPD_FAC" 2
 /begin AXIS_DESCR COM_AXIS sys_veh_spd u_vspd 12 0.000000 511.992188 AXIS_PTS_REF AFM_X_VSPD_A /end AXIS_DESCR
/end CHARACTERISTIC
/begin AXIS_PTS AFM_X_VSPD_A "axis of vehicle speed" 0x0002006C sys_veh_spd SSV__UWORD_S 0 u_vspd 12 0.000000 511.992188 DEPOSIT ABSOLUTE SYMBOL_LINK "AFM_X_VSPD_A" 2 /end AXIS_PTS
/begin CHARACTERISTIC AFM_V_AMB_T_MIN "ambient temp min" VALUE 0x0002038C __SWORD_S 0 u_deg_C -256 255.9921875 FORMAT "%4.2" /end CHARACTERISTIC
/begin CHARACTERISTIC AFM_V_AMB_T_MAX "ambient temp min" VALUE 0x0002038C __SWORD_S 0 u_deg_C -256 255.9921875 FORMAT "%4.2" SYMBOL_LINK "AFM_V_AMB_T_MAX" 2 /end CHARACTERISTIC
/begin CHARACTERISTIC AFM_V_AMB_T_FIL "ambient temp filter" VALUE 0x0002038C __UWORD_S 0 u_filter 0 0.9999847412109375 FORMAT "%4.3" /end CHARACTERISTIC
/begin CHARACTERISTIC AFM_V_AMB_T_EN_VSPD_MIN "ambient temp update enable vehicle speed min" VALUE 0x0002038C __UWORD_S 0 u_vspd 0 511.992188 FORMAT "%4.1" /end CHARACTERISTIC
/begin CHARACTERISTIC AFM_V_AMB_T_EN_VSPD_MAX "ambient temp update enable vehicle speed max" VALUE 0x0002038C __UWORD_S 0 u_vspd 0 511.992188 FORMAT "%4.1" SYMBOL_LINK "AFM_V_AMB_T_EN_VSPD_MAX" 2 /end CHARACTERISTIC
/begin CHARACTERISTIC AFM_V_AMB_T_EN_FLW_MIN "ambient temp update enable airflow min" VALUE 0x0002038C __UWORD_S 0 u_g_per_sec 0 511.992188 FORMAT "%4.1" /end CHARACTERISTIC
/begin CHARACTERISTIC AFM_V_AMB_T_EN_FLW_MAX "ambient temp update enable airflow max" VALUE 0x0002038C __UWORD_S 0 u_g_per_sec 0 511.992188 FORMAT "%4.1" SYMBOL_LINK "AFM_V_AMB_T_EN_FLW_MAX" 2 /end CHARACTERISTIC
/begin CHARACTERISTIC AFM_V_AMB_T_INIT_EN_DLT "ambient temp keyon update enable delta max between iat and ect" VALUE 0x0002038C __SWORD_S 0 u_deg_C -256 255.9921875 FORMAT "%4.2" /end CHARACTERISTIC
/begin CHARACTERISTIC AFM_V_AMB_T_INIT_EN_ECT "ambient temp keyon update enable ect max" VALUE 0x0002038C __SWORD_S 0 u_deg_C -256 255.9921875 FORMAT "%4.2" /end CHARACTERISTIC
/begin CHARACTERISTIC AFM_V_AMB_T_EN_FAC_MIN "ambient temp update enable heater factor min" VALUE 0x0002038C __UWORD_S 0 u_fac_2 0 1.999969482421875 FORMAT "%4.3" /end CHARACTERISTIC
/begin CHARACTERISTIC AFM_C_EGR_COOLER_P_DLT "delta pressure across EGR cooler" CURVE 0x27980 __UWORD_S 0 u_kPa_0_128 0 127.998046875 SYMBOL_LINK "AFM_C_EGR_COOLER_P_DLT" 2
 /begin AXIS_DESCR COM_AXIS afm_egr_flw u_g_per_sec_64 7 0 63.9990234375 AXIS_PTS_REF AFM_X_EGR_FLW_A /end AXIS_DESCR
/end CHARACTERISTIC
/begin AXIS_PTS AFM_X_EGR_FLW_A "axis of egrflow" 0x2794C afm_egr_flw SSV__UWORD_S 0 u_g_per_sec_64 7 0 63.9990234375 FORMAT "%5.3" DEPOSIT ABSOLUTE SYMBOL_LINK "AFM_X_EGR_FLW_A" 2 /end AXIS_PTS
/begin CHARACTERISTIC AFM_V_EGR_COOLER_P_DLT_FIL "Filter coefficient of delta pressure across EGR cooler" VALUE 0x2028A __UWORD_S 0 u_filter 0 0.9999847412109375 FORMAT "%10.9" /end CHARACTERISTIC
/begin CHARACTERISTIC AFM_C_CAT_P_DROP "catalyst pressure drop" CURVE 0x000200B0 __UWORD_S 0 u_kPa_0_128 0 127.998046875 FORMAT "%4.3" SYMBOL_LINK "AFM_C_CAT_P_DROP" 2
 /begin AXIS_DESCR COM_AXIS afm_cyl_flw u_g_per_sec 7 0.000000 511.9921875 AXIS_PTS_REF AFM_X_CYL_FLW_A /end AXIS_DESCR
/end CHARACTERISTIC
/begin AXIS_PTS AFM_X_CYL_FLW_A "axis of egrflow" 0x2794C afm_cyl_flw SSV__UWORD_S 0 u_g_per_sec 7 0 511.9921875 FORMAT "%5.3" DEPOSIT ABSOLUTE SYMBOL_LINK "AFM_X_CYL_FLW_A" 2 /end AXIS_PTS
/begin CHARACTERISTIC AFM_C_AIR_FILTR_P_DROP "catalyst pressure drop" CURVE 0x000200B0 __UWORD_S 0 u_kPa_0_32 0 31.99951171875 FORMAT "%5.3" SYMBOL_LINK "AFM_C_AIR_FILTR_P_DROP" 2
 /begin AXIS_DESCR COM_AXIS afm_frsh_air_flw u_g_per_sec 7 0.000000 511.9921875 AXIS_PTS_REF AFM_X_AIR_FLW_I /end AXIS_DESCR
/end CHARACTERISTIC
/begin AXIS_PTS AFM_X_AIR_FLW_I "axis of egrflow" 0x2794C afm_frsh_air_flw SSV__UWORD_S 0 u_g_per_sec 7 0 511.9921875 FORMAT "%5.3" DEPOSIT ABSOLUTE SYMBOL_LINK "AFM_X_AIR_FLW_I" 2 /end AXIS_PTS
/begin CHARACTERISTIC AFM_V_STK_FLW_LD_DEC_FIL "stroke airflow setpoint percent decrease filter" VALUE 0x0002038C __UWORD_S 0 u_filter 0 0.9999847412109375 FORMAT "%4.3" /end CHARACTERISTIC
/begin CHARACTERISTIC AFM_V_STK_FLW_LD_INC_FIL "stroke airflow setpoint percent increase filter" VALUE 0x0002038C __UWORD_S 0 u_filter 0 0.9999847412109375 FORMAT "%4.3" /end CHARACTERISTIC
/begin CHARACTERISTIC AFM_C_AIR_FLW_MAX "air flow max standard condition" CURVE 0x000200B0 __UWORD_S 0 u_g_per_sec 0 511.9921875 SYMBOL_LINK "AFM_C_AIR_FLW_MAX" 2
 /begin AXIS_DESCR FIX_AXIS sys_eng_spd u_espd 9 0 6400 /begin FIX_AXIS_PAR_LIST 0 6400 12800 19200 25600 32000 38400 44800 51200 /end FIX_AXIS_PAR_LIST /end AXIS_DESCR
/end CHARACTERISTIC
/begin CHARACTERISTIC AFM_V_PR_EXP "press ratio exponent" VALUE 0x0002038C __UWORD_S 0 u_fac_1 0 0.9999847412109375 /end CHARACTERISTIC
/begin CHARACTERISTIC AFM_C_CP_FLW "canister purge flow" CURVE 0x000200B0 __UWORD_S 0 u_g_per_sec_64 0 63.9990234375 FORMAT "%4.2" SYMBOL_LINK "AFM_C_CP_FLW" 2 /begin AXIS_DESCR COM_AXIS evac_dc u_pct 21 0 100 AXIS_PTS_REF AFM_X_CP_DTY /end AXIS_DESCR /end CHARACTERISTIC
/begin AXIS_PTS AFM_X_CP_DTY "canister purge duty" 0x2794C evac_dc SSV__UWORD_S 0 u_pct 21 0 100 DEPOSIT ABSOLUTE SYMBOL_LINK "AFM_X_CP_DTY" 2 /end AXIS_PTS
/begin CHARACTERISTIC AFM_C_CP_FLW_PR_FAC "canister purge flow press ratio factor" CURVE 0x000200B0 __UWORD_S 0 u_fac_2 0 1.999969482421875 FORMAT "%4.3" SYMBOL_LINK "AFM_C_CP_FLW_PR_FAC" 2
 /begin AXIS_DESCR FIX_AXIS NO_INPUT_QUANTITY u_fac_2 15 0.3 1
  /begin FIX_AXIS_PAR_LIST 9830 14417 17039 18939 21626 24313 26705 28442 29753 30736 31522 32079 32440 32702 32768 /end FIX_AXIS_PAR_LIST
 /end AXIS_DESCR
/end CHARACTERISTIC
/begin CHARACTERISTIC AFM_V_EGR_CLS_THR "EGR close position thr" VALUE 0x0002038C __UWORD_S 0 u_pct 0 199.996948 /end CHARACTERISTIC
/begin CHARACTERISTIC AFM_V_EGR_VLD_DLY "EGR valid runtime delay" VALUE 0x0002038C __UWORD_S 0 u_1s_tmr 0 65535 /end CHARACTERISTIC
/begin CHARACTERISTIC AFM_V_THRT_LRN_AR_DIF "throttle flow learn area difference max" VALUE 0x0002038C __SLONG_S 0 u_g_per_sec_s_l -512 511.984375 /end CHARACTERISTIC
/begin CHARACTERISTIC AFM_V_THRT_LRN_ECT "throttle flow learn enable ECT min" VALUE 0x0002038C __SWORD_S 0 u_deg_C -256 255.9921875 FORMAT "%4.2" /end CHARACTERISTIC
/begin CHARACTERISTIC AFM_V_THRT_LRN_EN_DLY "throttle flow learn enable delay after conditions met" VALUE 0x0002038C __UWORD_S 0 u_8x_tmr 0 4095.9375 FORMAT "%5.1" /end CHARACTERISTIC
/begin CHARACTERISTIC AFM_V_THRT_LRN_MAP_DLT "throttle flow learn enable MAP delta max" VALUE 0x0002038C __UWORD_S 0 u_kPa_0_256 0 255.99609375 FORMAT "%5.1" /end CHARACTERISTIC
/begin CHARACTERISTIC AFM_V_THRT_LRN_TPS_DLT "throttle flow learn enable TPS delta max" VALUE 0x0002038C __UWORD_S 0 u_pct 0 199.996948 /end CHARACTERISTIC
/begin CHARACTERISTIC AFM_C_CP_THRT_LRN_AR "throttle flow learn area break point" CURVE 0x000200B0 __UWORD_S 0 u_pct 0 199.996948 FORMAT "%4.1" SYMBOL_LINK "AFM_C_CP_THRT_LRN_AR" 2
 /begin AXIS_DESCR FIX_AXIS NO_INPUT_QUANTITY u_cnts 9 1 9 /begin FIX_AXIS_PAR_LIST 1 2 3 4 5 6 7 8 9 /end FIX_AXIS_PAR_LIST /end AXIS_DESCR
/end CHARACTERISTIC
/begin CHARACTERISTIC AFM_V_EGR_PR_FIL "EGR press ratio filter" VALUE 0x0002038C __UWORD_S 0 u_filter 0 0.9999847412109375 FORMAT "%4.3" /end CHARACTERISTIC
/begin CHARACTERISTIC AFM_M_VE_VGIS01_OFST "VE offset VGIS1 disable VGIS2 enable" MAP 0x29194 __SWORD_S 0 u_pct -100 99.9969 SYMBOL_LINK "AFM_M_VE_VGIS01_OFST" 4
 /begin AXIS_DESCR COM_AXIS sys_eng_spd u_espd 12 0.000000 8191.875000 AXIS_PTS_REF AFM_X_ESPD_B /end AXIS_DESCR
 /begin AXIS_DESCR COM_AXIS afm_exh_to_map_fac u_fac_16 4 0.000000 15.999756 AXIS_PTS_REF AFM_X_EXH_TO_MAP_RT_A /end AXIS_DESCR
/end CHARACTERISTIC
/begin CHARACTERISTIC AFM_M_VE_VGIS10_OFST "VE offset VGIS1 enable VGIS2 disable" MAP 0x29194 __SWORD_S 0 u_pct -100 99.9969 SYMBOL_LINK "AFM_M_VE_VGIS10_OFST" 4
 /begin AXIS_DESCR COM_AXIS sys_eng_spd u_espd 12 0.000000 8191.875000 AXIS_PTS_REF AFM_X_ESPD_B /end AXIS_DESCR
 /begin AXIS_DESCR COM_AXIS afm_exh_to_map_fac u_fac_16 4 0.000000 15.999756 AXIS_PTS_REF AFM_X_EXH_TO_MAP_RT_A /end AXIS_DESCR
/end CHARACTERISTIC
/begin CHARACTERISTIC AFM_M_VE_VGIS11_OFST "VE offset VGIS1 enable VGIS2 enable" MAP 0x29194 __SWORD_S 0 u_pct -100 99.9969 SYMBOL_LINK "AFM_M_VE_VGIS11_OFST" 4
 /begin AXIS_DESCR COM_AXIS sys_eng_spd u_espd 12 0.000000 8191.875000 AXIS_PTS_REF AFM_X_ESPD_B /end AXIS_DESCR
 /begin AXIS_DESCR COM_AXIS afm_exh_to_map_fac u_fac_16 4 0.000000 15.999756 AXIS_PTS_REF AFM_X_EXH_TO_MAP_RT_A /end AXIS_DESCR
/end CHARACTERISTIC
/begin AXIS_PTS AFM_X_EXH_TO_MAP_RT_A "exh to map breakpoint" 0x28C04 afm_exh_to_map_fac SSV__UWORD_S 0 u_fac_16 4 0.000000 15.999756 FORMAT "%4.2" DEPOSIT ABSOLUTE SYMBOL_LINK "AFM_X_EXH_TO_MAP_RT_A" 2 /end AXIS_PTS
/begin CHARACTERISTIC ETCS_V_EGR_SP_STP_HI "EGR setpoint change step high" VALUE 0x0002038C __UWORD_S 0 u_pct 0 199.996948 /end CHARACTERISTIC
/begin CHARACTERISTIC ETCS_V_EGR_SP_RMP_STP "EGR setpoint ramp step" VALUE 0x0002038C __UWORD_S 0 u_pct 0 199.996948 /end CHARACTERISTIC
/begin CHARACTERISTIC ETCS_V_EGR_VAC_MIN "Minimum desired vacuum during EGR operation" VALUE 0x0002038C __UWORD_S 0 u_kPa_0_256 0 255.99609375 /end CHARACTERISTIC
/begin CHARACTERISTIC ETCS_V_VAC_LMT_EGR_SP_FIL "EGR setpoint filter,when vacuum limit active" VALUE 0x0002038C __UWORD_S 0 u_filter 0 0.9999847412109375 FORMAT "%5.2" /end CHARACTERISTIC
/begin CHARACTERISTIC ETCS_V_EGR_SP_INC_FIL "normal EGR setpoint increase filter" VALUE 0x0002038C __UWORD_S 0 u_filter 0 0.9999847412109375 FORMAT "%5.2" /end CHARACTERISTIC
/begin CHARACTERISTIC ETCS_V_RUN_CTRL_SEG_MAX "run control mode enable segment time max" VALUE 0x0002038C __UWORD_S 0 u_millisec 0 1023.984375 FORMAT "%5.1" /end CHARACTERISTIC
/begin CHARACTERISTIC ETCS_C_STRT_THROT_PR_SP "start up throttle press ratio setpoint" CURVE 0x000200B0 __UWORD_S 0 u_fac_2 0 1.999969482421875 SYMBOL_LINK "ETCS_C_STRT_THROT_PR_SP" 2
 /begin AXIS_DESCR COM_AXIS sys_ect u_deg_C 8 -256 255.9921875 AXIS_PTS_REF ETCS_X_ECT_A /end AXIS_DESCR
/end CHARACTERISTIC
/begin AXIS_PTS ETCS_X_ECT_A "axis of ect" 0x2794C sys_ect SSV__SWORD_S 0 u_deg_C 8 -256 255.9921875 FORMAT "%3.2" DEPOSIT ABSOLUTE SYMBOL_LINK "ETCS_X_ECT_A" 2 /end AXIS_PTS
/begin CHARACTERISTIC ETCS_V_THRT_PR_SP_HI "throttle press ratio raw setpoint high threshhold to enable filt" VALUE 0x0002038C __UWORD_S 0 u_fac_2 0 1.999969482421875 /end CHARACTERISTIC
/begin CHARACTERISTIC ETCS_C_THRT_PR_SP_FIL "throttle press ratio setpoint filter" CURVE 0x000200B0 __UWORD_S 0 u_filter 0 0.9999847412109375 FORMAT "%3.2" SYMBOL_LINK "ETCS_C_THRT_PR_SP_FIL" 2
 /begin AXIS_DESCR FIX_AXIS NO_INPUT_QUANTITY x_ratio 11 0.8 1 /begin FIX_AXIS_PAR_LIST 0.8 0.82 0.84 0.86 0.88 0.9 0.92 0.94 0.96 0.98 1 /end FIX_AXIS_PAR_LIST /end AXIS_DESCR
/end CHARACTERISTIC
/begin CHARACTERISTIC ETCS_V_THRT_PR_SP_HI_HYS "throttle press ratio raw setpoint high threshhold hys" VALUE 0x0002038C __UWORD_S 0 u_fac_2 0 1.999969482421875 /end CHARACTERISTIC
/begin CHARACTERISTIC ETCS_M_THRT_PR_SP_MAX "throttle press ratio setpoint max" MAP 0x00020320 __UWORD_S 0 u_fac_2 0 1.999969482421875 SYMBOL_LINK "ETCS_M_THRT_PR_SP_MAX" 4
 /begin AXIS_DESCR FIX_AXIS sys_eng_spd u_espd 19 0 7200
  /begin FIX_AXIS_PAR_LIST 0 3200 6400 9600 12800 16000 19200 22400 25600 28800 32000 35200 38400 41600 44800 48000 51200 54400 57600 /end FIX_AXIS_PAR_LIST
 /end AXIS_DESCR
 /begin AXIS_DESCR FIX_AXIS tq_vr_pps u_pct 21 0 100
  /begin FIX_AXIS_PAR_LIST 0 1638 3276 4915 6553 8192 9830 11468 13107 14745 16384 18022 19660 21299 22937 24576 26214 27852 29491 31129 32768 /end FIX_AXIS_PAR_LIST
 /end AXIS_DESCR
/end CHARACTERISTIC
/begin CHARACTERISTIC ETCS_V_THRO_IN_P_RMP_STP "throttle inlet press ramp step" VALUE 0x0002038C __UWORD_S 0 u_kPa_0_256 0 255.99609375 /end CHARACTERISTIC
/begin CHARACTERISTIC FMSP_V_ADP_MAX "fuel mass adption max" VALUE 0x0002038C __UWORD_S 0 u_fac_2 0 1.999969482421875 /end CHARACTERISTIC
/begin CHARACTERISTIC FMSP_V_ADP_MIN "fuel mass adption max" VALUE 0x0002038C __UWORD_S 0 u_fac_2 0 1.999969482421875 /end CHARACTERISTIC
/begin CHARACTERISTIC FMSP_M_CL_P_NEG "fuel close loop negtive P-jump " MAP 0x00020320 __UWORD_S 0 u_milli_pct 0 1999.969482421875 SYMBOL_LINK "FMSP_M_CL_P_NEG" 4
 /begin AXIS_DESCR COM_AXIS sys_eng_spd u_espd 8 0.000000 8191.875000 AXIS_PTS_REF FMSP_X_ESPD /end AXIS_DESCR
 /begin AXIS_DESCR COM_AXIS afm_stk_flw u_stk_flw 8 0.000000 1.99996948242187 AXIS_PTS_REF FMSP_X_STRK_AIR /end AXIS_DESCR
/end CHARACTERISTIC
/begin CHARACTERISTIC FMSP_M_CL_IDL_P_NEG "fuel close loop idle negtive P-jump " MAP 0x00020320 __UWORD_S 0 u_milli_pct 0 1999.969482421875 SYMBOL_LINK "FMSP_M_CL_IDL_P_NEG" 4
 /begin AXIS_DESCR COM_AXIS sys_eng_spd u_espd 8 0.000000 8191.875000 AXIS_PTS_REF FMSP_X_ESPD_CL_IDL /end AXIS_DESCR
 /begin AXIS_DESCR COM_AXIS afm_stk_flw u_stk_flw 8 0.000000 1.99996948242187 AXIS_PTS_REF FMSP_X_IDL_STRK_AIR /end AXIS_DESCR
/end CHARACTERISTIC
/begin CHARACTERISTIC FMSP_M_CL_P_POS "fuel close loop positive P-jump " MAP 0x00020320 __UWORD_S 0 u_milli_pct 0 1999.969482421875 SYMBOL_LINK "FMSP_M_CL_P_POS" 4
 /begin AXIS_DESCR COM_AXIS sys_eng_spd u_espd 8 0.000000 8191.875000 AXIS_PTS_REF FMSP_X_ESPD /end AXIS_DESCR
 /begin AXIS_DESCR COM_AXIS afm_stk_flw u_stk_flw 8 0.000000 1.99996948242187 AXIS_PTS_REF FMSP_X_STRK_AIR /end AXIS_DESCR
/end CHARACTERISTIC
/begin CHARACTERISTIC FMSP_M_CL_IDL_P_POS "fuel close loop idle positive P-jump " MAP 0x00020320 __UWORD_S 0 u_milli_pct 0 1999.969482421875 SYMBOL_LINK "FMSP_M_CL_IDL_P_POS" 4
 /begin AXIS_DESCR COM_AXIS sys_eng_spd u_espd 8 0.000000 8191.875000 AXIS_PTS_REF FMSP_X_ESPD_CL_IDL /end AXIS_DESCR
 /begin AXIS_DESCR COM_AXIS afm_stk_flw u_stk_flw 8 0.000000 1.99996948242187 AXIS_PTS_REF FMSP_X_IDL_STRK_AIR /end AXIS_DESCR
/end CHARACTERISTIC
/begin CHARACTERISTIC FMSP_M_CL_IDL_I_POS "fuel close loop idle positive int" MAP 0x00020320 __UWORD_S 0 u_milli_pct 0 1999.969482421875 SYMBOL_LINK "FMSP_M_CL_IDL_I_POS" 4
 /begin AXIS_DESCR COM_AXIS sys_eng_spd u_espd 8 0.000000 8191.875000 AXIS_PTS_REF FMSP_X_ESPD_CL_IDL /end AXIS_DESCR
 /begin AXIS_DESCR COM_AXIS afm_stk_flw u_stk_flw 8 0.000000 1.99996948242187 AXIS_PTS_REF FMSP_X_IDL_STRK_AIR /end AXIS_DESCR
/end CHARACTERISTIC
/begin CHARACTERISTIC FMSP_M_CL_I_POS "fuel close loop positive int" MAP 0x00020320 __UWORD_S 0 u_milli_pct 0 1999.969482421875 SYMBOL_LINK "FMSP_M_CL_I_POS" 4
 /begin AXIS_DESCR COM_AXIS sys_eng_spd u_espd 8 0.000000 8191.875000 AXIS_PTS_REF FMSP_X_ESPD /end AXIS_DESCR
 /begin AXIS_DESCR COM_AXIS afm_stk_flw u_stk_flw 8 0.000000 1.99996948242187 AXIS_PTS_REF FMSP_X_STRK_AIR /end AXIS_DESCR
/end CHARACTERISTIC
/begin CHARACTERISTIC FMSP_M_CL_IDL_I_NEG "fuel close loop idle negtive int" MAP 0x00020320 __UWORD_S 0 u_milli_pct 0 1999.969482421875 SYMBOL_LINK "FMSP_M_CL_IDL_I_NEG" 4
 /begin AXIS_DESCR COM_AXIS sys_eng_spd u_espd 8 0.000000 8191.875000 AXIS_PTS_REF FMSP_X_ESPD_CL_IDL /end AXIS_DESCR
 /begin AXIS_DESCR COM_AXIS afm_stk_flw u_stk_flw 8 0.000000 1.99996948242187 AXIS_PTS_REF FMSP_X_IDL_STRK_AIR /end AXIS_DESCR
/end CHARACTERISTIC
/begin CHARACTERISTIC FMSP_M_CL_I_NEG "fuel close loop negtive int" MAP 0x00020320 __UWORD_S 0 u_milli_pct 0 1999.969482421875 SYMBOL_LINK "FMSP_M_CL_I_NEG" 4
 /begin AXIS_DESCR COM_AXIS sys_eng_spd u_espd 8 0.000000 8191.875000 AXIS_PTS_REF FMSP_X_ESPD /end AXIS_DESCR
 /begin AXIS_DESCR COM_AXIS afm_stk_flw u_stk_flw 8 0.000000 1.99996948242187 AXIS_PTS_REF FMSP_X_STRK_AIR /end AXIS_DESCR
/end CHARACTERISTIC
/begin CHARACTERISTIC FMSP_M_CL_IDL_POS_HLD_T "fuel close loop idle positive hold time" MAP 0x00020320 __UWORD_S 0 u_2x_tmr 0 1023.984375 SYMBOL_LINK "FMSP_M_CL_IDL_POS_HLD_T" 4
 /begin AXIS_DESCR COM_AXIS sys_eng_spd u_espd 8 0.000000 8191.875000 AXIS_PTS_REF FMSP_X_ESPD_CL_IDL /end AXIS_DESCR
 /begin AXIS_DESCR COM_AXIS afm_stk_flw u_stk_flw 8 0.000000 1.99996948242187 AXIS_PTS_REF FMSP_X_IDL_STRK_AIR /end AXIS_DESCR
/end CHARACTERISTIC
/begin CHARACTERISTIC FMSP_M_CL_POS_HLD_T "fuel close loop positive hold time" MAP 0x00020320 __UWORD_S 0 u_2x_tmr 0 1023.984375 SYMBOL_LINK "FMSP_M_CL_POS_HLD_T" 4
 /begin AXIS_DESCR COM_AXIS sys_eng_spd u_espd 8 0.000000 8191.875000 AXIS_PTS_REF FMSP_X_ESPD /end AXIS_DESCR
 /begin AXIS_DESCR COM_AXIS afm_stk_flw u_stk_flw 8 0.000000 1.99996948242187 AXIS_PTS_REF FMSP_X_STRK_AIR /end AXIS_DESCR
/end CHARACTERISTIC
/begin CHARACTERISTIC FMSP_M_CL_IDL_NEG_HLD_T "fuel close loop idle negtive hold time" MAP 0x00020320 __UWORD_S 0 u_2x_tmr 0 1023.984375 SYMBOL_LINK "FMSP_M_CL_IDL_NEG_HLD_T" 4
 /begin AXIS_DESCR COM_AXIS sys_eng_spd u_espd 8 0.000000 8191.875000 AXIS_PTS_REF FMSP_X_ESPD_CL_IDL /end AXIS_DESCR
 /begin AXIS_DESCR COM_AXIS afm_stk_flw u_stk_flw 8 0.000000 1.99996948242187 AXIS_PTS_REF FMSP_X_IDL_STRK_AIR /end AXIS_DESCR
/end CHARACTERISTIC
/begin CHARACTERISTIC FMSP_M_CL_NEG_HLD_T "fuel close loop negtive hold time" MAP 0x00020320 __UWORD_S 0 u_2x_tmr 0 1023.984375 SYMBOL_LINK "FMSP_M_CL_NEG_HLD_T" 4
 /begin AXIS_DESCR COM_AXIS sys_eng_spd u_espd 8 0.000000 8191.875000 AXIS_PTS_REF FMSP_X_ESPD /end AXIS_DESCR
 /begin AXIS_DESCR COM_AXIS afm_stk_flw u_stk_flw 8 0.000000 1.99996948242187 AXIS_PTS_REF FMSP_X_STRK_AIR /end AXIS_DESCR
/end CHARACTERISTIC
/begin AXIS_PTS FMSP_X_ESPD "engine speed breakpoint" 0x0002006C sys_eng_spd SSV__UWORD_S 0 u_espd 8 0.000000 8191.875000 FORMAT "%6.2" DEPOSIT ABSOLUTE SYMBOL_LINK "FMSP_X_ESPD" 2 /end AXIS_PTS
/begin AXIS_PTS FMSP_X_ESPD_CL_IDL "engine speed breakpoint" 0x0002006C sys_eng_spd SSV__UWORD_S 0 u_espd 8 0.000000 8191.875000 FORMAT "%6.2" DEPOSIT ABSOLUTE SYMBOL_LINK "FMSP_X_ESPD_CL_IDL" 2 /end AXIS_PTS
/begin AXIS_PTS FMSP_X_ESPD_B "engine speed breakpoint" 0x0002006C sys_eng_spd SSV__UWORD_S 0 u_espd 9 0.000000 8191.875000 FORMAT "%6.2" DEPOSIT ABSOLUTE SYMBOL_LINK "FMSP_X_ESPD_B" 2 /end AXIS_PTS
/begin AXIS_PTS FMSP_X_STRK_AIR "stroke airflow breakpoint" 0x0002006C afm_stk_flw SSV__UWORD_S 0 u_stk_flw 8 0.000000 1.99996948242187 FORMAT "%6.2" DEPOSIT ABSOLUTE SYMBOL_LINK "FMSP_X_STRK_AIR" 2 /end AXIS_PTS
/begin AXIS_PTS FMSP_X_IDL_STRK_AIR "stroke airflow breakpoint" 0x0002006C afm_stk_flw SSV__UWORD_S 0 u_stk_flw 8 0.000000 1.99996948242187 FORMAT "%6.2" DEPOSIT ABSOLUTE SYMBOL_LINK "FMSP_X_IDL_STRK_AIR" 2 /end AXIS_PTS
/begin CHARACTERISTIC FMSP_V_CL_O2_LEAN_THR "o2 lean thr for close loop" VALUE 0x0002038C __UWORD_S 0 u_volt_32 0 31.99951171875 FORMAT "%5.2" /end CHARACTERISTIC
/begin CHARACTERISTIC FMSP_V_CL_O2_RICH_THR "o2 rich thr for close loop" VALUE 0x0002038C __UWORD_S 0 u_volt_32 0 31.99951171875 FORMAT "%5.2" /end CHARACTERISTIC
/begin CHARACTERISTIC FMSP_M_POW_EN_THR "fuel power enable threshold" MAP 0x00020320 __UBYTE_S 0 u_pct_lo 0 127.5 FORMAT "%4.1" SYMBOL_LINK "FMSP_M_POW_EN_THR" 3
 /begin AXIS_DESCR COM_AXIS sys_eng_spd u_espd 9 0.000000 8191.875000 AXIS_PTS_REF FMSP_X_ESPD_B /end AXIS_DESCR
 /begin AXIS_DESCR COM_AXIS sys_ect u_deg_C 5 -256.000000 255.9921875 AXIS_PTS_REF FMSP_X_ECT_A /end AXIS_DESCR
/end CHARACTERISTIC
/begin AXIS_PTS FMSP_X_ECT_A "ect breakpoint" 0x0002006C sys_ect SSV__SWORD_S 0 u_deg_C 5 -256.000000 255.9921875 FORMAT "%4.1" DEPOSIT ABSOLUTE SYMBOL_LINK "FMSP_X_ECT_A" 2 /end AXIS_PTS
/begin CHARACTERISTIC FMSP_C_ECO_POW_EN_THR "power afr ect correction" CURVE 0x000200B0 __UBYTE_S 0 u_pct_lo 0 127.5 FORMAT "%4.1" SYMBOL_LINK "FMSP_C_ECO_POW_EN_THR" 2
 /begin AXIS_DESCR COM_AXIS sys_eng_spd u_espd 9 0.000000 8191.875000 AXIS_PTS_REF FMSP_X_ESPD_B /end AXIS_DESCR
/end CHARACTERISTIC
/begin CHARACTERISTIC FMSP_M_POW_AF "fuel power rich afr" MAP 0x00020320 __UBYTE_S 0 u_afr_b 0 63.75 SYMBOL_LINK "FMSP_M_POW_AF" 3
 /begin AXIS_DESCR COM_AXIS sys_eng_spd u_espd 9 0.000000 8191.875000 AXIS_PTS_REF FMSP_X_ESPD_B /end AXIS_DESCR
 /begin AXIS_DESCR FIX_AXIS tq_tot_req_pct u_pct 9 0 100 /begin FIX_AXIS_PAR_LIST 0 4096 8192 12288 16384 20480 24576 28672 32768 /end FIX_AXIS_PAR_LIST /end AXIS_DESCR
/end CHARACTERISTIC
/begin CHARACTERISTIC FMSP_M_ECO_POW_AF "fuel power rich afr" MAP 0x00020320 __UBYTE_S 0 u_afr_b 0 63.75 SYMBOL_LINK "FMSP_M_ECO_POW_AF" 3
 /begin AXIS_DESCR COM_AXIS sys_eng_spd u_espd 9 0.000000 8191.875000 AXIS_PTS_REF FMSP_X_ESPD_B /end AXIS_DESCR
 /begin AXIS_DESCR COM_AXIS tq_tot_req_pct u_pct 5 0 199.996948 AXIS_PTS_REF FMSP_X_TQ_PCT_A /end AXIS_DESCR
/end CHARACTERISTIC
/begin AXIS_PTS FMSP_X_TQ_PCT_A "torq percent breakpoint" 0x0002006C tq_tot_req_pct SSV__UWORD_S 0 u_pct 5 0 199.996948 FORMAT "%4.1" DEPOSIT ABSOLUTE SYMBOL_LINK "FMSP_X_TQ_PCT_A" 2 /end AXIS_PTS
/begin CHARACTERISTIC FMSP_C_POW_AF_ECT_FAC "power afr ect correction" CURVE 0x000200B0 __UWORD_S 0 u_fac_1 0 0.999984741210937 SYMBOL_LINK "FMSP_C_POW_AF_ECT_FAC" 2
 /begin AXIS_DESCR FIX_AXIS sys_ect u_deg_C 17 -40 152
  /begin FIX_AXIS_PAR_LIST -5120 -3584 -2048 -512 1024 2560 4096 5632 7168 8704 10240 11776 13312 14848 16384 17920 19456 /end FIX_AXIS_PAR_LIST
 /end AXIS_DESCR
/end CHARACTERISTIC
/begin CHARACTERISTIC FMSP_V_POW_SRC_CFG "power fuel enable source config" VALUE 0x0002038C __UBYTE_S 0 b_pow_src 0 1 FORMAT "%5.0" /end CHARACTERISTIC
/begin CHARACTERISTIC FMSP_V_POW_EN_HYS "fuel power enable threshold hys" VALUE 0x0002038C __UWORD_S 0 u_pct 0 199.996948 /end CHARACTERISTIC
/begin CHARACTERISTIC FMSP_V_ECO_POW_EN_HYS "eco mode fuel power enable threshold hys" VALUE 0x0002038C __UWORD_S 0 u_pct 0 199.996948 /end CHARACTERISTIC
/begin CHARACTERISTIC FMSP_C_POW_DLY "power afr enable delay" CURVE 0x000200B0 __UWORD_S 0 u_2x_tmr 0 1023.984375 SYMBOL_LINK "FMSP_C_POW_DLY" 2
 /begin AXIS_DESCR FIX_AXIS sys_amp u_kPa_0_256 7 75 105 /begin FIX_AXIS_PAR_LIST 19200 20480 21760 23040 24320 25600 26880 /end FIX_AXIS_PAR_LIST /end AXIS_DESCR
/end CHARACTERISTIC
/begin CHARACTERISTIC FMSP_C_POW_DLY_EXT_BIAS "power afr enable delay exit bias,which added on power enable thr" CURVE 0x000200B0 __UBYTE_S 0 u_pct_lo 0 127.5 FORMAT "%4.3" SYMBOL_LINK "FMSP_C_POW_DLY_EXT_BIAS" 2
 /begin AXIS_DESCR COM_AXIS sys_eng_spd u_espd 9 0.000000 8191.875000 AXIS_PTS_REF FMSP_X_ESPD_B /end AXIS_DESCR
/end CHARACTERISTIC
/begin CHARACTERISTIC FMSP_V_POW_DLY_EXT_ESPD "power afr enable delay exit engnie speed thr" VALUE 0x0002038C __UWORD_S 0 u_espd 0 8191.875000 FORMAT "%6.2" /end CHARACTERISTIC
/begin CHARACTERISTIC FMSP_V_UO2_RDY_HI "o2 ready high thr" VALUE 0x0002038C __UWORD_S 0 u_volt_32 0 31.99951171875 FORMAT "%3.2" /end CHARACTERISTIC
/begin CHARACTERISTIC FMSP_V_DO2_RDY_HI "o2 ready high thr" VALUE 0x0002038C __UWORD_S 0 u_volt_32 0 31.99951171875 FORMAT "%3.2" /end CHARACTERISTIC
/begin CHARACTERISTIC FMSP_V_UO2_RDY_LO "o2 ready low thr" VALUE 0x0002038C __UWORD_S 0 u_volt_32 0 31.99951171875 FORMAT "%3.2" /end CHARACTERISTIC
/begin CHARACTERISTIC FMSP_V_DO2_RDY_LO "o2 ready low thr" VALUE 0x0002038C __UWORD_S 0 u_volt_32 0 31.99951171875 FORMAT "%3.2" /end CHARACTERISTIC
/begin CHARACTERISTIC FMSP_V_O2_PMP_RDY_THR "o2 ready thr for pumping o2 sensor" VALUE 0x0002038C __UWORD_S 0 u_volt_32 0 31.99951171875 FORMAT "%3.2" /end CHARACTERISTIC
/begin CHARACTERISTIC FMSP_V_O2_RDY_EXT_DUR "o2 ready exit delay" VALUE 0x0002038C __UWORD_S 0 u_2x_tmr 0 1023.984375 /end CHARACTERISTIC
/begin CHARACTERISTIC FMSP_V_RL_CHK_DLY "o2 rich lean check delay" VALUE 0x0002038C __UWORD_S 0 u_2x_tmr 0 1023.984375 /end CHARACTERISTIC
/begin CHARACTERISTIC FMSP_V_O2_PMP_RDY_DLY "pumping o2 ready delay" VALUE 0x0002038C __UWORD_S 0 u_2x_tmr 0 1023.984375 /end CHARACTERISTIC
/begin CHARACTERISTIC FMSP_V_O2_RDY_PMP_EXT_DUR "pumping o2 ready delay" VALUE 0x0002038C __UWORD_S 0 u_2x_tmr 0 1023.984375 /end CHARACTERISTIC
/begin CHARACTERISTIC FMSP_V_CL_EN_RUN_DLY "fuel close loop enable engine run duration delay" VALUE 0x0002038C __UWORD_S 0 u_1s_tmr 0 65535 /end CHARACTERISTIC
/begin CHARACTERISTIC FMSP_V_CL_EN_RUN_DLY_AST "fuel close loop enable engine run duration delay auto start" VALUE 0x0002038C __UWORD_S 0 u_1s_tmr 0 65535 /end CHARACTERISTIC
/begin CHARACTERISTIC FMSP_C_CL_EN_FLW_SUM "fuel close loop enable,airflow sum thr" CURVE 0x000200B0 __UWORD_S 0 u_gram 0 4095.9375 SYMBOL_LINK "FMSP_C_CL_EN_FLW_SUM" 2
 /begin AXIS_DESCR FIX_AXIS sys_keyon_ect u_deg_C 17 -40 120
  /begin FIX_AXIS_PAR_LIST -5120 -3840 -2560 -1280 0 1280 2560 3840 5120 6400 7680 8960 10240 11520 12800 14080 15360 /end FIX_AXIS_PAR_LIST
 /end AXIS_DESCR
/end CHARACTERISTIC
/begin CHARACTERISTIC FMSP_C_CL_EN_ECT "fuel close loop enable,ect thr" CURVE 0x000200B0 __SWORD_S 0 u_deg_C -256 255.9921875 SYMBOL_LINK "FMSP_C_CL_EN_ECT" 2
 /begin AXIS_DESCR FIX_AXIS sys_keyon_ect u_deg_C 17 -40 120
  /begin FIX_AXIS_PAR_LIST -5120 -3840 -2560 -1280 0 1280 2560 3840 5120 6400 7680 8960 10240 11520 12800 14080 15360 /end FIX_AXIS_PAR_LIST
 /end AXIS_DESCR
/end CHARACTERISTIC
/begin CHARACTERISTIC FMSP_C_CL_EXT_MAP_MIN "fuel close loop exit when map below thr" CURVE 0x000200B0 __UWORD_S 0 u_kPa_0_256 0 255.99609375 SYMBOL_LINK "FMSP_C_CL_EXT_MAP_MIN" 2
 /begin AXIS_DESCR FIX_AXIS sys_eng_spd u_espd 17 0 6400
  /begin FIX_AXIS_PAR_LIST 0 3200 6400 9600 12800 16000 19200 22400 25600 28800 32000 35200 38400 41600 44800 48000 51200 /end FIX_AXIS_PAR_LIST
 /end AXIS_DESCR
/end CHARACTERISTIC
/begin CHARACTERISTIC FMSP_V_ADP_EN_ECT_MAX "fuel adaption enable ect max" VALUE 0x0002038C __SWORD_S 0 u_deg_C -256 255.9921875 /end CHARACTERISTIC
/begin CHARACTERISTIC FMSP_V_ADP_EN_ECT_MIN "fuel adaption enable ect min" VALUE 0x0002038C __SWORD_S 0 u_deg_C -256 255.9921875 /end CHARACTERISTIC
/begin CHARACTERISTIC FMSP_V_ADP_EN_IAT_MAX "fuel adaption enable iat max" VALUE 0x0002038C __SWORD_S 0 u_deg_C -256 255.9921875 /end CHARACTERISTIC
/begin CHARACTERISTIC FMSP_V_ADP_EN_MAF_MAX "fuel adaption enable maf max" VALUE 0x0002038C __UWORD_S 0 u_stk_flw 0 1.99996948242187 /end CHARACTERISTIC
/begin CHARACTERISTIC FMSP_C_ADP_EN_RUN_MIN "fuel adaption enable runtime min" CURVE 0x000200B0 __UWORD_S 0 u_1s_tmr 0 65535 SYMBOL_LINK "FMSP_C_ADP_EN_RUN_MIN" 2
 /begin AXIS_DESCR FIX_AXIS sys_ect u_deg_C 7 -30 120 /begin FIX_AXIS_PAR_LIST -3840 -1280 1280 3840 6400 8960 11520 /end FIX_AXIS_PAR_LIST /end AXIS_DESCR
/end CHARACTERISTIC
/begin CHARACTERISTIC FMSP_C_CL_MIN "fuel close loop control min" CURVE 0x000200B0 __UWORD_S 0 u_fac_2 0 1.999969482421875 FORMAT "%5.4" SYMBOL_LINK "FMSP_C_CL_MIN" 2
 /begin AXIS_DESCR COM_AXIS sys_ect u_deg_C 11 -256 255.9921875 AXIS_PTS_REF FMSP_X_ECT_L /end AXIS_DESCR
/end CHARACTERISTIC
/begin CHARACTERISTIC FMSP_C_CL_MAX "fuel close loop control max" CURVE 0x000200B0 __UWORD_S 0 u_fac_2 0 1.999969482421875 FORMAT "%5.4" SYMBOL_LINK "FMSP_C_CL_MAX" 2
 /begin AXIS_DESCR COM_AXIS sys_ect u_deg_C 11 -256 255.9921875 AXIS_PTS_REF FMSP_X_ECT_L /end AXIS_DESCR
/end CHARACTERISTIC
/begin AXIS_PTS FMSP_X_ECT_L "ect breakpoint" 0x0002006C sys_ect SSV__SWORD_S 0 u_deg_C 11 -256 255.9921875 FORMAT "%4.1" DEPOSIT ABSOLUTE SYMBOL_LINK "FMSP_X_ECT_L" 2 /end AXIS_PTS
/begin CHARACTERISTIC FMSP_V_ADP_CP_OFF_DUR_LO "force purge off duration controlled by fuel adaption" VALUE 0x0002038C __UWORD_S 0 u_1s_tmr 0 65535 /end CHARACTERISTIC
/begin CHARACTERISTIC FMSP_V_ADP_CP_OFF_DUR_HI "force purge off duration controlled by fuel adaption" VALUE 0x0002038C __UWORD_S 0 u_1s_tmr 0 65535 /end CHARACTERISTIC
/begin CHARACTERISTIC FMSP_M_ST_AF "start air fuel ratio" MAP 0x00020320 __UWORD_S 0 u_afr 0 31.99951171875 FORMAT "%4.2" SYMBOL_LINK "FMSP_M_ST_AF" 4
 /begin AXIS_DESCR FIX_AXIS sys_eng_spd u_espd 5 0 800 /begin FIX_AXIS_PAR_LIST 0 1600 3200 4800 6400 /end FIX_AXIS_PAR_LIST /end AXIS_DESCR
 /begin AXIS_DESCR COM_AXIS sys_ect u_deg_C 17 -40.0 120 AXIS_PTS_REF FMSP_X_ECT_B /end AXIS_DESCR
/end CHARACTERISTIC
/begin CHARACTERISTIC FMSP_M_AUTO_ST_AF "auto start air fuel ratio" MAP 0x00020320 __UWORD_S 0 u_afr 0 31.99951171875 FORMAT "%4.2" SYMBOL_LINK "FMSP_M_AUTO_ST_AF" 4
 /begin AXIS_DESCR FIX_AXIS sys_eng_spd u_espd 5 0 800 /begin FIX_AXIS_PAR_LIST 0 1600 3200 4800 6400 /end FIX_AXIS_PAR_LIST /end AXIS_DESCR
 /begin AXIS_DESCR COM_AXIS sys_ect u_deg_C 17 -40.0 120 AXIS_PTS_REF FMSP_X_ECT_B /end AXIS_DESCR
/end CHARACTERISTIC
/begin AXIS_PTS FMSP_X_ECT_B "ect breakpoint" 0x0002006C sys_ect SSV__SWORD_S 0 u_deg_C 17 -256.000000 255.9921875 FORMAT "%4.1" DEPOSIT ABSOLUTE /end AXIS_PTS
/begin CHARACTERISTIC FMSP_M_ST_AF_AMP_FAC "start air fuel ratio amp factor" MAP 0x00020320 __UBYTE_S 0 u_fac_2_b 0 1.9921875 FORMAT "%4.3" SYMBOL_LINK "FMSP_M_ST_AF_AMP_FAC" 3
 /begin AXIS_DESCR COM_AXIS sys_amp u_kPa_0_256 7 0.000000 255.99609375 AXIS_PTS_REF FMSP_X_AMP_A /end AXIS_DESCR
 /begin AXIS_DESCR COM_AXIS sys_ect u_deg_C 6 -256.000000 255.9921875 AXIS_PTS_REF FMSP_X_ECT_C /end AXIS_DESCR
/end CHARACTERISTIC
/begin AXIS_PTS FMSP_X_ECT_C "ect breakpoint" 0x0002006C sys_ect SSV__SWORD_S 0 u_deg_C 6 -256.000000 255.9921875 FORMAT "%4.1" DEPOSIT ABSOLUTE SYMBOL_LINK "FMSP_X_ECT_C" 2 /end AXIS_PTS
/begin AXIS_PTS FMSP_X_AMP_A "amp breakpoint" 0x0002006C sys_amp SSV__UWORD_S 0 u_kPa_0_256 6 0.000000 255.99609375 FORMAT "%4.1" DEPOSIT ABSOLUTE SYMBOL_LINK "FMSP_X_AMP_A" 2 /end AXIS_PTS
/begin CHARACTERISTIC FMSP_V_ST_AF_BIAS "start af bias term" VALUE 0x0002038C __UWORD_S 0 u_afr 0 31.99951171875 FORMAT "%5.0" /end CHARACTERISTIC
/begin CHARACTERISTIC FMSP_V_AST_AF_BIAS "auto start af bias term" VALUE 0x0002038C __UWORD_S 0 u_afr 0 31.99951171875 FORMAT "%5.0" /end CHARACTERISTIC
/begin CHARACTERISTIC FMSP_V_CRST_EN_RUN_MIN "cold restart enable engine runtime min" VALUE 0x0002038C __UWORD_S 0 u_1s_tmr 0 65535 /end CHARACTERISTIC
/begin CHARACTERISTIC FMSP_V_CRST_EN_ECT_MAX "cold restart enable ect max" VALUE 0x0002038C __SWORD_S 0 u_deg_C -256 255.9921875 /end CHARACTERISTIC
/begin CHARACTERISTIC FMSP_V_CRST_EN_OFFT_MAX "cold restart enable off time max" VALUE 0x0002038C __UWORD_S 0 u_min 0 65535 /end CHARACTERISTIC
/begin CHARACTERISTIC FMSP_M_ST_AF_OFFT_FAC "start air fuel off time factor,0:cold restart,1:hot restart" MAP 0x00020320 __UWORD_S 0 u_fac_2 0 1.999969482421875 FORMAT "%4.3" SYMBOL_LINK "FMSP_M_ST_AF_OFFT_FAC" 4
 /begin AXIS_DESCR FIX_AXIS NO_INPUT_QUANTITY x_cnts 2 0 1 /begin FIX_AXIS_PAR_LIST 0 1 /end FIX_AXIS_PAR_LIST /end AXIS_DESCR
 /begin AXIS_DESCR FIX_AXIS NO_INPUT_QUANTITY u_min 9 0 90 /begin FIX_AXIS_PAR_LIST 0 7 15 22 30 45 60 75 90 /end FIX_AXIS_PAR_LIST /end AXIS_DESCR
/end CHARACTERISTIC
/begin CHARACTERISTIC FMSP_V_HRST_EN_IAT_MIN "hot restart enable keyon iat min" VALUE 0x0002038C __SWORD_S 0 u_deg_C -256 255.9921875 /end CHARACTERISTIC
/begin CHARACTERISTIC FMSP_V_HRST_EN_ECT_MIN "hot restart enable keyon ect min" VALUE 0x0002038C __SWORD_S 0 u_deg_C -256 255.9921875 /end CHARACTERISTIC
/begin CHARACTERISTIC FMSP_V_HRST_EN_OFFT_MIN "hot restart enable off time min" VALUE 0x0002038C __UWORD_S 0 u_min 0 65535 /end CHARACTERISTIC
/begin CHARACTERISTIC FMSP_V_HRST_EN_OFFT_MAX "hot restart enable off time max" VALUE 0x0002038C __UWORD_S 0 u_min 0 65535 /end CHARACTERISTIC
/begin CHARACTERISTIC FMSP_V_HRST_EXT_RUN_MIN "hot restart exit engine runtime min" VALUE 0x0002038C __UWORD_S 0 u_1s_tmr 0 65535 /end CHARACTERISTIC
/begin CHARACTERISTIC FMSP_C_HRST_AF_BIAS "hot start af bias" CURVE 0x000200B0 __UWORD_S 0 u_afr 0 31.99951171875 FORMAT "%4.2" SYMBOL_LINK "FMSP_C_HRST_AF_BIAS" 2
 /begin AXIS_DESCR COM_AXIS sys_ect u_deg_C 6 -256 255.9921875 AXIS_PTS_REF FMSP_X_ECT_D /end AXIS_DESCR
/end CHARACTERISTIC
/begin AXIS_PTS FMSP_X_ECT_D "ect breakpoint" 0x0002006C sys_ect SSV__SWORD_S 0 u_deg_C 6 -256.000000 255.9921875 FORMAT "%4.1" DEPOSIT ABSOLUTE SYMBOL_LINK "FMSP_X_ECT_D" 2 /end AXIS_PTS
/begin CHARACTERISTIC FMSP_C_ST_AF_BIAS_RST_OFFT_MIN "start af bias rest enable offtime min" CURVE 0x000200B0 __UWORD_S 0 u_min_hi 0 16383.75 SYMBOL_LINK "FMSP_C_ST_AF_BIAS_RST_OFFT_MIN" 2
 /begin AXIS_DESCR COM_AXIS sys_ect u_deg_C 3 -256 255.9921875 AXIS_PTS_REF FMSP_X_ECT_E /end AXIS_DESCR
/end CHARACTERISTIC
/begin AXIS_PTS FMSP_X_ECT_E "ect breakpoint" 0x0002006C sys_ect SSV__SWORD_S 0 u_deg_C 3 -256.000000 255.9921875 FORMAT "%4.1" DEPOSIT ABSOLUTE SYMBOL_LINK "FMSP_X_ECT_E" 2 /end AXIS_PTS
/begin CHARACTERISTIC FMSP_V_ST_AF_BIAS_RST_ECT_MIN "start af bias rest enable offtime min" VALUE 0x0002038C __SWORD_S 0 u_deg_C -256 255.9921875 /end CHARACTERISTIC
/begin CHARACTERISTIC FMSP_V_ST_AF_BIAS_RST_RUN_MIN "start af bias rest enable run min" VALUE 0x0002038C __UWORD_S 0 u_1s_tmr 0 65535 /end CHARACTERISTIC
/begin CHARACTERISTIC FMSP_M_RUN_AF_BS "run af base" MAP 0x00020320 __UBYTE_S 0 u_afr_b 0 31.875 FORMAT "%4.2" SYMBOL_LINK "FMSP_M_RUN_AF_BS" 3
 /begin AXIS_DESCR FIX_AXIS sys_eng_spd u_espd 17 0 6400
  /begin FIX_AXIS_PAR_LIST 0 3200 6400 9600 12800 16000 19200 22400 25600 28800 32000 35200 38400 41600 44800 48000 51200 /end FIX_AXIS_PAR_LIST
 /end AXIS_DESCR
 /begin AXIS_DESCR FIX_AXIS sys_map u_kPa_0_256 14 20 100
  /begin FIX_AXIS_PAR_LIST 5120 7680 10240 12800 14080 15360 16640 17920 19200 20480 21760 23040 24320 25600 /end FIX_AXIS_PAR_LIST
 /end AXIS_DESCR
/end CHARACTERISTIC
/begin CHARACTERISTIC FMSP_C_RUN_AF_ECT_FAC "run af ect factor" CURVE 0x000200B0 __UWORD_S 0 u_fac_2 0 1.999969482421875 FORMAT "%4.3" SYMBOL_LINK "FMSP_C_RUN_AF_ECT_FAC" 2
 /begin AXIS_DESCR COM_AXIS sys_ect u_deg_C 17 -256 255.9921875 AXIS_PTS_REF FMSP_X_ECT_F /end AXIS_DESCR
/end CHARACTERISTIC
/begin CHARACTERISTIC FMSP_C_TURB_PROT_AF "turbo temp protect af" CURVE 0x000200B0 __UWORD_S 0 u_afr 0 31.99951171875 FORMAT "%4.2" SYMBOL_LINK "FMSP_C_TURB_PROT_AF" 2
 /begin AXIS_DESCR COM_AXIS afm_intk_prt_t_c u_deg_C 3 -256 255.9921875 AXIS_PTS_REF FMSP_X_PORT_T_B /end AXIS_DESCR
/end CHARACTERISTIC
/begin AXIS_PTS FMSP_X_PORT_T_B "port temp breakpoint" 0x0002006C afm_intk_prt_t_c SSV__SWORD_S 0 u_deg_C 3 -256.000000 255.9921875 FORMAT "%4.1" DEPOSIT ABSOLUTE /end AXIS_PTS
/begin CHARACTERISTIC FMSP_C_TURB_PROT_AF_FAC "turbo temp protect af airflow factor" CURVE 0x000200B0 __UBYTE_S 0 u_fac_2_b 0 1.9921875 FORMAT "%4.3" SYMBOL_LINK "FMSP_C_TURB_PROT_AF_FAC" 3
 /begin AXIS_DESCR COM_AXIS afm_stk_flw_pct u_pct_8 5 0.000000 799.987793 AXIS_PTS_REF FMSP_X_STK_FLW_A /end AXIS_DESCR
/end CHARACTERISTIC
/begin AXIS_PTS FMSP_X_STK_FLW_A "stroke flow breakpoint" 0x0002006C afm_stk_flw_pct SSV__UWORD_S 0 u_pct_8 5 0.000000 799.987793 FORMAT "%4.1" DEPOSIT ABSOLUTE /end AXIS_PTS
/begin CHARACTERISTIC FMSP_V_CHRG_T_COOL_USE_KNK "charge temp cool use knock condition" VALUE 0x0002038C __UBYTE_S 0 b_true 0 1 FORMAT "%1.0" /end CHARACTERISTIC
/begin CHARACTERISTIC FMSP_V_HOT_CHRG_CHGT_HI "charge temp hot charge temp thr high" VALUE 0x0002038C __SWORD_S 0 u_deg_C -256.000000 255.9921875 FORMAT "%4.1" /end CHARACTERISTIC
/begin CHARACTERISTIC FMSP_V_HOT_CHRG_CHGT_LO "charge temp hot charge temp thr low" VALUE 0x0002038C __SWORD_S 0 u_deg_C -256.000000 255.9921875 FORMAT "%4.1" /end CHARACTERISTIC
/begin CHARACTERISTIC FMSP_V_HOT_CHRG_ECT_HI "charge temp hot ect thr high" VALUE 0x0002038C __SWORD_S 0 u_deg_C -256.000000 255.9921875 FORMAT "%4.1" /end CHARACTERISTIC
/begin CHARACTERISTIC FMSP_V_HOT_CHRG_ECT_LO "charge temp hot ect thr low" VALUE 0x0002038C __SWORD_S 0 u_deg_C -256.000000 255.9921875 FORMAT "%4.1" /end CHARACTERISTIC
/begin CHARACTERISTIC FMSP_V_CHRG_T_COOL_DLY "charge temp cool enable delay" VALUE 0x0002038C __UWORD_S 0 u_8x_tmr 0 4095.9375 FORMAT "%5.1" /end CHARACTERISTIC
/begin CHARACTERISTIC FMSP_V_CHRG_T_COOL_IG_RTD "charg temp cool knock ignition retard thr" VALUE 0x0002038C __SWORD_S 0 u_iga -256 255.9921875 FORMAT "%4.2" /end CHARACTERISTIC
/begin CHARACTERISTIC FMSP_V_HOT_CHRG_LD_HI "charg temp cool air load thr high" VALUE 0x0002038C __UWORD_S 0 u_pct_8 0 799.987793 FORMAT "%4.1" /end CHARACTERISTIC
/begin CHARACTERISTIC FMSP_V_HOT_CHRG_LD_LO "charg temp cool air load thr low" VALUE 0x0002038C __UWORD_S 0 u_pct_8 0 799.987793 FORMAT "%4.1" /end CHARACTERISTIC
/begin CHARACTERISTIC FMSP_C_ADP_EN_CL_MAX "adaption update enable close loop factor max" CURVE 0x000200B0 __UWORD_S 0 u_fac_2 0 1.999969482421875 FORMAT "%4.3" SYMBOL_LINK "FMSP_C_ADP_EN_CL_MAX" 2
 /begin AXIS_DESCR FIX_AXIS fmsp_adp_area u_cnts 26 0 25
  /begin FIX_AXIS_PAR_LIST 0 1 2 3 4 5 6 7 8 9 10 11 12 13 14 15 16 17 18 19 20 21 22 23 24 25 /end FIX_AXIS_PAR_LIST
 /end AXIS_DESCR
/end CHARACTERISTIC
/begin CHARACTERISTIC FMSP_C_ADP_EN_CL_MIN "adaption update enable close loop factor min" CURVE 0x000200B0 __UWORD_S 0 u_fac_2 0 1.999969482421875 FORMAT "%4.3" SYMBOL_LINK "FMSP_C_ADP_EN_CL_MIN" 2
 /begin AXIS_DESCR FIX_AXIS fmsp_adp_area u_cnts 26 0 25
  /begin FIX_AXIS_PAR_LIST 0 1 2 3 4 5 6 7 8 9 10 11 12 13 14 15 16 17 18 19 20 21 22 23 24 25 /end FIX_AXIS_PAR_LIST
 /end AXIS_DESCR
/end CHARACTERISTIC
/begin CHARACTERISTIC FMSP_C_ADP_ESPD_BND "adaption area engine speed boundary" CURVE 0x000200B0 __UWORD_S 0 u_espd 0 8191.875 FORMAT "%5.1" SYMBOL_LINK "FMSP_C_ADP_ESPD_BND" 2
 /begin AXIS_DESCR FIX_AXIS NO_INPUT_QUANTITY u_cnts 3 0 2 /begin FIX_AXIS_PAR_LIST 0 1 2 /end FIX_AXIS_PAR_LIST /end AXIS_DESCR
/end CHARACTERISTIC
/begin CHARACTERISTIC FMSP_C_ADP_IMEP_BND "adaption area ref imep boundary" CURVE 0x000200B0 __UWORD_S 0 u_kPa_0_4096 0 4095.937500 SYMBOL_LINK "FMSP_C_ADP_IMEP_BND" 2
 /begin AXIS_DESCR FIX_AXIS NO_INPUT_QUANTITY u_cnts 3 0 2 /begin FIX_AXIS_PAR_LIST 0 1 2 /end FIX_AXIS_PAR_LIST /end AXIS_DESCR
/end CHARACTERISTIC
/begin CHARACTERISTIC FMSP_V_ADP_IMEP_HYS "adaption area ref imep boundary hysteresis" VALUE 0x0002038C __UWORD_S 0 u_kPa_0_4096 0 4095.937500 /end CHARACTERISTIC
/begin CHARACTERISTIC FMSP_V_ADP_ESPD_HYS "adaption area engine speed boundary hysteresis" VALUE 0x0002038C __UWORD_S 0 u_espd 0 8191.875 FORMAT "%5.1" /end CHARACTERISTIC
/begin CHARACTERISTIC FMSP_V_ADP_DCL_ESPD_HI "adaption decel area engine speed high" VALUE 0x0002038C __UWORD_S 0 u_espd 0 8191.875 FORMAT "%5.1" /end CHARACTERISTIC
/begin CHARACTERISTIC FMSP_V_ADP_IDL_ESPD_HI "adaption idle area engine speed high" VALUE 0x0002038C __UWORD_S 0 u_espd 0 8191.875 FORMAT "%5.1" /end CHARACTERISTIC
/begin CHARACTERISTIC FMSP_V_ADP_PT_ESPD_HI "adaption partial area engine speed high" VALUE 0x0002038C __UWORD_S 0 u_espd 0 8191.875 FORMAT "%5.1" /end CHARACTERISTIC
/begin CHARACTERISTIC FMSP_V_ADP_PT_ESPD_LO "adaption partial area engine speed low" VALUE 0x0002038C __UWORD_S 0 u_espd 0 8191.875 FORMAT "%5.1" /end CHARACTERISTIC
/begin CHARACTERISTIC FMSP_V_RAIL_P "fuel rail pressure" VALUE 0x0002038C __UWORD_S 0 u_kPa_0_1024 0 1023.984375 FORMAT "%5.1" /end CHARACTERISTIC
/begin CHARACTERISTIC FMSP_V_ADP_DEC_INTVL "adp decrease inteval" VALUE 0x3BA02 __UWORD_S 0 u_2x_tmr 0.0 1023.984375 /end CHARACTERISTIC
/begin CHARACTERISTIC FMSP_V_ADP_INC_INTVL "adp increase inteval" VALUE 0x3BA02 __UWORD_S 0 u_2x_tmr 0.0 1023.984375 /end CHARACTERISTIC
/begin CHARACTERISTIC FMSP_V_ADP_CHG_STP "adaption change step" VALUE 0x0002038C __UWORD_S 0 u_fac_2 0 1.999969482421875 FORMAT "%4.3" /end CHARACTERISTIC
/begin CHARACTERISTIC FMSP_V_ADP_IDL_IMEP_BND "idle adaption area ref imep boundary" VALUE 0x0002038C __UWORD_S 0 u_kPa_0_4096 0 4095.937500 /end CHARACTERISTIC
/begin CHARACTERISTIC FMSP_V_ADP_IDL_IMEP_HYS "idle adaption area ref imep boundary hysteresis" VALUE 0x0002038C __UWORD_S 0 u_kPa_0_4096 0 4095.937500 /end CHARACTERISTIC
/begin CHARACTERISTIC FMSP_V_ADP_DCL_IMEP_HYS "deceleration adaption area ref imep boundary hysteresis" VALUE 0x0002038C __UWORD_S 0 u_kPa_0_4096 0 4095.937500 /end CHARACTERISTIC
/begin CHARACTERISTIC FMSP_V_ADP_DCL_IMEP_BND "deceleration adaption area ref imep boundary" VALUE 0x0002038C __UWORD_S 0 u_kPa_0_4096 0 4095.937500 /end CHARACTERISTIC
/begin CHARACTERISTIC FMSP_C_ADP_CLD_INIT_MIN "adaption min at power on" CURVE 0x000200B0 __UWORD_S 0 u_fac_2 0 1.999969482421875 FORMAT "%4.3" SYMBOL_LINK "FMSP_C_ADP_CLD_INIT_MIN" 2
 /begin AXIS_DESCR FIX_AXIS fmsp_adp_area u_cnts 26 0 25
  /begin FIX_AXIS_PAR_LIST 0 1 2 3 4 5 6 7 8 9 10 11 12 13 14 15 16 17 18 19 20 21 22 23 24 25 /end FIX_AXIS_PAR_LIST
 /end AXIS_DESCR
/end CHARACTERISTIC
/begin CHARACTERISTIC FMSP_C_ADP_HOT_INIT_MIN "adaption min at power on" CURVE 0x000200B0 __UWORD_S 0 u_fac_2 0 1.999969482421875 FORMAT "%4.3" SYMBOL_LINK "FMSP_C_ADP_HOT_INIT_MIN" 2
 /begin AXIS_DESCR FIX_AXIS fmsp_adp_area u_cnts 26 0 25
  /begin FIX_AXIS_PAR_LIST 0 1 2 3 4 5 6 7 8 9 10 11 12 13 14 15 16 17 18 19 20 21 22 23 24 25 /end FIX_AXIS_PAR_LIST
 /end AXIS_DESCR
/end CHARACTERISTIC
/begin CHARACTERISTIC FMSP_V_ADP_INT_ECT_THR "adp initial value limit ect thr" VALUE 0x0002038C __SWORD_S 0 u_deg_C -256 255.9921875 /end CHARACTERISTIC
/begin CHARACTERISTIC FMSP_V_ADP_CP_OFF_DLY_HI "fuel adpation purge off delay when adp learned" VALUE 0x0002038C __UWORD_S 0 u_pct 0 199.996948242187 /end CHARACTERISTIC
/begin CHARACTERISTIC FMSP_V_ADP_CP_OFF_DLY_LO "fuel adpation purge off delay when adp not learned" VALUE 0x0002038C __UWORD_S 0 u_pct 0 199.996948242187 /end CHARACTERISTIC
/begin CHARACTERISTIC FMSP_V_ADP_CP_OFF_MIN "adaption update purge off min" VALUE 0x0002038C __UWORD_S 0 u_1s_tmr 0 65535 /end CHARACTERISTIC
/begin CHARACTERISTIC FMSP_V_ADP_IDL_VSPD_THR "adp idle vehicle speed thr" VALUE 0x0002038C __UWORD_S 0 u_vspd 0 511.9921875 /end CHARACTERISTIC
/begin CHARACTERISTIC FMSP_V_ADP_IDL_VSPD_HYS "adp idle vehicle speed thr hys" VALUE 0x0002038C __UWORD_S 0 u_vspd 0 511.9921875 /end CHARACTERISTIC
/begin CHARACTERISTIC FMSP_V_ADP_IDL_HI_ECT "adp hot idle ect thr" VALUE 0x0002038C __SWORD_S 0 u_deg_C -256 255.9921875 /end CHARACTERISTIC
/begin CHARACTERISTIC FMSP_V_ADP_IDL_HI_IAT "adp hot idle iat thr" VALUE 0x0002038C __SWORD_S 0 u_deg_C -256 255.9921875 /end CHARACTERISTIC
/begin CHARACTERISTIC FMSP_V_ADP_IDL_HI_ECT_HYS "adp hot idle ect thr hys" VALUE 0x0002038C __SWORD_S 0 u_deg_C -256 255.9921875 /end CHARACTERISTIC
/begin CHARACTERISTIC FMSP_V_ADP_IDL_HI_IAT_HYS "adp hot idle iat thr hys" VALUE 0x0002038C __SWORD_S 0 u_deg_C -256 255.9921875 /end CHARACTERISTIC
/begin CHARACTERISTIC FMSP_V_ADP_DO2_RCH_HI "down o2 rich thr for o2 abnormal determine" VALUE 0x217E0 __UWORD_S 0 u_volt_32 0 31.99951171875 FORMAT "%5.2" /end CHARACTERISTIC
/begin CHARACTERISTIC FMSP_V_ADP_DO2_RCH_LO "down o2 rich thr for o2 abnormal determine" VALUE 0x217E0 __UWORD_S 0 u_volt_32 0 31.99951171875 FORMAT "%5.2" /end CHARACTERISTIC
/begin CHARACTERISTIC FMSP_V_ADP_UO2_ERR_HI "up o2 error thr for o2 abnormal determine" VALUE 0x217E0 __UWORD_S 0 u_volt_32 0 31.99951171875 FORMAT "%5.2" /end CHARACTERISTIC
/begin CHARACTERISTIC FMSP_V_ADP_UO2_ERR_LO "up o2 error thr for o2 abnormal determine" VALUE 0x217E0 __UWORD_S 0 u_volt_32 0 31.99951171875 FORMAT "%5.2" /end CHARACTERISTIC
/begin CHARACTERISTIC FMSP_V_ADP_ERR2_CL_MAX "adaption abnormal close max" VALUE 0x0002038C __UWORD_S 0 u_fac_2 0 1.999969482421875 FORMAT "%4.3" /end CHARACTERISTIC
/begin CHARACTERISTIC FMSP_V_ADP_ERR1_CL_MAX "adaption abnormal close max" VALUE 0x0002038C __UWORD_S 0 u_fac_2 0 1.999969482421875 FORMAT "%4.3" /end CHARACTERISTIC
/begin CHARACTERISTIC FMSP_V_ADP_ERR1_CHG_STP "adaption change step when o2 abnormal" VALUE 0x0002038C __UWORD_S 0 u_fac_2 0 1.999969482421875 FORMAT "%4.3" /end CHARACTERISTIC
/begin CHARACTERISTIC FMSP_V_ADP_ERR2_CHG_STP "adaption change step when o2 abnormal" VALUE 0x0002038C __UWORD_S 0 u_fac_2 0 1.999969482421875 FORMAT "%4.3" /end CHARACTERISTIC
/begin CHARACTERISTIC FMSP_V_ERR2_ADP_MAX "adaption max when o2 abnormal" VALUE 0x0002038C __UWORD_S 0 u_fac_2 0 1.999969482421875 FORMAT "%4.3" /end CHARACTERISTIC
/begin CHARACTERISTIC FMSP_V_ERR1_ADP_MAX "adaption max when o2 abnormal" VALUE 0x0002038C __UWORD_S 0 u_fac_2 0 1.999969482421875 FORMAT "%4.3" /end CHARACTERISTIC
/begin CHARACTERISTIC FMSP_V_ADP_STBL_DUR "adaption stable duration" VALUE 0x0002038C __UWORD_S 0 u_8x_tmr 0 4095.9375 FORMAT "%5.1" /end CHARACTERISTIC
/begin CHARACTERISTIC FMSP_C_ADP_CHG_DLY "adaption change delay" CURVE 0x000200B0 __UWORD_S 0 u_2x_tmr 0 1023.984375 SYMBOL_LINK "FMSP_C_ADP_CHG_DLY" 2
 /begin AXIS_DESCR FIX_AXIS fmsp_cl_fac_avg u_fac_2 17 0.75 1.25
  /begin FIX_AXIS_PAR_LIST 24576 25600 26624 27648 28672 29696 30720 31744 32768 33792 34816 35840 36864 37888 38912 39936 40960 /end FIX_AXIS_PAR_LIST
 /end AXIS_DESCR
/end CHARACTERISTIC
/begin CHARACTERISTIC FMSP_M_BAS_AF_AMP_FAC "run af base amp factor" MAP 0x00020320 __UBYTE_S 0 u_fac_2_b 0 1.9921875 FORMAT "%4.3" SYMBOL_LINK "FMSP_M_BAS_AF_AMP_FAC" 3
 /begin AXIS_DESCR FIX_AXIS sys_amp u_kPa_0_256 7 45 105 /begin FIX_AXIS_PAR_LIST 11520 14080 16640 19200 21760 24320 26880 /end FIX_AXIS_PAR_LIST /end AXIS_DESCR
 /begin AXIS_DESCR FIX_AXIS sys_ect u_deg_C 9 -20 60 /begin FIX_AXIS_PAR_LIST -2560 -1280 0 1280 2560 3840 5120 6400 7680 /end FIX_AXIS_PAR_LIST /end AXIS_DESCR
/end CHARACTERISTIC
/begin CHARACTERISTIC FMSP_V_IDL_AF_MAX "idle af max" VALUE 0x0002038C __UWORD_S 0 u_afr 0 31.99951171875 FORMAT "%4.2" /end CHARACTERISTIC
/begin CHARACTERISTIC FMSP_C_RUN_AF_BIAS "run af bias" CURVE 0x000200B0 __UWORD_S 0 u_afr 0 31.99951171875 FORMAT "%4.2" SYMBOL_LINK "FMSP_C_RUN_AF_BIAS" 2
 /begin AXIS_DESCR COM_AXIS sys_ect u_deg_C 17 -256 255.9921875 AXIS_PTS_REF FMSP_X_ECT_F /end AXIS_DESCR
/end CHARACTERISTIC
/begin AXIS_PTS FMSP_X_ECT_F "ect breakpoint" 0x0002006C sys_ect SSV__SWORD_S 0 u_deg_C 17 -256.000000 255.9921875 FORMAT "%4.1" DEPOSIT ABSOLUTE SYMBOL_LINK "FMSP_X_ECT_F" 2 /end AXIS_PTS
/begin CHARACTERISTIC FMSP_V_HRST_RUN_AF_BIAS "idle af max" VALUE 0x0002038C __UWORD_S 0 u_afr 0 31.99951171875 FORMAT "%4.2" /end CHARACTERISTIC
/begin CHARACTERISTIC FMSP_C_RUN_AF_DCY_DLY "run af bias decay delay" CURVE 0x000200B0 __UWORD_S 0 u_2x_tmr 0 1023.984375 SYMBOL_LINK "FMSP_C_RUN_AF_DCY_DLY" 2
 /begin AXIS_DESCR COM_AXIS sys_ect u_deg_C 17 -256 255.9921875 AXIS_PTS_REF FMSP_X_ECT_F /end AXIS_DESCR
/end CHARACTERISTIC
/begin CHARACTERISTIC FMSP_C_RUN_AF_HLD_DUR "run af bias hold duration before first decay" CURVE 0x000200B0 __UWORD_S 0 u_2x_tmr 0 1023.984375 SYMBOL_LINK "FMSP_C_RUN_AF_HLD_DUR" 2
 /begin AXIS_DESCR COM_AXIS sys_ect u_deg_C 17 -256 255.9921875 AXIS_PTS_REF FMSP_X_ECT_F /end AXIS_DESCR
/end CHARACTERISTIC
/begin CHARACTERISTIC FMSP_V_RUN_AF_DCY_FAC "run af bias decay factor" VALUE 0x0002038C __UWORD_S 0 u_fac_1 0 0.999984741210937 /end CHARACTERISTIC
/begin CHARACTERISTIC FMSP_C_ST_RUN_AF_DCY_DLY "start to run af decay delay" CURVE 0x000200B0 __UWORD_S 0 u_2x_tmr 0 1023.984375 SYMBOL_LINK "FMSP_C_ST_RUN_AF_DCY_DLY" 2
 /begin AXIS_DESCR COM_AXIS sys_ect u_deg_C 17 -256 255.9921875 AXIS_PTS_REF FMSP_X_ECT_F /end AXIS_DESCR
/end CHARACTERISTIC
/begin CHARACTERISTIC FMSP_V_ST_RUN_AF_DCY_FAC "start to run af decay factor" VALUE 0x0002038C __UWORD_S 0 u_fac_1 0 0.999984741210937 /end CHARACTERISTIC
/begin CHARACTERISTIC FMSP_C_ENG_PROT_AF "engine overheat protect af" CURVE 0x000200B0 __UWORD_S 0 u_afr 0 31.99951171875 FORMAT "%4.2" SYMBOL_LINK "FMSP_C_ENG_PROT_AF" 2
 /begin AXIS_DESCR FIX_AXIS sys_eng_spd u_espd 17 0 6400
  /begin FIX_AXIS_PAR_LIST 0 3200 6400 9600 12800 16000 19200 22400 25600 28800 32000 35200 38400 41600 44800 48000 51200 /end FIX_AXIS_PAR_LIST
 /end AXIS_DESCR
/end CHARACTERISTIC
/begin CHARACTERISTIC FMSP_V_TQ_AF_ECT_MIN "torq af control enable ect min" VALUE 0x0002038C __SWORD_S 0 u_deg_C -256 255.9921875 /end CHARACTERISTIC
/begin CHARACTERISTIC FMSP_V_TQ_AF_RUN_MIN "torq af control enable run min" VALUE 0x0002038C __UWORD_S 0 u_1s_tmr 0 65535 FORMAT "%5.2" /end CHARACTERISTIC
/begin CHARACTERISTIC FMSP_V_TQ_AF_CAT_MIN "torq af control enable cat temp min" VALUE 0x0002038C __SWORD_S 0 u_deg_C_n2048_p2048 -2048 2047.9375 /end CHARACTERISTIC
/begin CHARACTERISTIC FMSP_C_STCH_AF_FLW_SUM "fuel stoich af enable,airflow sum thr" CURVE 0x000200B0 __UWORD_S 0 u_gram 0 4095.9375 SYMBOL_LINK "FMSP_C_STCH_AF_FLW_SUM" 2
 /begin AXIS_DESCR FIX_AXIS sys_keyon_ect u_deg_C 17 -40 120
  /begin FIX_AXIS_PAR_LIST -5120 -3840 -2560 -1280 0 1280 2560 3840 5120 6400 7680 8960 10240 11520 12800 14080 15360 /end FIX_AXIS_PAR_LIST
 /end AXIS_DESCR
/end CHARACTERISTIC
/begin CHARACTERISTIC FMSP_C_TQ_AF "torq control af" CURVE 0x000200B0 __UWORD_S 0 u_afr 0 31.99951171875 FORMAT "%4.2" SYMBOL_LINK "FMSP_C_TQ_AF" 2
 /begin AXIS_DESCR FIX_AXIS afm_intk_vlv_t u_deg_K_512 9 243 403 /begin FIX_AXIS_PAR_LIST 31104 33664 36224 38784 41344 43904 46464 49024 51584 /end FIX_AXIS_PAR_LIST /end AXIS_DESCR
/end CHARACTERISTIC
/begin CHARACTERISTIC FMSP_V_TQ_RCH_AF "torq rich af when torq duration long" VALUE 0x0002038C __UWORD_S 0 u_afr 0 31.99951171875 FORMAT "%4.2" /end CHARACTERISTIC
/begin CHARACTERISTIC FMSP_V_TQ_RCF_AF_DUR_MIN "torq rich af duration long thr" VALUE 0x0002038C __UWORD_S 0 u_2x_tmr 0 1023.984375 /end CHARACTERISTIC
/begin CHARACTERISTIC FMSP_V_STCH_AF "idle af max" VALUE 0x0002038C __UWORD_S 0 u_afr 0 31.99951171875 FORMAT "%4.2" /end CHARACTERISTIC
/begin CHARACTERISTIC FMSP_C_GR_IN_AF_FAC "in gear transient af factor" CURVE 0x000200B0 __UWORD_S 0 u_fac_1 0 0.999984741210937 SYMBOL_LINK "FMSP_C_GR_IN_AF_FAC" 2
 /begin AXIS_DESCR COM_AXIS sys_ect u_deg_C 17 -256 255.9921875 AXIS_PTS_REF FMSP_X_ECT_F /end AXIS_DESCR
/end CHARACTERISTIC
/begin CHARACTERISTIC FMSP_C_GR_IN_AF_DLY "in gear transient af enable delay" CURVE 0x000200B0 __UWORD_S 0 u_2x_tmr 0 1023.984375 SYMBOL_LINK "FMSP_C_GR_IN_AF_DLY" 2
 /begin AXIS_DESCR COM_AXIS sys_ect u_deg_C 17 -256 255.9921875 AXIS_PTS_REF FMSP_X_ECT_F /end AXIS_DESCR
/end CHARACTERISTIC
/begin CHARACTERISTIC FMSP_C_GR_IN_AF_DUR "in gear transient af enable duration" CURVE 0x000200B0 __UWORD_S 0 u_2x_tmr 0 1023.984375 SYMBOL_LINK "FMSP_C_GR_IN_AF_DUR" 2
 /begin AXIS_DESCR COM_AXIS sys_ect u_deg_C 17 -256 255.9921875 AXIS_PTS_REF FMSP_X_ECT_F /end AXIS_DESCR
/end CHARACTERISTIC
/begin CHARACTERISTIC FMSP_C_AC_AF_FAC "ac transient af factor" CURVE 0x000200B0 __UWORD_S 0 u_fac_1 0 0.999984741210937 SYMBOL_LINK "FMSP_C_AC_AF_FAC" 2
 /begin AXIS_DESCR COM_AXIS sys_ect u_deg_C 17 -256 255.9921875 AXIS_PTS_REF FMSP_X_ECT_F /end AXIS_DESCR
/end CHARACTERISTIC
/begin CHARACTERISTIC FMSP_C_AC_AF_DLY "ac transient af enable delay" CURVE 0x000200B0 __UWORD_S 0 u_2x_tmr 0 1023.984375 SYMBOL_LINK "FMSP_C_AC_AF_DLY" 2
 /begin AXIS_DESCR COM_AXIS sys_ect u_deg_C 17 -256 255.9921875 AXIS_PTS_REF FMSP_X_ECT_F /end AXIS_DESCR
/end CHARACTERISTIC
/begin CHARACTERISTIC FMSP_C_AC_AF_DUR "ac transient af enable duration" CURVE 0x000200B0 __UWORD_S 0 u_2x_tmr 0 1023.984375 SYMBOL_LINK "FMSP_C_AC_AF_DUR" 2
 /begin AXIS_DESCR COM_AXIS sys_ect u_deg_C 17 -256 255.9921875 AXIS_PTS_REF FMSP_X_ECT_F /end AXIS_DESCR
/end CHARACTERISTIC
/begin CHARACTERISTIC FMSP_V_AC_AF_OFFT_MIN "ac transient af enable off time min" VALUE 0x0002038C __UWORD_S 0 u_min 0 65535 /end CHARACTERISTIC
/begin CHARACTERISTIC FMSP_C_CL_NORM_AF_UP_FAC "normal af ramp factor when close loop enable" CURVE 0x000200B0 __UWORD_S 0 u_pct_1 0 99.9984741210937 FORMAT "%6.4" SYMBOL_LINK "FMSP_C_CL_NORM_AF_UP_FAC" 2
 /begin AXIS_DESCR FIX_AXIS afm_intk_vlv_t u_deg_K_512 9 243 403 /begin FIX_AXIS_PAR_LIST 31104 33664 36224 38784 41344 43904 46464 49024 51584 /end FIX_AXIS_PAR_LIST /end AXIS_DESCR
/end CHARACTERISTIC
/begin CHARACTERISTIC FMSP_V_CL_OSC_AF_UP_FAC "osc recover af ramp factor when close loop enable" VALUE 0x0002038C __UWORD_S 0 u_pct_1 0 99.9984741210937 FORMAT "%6.4" /end CHARACTERISTIC
/begin CHARACTERISTIC FMSP_V_OP_AF_UP_FAC "af ramp factor when open loop" VALUE 0x0002038C __UWORD_S 0 u_pct_1 0 99.9984741210937 FORMAT "%6.4" /end CHARACTERISTIC
/begin CHARACTERISTIC FMSP_V_POW_AF_DWN_FAC "af ramp factor when power or cat prot en" VALUE 0x0002038C __UWORD_S 0 u_pct_1 0 99.9984741210937 FORMAT "%6.4" /end CHARACTERISTIC
/begin CHARACTERISTIC FMSP_V_OP_AF_DWN_FAC "af ramp factor when open loop" VALUE 0x0002038C __UWORD_S 0 u_pct_1 0 99.9984741210937 FORMAT "%6.4" /end CHARACTERISTIC
/begin CHARACTERISTIC FMSP_V_CL_AF_DWN_FAC "af ramp factor when close loop" VALUE 0x0002038C __UWORD_S 0 u_pct_1 0 99.9984741210937 FORMAT "%6.4" /end CHARACTERISTIC
/begin CHARACTERISTIC FMSP_V_ENG_OVR_HT_ECT_HI "engine over heat ect high" VALUE 0x0002038C __SWORD_S 0 u_deg_C -256 255.9921875 /end CHARACTERISTIC
/begin CHARACTERISTIC FMSP_V_ENG_OVR_HT_ECT_LO "engine over heat ect low" VALUE 0x0002038C __SWORD_S 0 u_deg_C -256 255.9921875 /end CHARACTERISTIC
/begin CHARACTERISTIC FMSP_V_ENG_OVR_HT_DUR "engine over heat conditions met duration" VALUE 0x0002038C __UWORD_S 0 u_1s_tmr 0 65535 /end CHARACTERISTIC
/begin CHARACTERISTIC FMSP_V_ENG_OVR_HT_DLY "engine over heat conditions met eval delay" VALUE 0x0002038C __UWORD_S 0 u_1s_tmr 0 65535 /end CHARACTERISTIC
/begin CHARACTERISTIC FMSP_C_ST_AF_BIAS_DCY_DLY "start af bias decay delay" CURVE 0x000200B0 __UBYTE_S 0 u_cnts 0 255 SYMBOL_LINK "FMSP_C_ST_AF_BIAS_DCY_DLY" 2
 /begin AXIS_DESCR FIX_AXIS sys_keyon_ect u_deg_C 6 -40 110 /begin FIX_AXIS_PAR_LIST -5120 -1280 2560 6400 10240 14080 /end FIX_AXIS_PAR_LIST /end AXIS_DESCR
/end CHARACTERISTIC
/begin CHARACTERISTIC FMSP_V_ST_AF_BIAS_HLD_DUR "start af bias first hold duration" VALUE 0x0002038C __UBYTE_S 0 u_cnts 0 255 /end CHARACTERISTIC
/begin CHARACTERISTIC FMSP_V_ST_AF_BIAS_DCY_FAC "start af bias decay factor" VALUE 0x0002038C __UWORD_S 0 u_fac_1 0 0.999984741210937 /end CHARACTERISTIC
/begin CHARACTERISTIC FMSP_M_PW_BASE_FAC "pulse width port temp correction factor" MAP 0x00020320 __UWORD_S 0 u_fac_2 0 1.999969482421875 FORMAT "%4.3" SYMBOL_LINK "FMSP_M_PW_BASE_FAC" 4
 /begin AXIS_DESCR FIX_AXIS sys_eng_spd u_espd 17 0.000000 8191.875
  /begin FIX_AXIS_PAR_LIST 0 3200 6400 9600 12800 16000 19200 22400 25600 28800 32000 35200 38400 41600 44800 48000 51200 /end FIX_AXIS_PAR_LIST
 /end AXIS_DESCR
 /begin AXIS_DESCR COM_AXIS NO_INPUT_QUANTITY u_kPa_0_4096 9 0.000000 4095.937500 AXIS_PTS_REF FMSP_X_IMEP /end AXIS_DESCR
/end CHARACTERISTIC
/begin AXIS_PTS FMSP_X_IMEP "imep breakpoint" 0x0002006C NO_INPUT_QUANTITY SSV__UWORD_S 0 u_kPa_0_4096 9 0.000000 4095.937500 FORMAT "%5.1" DEPOSIT ABSOLUTE SYMBOL_LINK "FMSP_X_IMEP" 2 /end AXIS_PTS
/begin CHARACTERISTIC FMSP_C_PW_PORT_T_FAC "pulse width port temp correction factor 2" CURVE 0x000200B0 __UWORD_S 0 u_fac_2 0 1.999969482421875 FORMAT "%4.3" SYMBOL_LINK "FMSP_C_PW_PORT_T_FAC" 2
 /begin AXIS_DESCR COM_AXIS afm_intk_prt_t u_deg_K 10 0.000000 2047.96875 AXIS_PTS_REF FMSP_X_PORT_T_A /end AXIS_DESCR
/end CHARACTERISTIC
/begin AXIS_PTS FMSP_X_PORT_T_A "map breakpoint" 0x0002006C afm_intk_prt_t SSV__UWORD_S 0 u_deg_K 10 0.000000 2047.96875 FORMAT "%5.1" DEPOSIT ABSOLUTE SYMBOL_LINK "FMSP_X_PORT_T_A" 2 /end AXIS_PTS
/begin CHARACTERISTIC FMSP_C_PW_T_FAC_BIAS "pulse width port temp correction start bias" CURVE 0x000200B0 __SWORD_S 0 u_fac_n1_p1 -1 0.999969482421875 FORMAT "%4.3" SYMBOL_LINK "FMSP_C_PW_T_FAC_BIAS" 2
 /begin AXIS_DESCR COM_AXIS afm_intk_prt_t u_deg_K 10 0.000000 2047.96875 AXIS_PTS_REF FMSP_X_PORT_T_A /end AXIS_DESCR
/end CHARACTERISTIC
/begin CHARACTERISTIC FMSP_C_PW_T_FAC_BIAS_DCY "pulse width port temp correction start bias decay base interval" CURVE 0x000200B0 __UWORD_S 0 u_cnts 0 65535 FORMAT "%5.0" SYMBOL_LINK "FMSP_C_PW_T_FAC_BIAS_DCY" 2
 /begin AXIS_DESCR FIX_AXIS sys_keyon_ect u_deg_C 15 -40 128
  /begin FIX_AXIS_PAR_LIST -5120 -3584 -2048 -512 1024 2560 4096 5632 7168 8704 10240 11776 13312 14848 16384 /end FIX_AXIS_PAR_LIST
 /end AXIS_DESCR
/end CHARACTERISTIC
/begin CHARACTERISTIC FMSP_C_PRM_PW "prime pulse width" CURVE 0x000200B0 __UWORD_S 0 u_millisec 0 1023.984375 FORMAT "%5.1" SYMBOL_LINK "FMSP_C_PRM_PW" 2
 /begin AXIS_DESCR COM_AXIS sys_ect u_deg_C 17 -256 255.9921875 AXIS_PTS_REF FMSP_X_ECT_G /end AXIS_DESCR
/end CHARACTERISTIC
/begin AXIS_PTS FMSP_X_ECT_G "ect breakpoint" 0x0002006C sys_ect SSV__SWORD_S 0 u_deg_C 17 -256 255.9921875 FORMAT "%4.1" DEPOSIT ABSOLUTE SYMBOL_LINK "FMSP_X_ECT_G" 2 /end AXIS_PTS
/begin CHARACTERISTIC FMSP_C_PRM_PW_AMP_FAC "prime pulse width amp factor" CURVE 0x000200B0 __UWORD_S 0 u_fac_2 0 1.999969482421875 FORMAT "%4.3" SYMBOL_LINK "FMSP_C_PRM_PW_AMP_FAC" 2
 /begin AXIS_DESCR FIX_AXIS sys_amp u_kPa_0_256 7 45 105 /begin FIX_AXIS_PAR_LIST 11520 14080 16640 19200 21760 24320 26880 /end FIX_AXIS_PAR_LIST /end AXIS_DESCR
/end CHARACTERISTIC
/begin CHARACTERISTIC FMSP_C_PRM_PW_RUN_MIN "prime pulse width re-enable run min" CURVE 0x000200B0 __UBYTE_S 0 u_4s_tmr 0 1020 FORMAT "%4.0" SYMBOL_LINK "FMSP_C_PRM_PW_RUN_MIN" 2
 /begin AXIS_DESCR COM_AXIS sys_ect u_deg_C 17 -256 255.9921875 AXIS_PTS_REF FMSP_X_ECT_G /end AXIS_DESCR
/end CHARACTERISTIC
/begin CHARACTERISTIC FMSP_V_CRST_PRM_PW_MIN "cold prime pulse min" VALUE 0x0002038C __UWORD_S 0 u_millisec 0 1023.984375 FORMAT "%5.1" /end CHARACTERISTIC
/begin CHARACTERISTIC FMSP_M_PRM_PW_OFFT_FAC "restart prime pulse off time factor,0:cold restart,1:hot restart" MAP 0x00020320 __UWORD_S 0 u_fac_8 0 7.9998779296875 FORMAT "%4.3" SYMBOL_LINK "FMSP_M_PRM_PW_OFFT_FAC" 4
 /begin AXIS_DESCR FIX_AXIS NO_INPUT_QUANTITY x_cnts 2 0 1 /begin FIX_AXIS_PAR_LIST 0 1 /end FIX_AXIS_PAR_LIST /end AXIS_DESCR
 /begin AXIS_DESCR FIX_AXIS NO_INPUT_QUANTITY u_min 9 0 90 /begin FIX_AXIS_PAR_LIST 0 7 15 22 30 45 60 75 90 /end FIX_AXIS_PAR_LIST /end AXIS_DESCR
/end CHARACTERISTIC
/begin CHARACTERISTIC FMSP_V_PRM_PW_RST_ECT_MIN "prime pulse re-enable ect min" VALUE 0x0002038C __SWORD_S 0 u_deg_C -256 255.9921875 /end CHARACTERISTIC
/begin CHARACTERISTIC FMSP_C_PRM_PW_RST_OFFT_MIN "prime pulse re-enable off time min" CURVE 0x000200B0 __UWORD_S 0 u_min_hi 0 16383.75 SYMBOL_LINK "FMSP_C_PRM_PW_RST_OFFT_MIN" 2
 /begin AXIS_DESCR COM_AXIS sys_ect u_deg_C 3 -256 255.9921875 AXIS_PTS_REF FMSP_X_ECT_E /end AXIS_DESCR
/end CHARACTERISTIC
/begin CHARACTERISTIC FMSP_C_PRM_PW_EN_DLY "prime pulse enable delay after engine turn" CURVE 0x000200B0 __UWORD_S 0 u_1x_tmr 0 511.9921875 FORMAT "%7.2" SYMBOL_LINK "FMSP_C_PRM_PW_EN_DLY" 2
 /begin AXIS_DESCR COM_AXIS sys_ect u_deg_C 17 -40.0 120 AXIS_PTS_REF FMSP_X_ECT_B /end AXIS_DESCR
/end CHARACTERISTIC
/begin CHARACTERISTIC FMSP_V_INJ_OFF_MISF_THR "injection disable misfire ratio" VALUE 0x0002038C __UWORD_S 0 u_fac_1 0 0.999984741210937 /end CHARACTERISTIC
/begin CHARACTERISTIC FMSP_C_PW_BAT_VLT_FAC "pulse width voltage factor" CURVE 0x000200B0 __UWORD_S 0 u_fac_2 0 1.999969482421875 FORMAT "%4.3" SYMBOL_LINK "FMSP_C_PW_BAT_VLT_FAC" 2
 /begin AXIS_DESCR FIX_AXIS hw_bat_vlt u_volt_32 17 0 25.6
  /begin FIX_AXIS_PAR_LIST 0 3276 6553 9830 13107 16384 19660 22937 26214 29491 32768 36044 39321 42598 45875 49152 52428 /end FIX_AXIS_PAR_LIST
 /end AXIS_DESCR
/end CHARACTERISTIC
/begin CHARACTERISTIC FMSP_V_ADP_DIS_UO2FL_MIN "uo2 fail time to disable adaption" VALUE 0x0002038C __UWORD_S 0 u_2x_tmr 0 1023.984375 /end CHARACTERISTIC
/begin CHARACTERISTIC FMSP_V_POST_PW_MIN "post pulse min" VALUE 0x0002038C __UWORD_S 0 u_millisec 0 1023.984375 FORMAT "%5.1" /end CHARACTERISTIC
/begin CHARACTERISTIC FMSP_V_PW_MAX "pulse width max" VALUE 0x0002038C __UWORD_S 0 u_millisec 0 1023.984375 FORMAT "%5.1" /end CHARACTERISTIC
/begin CHARACTERISTIC FMSP_V_PW_MIN "pulse width min" VALUE 0x0002038C __UWORD_S 0 u_millisec 0 1023.984375 FORMAT "%5.1" /end CHARACTERISTIC
/begin CHARACTERISTIC FMSP_C_PUC_RUN_MIN "trailing throttle fuel cut off enable run time min" CURVE 0x000200B0 __UWORD_S 0 u_1s_tmr 0 65535 SYMBOL_LINK "FMSP_C_PUC_RUN_MIN" 2
 /begin AXIS_DESCR COM_AXIS sys_keyon_ect u_deg_C 6 -256 255.9921875 AXIS_PTS_REF FMSP_X_ECT_H /end AXIS_DESCR
/end CHARACTERISTIC
/begin AXIS_PTS FMSP_X_ECT_H "ect breakpoint" 0x0002006C sys_keyon_ect SSV__SWORD_S 0 u_deg_C 6 -256 255.9921875 FORMAT "%4.1" DEPOSIT ABSOLUTE SYMBOL_LINK "FMSP_X_ECT_H" 2 /end AXIS_PTS
/begin CHARACTERISTIC FMSP_C_PUC_PRK_RUN_MIN "park trailing throttle fuel cut off enable run time min" CURVE 0x000200B0 __UWORD_S 0 u_1s_tmr 0 65535 SYMBOL_LINK "FMSP_C_PUC_PRK_RUN_MIN" 2
 /begin AXIS_DESCR COM_AXIS sys_ect u_deg_C 4 -256 255.9921875 AXIS_PTS_REF FMSP_X_ECT_K /end AXIS_DESCR
/end CHARACTERISTIC
/begin AXIS_PTS FMSP_X_ECT_K "ect breakpoint" 0x0002006C sys_ect SSV__SWORD_S 0 u_deg_C 4 -256 255.9921875 FORMAT "%4.1" DEPOSIT ABSOLUTE SYMBOL_LINK "FMSP_X_ECT_K" 2 /end AXIS_PTS
/begin CHARACTERISTIC FMSP_C_PUC_MED_VSPD_MAP "trailing throttle fuel cut off enable map when med vehicle speed" CURVE 0x000200B0 __UBYTE_S 0 u_kPa_b 0 255 SYMBOL_LINK "FMSP_C_PUC_MED_VSPD_MAP" 2
 /begin AXIS_DESCR COM_AXIS sys_ect u_deg_C 5 -256 255.9921875 AXIS_PTS_REF FMSP_X_ECT_I /end AXIS_DESCR
/end CHARACTERISTIC
/begin CHARACTERISTIC FMSP_C_PUC_AC_ON_MAP "trailing throttle fuel cut off enable map when ac on and not med vspd" CURVE 0x000200B0 __UBYTE_S 0 u_kPa_b 0 255 SYMBOL_LINK "FMSP_C_PUC_AC_ON_MAP" 2
 /begin AXIS_DESCR COM_AXIS sys_ect u_deg_C 5 -256 255.9921875 AXIS_PTS_REF FMSP_X_ECT_I /end AXIS_DESCR
/end CHARACTERISTIC
/begin CHARACTERISTIC FMSP_C_PUC_AC_OFF_MAP "trailing throttle fuel cut off enable map when ac off and not med vspd" CURVE 0x000200B0 __UBYTE_S 0 u_kPa_b 0 255 SYMBOL_LINK "FMSP_C_PUC_AC_OFF_MAP" 2
 /begin AXIS_DESCR COM_AXIS sys_ect u_deg_C 5 -256 255.9921875 AXIS_PTS_REF FMSP_X_ECT_I /end AXIS_DESCR
/end CHARACTERISTIC
/begin AXIS_PTS FMSP_X_ECT_I "ect breakpoint" 0x0002006C sys_ect SSV__SWORD_S 0 u_deg_C 5 -256 255.9921875 FORMAT "%4.1" DEPOSIT ABSOLUTE SYMBOL_LINK "FMSP_X_ECT_I" 2 /end AXIS_PTS
/begin CHARACTERISTIC FMSP_V_PUC_NORM_MAP_HYS "trailing throttle fuel cut off enable map hys" VALUE 0x0002038C __UWORD_S 0 u_kPa_0_256 0 255.99609375 FORMAT "%4.1" /end CHARACTERISTIC
/begin CHARACTERISTIC FMSP_V_PUC_STRCT_MAP_HYS "trailing throttle fuel cut off enable map hys when exit by map" VALUE 0x0002038C __UWORD_S 0 u_kPa_0_256 0 255.99609375 FORMAT "%4.1" /end CHARACTERISTIC
/begin CHARACTERISTIC FMSP_V_PUC_PRK_MAP_THR "park trailing throttle fuel cut off map thr" VALUE 0x0002038C __UWORD_S 0 u_kPa_0_256 0 255.99609375 FORMAT "%4.1" /end CHARACTERISTIC
/begin CHARACTERISTIC FMSP_V_PUC_PRK_MAP_HYS "park trailing throttle fuel cut off map hys" VALUE 0x0002038C __UWORD_S 0 u_kPa_0_256 0 255.99609375 FORMAT "%4.1" /end CHARACTERISTIC
/begin AXIS_PTS FMSP_X_ECT_J "ect breakpoint" 0x0002006C sys_ect SSV__SWORD_S 0 u_deg_C 7 -256 255.9921875 FORMAT "%4.1" DEPOSIT ABSOLUTE SYMBOL_LINK "FMSP_X_ECT_J" 2 /end AXIS_PTS
/begin CHARACTERISTIC FMSP_M_PUC_TCC_ESPD "trailing throttle fuel cut off enable engine speed when tcc locked" MAP 0x00020320 __UBYTE_S 0 u_espd_b 0 2040 FORMAT "%4.0" SYMBOL_LINK "FMSP_M_PUC_TCC_ESPD" 3
 /begin AXIS_DESCR FIX_AXIS fmsp_fwd_gear u_fwd_gear 8 0 7 /begin FIX_AXIS_PAR_LIST 0 1 2 3 4 5 6 7 /end FIX_AXIS_PAR_LIST /end AXIS_DESCR
 /begin AXIS_DESCR COM_AXIS sys_ect u_deg_C 7 -256 255.9921875 AXIS_PTS_REF FMSP_X_ECT_J /end AXIS_DESCR
/end CHARACTERISTIC
/begin CHARACTERISTIC FMSP_M_PUC_HYB_TCC_ESPD "trailing throttle fuel cut off enable engine speed when tcc locked and hybrid idle mode" MAP 0x00020320 __UBYTE_S 0 u_espd_b 0 2040 FORMAT "%4.0" SYMBOL_LINK "FMSP_M_PUC_HYB_TCC_ESPD" 3
 /begin AXIS_DESCR FIX_AXIS fmsp_fwd_gear u_fwd_gear 8 0 7 /begin FIX_AXIS_PAR_LIST 0 1 2 3 4 5 6 7 /end FIX_AXIS_PAR_LIST /end AXIS_DESCR
 /begin AXIS_DESCR COM_AXIS sys_ect u_deg_C 7 -256 255.9921875 AXIS_PTS_REF FMSP_X_ECT_J /end AXIS_DESCR
/end CHARACTERISTIC
/begin CHARACTERISTIC FMSP_M_PUC_ECO_TCC_ESPD "trailing throttle fuel cut off enable engine speed when tcc locked and eco mode" MAP 0x00020320 __UBYTE_S 0 u_espd_b 0 2040 FORMAT "%4.0" SYMBOL_LINK "FMSP_M_PUC_ECO_TCC_ESPD" 3
 /begin AXIS_DESCR FIX_AXIS fmsp_fwd_gear u_fwd_gear 8 0 7 /begin FIX_AXIS_PAR_LIST 0 1 2 3 4 5 6 7 /end FIX_AXIS_PAR_LIST /end AXIS_DESCR
 /begin AXIS_DESCR COM_AXIS sys_ect u_deg_C 7 -256 255.9921875 AXIS_PTS_REF FMSP_X_ECT_J /end AXIS_DESCR
/end CHARACTERISTIC
/begin CHARACTERISTIC FMSP_M_PUC_HYB_ESPD "trailing throttle fuel cut off enable engine speed when hybrid idle mode" MAP 0x00020320 __UBYTE_S 0 u_espd_b 0 2040 FORMAT "%4.0" SYMBOL_LINK "FMSP_M_PUC_HYB_ESPD" 3
 /begin AXIS_DESCR FIX_AXIS fmsp_fwd_gear u_fwd_gear 8 0 7 /begin FIX_AXIS_PAR_LIST 0 1 2 3 4 5 6 7 /end FIX_AXIS_PAR_LIST /end AXIS_DESCR
 /begin AXIS_DESCR COM_AXIS sys_ect u_deg_C 7 -256 255.9921875 AXIS_PTS_REF FMSP_X_ECT_J /end AXIS_DESCR
/end CHARACTERISTIC
/begin CHARACTERISTIC FMSP_C_PUC_PN_ACON_ESPD "trailing throttle fuel cut off enable engine speed when ac on and gear p/n" CURVE 0x000200B0 __UWORD_S 0 u_espd 0 8191.875 FORMAT "%5.1" SYMBOL_LINK "FMSP_C_PUC_PN_ACON_ESPD" 2
 /begin AXIS_DESCR COM_AXIS sys_ect u_deg_C 7 -256 255.9921875 AXIS_PTS_REF FMSP_X_ECT_J /end AXIS_DESCR
/end CHARACTERISTIC
/begin CHARACTERISTIC FMSP_C_PUC_PN_ACOFF_ESPD "trailing throttle fuel cut off enable engine speed when ac off and gear p/n" CURVE 0x000200B0 __UWORD_S 0 u_espd 0 8191.875 FORMAT "%5.1" SYMBOL_LINK "FMSP_C_PUC_PN_ACOFF_ESPD" 2
 /begin AXIS_DESCR COM_AXIS sys_ect u_deg_C 7 -256 255.9921875 AXIS_PTS_REF FMSP_X_ECT_J /end AXIS_DESCR
/end CHARACTERISTIC
/begin CHARACTERISTIC FMSP_M_PUC_DR_ACON_ESPD "trailing throttle fuel cut off enable engine speed when ac on and gear drive" MAP 0x00020320 __UBYTE_S 0 u_espd_b 0 2040 FORMAT "%4.0" SYMBOL_LINK "FMSP_M_PUC_DR_ACON_ESPD" 3
 /begin AXIS_DESCR FIX_AXIS fmsp_fwd_gear u_fwd_gear 8 0 7 /begin FIX_AXIS_PAR_LIST 0 1 2 3 4 5 6 7 /end FIX_AXIS_PAR_LIST /end AXIS_DESCR
 /begin AXIS_DESCR COM_AXIS sys_ect u_deg_C 7 -256 255.9921875 AXIS_PTS_REF FMSP_X_ECT_J /end AXIS_DESCR
/end CHARACTERISTIC
/begin CHARACTERISTIC FMSP_M_PUC_DR_ACOFF_ESPD "trailing throttle fuel cut off enable engine speed when ac off and gear drive" MAP 0x00020320 __UBYTE_S 0 u_espd_b 0 2040 FORMAT "%4.0" SYMBOL_LINK "FMSP_M_PUC_DR_ACOFF_ESPD" 3
 /begin AXIS_DESCR FIX_AXIS fmsp_fwd_gear u_fwd_gear 8 0 7 /begin FIX_AXIS_PAR_LIST 0 1 2 3 4 5 6 7 /end FIX_AXIS_PAR_LIST /end AXIS_DESCR
 /begin AXIS_DESCR COM_AXIS sys_ect u_deg_C 7 -256 255.9921875 AXIS_PTS_REF FMSP_X_ECT_J /end AXIS_DESCR
/end CHARACTERISTIC
/begin CHARACTERISTIC FMSP_M_PUC_ECO_DR_ACON_ESPD "trailing throttle fuel cut off enable engine speed when ac on ,gear drive and eco mode" MAP 0x00020320 __UBYTE_S 0 u_espd_b 0 2040 FORMAT "%4.0" SYMBOL_LINK "FMSP_M_PUC_ECO_DR_ACON_ESPD" 3
 /begin AXIS_DESCR FIX_AXIS fmsp_fwd_gear u_fwd_gear 8 0 7 /begin FIX_AXIS_PAR_LIST 0 1 2 3 4 5 6 7 /end FIX_AXIS_PAR_LIST /end AXIS_DESCR
 /begin AXIS_DESCR COM_AXIS sys_ect u_deg_C 7 -256 255.9921875 AXIS_PTS_REF FMSP_X_ECT_J /end AXIS_DESCR
/end CHARACTERISTIC
/begin CHARACTERISTIC FMSP_M_PUC_ECO_DR_ACOFF_ESPD "trailing throttle fuel cut off enable engine speed when ac off ,gear drive and eco mode" MAP 0x00020320 __UBYTE_S 0 u_espd_b 0 2040 FORMAT "%4.0" SYMBOL_LINK "FMSP_M_PUC_ECO_DR_ACOFF_ESPD" 3
 /begin AXIS_DESCR FIX_AXIS fmsp_fwd_gear u_fwd_gear 8 0 7 /begin FIX_AXIS_PAR_LIST 0 1 2 3 4 5 6 7 /end FIX_AXIS_PAR_LIST /end AXIS_DESCR
 /begin AXIS_DESCR COM_AXIS sys_ect u_deg_C 7 -256 255.9921875 AXIS_PTS_REF FMSP_X_ECT_J /end AXIS_DESCR
/end CHARACTERISTIC
/begin CHARACTERISTIC FMSP_V_PUC_USE_TCC_ESPD "use tcc lock trailing throttle fuel cut off engine speed thr" VALUE 0x0002038C __UBYTE_S 0 b_true 0 1 FORMAT "%1.0" /end CHARACTERISTIC
/begin CHARACTERISTIC FMSP_V_PUC_ESPD_GR_HI_THR "trailing throttle fuel cut off engine speed high gear thr" VALUE 0x0002038C __UBYTE_S 0 u_fwd_gear 0 7 FORMAT "%1.0" /end CHARACTERISTIC
/begin CHARACTERISTIC FMSP_V_PUC_NORM_TCC_ESPD_HYS "trailing throttle fuel cut off engine speed hysteresis,tcc locked" VALUE 0x0002038C __UWORD_S 0 u_espd 0 8191.875 FORMAT "%5.1" /end CHARACTERISTIC
/begin CHARACTERISTIC FMSP_V_PUC_ECO_NORM_TCC_ESPD_HYS "trailing throttle fuel cut off engine speed hysteresis,eco and tcc locked" VALUE 0x0002038C __UWORD_S 0 u_espd 0 8191.875 FORMAT "%5.1" /end CHARACTERISTIC
/begin CHARACTERISTIC FMSP_V_PUC_NORM_HI_GR_ESPD_HYS "trailing throttle fuel cut off engine speed hysteresis,high gear" VALUE 0x0002038C __UWORD_S 0 u_espd 0 8191.875 FORMAT "%5.1" /end CHARACTERISTIC
/begin CHARACTERISTIC FMSP_V_PUC_ECO_NORM_HI_GR_ESPD_HYS "trailing throttle fuel cut off engine speed hysteresis,eco and high gear" VALUE 0x0002038C __UWORD_S 0 u_espd 0 8191.875 FORMAT "%5.1" /end CHARACTERISTIC
/begin CHARACTERISTIC FMSP_V_PUC_NORM_LO_GR_ESPD_HYS "trailing throttle fuel cut off engine speed hysteresis,low gear" VALUE 0x0002038C __UWORD_S 0 u_espd 0 8191.875 FORMAT "%5.1" /end CHARACTERISTIC
/begin CHARACTERISTIC FMSP_V_PUC_ECO_NORM_LO_GR_ESPD_HYS "trailing throttle fuel cut off engine speed hysteresis,eco and low gear" VALUE 0x0002038C __UWORD_S 0 u_espd 0 8191.875 FORMAT "%5.1" /end CHARACTERISTIC
/begin CHARACTERISTIC FMSP_V_PUC_STRCT_TCC_ESPD_HYS "trailing throttle fuel cut off engine speed strict hysteresis,tcc locked" VALUE 0x0002038C __UWORD_S 0 u_espd 0 8191.875 FORMAT "%5.1" /end CHARACTERISTIC
/begin CHARACTERISTIC FMSP_V_PUC_ECO_STRCT_TCC_ESPD_HYS "trailing throttle fuel cut off engine speed strict hysteresis,eco and tcc locked" VALUE 0x0002038C __UWORD_S 0 u_espd 0 8191.875 FORMAT "%5.1" /end CHARACTERISTIC
/begin CHARACTERISTIC FMSP_V_PUC_STRCT_HI_GR_ESPD_HYS "trailing throttle fuel cut off engine speed strict hysteresis,high gear" VALUE 0x0002038C __UWORD_S 0 u_espd 0 8191.875 FORMAT "%5.1" /end CHARACTERISTIC
/begin CHARACTERISTIC FMSP_V_PUC_ECO_STRCT_HI_GR_ESPD_HYS "trailing throttle fuel cut off engine speed strict hysteresis,eco and high gear" VALUE 0x0002038C __UWORD_S 0 u_espd 0 8191.875 FORMAT "%5.1" /end CHARACTERISTIC
/begin CHARACTERISTIC FMSP_V_PUC_STRCT_LO_GR_ESPD_HYS "trailing throttle fuel cut off engine speed strict hysteresis,low gear" VALUE 0x0002038C __UWORD_S 0 u_espd 0 8191.875 FORMAT "%5.1" /end CHARACTERISTIC
/begin CHARACTERISTIC FMSP_V_PUC_ECO_STRCT_LO_GR_ESPD_HYS "trailing throttle fuel cut off engine speed strict hysteresis,eco and low gear" VALUE 0x0002038C __UWORD_S 0 u_espd 0 8191.875 FORMAT "%5.1" /end CHARACTERISTIC
/begin CHARACTERISTIC FMSP_V_PUC_PRK_ESPD_HYS "park trailing throttle fuel cut off engine speed hysteresis" VALUE 0x0002038C __UWORD_S 0 u_espd 0 8191.875 FORMAT "%5.1" /end CHARACTERISTIC
/begin CHARACTERISTIC FMSP_V_PUC_ESPD_CP_BIAS "trailing throttle fuel cut off engine speed purge bias" VALUE 0x0002038C __UWORD_S 0 u_espd 0 8191.875 FORMAT "%5.1" /end CHARACTERISTIC
/begin CHARACTERISTIC FMSP_V_PUC_CP_BIAS_IAT_MIN "trailing throttle fuel cut off engine speed purge bias enable iat min" VALUE 0x0002038C __SWORD_S 0 u_deg_C -256 255.9921875 /end CHARACTERISTIC
/begin CHARACTERISTIC FMSP_V_PUC_CP_BIAS_CONC_THR "trailing throttle fuel cut off engine speed purge bias enable purge concentration min" VALUE 0x0002038C __UWORD_S 0 u_pct 0 199.996948242187 /end CHARACTERISTIC
/begin CHARACTERISTIC FMSP_V_PUC_HYB_IDL_ESPD_BIAS "trailing throttle fuel cut off engine speed purge bias" VALUE 0x0002038C __UWORD_S 0 u_espd 0 8191.875 FORMAT "%5.1" /end CHARACTERISTIC
/begin CHARACTERISTIC FMSP_V_PUC_IDL_ESPD_BIAS "trailing throttle fuel cut off engine speed purge bias" VALUE 0x0002038C __UWORD_S 0 u_espd 0 8191.875 FORMAT "%5.1" /end CHARACTERISTIC
/begin CHARACTERISTIC FMSP_V_PUC_VSPD_THR_HI "trailing throttle fuel cut off vehicle speed high thr" VALUE 0x0002038C __UWORD_S 0 u_vspd 0 511.9921875 FORMAT "%5.1" /end CHARACTERISTIC
/begin CHARACTERISTIC FMSP_V_PUC_VSPD_THR_LO "trailing throttle fuel cut off vehicle speed high thr" VALUE 0x0002038C __UWORD_S 0 u_vspd 0 511.9921875 FORMAT "%5.1" /end CHARACTERISTIC
/begin CHARACTERISTIC FMSP_V_PUC_VSPD_MIN "trailing throttle fuel cut off vehicle speed min" VALUE 0x0002038C __UWORD_S 0 u_vspd 0 511.9921875 FORMAT "%5.1" /end CHARACTERISTIC
/begin CHARACTERISTIC FMSP_C_PUC_THRO_THR "trailing throttle fuel cut off throttle thr" CURVE 0x000200B0 __UWORD_S 0 u_pct 0 199.996948242187 FORMAT "%4.1" SYMBOL_LINK "FMSP_C_PUC_THRO_THR" 2
 /begin AXIS_DESCR FIX_AXIS sys_eng_spd u_espd 17 0 6400
  /begin FIX_AXIS_PAR_LIST 0 3200 6400 9600 12800 16000 19200 22400 25600 28800 32000 35200 38400 41600 44800 48000 51200 /end FIX_AXIS_PAR_LIST
 /end AXIS_DESCR
/end CHARACTERISTIC
/begin CHARACTERISTIC FMSP_V_PUC_THRO_HYS "trailing throttle fuel cut off throttle hys" VALUE 0x0002038C __UWORD_S 0 u_pct 0 199.996948242187 FORMAT "%4.1" /end CHARACTERISTIC
/begin CHARACTERISTIC FMSP_C_PUC_EN_DLY "trailing throttle fuel cut off enable delay" CURVE 0x000200B0 __UWORD_S 0 u_2x_tmr 0 1023.984375 SYMBOL_LINK "FMSP_C_PUC_EN_DLY" 2
 /begin AXIS_DESCR COM_AXIS sys_eng_spd u_espd 5 0 8191.875 AXIS_PTS_REF FMSP_X_ESPD_C /end AXIS_DESCR
/end CHARACTERISTIC
/begin AXIS_PTS FMSP_X_ESPD_C "engine speed breakpoint" 0x0002006C sys_eng_spd SSV__UWORD_S 0 u_espd 5 0.000000 8191.875000 FORMAT "%6.2" DEPOSIT ABSOLUTE SYMBOL_LINK "FMSP_X_ESPD_C" 2 /end AXIS_PTS
/begin CHARACTERISTIC FMSP_V_PUC_EXT_DUR_MIN "trailing throttle fuel cut off enable min duration from last puc" VALUE 0x0002038C __UWORD_S 0 u_2x_tmr 0 1023.984375 /end CHARACTERISTIC
/begin CHARACTERISTIC FMSP_V_FCO_ESPD_HI "fuel cut off engine speed hi" VALUE 0x0002038C __UWORD_S 0 u_espd 0 8191.875 FORMAT "%5.1" /end CHARACTERISTIC
/begin CHARACTERISTIC FMSP_V_FCO_ESPD_LO "fuel cut off engine speed lo" VALUE 0x0002038C __UWORD_S 0 u_espd 0 8191.875 FORMAT "%5.1" /end CHARACTERISTIC
/begin CHARACTERISTIC FMSP_V_FCO_VSPD_HI "fuel cut off vehicle speed hi" VALUE 0x0002038C __UWORD_S 0 u_vspd 0 511.9921875 FORMAT "%5.1" /end CHARACTERISTIC
/begin CHARACTERISTIC FMSP_V_FCO_VSPD_LO "fuel cut off vehicle speed lo" VALUE 0x0002038C __UWORD_S 0 u_vspd 0 511.9921875 FORMAT "%4.1" /end CHARACTERISTIC
/begin CHARACTERISTIC FMSP_V_PN_FCO_ESPD_HI "fuel cut off engine speed hi at P/N" VALUE 0x0002038C __UWORD_S 0 u_espd 0 8191.875 FORMAT "%5.1" /end CHARACTERISTIC
/begin CHARACTERISTIC FMSP_V_PN_FCO_ESPD_LO "fuel cut off engine speed lo at P/N" VALUE 0x0002038C __UWORD_S 0 u_espd 0 8191.875 FORMAT "%5.1" /end CHARACTERISTIC
/begin CHARACTERISTIC FMSP_V_PN_FCO_RUN_MIN "PN fuel cut off runtime min" VALUE 0x0002038C __UWORD_S 0 u_1s_tmr 0 65535 /end CHARACTERISTIC
/begin CHARACTERISTIC FMSP_V_ETC_FCO_ESPD "fuel cut off engine speed when etc control request" VALUE 0x0002038C __UWORD_S 0 u_espd 0 8191.875 FORMAT "%5.1" /end CHARACTERISTIC
/begin CHARACTERISTIC FMSP_V_ETC_FCO_FLW "fuel cut off engine speed when etc control request" VALUE 0x0002038C __UWORD_S 0 u_g_per_sec 0 511.9921875 /end CHARACTERISTIC
/begin CHARACTERISTIC FMSP_M_FCO_ACTV_CYL_DLY "fuel cut off active cylinder delay" MAP 0x00020320 __UBYTE_S 0 u_cnts 0 255 SYMBOL_LINK "FMSP_M_FCO_ACTV_CYL_DLY" 2
 /begin AXIS_DESCR FIX_AXIS NO_INPUT_QUANTITY u_cnts 4 1 4 /begin FIX_AXIS_PAR_LIST 1 2 3 4 /end FIX_AXIS_PAR_LIST /end AXIS_DESCR
 /begin AXIS_DESCR FIX_AXIS fmsp_fwd_gear u_fwd_gear 8 0 7 /begin FIX_AXIS_PAR_LIST 0 1 2 3 4 5 6 7 /end FIX_AXIS_PAR_LIST /end AXIS_DESCR
/end CHARACTERISTIC
/begin CHARACTERISTIC FMSP_V_CL_FCO_DLY_HI_DUR "close loop delay fuel cut off hi/lo duration thr" VALUE 0x0002038C __UWORD_S 0 u_2x_tmr 0 1023.984375 /end CHARACTERISTIC
/begin CHARACTERISTIC FMSP_V_CL_FCO_DLY_HI "close loop delay fuel cut off hi" VALUE 0x0002038C __UWORD_S 0 u_2x_tmr 0 1023.984375 /end CHARACTERISTIC
/begin CHARACTERISTIC FMSP_V_CL_FCO_DLY_LO "close loop delay fuel cut off hi" VALUE 0x0002038C __UWORD_S 0 u_2x_tmr 0 1023.984375 /end CHARACTERISTIC
/begin CHARACTERISTIC FMSP_V_FCO_HYB_CYL_EXT_EN_ESPD "fuel cut off single cylinder exit enable engine speed,hybrid" VALUE 0x0002038C __UWORD_S 0 u_espd 0 8191.875 FORMAT "%5.1" /end CHARACTERISTIC
/begin CHARACTERISTIC FMSP_V_FCO_ACON_CYL_EXT_EN_ESPD "fuel cut off single cylinder exit enable engine speed,ac on" VALUE 0x0002038C __UWORD_S 0 u_espd 0 8191.875 FORMAT "%5.1" /end CHARACTERISTIC
/begin CHARACTERISTIC FMSP_V_FCO_ACOFF_CYL_EXT_EN_ESPD "fuel cut off single cylinder exit enable engine speed,ac on" VALUE 0x0002038C __UWORD_S 0 u_espd 0 8191.875 FORMAT "%5.1" /end CHARACTERISTIC
/begin CHARACTERISTIC FMSP_V_FCO_CYL_EXT_EN_TP "fuel cut off single cylinder exit enable throttle position" VALUE 0x0002038C __UWORD_S 0 u_pct 0 199.996948242187 FORMAT "%4.1" /end CHARACTERISTIC
/begin CHARACTERISTIC FMSP_V_FCO_HYB_CYL_EXT_EN_TP "fuel cut off single cylinder exit enable throttle position" VALUE 0x0002038C __UWORD_S 0 u_pct 0 199.996948242187 FORMAT "%4.1" /end CHARACTERISTIC
/begin CHARACTERISTIC FMSP_C_FCO_ACTV_PN_CYL_DLY "fuel cut off active cylinder delay" CURVE 0x000200B0 __UBYTE_S 0 u_cnts 0 255
 /begin AXIS_DESCR FIX_AXIS NO_INPUT_QUANTITY u_cnts 4 1 4 /begin FIX_AXIS_PAR_LIST 1 2 3 4 /end FIX_AXIS_PAR_LIST /end AXIS_DESCR
/end CHARACTERISTIC
/begin CHARACTERISTIC FMSP_C_FCO_CYL_EXT_DLY_PN "fuel cut off exit cylinder delay pn" CURVE 0x000200B0 __UBYTE_S 0 u_cnts 0 255
 /begin AXIS_DESCR FIX_AXIS NO_INPUT_QUANTITY u_cnts 4 1 4 /begin FIX_AXIS_PAR_LIST 1 2 3 4 /end FIX_AXIS_PAR_LIST /end AXIS_DESCR
/end CHARACTERISTIC
/begin CHARACTERISTIC FMSP_M_FCO_CYL_EXT_DLY_CLS "fuel cut off exit cylinder delay close throttle" MAP 0x00020320 __UBYTE_S 0 u_cnts 0 255 SYMBOL_LINK "FMSP_M_FCO_CYL_EXT_DLY_CLS" 2
 /begin AXIS_DESCR FIX_AXIS NO_INPUT_QUANTITY u_cnts 4 1 4 /begin FIX_AXIS_PAR_LIST 1 2 3 4 /end FIX_AXIS_PAR_LIST /end AXIS_DESCR
 /begin AXIS_DESCR FIX_AXIS fmsp_fwd_gear u_fwd_gear 8 0 7 /begin FIX_AXIS_PAR_LIST 0 1 2 3 4 5 6 7 /end FIX_AXIS_PAR_LIST /end AXIS_DESCR
/end CHARACTERISTIC
/begin CHARACTERISTIC FMSP_M_FCO_CYL_EXT_DLY_OPN "fuel cut off exit cylinder delay open throttle" MAP 0x00020320 __UBYTE_S 0 u_cnts 0 255 SYMBOL_LINK "FMSP_M_FCO_CYL_EXT_DLY_OPN" 2
 /begin AXIS_DESCR FIX_AXIS NO_INPUT_QUANTITY u_cnts 4 1 4 /begin FIX_AXIS_PAR_LIST 1 2 3 4 /end FIX_AXIS_PAR_LIST /end AXIS_DESCR
 /begin AXIS_DESCR FIX_AXIS fmsp_fwd_gear u_fwd_gear 8 0 7 /begin FIX_AXIS_PAR_LIST 0 1 2 3 4 5 6 7 /end FIX_AXIS_PAR_LIST /end AXIS_DESCR
/end CHARACTERISTIC
/begin CHARACTERISTIC FMSP_V_OSC_AF_FUEL_MIN "osc af exit fuel min" VALUE 0x0002038C __UWORD_S 0 u_gram_4 0 3.99993896484375 /end CHARACTERISTIC
/begin CHARACTERISTIC FMSP_V_OSC_AF_DO2_THR "osc af exit down o2 volt min" VALUE 0x0002038C __UWORD_S 0 u_volt_32 0 31.99951171875 FORMAT "%4.3" /end CHARACTERISTIC
/begin CHARACTERISTIC FMSP_V_OSC_REQ_FAC "factor of osc af request" VALUE 0x0002038C __UWORD_S 0 u_fac_32 0 31.99951171875 FORMAT "%4.2" /end CHARACTERISTIC
/begin CHARACTERISTIC FMSP_V_OSC_AF_EXT_DUR_MIN "osc af exit duration min" VALUE 0x0002038C __UWORD_S 0 u_2x_tmr 0 1023.984375 /end CHARACTERISTIC
/begin CHARACTERISTIC FMSP_V_OSC_AF_MIN "osc af min" VALUE 0x0002038C __UWORD_S 0 u_afr 0 31.99951171875 FORMAT "%5.0" /end CHARACTERISTIC
/begin CHARACTERISTIC FMSP_V_OSC_AF_EN_CAT_T_MIN "osc af enable cat temp min" VALUE 0x0002038C __SWORD_S 0 u_deg_C_h -2048 2047.9375 FORMAT "%5.0" /end CHARACTERISTIC
/begin CHARACTERISTIC FMSP_V_OSC_MAX "osc quality max" VALUE 0x0002038C __UWORD_S 0 u_gram_4 0 3.99993896484375 /end CHARACTERISTIC
/begin CHARACTERISTIC FMSP_V_CFDM_FLW "airflow cfdm osc calculated" VALUE 0x0002038C __UWORD_S 0 u_g_per_sec_64 0 63.9990234375 FORMAT "%4.3" /end CHARACTERISTIC
/begin CHARACTERISTIC FMSP_C_OSC_DEC_SPD "osc decrease speed" CURVE 0x000200B0 __UWORD_S 0 u_g_per_sec_1 0 0.999984741210937 SYMBOL_LINK "FMSP_C_OSC_DEC_SPD" 2
 /begin AXIS_DESCR COM_AXIS fmsp_do2_rt u_fac_2 7 0 1.99996948242187 AXIS_PTS_REF FMSP_X_DO2_RT /end AXIS_DESCR
/end CHARACTERISTIC
/begin CHARACTERISTIC FMSP_C_DO2_RT "osc decrease speed" CURVE 0x000200B0 __UWORD_S 0 u_fac_2 0 1.99996948242187 FORMAT "%4.3" SYMBOL_LINK "FMSP_C_DO2_RT" 2
 /begin AXIS_DESCR COM_AXIS sys_do2_vlt u_volt_32 15 0 31.99951171875 AXIS_PTS_REF FMSP_X_DO2_VLT /end AXIS_DESCR
/end CHARACTERISTIC
/begin AXIS_PTS FMSP_X_DO2_RT "engine speed breakpoint" 0x0002006C fmsp_do2_rt SSV__UWORD_S 0 u_fac_2 7 0.000000 1.99996948242187 FORMAT "%4.3" DEPOSIT ABSOLUTE SYMBOL_LINK "FMSP_X_DO2_RT" 2 /end AXIS_PTS
/begin AXIS_PTS FMSP_X_DO2_VLT "engine speed breakpoint" 0x0002006C sys_do2_vlt SSV__UWORD_S 0 u_volt_32 15 0 31.99951171875 FORMAT "%4.3" DEPOSIT ABSOLUTE SYMBOL_LINK "FMSP_X_DO2_VLT" 2 /end AXIS_PTS
/begin CHARACTERISTIC FMSP_V_CAT_RCH_TEMP "Catalyst enrich fuel temperature threshold." VALUE 0x0002038C __SWORD_S 0 u_deg_C_n2048_p2048 -2048 2047.9375 /end CHARACTERISTIC
/begin CHARACTERISTIC FMSP_V_PUC_RCH_MAF "After fuel cut off enrich fuel enable air flow threshold." VALUE 0x0002038C __UWORD_S 0 u_gram_1024 0 1023.984375 FORMAT "%5.1" /end CHARACTERISTIC
/begin CHARACTERISTIC FMSP_V_PUC_RCH_DO2 "After fuel cut off enrich fuel enable rear O2 sensor voltage threshold." VALUE 0x0002038C __UWORD_S 0 u_volt_32 0 31.99951171875 FORMAT "%4.3" /end CHARACTERISTIC
/begin CHARACTERISTIC FMSP_V_CL_IDL_DLY "close loop use idle control delay after enter idle state" VALUE 0x0002038C __UWORD_S 0 u_2x_tmr 0 1023.984375 /end CHARACTERISTIC
/begin CHARACTERISTIC FMSP_C_PUC_DCY_MAF "After fuel cut off decay air flow." CURVE 0x000200B0 __UWORD_S 0 u_gram_1024 0 1023.984375 FORMAT "%4.3" SYMBOL_LINK "FMSP_C_PUC_DCY_MAF" 2
 /begin AXIS_DESCR COM_AXIS fmsp_puc_maf_int u_gram_1024 6 0 1023.984375 AXIS_PTS_REF FMSP_X_PUC_MAF_INT /end AXIS_DESCR
/end CHARACTERISTIC
/begin AXIS_PTS FMSP_X_PUC_MAF_INT "Tunable breakpoint MAF int axis." 0x0002006C fmsp_puc_maf_int SSV__UWORD_S 0 u_gram_1024 6 0 1023.984375 FORMAT "%4.3" DEPOSIT ABSOLUTE SYMBOL_LINK "FMSP_X_PUC_MAF_INT" 2 /end AXIS_PTS
/begin CHARACTERISTIC FMSP_C_P_PUC_DLY "After fuel cut off enrich proportional term delay time." CURVE 0x000200B0 __UWORD_S 0 u_2x_tmr 0 1023.984375 SYMBOL_LINK "FMSP_C_P_PUC_DLY" 2
 /begin AXIS_DESCR COM_AXIS afm_cyl_flw u_g_per_sec 6 0 511.9921875 AXIS_PTS_REF FMSP_X_PUC_DLY /end AXIS_DESCR
/end CHARACTERISTIC
/begin AXIS_PTS FMSP_X_PUC_DLY "Tunable breakpoint PUC delay axis." 0x0002006C afm_cyl_flw SSV__UWORD_S 0 u_g_per_sec 6 0 511.9921875 FORMAT "%4.3" DEPOSIT ABSOLUTE SYMBOL_LINK "FMSP_X_PUC_DLY" 2 /end AXIS_PTS
/begin CHARACTERISTIC FMSP_C_TQ_MNG_ON_CYL_A "power manage on cylinder type A" CURVE 0x000200B0 __UBYTE_S 0 u_pwr_mng_cyl 0 255 FORMAT "%1.0"
 /begin AXIS_DESCR FIX_AXIS NO_INPUT_QUANTITY u_cnts 4 0 3 /begin FIX_AXIS_PAR_LIST 0 1 2 3 /end FIX_AXIS_PAR_LIST /end AXIS_DESCR
/end CHARACTERISTIC
/begin CHARACTERISTIC FMSP_C_TQ_MNG_ON_CYL_B "power manage on cylinder type B" CURVE 0x000200B0 __UBYTE_S 0 u_pwr_mng_cyl 0 255 FORMAT "%3.0"
 /begin AXIS_DESCR FIX_AXIS NO_INPUT_QUANTITY u_cnts 4 0 3 /begin FIX_AXIS_PAR_LIST 0 1 2 3 /end FIX_AXIS_PAR_LIST /end AXIS_DESCR
/end CHARACTERISTIC
/begin CHARACTERISTIC FMSP_V_ESPD_FALL_FAC "engine speed fall thr factor" VALUE 0x0002038C __UWORD_S 0 u_fac_1 0 0.999984741210937 /end CHARACTERISTIC
/begin CHARACTERISTIC FMSP_V_PF_LRN_EN "poor fuel learn enable" VALUE 0x0002038C __UBYTE_S 0 b_true 0 1 FORMAT "%1.0" /end CHARACTERISTIC
/begin CHARACTERISTIC FMSP_V_PF_EN_ECT_MIN "poor fuel enable ect min" VALUE 0x0002038C __SWORD_S 0 u_deg_C -256 255.9921875 FORMAT "%4.3" /end CHARACTERISTIC
/begin CHARACTERISTIC FMSP_V_PF_EN_ECT_MAX "poor fuel enable ect max" VALUE 0x0002038C __SWORD_S 0 u_deg_C -256 255.9921875 FORMAT "%4.3" /end CHARACTERISTIC
/begin CHARACTERISTIC FMSP_V_PF_EN_AMP_MIN "poor fuel enable amp min" VALUE 0x0002038C __UWORD_S 0 u_kPa_0_256 0 255.99609375 FORMAT "%4.1" /end CHARACTERISTIC
/begin CHARACTERISTIC FMSP_V_PF_EN_FLV_MIN "poor fuel enable fuel level min" VALUE 0x0002038C __UWORD_S 0 u_pct_1 0 99.9984741210937 FORMAT "%4.2" /end CHARACTERISTIC
/begin CHARACTERISTIC FMSP_V_PF_EN_T_DLT_MAX "poor fuel enable temp delta max between IAT and ECT" VALUE 0x0002038C __SWORD_S 0 u_deg_C -256 255.9921875 FORMAT "%4.3" /end CHARACTERISTIC
/begin CHARACTERISTIC FMSP_V_PF_EN_VLT_MIN "poor fuel enable bat voltage min" VALUE 0x0002038C __UWORD_S 0 u_volt_32 0 31.99951171875 FORMAT "%4.2" /end CHARACTERISTIC
/begin CHARACTERISTIC FMSP_C_PF_EN_RUN_MIN "poor fuel enable runtime min" CURVE 0x000200B0 __UBYTE_S 0 u_cnts 0 255 SYMBOL_LINK "FMSP_C_PF_EN_RUN_MIN" 2
 /begin AXIS_DESCR FIX_AXIS sys_keyon_ect u_deg_C 8 -30 40 /begin FIX_AXIS_PAR_LIST -3840 -2560 -1280 0 1280 2560 3840 5120 /end FIX_AXIS_PAR_LIST /end AXIS_DESCR
/end CHARACTERISTIC
/begin CHARACTERISTIC FMSP_C_PF_EN_RUN_MAX "poor fuel enable runtime max" CURVE 0x000200B0 __UBYTE_S 0 u_cnts 0 255 SYMBOL_LINK "FMSP_C_PF_EN_RUN_MAX" 2
 /begin AXIS_DESCR FIX_AXIS sys_keyon_ect u_deg_C 8 -30 40 /begin FIX_AXIS_PAR_LIST -3840 -2560 -1280 0 1280 2560 3840 5120 /end FIX_AXIS_PAR_LIST /end AXIS_DESCR
/end CHARACTERISTIC
/begin CHARACTERISTIC FMSP_C_PF_LRN_INTRVL "poor fuel learn interval" CURVE 0x000200B0 __UWORD_S 0 u_2x_tmr 0 1023.984375 SYMBOL_LINK "FMSP_C_PF_LRN_INTRVL" 2
 /begin AXIS_DESCR FIX_AXIS sys_keyon_ect u_deg_C 8 -30 40 /begin FIX_AXIS_PAR_LIST -3840 -2560 -1280 0 1280 2560 3840 5120 /end FIX_AXIS_PAR_LIST /end AXIS_DESCR
/end CHARACTERISTIC
/begin CHARACTERISTIC FMSP_V_PF_LRN_INC_STP "poor fuel learn increase step" VALUE 0x0002038C __UWORD_S 0 u_pct_1 0 99.9984741210937 FORMAT "%4.2" /end CHARACTERISTIC
/begin CHARACTERISTIC FMSP_V_PF_LRN_MAX "poor fuel learn max" VALUE 0x0002038C __UWORD_S 0 u_pct_1 0 99.9984741210937 FORMAT "%4.2" /end CHARACTERISTIC
/begin CHARACTERISTIC FMSP_C_PF_LRN_CELL_THR "poor fuel learn interval" CURVE 0x000200B0 __SWORD_S 0 u_deg_C -256 255.9921875
 /begin AXIS_DESCR FIX_AXIS NO_INPUT_QUANTITY u_cnts 7 0 6 /begin FIX_AXIS_PAR_LIST 0 1 2 3 4 5 6 /end FIX_AXIS_PAR_LIST /end AXIS_DESCR
/end CHARACTERISTIC
/begin CHARACTERISTIC FMSP_V_PF_FAC_DCY_INTRVL "poor fuel factor decay interval" VALUE 0x0002038C __UWORD_S 0 u_2x_tmr 0 1023.984375 /end CHARACTERISTIC
/begin CHARACTERISTIC FMSP_C_PF_FAC_DCY_DLY "poor fuel factor decay runtime delay" CURVE 0x000200B0 __UBYTE_S 0 u_1s_tmr 0 255 FORMAT "%3.0" SYMBOL_LINK "FMSP_C_PF_FAC_DCY_DLY" 2
 /begin AXIS_DESCR FIX_AXIS sys_keyon_ect u_deg_C 8 -30 40 /begin FIX_AXIS_PAR_LIST -3840 -2560 -1280 0 1280 2560 3840 5120 /end FIX_AXIS_PAR_LIST /end AXIS_DESCR
/end CHARACTERISTIC
/begin CHARACTERISTIC FMSP_C_PF_FAC_DCY_MUL "poor fuel factor decay mult" VALUE 0x0002038C __UWORD_S 0 u_fac_1 0 0.999984741210937 /end CHARACTERISTIC
/begin CHARACTERISTIC FMSP_V_PF_LRN_HLD_DUR "poor fuel learn hold duration" VALUE 0x0002038C __UWORD_S 0 u_2x_tmr 0 1023.984375 /end CHARACTERISTIC
/begin CHARACTERISTIC FMSP_V_PF_IDL_INC_ERR_MIN "poor fuel idle learn increase enable idle speed error min" VALUE 0x0002038C __SWORD_S 0 u_espd -4096 4095.875 FORMAT "%5.1" /end CHARACTERISTIC
/begin CHARACTERISTIC FMSP_V_PF_IDL_INC_ERR_MAX "poor fuel idle learn increase enable idle speed error max" VALUE 0x0002038C __SWORD_S 0 u_espd -4096 4095.875 FORMAT "%5.1" /end CHARACTERISTIC
/begin CHARACTERISTIC FMSP_V_PF_IDL_INC_DLY "poor fuel idle learn increase delay" VALUE 0x0002038C __UWORD_S 0 u_2x_tmr 0 1023.984375 /end CHARACTERISTIC
/begin CHARACTERISTIC FMSP_V_PF_IDL_INC_STP "poor fuel idle learn increase step" VALUE 0x0002038C __UWORD_S 0 u_pct_1 0 99.9984741210937 FORMAT "%4.2" /end CHARACTERISTIC
/begin CHARACTERISTIC FMSP_V_PF_IDL_DEC_ERR_MIN "poor fuel idle learn decrease enable idle speed error min" VALUE 0x0002038C __SWORD_S 0 u_espd -4096 4095.875 FORMAT "%5.1" /end CHARACTERISTIC
/begin CHARACTERISTIC FMSP_V_PF_IDL_DEC_ERR_MAX "poor fuel idle learn decrease enable idle speed error max" VALUE 0x0002038C __SWORD_S 0 u_espd -4096 4095.875 FORMAT "%5.1" /end CHARACTERISTIC
/begin CHARACTERISTIC FMSP_V_PF_IDL_DEC_DLY "poor fuel idle learn decrease delay" VALUE 0x0002038C __UWORD_S 0 u_2x_tmr 0 1023.984375 /end CHARACTERISTIC
/begin CHARACTERISTIC FMSP_V_PF_IDL_DEC_STP "poor fuel idle learn decrease step" VALUE 0x0002038C __UWORD_S 0 u_pct_1 0 99.9984741210937 FORMAT "%4.2" /end CHARACTERISTIC
/begin CHARACTERISTIC FMSP_C_PF_IDL_LRN_RUN_MAX "poor fuel idle learn enable runtime max" CURVE 0x000200B0 __UBYTE_S 0 u_cnts 0 255 SYMBOL_LINK "FMSP_C_PF_IDL_LRN_RUN_MAX" 2
 /begin AXIS_DESCR FIX_AXIS sys_keyon_ect u_deg_C 8 -30 40 /begin FIX_AXIS_PAR_LIST -3840 -2560 -1280 0 1280 2560 3840 5120 /end FIX_AXIS_PAR_LIST /end AXIS_DESCR
/end CHARACTERISTIC
/begin CHARACTERISTIC FMSP_C_PF_IDL_LRN_RUN_MIN "poor fuel idle learn enable runtime min" CURVE 0x000200B0 __UBYTE_S 0 u_cnts 0 255 SYMBOL_LINK "FMSP_C_PF_IDL_LRN_RUN_MIN" 2
 /begin AXIS_DESCR FIX_AXIS sys_keyon_ect u_deg_C 8 -30 40 /begin FIX_AXIS_PAR_LIST -3840 -2560 -1280 0 1280 2560 3840 5120 /end FIX_AXIS_PAR_LIST /end AXIS_DESCR
/end CHARACTERISTIC
/begin CHARACTERISTIC FMSP_V_HYB_DO2_OSC_DLY "down o2 OSC af valid delay" VALUE 0x0002038C __UWORD_S 0 u_1s_tmr 0 65535 /end CHARACTERISTIC
/begin CHARACTERISTIC FMSP_V_PUC_MAP_STBL_DLY "puc map stable delay" VALUE 0x0002038C __UWORD_S 0 u_16x_tmr 0 8191.875 /end CHARACTERISTIC
/begin CHARACTERISTIC FMSP_V_PRK_PUC_RMP_EXT_EN "True means enable Park PUC cylinder exit" VALUE 0x26B4C __UBYTE_S 0 b_true 0 1 FORMAT "%1.0" /end CHARACTERISTIC
/begin CHARACTERISTIC FMSP_V_PRK_PUC_RMP_EXT_ECT "min engine coolant temp to enable Park PUC cylinder exit" VALUE 0x21C80 __SWORD_S 0 u_deg_C -256 255.9921875 /end CHARACTERISTIC
/begin CHARACTERISTIC FMSP_V_ADP_CP_CTRL_FIL "Filter coefficient for the PurgeOnOffIndex." VALUE 0x0002038C __UWORD_S 0 u_filter 0 0.9999847412109375 FORMAT "%6.5" /end CHARACTERISTIC
/begin CHARACTERISTIC FMSP_C_ADP_NB "Adaptive neighbor cell number." CURVE 0x000200B0 __UBYTE_S 0 u_cnts 0 255 SYMBOL_LINK "FMSP_C_ADP_NB" 2
 /begin AXIS_DESCR FIX_AXIS NO_INPUT_QUANTITY u_cnts 26 0 25
  /begin FIX_AXIS_PAR_LIST 0 1 2 3 4 5 6 7 8 9 10 11 12 13 14 15 16 17 18 19 20 21 22 23 24 25 /end FIX_AXIS_PAR_LIST
 /end AXIS_DESCR
/end CHARACTERISTIC
/begin CHARACTERISTIC FMSP_V_TF_MULT_MX "Transient fuel multiplier max limit." VALUE 0x0002038C __SWORD_S 0 u_fac_n1_p1 -1 0.999969482421875 FORMAT "%4.3" /end CHARACTERISTIC
/begin CHARACTERISTIC FMSP_V_TF_MULT_MN "Transient fuel multiplier min limit." VALUE 0x0002038C __SWORD_S 0 u_fac_n1_p1 -1 0.999969482421875 FORMAT "%4.3" /end CHARACTERISTIC
/begin COMPU_METHOD u_volt_32 "voltage" RAT_FUNC "%6.4" "V" COEFFS 0.0 1.0 0.000000 0.0 0.0 0.00048828125 /end COMPU_METHOD
/begin COMPU_METHOD u_kPa_b "press" RAT_FUNC "%3.0" "kPa" COEFFS 0.0 1.0 0.000000 0.0 0.0 1.0 /end COMPU_METHOD
/begin COMPU_METHOD u_kPa_0_32 "press" RAT_FUNC "%5.2" "kPa" COEFFS 0.0 1.0 0.000000 0.0 0.0 0.00048828125 /end COMPU_METHOD
/begin COMPU_METHOD u_kPa_0_128 "press" RAT_FUNC "%5.2" "kPa" COEFFS 0.0 1.0 0.000000 0.0 0.0 0.001953125 /end COMPU_METHOD
/begin COMPU_METHOD u_kPa_0_256 "press" RAT_FUNC "%5.2" "kPa" COEFFS 0.0 1.0 0.000000 0.0 0.0 0.00390625 /end COMPU_METHOD
/begin COMPU_METHOD u_kPa_0_512 "press" RAT_FUNC "%5.2" "kPa" COEFFS 0.0 1.0 0.000000 0.0 0.0 0.0078125 /end COMPU_METHOD
/begin COMPU_METHOD u_kPa_0_1024 "press" RAT_FUNC "%5.2" "kPa" COEFFS 0.0 1.0 0.000000 0.0 0.0 0.015625 /end COMPU_METHOD
/begin COMPU_METHOD u_kPa_256n_256p "press" RAT_FUNC "%5.2" "kPa" COEFFS 0.0 1.0 0.000000 0.0 0.0 0.0078125 /end COMPU_METHOD
/begin COMPU_METHOD u_kPaSec "press" RAT_FUNC "%5.2" "kPa/s" COEFFS 0.0 1.0 0.000000 0.0 0.0 0.125 /end COMPU_METHOD
/begin COMPU_METHOD u_kPaSec_b "press" RAT_FUNC "%5.2" "kPa/s" COEFFS 0.0 1.0 0.000000 0.0 0.0 0.00390625 /end COMPU_METHOD
/begin COMPU_METHOD u_fac_16384 "factor" RAT_FUNC "%6.1" "fac" COEFFS 0.0 1.0 0.000000 0.0 0.0 0.25 /end COMPU_METHOD
/begin COMPU_METHOD u_fac_2048 "factor" RAT_FUNC "%5.1" "fac" COEFFS 0.0 1.0 0.000000 0.0 0.0 0.03125 /end COMPU_METHOD
/begin COMPU_METHOD u_fac_1024 "factor" RAT_FUNC "%5.1" "fac" COEFFS 0.0 1.0 0.000000 0.0 0.0 0.015625 /end COMPU_METHOD
/begin COMPU_METHOD u_fac_512 "factor" RAT_FUNC "%5.1" "fac" COEFFS 0.0 1.0 0.000000 0.0 0.0 0.0078125 /end COMPU_METHOD
/begin COMPU_METHOD u_fac_128 "factor" RAT_FUNC "%5.2" "fac" COEFFS 0.0 1.0 0.000000 0.0 0.0 0.001953125 /end COMPU_METHOD
/begin COMPU_METHOD u_fac_32 "factor" RAT_FUNC "%8.6" "fac" COEFFS 0.0 1.0 0.000000 0.0 0.0 0.00048828125 /end COMPU_METHOD
/begin COMPU_METHOD u_fac_16 "factor" RAT_FUNC "%5.3" "fac" COEFFS 0.0 1.0 0.000000 0.0 0.0 0.000244140625 /end COMPU_METHOD
/begin COMPU_METHOD u_fac_8 "factor" RAT_FUNC "%8.7" "fac" COEFFS 0.0 1.0 0.000000 0.0 0.0 0.0001220703125 /end COMPU_METHOD
/begin COMPU_METHOD u_fac_4 "factor" RAT_FUNC "%5.4" "fac" COEFFS 0.0 1.0 0.000000 0.0 0.0 0.00006103515625 /end COMPU_METHOD
/begin COMPU_METHOD u_fac_2 "factor" RAT_FUNC "%3.2" "fac" COEFFS 0.0 1.0 0.000000 0.0 0.0 0.000030517578125 /end COMPU_METHOD
/begin COMPU_METHOD u_fac_1 "factor" RAT_FUNC "%4.3" "fac" COEFFS 0.0 1.0 0.000000 0.0 0.0 0.0000152587890625 /end COMPU_METHOD
/begin COMPU_METHOD u_fac_2_b "factor" RAT_FUNC "%3.2" "fac" COEFFS 0.0 1.0 0.000000 0.0 0.0 0.0078125 /end COMPU_METHOD
/begin COMPU_METHOD u_milli_pct1 "factor" RAT_FUNC "%6.5" "%" COEFFS 0.0 1.0 0.000000 0.0 0.0 0.000095367431640625 /end COMPU_METHOD
/begin COMPU_METHOD u_milli_pct2 "factor" RAT_FUNC "%6.5" "%" COEFFS 0.0 1.0 0.000000 0.0 0.0 0.000011920928955078125 /end COMPU_METHOD
/begin COMPU_METHOD u_fac_n1_p1 "factor" RAT_FUNC "%3.2" "fac" COEFFS 0.0 1.0 0.000000 0.0 0.0 0.000030517578125 /end COMPU_METHOD
/begin COMPU_METHOD u_fac_n4_p4 "factor" RAT_FUNC "%3.2" "fac" COEFFS 0.0 1.0 0.000000 0.0 0.0 0.0001220703125 /end COMPU_METHOD
/begin COMPU_METHOD u_ml "mililiter" RAT_FUNC "%7.3" "ml" COEFFS 0.0 1.0 0.000000 0.0 0.0 0.015625 /end COMPU_METHOD
/begin COMPU_METHOD u_ml_b "mililiter" RAT_FUNC "%5.0" "ml" COEFFS 0.0 1.0 0.000000 0.0 0.0 1.0 /end COMPU_METHOD
/begin COMPU_METHOD u_deg_K_512 "degK" RAT_FUNC "%6.2" "K" COEFFS 0.0 1.0 0.0 0.0 0.0 0.0078125 /end COMPU_METHOD
/begin COMPU_METHOD u_deg_K "degK" RAT_FUNC "%6.2" "K" COEFFS 0.0 1.0 0.0 0.0 0.0 0.03125 /end COMPU_METHOD
/begin COMPU_METHOD u_deg_K_s "degK" RAT_FUNC "%6.2" "K" COEFFS 0.0 1.0 0.0 0.0 0.0 0.0625 /end COMPU_METHOD
/begin COMPU_METHOD u_deg_K_s_b "degK" RAT_FUNC "%5.2" "K" COEFFS 0.0 1.0 0.0 0.0 0.0 0.015625 /end COMPU_METHOD
/begin COMPU_METHOD u_deg_C "degC" RAT_FUNC "%5.2" "¡æ" COEFFS 0.0 1.0 0.0 0.0 0.0 0.0078125 /end COMPU_METHOD
/begin COMPU_METHOD u_deg_C_n2048_p2048 "degC" RAT_FUNC "%5.1" "¡æ" COEFFS 0.0 1.0 0.0 0.0 0.0 0.0625 /end COMPU_METHOD
/begin COMPU_METHOD u_deg_C_h "degC" RAT_FUNC "%5.1" "¡æ" COEFFS 0.0 1.0 0.0 0.0 0.0 0.0625 /end COMPU_METHOD
/begin COMPU_METHOD u_filter "filter" RAT_FUNC "%11.10" "coef" COEFFS 0.0 1.0 0.0 0.0 0.0 0.0000152587890625 /end COMPU_METHOD
/begin COMPU_METHOD u_cnts "counts" RAT_FUNC "%3.0" "cnts" COEFFS 0.0 1.0 0.0 0.0 0.0 1.0 /end COMPU_METHOD
/begin COMPU_METHOD u_min "min timer" RAT_FUNC "%5.0" "min" COEFFS 0.0 1.0 0.0 0.0 0.0 1.00 /end COMPU_METHOD
/begin COMPU_METHOD u_min_hi "min timer" RAT_FUNC "%7.2" "min" COEFFS 0.0 1.0 0.0 0.0 0.0 0.25 /end COMPU_METHOD
/begin COMPU_METHOD u_1x_tmr "7.81 timer" RAT_FUNC "%4.3" "s" COEFFS 0.0 1.0 0.0 0.0 0.0 0.0078125 /end COMPU_METHOD
/begin COMPU_METHOD u_2x_tmr "15.6 timer" RAT_FUNC "%6.2" "s" COEFFS 0.0 1.0 0.0 0.0 0.0 0.015625 /end COMPU_METHOD
/begin COMPU_METHOD u_8x_tmr "62.5 timer" RAT_FUNC "%6.2" "s" COEFFS 0.0 1.0 0.0 0.0 0.0 0.0625 /end COMPU_METHOD
/begin COMPU_METHOD u_16x_tmr "125 timer" RAT_FUNC "%5.1" "s" COEFFS 0.0 1.0 0.0 0.0 0.0 0.125 /end COMPU_METHOD
/begin COMPU_METHOD u_1s_tmr "1 sec timer" RAT_FUNC "%5.0" "s" COEFFS 0.0 1.0 0.0 0.0 0.0 1.0 /end COMPU_METHOD
/begin COMPU_METHOD u_4s_tmr "4 sec timer" RAT_FUNC "%5.0" "s" COEFFS 0.0 1.0 0.0 0.0 0.0 4.0 /end COMPU_METHOD
/begin COMPU_METHOD u_millisec "millisec" RAT_FUNC "%6.2" "ms" COEFFS 0.0 1.0 0.0 0.0 0.0 0.015625 /end COMPU_METHOD
/begin COMPU_METHOD u_g_per_sec_1024_l "g per second" RAT_FUNC "%6.2" "g/s" COEFFS 0.0 1.0 0.000000 0.0 0.0 0.0000002384185791015625 /end COMPU_METHOD
/begin COMPU_METHOD b_true "" TAB_VERB "%6.3" "" COMPU_TAB_REF b_true /end COMPU_METHOD
/begin COMPU_VTAB b_true "" TAB_VERB 2 0 "FALSE" 1 "TRUE" /end COMPU_VTAB
/begin COMPU_METHOD b_enable "" TAB_VERB "%6.3" "" COMPU_TAB_REF b_enable /end COMPU_METHOD
/begin COMPU_VTAB b_enable "" TAB_VERB 2 0 "DISABLE" 1 "ENABLE" /end COMPU_VTAB
/begin COMPU_METHOD b_pow_src "" TAB_VERB "%6.3" "" COMPU_TAB_REF b_pow_src /end COMPU_METHOD
/begin COMPU_VTAB b_pow_src "" TAB_VERB 2 0 "TORQ_PCT" 1 "PPS_PCT" /end COMPU_VTAB
/begin COMPU_METHOD u_fm_st "" TAB_VERB "%6.3" "" COMPU_TAB_REF u_fm_st /end COMPU_METHOD
/begin COMPU_VTAB u_fm_st "" TAB_VERB 3 0 "START" 1 "RUN" 2 "OFF" /end COMPU_VTAB
/begin COMPU_METHOD u_af_trs_st "" TAB_VERB "%4.0" "" COMPU_TAB_REF u_af_trs_st /end COMPU_METHOD
/begin COMPU_VTAB u_af_trs_st "" TAB_VERB 4 0 "OFF" 1 "DELAY" 2 "ACTV" 3 "FINISH" /end COMPU_VTAB
/begin COMPU_METHOD u_adp_scp "" TAB_VERB "%4.0" "" COMPU_TAB_REF u_adp_scp /end COMPU_METHOD
/begin COMPU_VTAB u_adp_scp "" TAB_VERB 3 0 "IDL" 1 "DCL" 2 "PLD" /end COMPU_VTAB
/begin COMPU_METHOD u_fwd_gear "" TAB_VERB "%4.0" "" COMPU_TAB_REF u_fwd_gear /end COMPU_METHOD
/begin COMPU_VTAB u_fwd_gear "" TAB_VERB 8 0 "1" 1 "2" 2 "3" 3 "4" 4 "5" 5 "6" 6 "7" 7 "8" /end COMPU_VTAB
/begin COMPU_METHOD u_puc_espd_thr "" TAB_VERB "%4.0" "" COMPU_TAB_REF u_puc_espd_thr /end COMPU_METHOD
/begin COMPU_VTAB u_puc_espd_thr "" TAB_VERB 3 0 "GR_LO" 1 "GR_HI" 2 "TCC_LCK" /end COMPU_VTAB
/begin COMPU_METHOD u_fco_st "" TAB_VERB "%4.0" "" COMPU_TAB_REF u_fco_st /end COMPU_METHOD
/begin COMPU_VTAB u_fco_st "" TAB_VERB 4 0 "ON" 1 "OFF" 2 "ACTV" 3 "EXIT" /end COMPU_VTAB
/begin COMPU_METHOD u_espd "engine speed" RAT_FUNC "%5.2" "rpm" COEFFS 0.0 1.0 0.000000 0.0 0.0 0.125 /end COMPU_METHOD
/begin COMPU_METHOD u_tps_chn "" TAB_VERB "%10.4" "" COMPU_TAB_REF u_tps_chn /end COMPU_METHOD
/begin COMPU_VTAB u_tps_chn "" TAB_VERB 2 0 "TPS 1" 1 "TPS 2" /end COMPU_VTAB
/begin COMPU_METHOD u_tps_lmt "" TAB_VERB "%10.4" "" COMPU_TAB_REF u_tps_lmt /end COMPU_METHOD
/begin COMPU_VTAB u_tps_lmt "" TAB_VERB 2 0 "MAX" 1 "MIN" /end COMPU_VTAB
/begin COMPU_METHOD u_espd_b "engine speed" RAT_FUNC "%5.2" "rpm" COEFFS 0.0 1.0 0.000000 0.0 0.0 8.0 /end COMPU_METHOD
/begin COMPU_METHOD u_vspd "vehicle speed" RAT_FUNC "%5.2" "kph" COEFFS 0.0 1.0 0.000000 0.0 0.0 0.0078125 /end COMPU_METHOD
/begin COMPU_METHOD u_pct "percentage" RAT_FUNC "%5.2" "%" COEFFS 0.0 1.0 0.000000 0.0 0.0 0.0030517578125 /end COMPU_METHOD
/begin COMPU_METHOD u_pct_lo "percentage" RAT_FUNC "%5.2" "%" COEFFS 0.0 1.0 0.000000 0.0 0.0 0.5 /end COMPU_METHOD
/begin COMPU_METHOD u_milli_pct "factor" RAT_FUNC "%7.3" "¡ë" COEFFS 0.0 1.0 0.000000 0.0 0.0 0.030517578125 /end COMPU_METHOD
/begin COMPU_METHOD u_pct_1 "percentage" RAT_FUNC "%5.2" "%" COEFFS 0.0 1.0 0.000000 0.0 0.0 0.00152587890625 /end COMPU_METHOD
/begin COMPU_METHOD u_pct_8 "percentage" RAT_FUNC "%5.2" "%" COEFFS 0.0 1.0 0.000000 0.0 0.0 0.01220703125 /end COMPU_METHOD
/begin COMPU_METHOD u_pct_r "real pct" RAT_FUNC "%5.2" "%" COEFFS 0.0 1.0 0.000000 0.0 0.0 0.001953125 /end COMPU_METHOD
/begin COMPU_METHOD u_stk_flw "stroke flow" RAT_FUNC "%5.4" "g/stk" COEFFS 0.0 1.0 0.000000 0.0 0.0 0.000030517578125 /end COMPU_METHOD
/begin COMPU_METHOD u_g_per_sec "g per second" RAT_FUNC "%5.2" "g/s" COEFFS 0.0 1.0 0.000000 0.0 0.0 0.0078125 /end COMPU_METHOD
/begin COMPU_METHOD u_g_per_sec_1 "g per second" RAT_FUNC "%4.3" "g/s" COEFFS 0.0 1.0 0.000000 0.0 0.0 0.0000152587890625 /end COMPU_METHOD
/begin COMPU_METHOD u_g_per_sec_64 "g per second" RAT_FUNC "%5.2" "g/s" COEFFS 0.0 1.0 0.000000 0.0 0.0 0.0009765625 /end COMPU_METHOD
/begin COMPU_METHOD u_g_per_sec_1024 "g per second" RAT_FUNC "%5.2" "g/s" COEFFS 0.0 1.0 0.000000 0.0 0.0 0.015625 /end COMPU_METHOD
/begin COMPU_METHOD u_g_per_sec_s "g per second" RAT_FUNC "%5.2" "g/s" COEFFS 0.0 1.0 0.000000 0.0 0.0 0.015625 /end COMPU_METHOD
/begin COMPU_METHOD u_g_per_sec_s_l "g per second" RAT_FUNC "%5.2" "g/s" COEFFS 0.0 1.0 0.000000 0.0 0.0 0.000000238418579 /end COMPU_METHOD
/begin COMPU_METHOD u_afr "airfuel" RAT_FUNC "%3.1" "Ratio" COEFFS 0.0 1.0 0.000000 0.0 0.0 0.00048828125 /end COMPU_METHOD
/begin COMPU_METHOD u_afr_b "airfuel" RAT_FUNC "%3.1" "Ratio" COEFFS 0.0 1.0 0.000000 0.0 0.0 0.125 /end COMPU_METHOD
/begin COMPU_METHOD u_kPa_0_4096 "IMEP" RAT_FUNC "%6.2" "kPa" COEFFS 0.0 1.0 0.000000 0.0 0.0 0.0625 /end COMPU_METHOD
/begin COMPU_METHOD u_iga "ignition angle" RAT_FUNC "%3.1" "Deg" COEFFS 0.0 1.0 0.000000 0.0 0.0 0.0078125 /end COMPU_METHOD
/begin COMPU_METHOD u_gram_4 "gram" RAT_FUNC "%4.3" "g" COEFFS 0.0 1.0 0.000000 0.0 0.0 0.00006103515625 /end COMPU_METHOD
/begin COMPU_METHOD u_gram "gram" RAT_FUNC "%6.2" "g" COEFFS 0.0 1.0 0.000000 0.0 0.0 0.0625 /end COMPU_METHOD
/begin COMPU_METHOD u_gram_l "gram" RAT_FUNC "%6.2" "g" COEFFS 0.0 1.0 0.000000 0.0 0.0 0.0078125 /end COMPU_METHOD
/begin COMPU_METHOD x_cnts "counts" RAT_FUNC "%3.0" "cnts" COEFFS 0.0 1.0 0.0 0.0 0.0 1.0 /end COMPU_METHOD
/begin COMPU_METHOD x_ratio "counts" RAT_FUNC "%3.2" "ratio" COEFFS 0.0 1.0 0.0 0.0 0.0 1.0 /end COMPU_METHOD
/begin COMPU_METHOD u_kPa_0_128 "press" RAT_FUNC "%5.2" "kPa" COEFFS 0.0 1.0 0.000000 0.0 0.0 0.001953125 /end COMPU_METHOD
/begin COMPU_METHOD u_gram_1024 "gram" RAT_FUNC "%5.2" "g" COEFFS 0.0 1.0 0.000000 0.0 0.0 0.015625 /end COMPU_METHOD
/begin COMPU_METHOD u_pwr_mng_cyl "" TAB_VERB "%6.3" "" COMPU_TAB_REF u_pwr_mng_cyl /end COMPU_METHOD
/begin COMPU_VTAB u_pwr_mng_cyl "" TAB_VERB 15 0 "ALL_OFF" 16 "CYL4_ON" 32 "CYL3_ON" 48 "CYL34_ON" 64 "CYL2_ON" 80 "CYL24_ON" 96 "CYL23_ON" 112 "CYL234_ON" 128 "CYL1_ON" 144 "CYL14_ON" 160 "CYL13_ON" 176 "CYL134_ON" 192 "CYL12_ON" 208 "CYL124_ON" 224 "CYL123_ON" /end COMPU_VTAB
/begin COMPU_METHOD u_m3_per_s "cubic meter per second" RAT_FUNC "%5.4" "m3/s" COEFFS 0.0 1.0 0.000000 0.0 0.0 0.00006103515625 /end COMPU_METHOD
/begin COMPU_METHOD u_inj_mode "" TAB_VERB "%6.3" "" COMPU_TAB_REF u_inj_mode /end COMPU_METHOD
/begin COMPU_VTAB u_inj_mode "" TAB_VERB 2 0 "SIMULTANEOUS" 1 "SEQUENTIAL" /end COMPU_VTAB
/begin COMPU_METHOD u_cp_conc_stat "" TAB_VERB "%4.0" "" COMPU_TAB_REF u_cp_conc_stat /end COMPU_METHOD
/begin COMPU_VTAB u_cp_conc_stat "" TAB_VERB 4 0 "Inactive" 1 "UpStep" 2 "DownStep" 3 "Stable" /end COMPU_VTAB
/begin FUNCTION airflow_mdl ""
 /begin DEF_CHARACTERISTIC AFM_V_VOL_CYL AFM_V_VOL_IM AFM_M_EXH_T_IG_BIAS AFM_X_AIR_FLW AFM_X_IGA_RTD AFM_C_EXH_T_AF_BIAS AFM_C_THRO_FLW AFM_X_TPS_PCT AFM_V_THRO_FLW_ADP_CFG AFM_C_THRO_FLW_ADP_MAX AFM_C_THRO_FLW_ADP_MIN AFM_M_VE_MN AFM_X_ESPD_A AFM_X_EXH_TO_MAP_RT AFM_V_EXH_T_EGR_FAC AFM_M_EXH_T_VSPD_COOL AFM_X_IAT_A AFM_M_EXH_T_MBT AFM_X_IMEP_MBT AFM_M_EXH_MNFD_HT_FAC AFM_X_AIR_FLW_B AFM_C_INTK_MNFD_HT_FAC AFM_X_AIR_FLW_C AFM_M_INTK_PRT_HT_FAC_IMEP AFM_M_INTK_PRT_HT_FAC_PR AFM_X_ESPD_B AFM_C_PORT_HT_ECT_FAC AFM_X_ECT_A AFM_M_PORT_T_VVT_BIAS AFM_X_AIR_FLW_D AFM_X_VLV_OVLP AFM_V_EXH_P_AREA_FAC AFM_C_EXH_P_FAC AFM_X_EXH_P_AREA_FAC AFM_M_VE_BP1_FIT_C AFM_M_VE_BP2_FIT_C AFM_M_VE_BP3_FIT_C AFM_M_VE_BP4_FIT_C AFM_M_VE_BP5_FIT_C AFM_M_VE_BP1_FIT_B AFM_M_VE_BP2_FIT_B AFM_M_VE_BP3_FIT_B AFM_M_VE_BP4_FIT_B AFM_M_VE_BP5_FIT_B AFM_M_VE_BP1_FIT_A AFM_M_VE_BP2_FIT_A AFM_M_VE_BP3_FIT_A AFM_M_VE_BP4_FIT_A AFM_M_VE_BP5_FIT_A AFM_C_VE_INTK_BP AFM_M_VE_PORT_T_FAC AFM_X_AIR_FLW_E AFM_X_PORT_T_A AFM_C_EGR_PCT_FIL AFM_V_EGR_PCT_MAX AFM_V_MMAP_MAX_FAC AFM_V_MAP_PRED_CNTS AFM_V_AMP_UPDT_ESPD_MIN AFM_V_AMP_UPDT_ESPD_MAX AFM_V_AMP_UPDT_MAP_DLT AFM_V_AMP_FLW_RT_MAX AFM_V_AMP_UPDT_RT_MAX AFM_V_MMAP_P_GN AFM_V_MMAP_I_GN AFM_V_AMP_UPDT_TPS_MIN AFM_V_AMP_DFLT AFM_C_THRO_AR_EFF AFM_V_AMP_UPDT_STDY_MIN AFM_M_AMP_PR_RT AFM_M_EGR_FLW_FAC AFM_X_ESPD_C AFM_X_AIR_FLW_F AFM_X_ESPD_C AFM_X_EXH_T_A AFM_X_EGR_FLW AFM_M_EGR_IN_T_BIAS AFM_C_EGR_IN_HT_FAC AFM_C_EGR_OUT_HT_FAC AFM_C_FCO_EXH_T_BIAS AFM_X_ESPD_D AFM_M_FCO_EXH_T_HT_BAS_FAC AFM_M_FCO_EXH_T_HT_COR_FAC AFM_V_FCO_EXH_T_FLT_DUR AFM_V_ASTP_EXH_T_FLT_DUR AFM_C_FCO_EXH_T_FIL AFM_X_AIR_FLW_H AFM_V_FCO_EXH_T_EXT_DLY AFM_V_FCO_EXH_T_EXT_DLT AFM_V_ASTP_EXH_T_EXT_FIL AFM_V_FCO_EXH_T_EXT_FIL AFM_V_INTK_VLV_HT_FAC AFM_V_INTK_VLV_HT_BIAS AFM_V_INTK_VLV_RAD_FAC AFM_V_INTK_VLV_RAD_BIAS AFM_V_INTK_VLV_T_STP_FIL AFM_V_AMB_T_DFLT AFM_X_AIR_FLW_G AFM_C_AMB_T_HT_FLW_FAC AFM_C_AMB_T_HT_VSPD_FAC AFM_X_VSPD_A AFM_V_AMB_T_MIN AFM_V_AMB_T_MAX AFM_V_AMB_T_FIL AFM_V_AMB_T_EN_VSPD_MIN AFM_V_AMB_T_EN_VSPD_MAX AFM_V_AMB_T_EN_FLW_MIN AFM_V_AMB_T_EN_FLW_MAX AFM_V_AMB_T_INIT_EN_DLT AFM_V_AMB_T_INIT_EN_ECT AFM_V_AMB_T_EN_FAC_MIN AFM_C_CAT_P_DROP AFM_X_CYL_FLW_A AFM_C_AIR_FILTR_P_DROP AFM_X_AIR_FLW_I AFM_V_STK_FLW_LD_DEC_FIL AFM_V_STK_FLW_LD_INC_FIL AFM_C_AIR_FLW_MAX AFM_V_PR_EXP AFM_C_CP_FLW AFM_X_CP_DTY AFM_C_CP_FLW_PR_FAC AFM_V_EGR_CLS_THR AFM_V_EGR_VLD_DLY AFM_V_THRT_LRN_AR_DIF AFM_V_THRT_LRN_ECT AFM_V_THRT_LRN_EN_DLY AFM_V_THRT_LRN_MAP_DLT AFM_V_THRT_LRN_TPS_DLT AFM_C_CP_THRT_LRN_AR AFM_V_EGR_PR_FIL AFM_C_EGR_FLW AFM_C_EGR_COOLER_P_DLT AFM_V_EGR_COOLER_P_DLT_FIL AFM_X_EGR_FLW_A AFM_M_VE_VGIS01_OFST AFM_M_VE_VGIS10_OFST AFM_M_VE_VGIS11_OFST /end DEF_CHARACTERISTIC
 /begin OUT_MEASUREMENT afm_air_flw afm_im_flw afm_egr_flw afm_cp_flw afm_tps_flw afm_cyl_flw afm_stk_flw afm_frsh_air_flw afm_exh_prt_t afm_exh_to_map_fac afm_exh_t_ig_bias afm_exh_t_af_cool afm_exh_t_egr_cool afm_exh_t_vspd_cool afm_exh_mnfd_t afm_thro_t afm_intk_mnfd_t afm_intk_prt_t afm_egr_pct afm_exh_p_area_fac afm_stk_flw_pct afm_ve afm_mdl_map afm_mmap_max afm_mmap_raw afm_mmap_lst afm_mmap_d afm_mmap_d_bs afm_mmap_dlt afm_mmap_d_p afm_mmap_d_i afm_mmap_sum_adp_nv afm_exh_press afm_pred_map afm_exh_flw afm_pred_frsh_air_flw afm_pred_prt_flw afm_ar_eff afm_amp_flw_scld_rt afm_air_flw_sum afm_intk_prt_t_c afm_intk_vlv_t afm_intk_vlv_t_raw afm_amb_t_nv afm_iat afm_egr_t_in afm_cat_temp afm_ect afm_egr_t_out afm_exh_prt_t_egr_bias afm_egr_p_in afm_egr_cooler_p_dlt afm_cat_p_out afm_ld_pct_flw afm_fiter_out_p afm_stk_flw_pct_vir afm_thro_flw_adp afm_pr_map2purg afm_mdl_map_ss afm_mdl_map_mmv afm_exh_pipe_t afm_intcl_out_t afm_bstp2amp_rt afm_intcl_p_dwn_pre afm_intcl_p_dwn_pst afm_intcl_p_dwn afm_cmpr_out_p afm_std_flw /end OUT_MEASUREMENT
/end FUNCTION
/begin FUNCTION etcs ""
 /begin DEF_CHARACTERISTIC ETCS_V_EGR_SP_STP_HI ETCS_V_EGR_SP_RMP_STP ETCS_V_EGR_VAC_MIN ETCS_V_VAC_LMT_EGR_SP_FIL ETCS_V_EGR_SP_INC_FIL ETCS_V_RUN_CTRL_SEG_MAX ETCS_C_STRT_THROT_PR_SP ETCS_X_ECT_A ETCS_V_THRT_PR_SP_HI ETCS_C_THRT_PR_SP_FIL ETCS_V_THRT_PR_SP_HI_HYS ETCS_M_THRT_PR_SP_MAX ETCS_V_THRO_IN_P_RMP_STP /end DEF_CHARACTERISTIC
 /begin OUT_MEASUREMENT etcs_thr_pq_lmt etcs_map_sp etcs_thro_flw_sp etcs_thro_pos_sp etcs_thr_pq etcs_thro_pq_lmt_sp /end OUT_MEASUREMENT
/end FUNCTION
/begin FUNCTION fmsp_af ""
 /begin DEF_CHARACTERISTIC FMSP_M_POW_EN_THR FMSP_C_ECO_POW_EN_THR FMSP_M_POW_AF FMSP_M_ECO_POW_AF FMSP_C_POW_AF_ECT_FAC FMSP_V_POW_SRC_CFG FMSP_V_POW_EN_HYS FMSP_V_ECO_POW_EN_HYS FMSP_C_POW_DLY FMSP_C_POW_DLY_EXT_BIAS FMSP_V_POW_DLY_EXT_ESPD FMSP_M_ST_AF FMSP_M_AUTO_ST_AF FMSP_M_ST_AF_AMP_FAC FMSP_V_ST_AF_BIAS FMSP_V_AST_AF_BIAS FMSP_V_CRST_EN_RUN_MIN FMSP_V_CRST_EN_ECT_MAX FMSP_V_CRST_EN_OFFT_MAX FMSP_M_ST_AF_OFFT_FAC FMSP_V_HRST_EN_IAT_MIN FMSP_V_HRST_EN_ECT_MIN FMSP_V_HRST_EN_OFFT_MIN FMSP_V_HRST_EN_OFFT_MAX FMSP_V_HRST_EXT_RUN_MIN FMSP_C_HRST_AF_BIAS FMSP_C_ST_AF_BIAS_RST_OFFT_MIN FMSP_V_ST_AF_BIAS_RST_ECT_MIN FMSP_V_ST_AF_BIAS_RST_RUN_MIN FMSP_M_RUN_AF_BS FMSP_C_RUN_AF_ECT_FAC FMSP_M_BAS_AF_AMP_FAC FMSP_V_IDL_AF_MAX FMSP_C_RUN_AF_BIAS FMSP_V_OSC_AF_MIN FMSP_V_OSC_AF_EN_CAT_T_MIN FMSP_V_OSC_MAX FMSP_V_HRST_RUN_AF_BIAS FMSP_C_RUN_AF_DCY_DLY FMSP_C_RUN_AF_HLD_DUR FMSP_V_RUN_AF_DCY_FAC FMSP_C_ST_RUN_AF_DCY_DLY FMSP_V_ST_RUN_AF_DCY_FAC FMSP_C_ENG_PROT_AF FMSP_V_TQ_AF_ECT_MIN FMSP_V_TQ_AF_RUN_MIN FMSP_V_TQ_AF_CAT_MIN FMSP_C_STCH_AF_FLW_SUM FMSP_C_TQ_AF FMSP_V_TQ_RCH_AF FMSP_V_TQ_RCF_AF_DUR_MIN FMSP_V_STCH_AF FMSP_C_GR_IN_AF_FAC FMSP_C_GR_IN_AF_DLY FMSP_C_GR_IN_AF_DUR FMSP_C_AC_AF_FAC FMSP_C_AC_AF_DLY FMSP_C_AC_AF_DUR FMSP_V_AC_AF_OFFT_MIN FMSP_C_CL_NORM_AF_UP_FAC FMSP_V_CL_OSC_AF_UP_FAC FMSP_V_OP_AF_UP_FAC FMSP_V_POW_AF_DWN_FAC FMSP_V_OP_AF_DWN_FAC FMSP_V_CL_AF_DWN_FAC FMSP_V_ENG_OVR_HT_ECT_HI FMSP_V_ENG_OVR_HT_ECT_LO FMSP_V_ENG_OVR_HT_DUR FMSP_V_ENG_OVR_HT_DLY FMSP_C_ST_AF_BIAS_DCY_DLY FMSP_V_ST_AF_BIAS_HLD_DUR FMSP_V_ST_AF_BIAS_DCY_FAC FMSP_V_OSC_AF_FUEL_MIN FMSP_V_OSC_AF_EXT_DUR_MIN FMSP_V_OSC_AF_DO2_THR FMSP_V_OSC_REQ_FAC FMSP_V_CFDM_FLW FMSP_C_OSC_DEC_SPD FMSP_C_DO2_RT FMSP_V_ESPD_FALL_FAC FMSP_V_PF_LRN_EN FMSP_V_PF_EN_ECT_MIN FMSP_V_PF_EN_ECT_MAX FMSP_V_PF_EN_AMP_MIN FMSP_V_PF_EN_FLV_MIN FMSP_V_PF_EN_T_DLT_MAX FMSP_V_PF_EN_VLT_MIN FMSP_C_PF_EN_RUN_MIN FMSP_C_PF_EN_RUN_MAX FMSP_C_PF_LRN_INTRVL FMSP_V_PF_LRN_INC_STP FMSP_V_PF_LRN_MAX FMSP_C_PF_LRN_CELL_THR FMSP_V_PF_FAC_DCY_INTRVL FMSP_C_PF_FAC_DCY_DLY FMSP_C_PF_FAC_DCY_MUL FMSP_V_PF_LRN_HLD_DUR FMSP_V_PF_IDL_INC_ERR_MIN FMSP_V_PF_IDL_INC_ERR_MAX FMSP_V_PF_IDL_INC_DLY FMSP_V_PF_IDL_INC_STP FMSP_C_PF_IDL_LRN_RUN_MAX FMSP_C_PF_IDL_LRN_RUN_MIN FMSP_V_PF_IDL_DEC_ERR_MIN FMSP_V_PF_IDL_DEC_ERR_MAX FMSP_V_PF_IDL_DEC_DLY FMSP_V_PF_IDL_DEC_STP FMSP_V_HYB_DO2_OSC_DLY FMSP_V_ADP_CP_CTRL_FIL FMSP_C_TURB_PROT_AF FMSP_C_TURB_PROT_AF_FAC FMSP_V_CHRG_T_COOL_USE_KNK FMSP_V_HOT_CHRG_CHGT_HI FMSP_V_HOT_CHRG_CHGT_LO FMSP_V_HOT_CHRG_ECT_HI FMSP_V_HOT_CHRG_ECT_LO FMSP_V_CHRG_T_COOL_DLY FMSP_V_CHRG_T_COOL_IG_RTD FMSP_V_HOT_CHRG_LD_HI FMSP_V_HOT_CHRG_LD_LO /end DEF_CHARACTERISTIC
 /begin OUT_MEASUREMENT fmsp_af_sp fmsp_pow_afr_en fmsp_pow_dly fmsp_fuel_st fmsp_bs_st_af fmsp_st_af fmsp_clr_afr_en fmsp_cld_restrt fmsp_off_af_nv fmsp_hot_restrt fmsp_hot_offt_sum fmsp_st_af_bias fmsp_run_af_bs fmsp_stch_af fmsp_run_af fmsp_st2run_af fmsp_st2run_af_dlt fmsp_off_run_af_bias_nv fmsp_tq_af_dur fmsp_cat_prot_af fmsp_eng_prot_en fmsp_tq_af_en fmsp_stch_af_en fmsp_osc_af_actv fmsp_gr_in_af_st fmsp_ac_in_af_st fmsp_gr_in_af_fac fmsp_ac_af_fac fmsp_af_rmp_stp fmsp_osc_af_bias fmsp_osc_fuel_sp fmsp_osc_af_en fmsp_osc_af_fn fmsp_osc_quality fmsp_do2_rt fmsp_pf_lrn_en fmsp_pf_lrn_conds_met fmsp_pf_run_conds_met fmsp_pf_det fmsp_pf_af_fac fmsp_pf_af_fac_nv0 fmsp_pf_af_fac_nv1 fmsp_pf_af_fac_nv2 fmsp_pf_af_fac_nv3 fmsp_pf_af_fac_nv4 fmsp_pf_af_fac_nv5 fmsp_pf_af_fac_nv6 fmsp_pf_idl_lrn_met fmsp_inj_mode fmsp_run_af_bias_init_stat fmsp_run_af_bias_nv fmsp_exh_prot_af fmsp_af_sp_raw fmsp_af_sp_rmp fmsp_af_ramp_fac fmsp_turb_prot_en /end OUT_MEASUREMENT
/end FUNCTION
/begin FUNCTION fmsp_pw ""
 /begin DEF_CHARACTERISTIC FMSP_V_ADP_MAX FMSP_V_ADP_MIN FMSP_V_ADP_EN_ECT_MAX FMSP_V_ADP_EN_ECT_MIN FMSP_C_ADP_EN_RUN_MIN FMSP_V_ADP_CP_OFF_DUR_LO FMSP_V_ADP_CP_OFF_DUR_HI FMSP_C_ADP_EN_CL_MAX FMSP_C_ADP_EN_CL_MIN FMSP_M_PW_BASE_FAC FMSP_C_PW_PORT_T_FAC FMSP_V_ADP_EN_IAT_MAX FMSP_V_ADP_EN_MAF_MAX FMSP_C_ADP_ESPD_BND FMSP_C_ADP_IMEP_BND FMSP_V_ADP_ESPD_HYS FMSP_V_ADP_IMEP_HYS FMSP_V_ADP_CHG_STP FMSP_V_ADP_IDL_IMEP_BND FMSP_V_ADP_IDL_IMEP_HYS FMSP_V_ADP_DCL_IMEP_HYS FMSP_V_ADP_DCL_IMEP_BND FMSP_C_ADP_CLD_INIT_MIN FMSP_C_ADP_HOT_INIT_MIN FMSP_V_ADP_INT_ECT_THR FMSP_C_TQ_MNG_ON_CYL_B FMSP_V_ADP_CP_OFF_DLY_HI FMSP_V_ADP_CP_OFF_DLY_LO FMSP_V_ADP_CP_OFF_MIN FMSP_V_ADP_IDL_HI_ECT FMSP_V_ADP_IDL_HI_IAT FMSP_V_ADP_IDL_VSPD_THR FMSP_V_ADP_IDL_VSPD_HYS FMSP_V_ADP_IDL_HI_ECT_HYS FMSP_V_ADP_IDL_HI_IAT_HYS FMSP_V_ADP_DO2_RCH_HI FMSP_V_ADP_DO2_RCH_LO FMSP_V_ADP_UO2_ERR_HI FMSP_V_ADP_UO2_ERR_LO FMSP_V_ADP_ERR2_CL_MAX FMSP_V_ADP_ERR1_CL_MAX FMSP_V_ADP_ERR1_CHG_STP FMSP_V_ADP_ERR2_CHG_STP FMSP_C_TQ_MNG_ON_CYL_A FMSP_V_ERR2_ADP_MAX FMSP_V_ERR1_ADP_MAX FMSP_C_ADP_CHG_DLY FMSP_C_PW_T_FAC_BIAS FMSP_C_PW_T_FAC_BIAS_DCY FMSP_C_PRM_PW FMSP_C_PRM_PW_AMP_FAC FMSP_C_PRM_PW_RUN_MIN FMSP_V_CRST_PRM_PW_MIN FMSP_M_PRM_PW_OFFT_FAC FMSP_V_PRM_PW_RST_ECT_MIN FMSP_C_PRM_PW_RST_OFFT_MIN FMSP_C_PRM_PW_EN_DLY FMSP_V_INJ_OFF_MISF_THR FMSP_C_PW_BAT_VLT_FAC FMSP_V_ADP_DIS_UO2FL_MIN FMSP_V_POST_PW_MIN FMSP_V_PW_MAX FMSP_V_PW_MIN FMSP_V_ADP_STBL_DUR FMSP_V_ADP_DCL_ESPD_HI FMSP_V_ADP_IDL_ESPD_HI FMSP_V_ADP_PT_ESPD_HI FMSP_V_ADP_PT_ESPD_LO FMSP_V_RAIL_P FMSP_V_ADP_DEC_INTVL FMSP_V_ADP_INC_INTVL FMSP_C_ADP_NB FMSP_V_TF_MULT_MX FMSP_V_TF_MULT_MN /end DEF_CHARACTERISTIC
 /begin OUT_MEASUREMENT fmsp_pw_cyl fmsp_pw_unlmt fmsp_prm_pw fmsp_adp_cp_ctrl fmsp_adp_area fmsp_adp_scp fmsp_pw_port_t_fac fmsp_adp fmsp_adp_chg_actv fmsp_adp_chg_met fmsp_adp_cp_indx fmsp_adp_uo2_err1 fmsp_adp_uo2_err2 fmsp_adp_nv fmsp_adp_chgd fmsp_inj_bias fmsp_inj_actv_cnts fmsp_prm_pw_fn fmsp_misf_inj_off fmsp_pw_bat_vlt_fac fmsp_pw_fnl fmsp_pw_vlt fmsp_pw_cl fmsp_pw_adp fmsp_pw_raw fmsp_stk_fnl fmsp_stk_cyl_cor fmsp_stk_tq fmsp_stk_fco fmsp_stk_raw fmsp_stk_sp fmsp_puc_on fmsp_prm_pw_dly_fn fmsp_prm_pw_conds_met fmsp_prm_pw_en fmsp_tq_fault_cyl_en fmsp_tq_cyl_en fmsp_fault_cyl_en fmsp_cyls_fault_dis /end OUT_MEASUREMENT
/end FUNCTION
/begin FUNCTION fmsp_cl ""
 /begin DEF_CHARACTERISTIC FMSP_V_UO2_RDY_HI FMSP_V_UO2_RDY_LO FMSP_V_DO2_RDY_HI FMSP_V_DO2_RDY_LO FMSP_V_O2_PMP_RDY_THR FMSP_V_O2_RDY_EXT_DUR FMSP_V_O2_PMP_RDY_DLY FMSP_M_CL_P_NEG FMSP_M_CL_P_POS FMSP_M_CL_IDL_P_POS FMSP_M_CL_IDL_P_NEG FMSP_C_CL_MIN FMSP_C_CL_MAX FMSP_V_RL_CHK_DLY FMSP_X_ECT_L FMSP_M_CL_IDL_I_POS FMSP_M_CL_I_POS FMSP_M_CL_IDL_I_NEG FMSP_M_CL_I_NEG FMSP_V_CL_O2_LEAN_THR FMSP_V_CL_O2_RICH_THR FMSP_M_CL_IDL_POS_HLD_T FMSP_M_CL_POS_HLD_T FMSP_M_CL_IDL_NEG_HLD_T FMSP_M_CL_NEG_HLD_T FMSP_C_CL_EXT_MAP_MIN FMSP_V_O2_RDY_PMP_EXT_DUR FMSP_V_CL_EN_RUN_DLY FMSP_C_CL_EN_FLW_SUM FMSP_C_CL_EN_ECT FMSP_V_CL_EN_RUN_DLY_AST FMSP_V_CL_FCO_DLY_HI_DUR FMSP_V_CL_FCO_DLY_HI FMSP_V_CL_FCO_DLY_LO FMSP_V_CAT_RCH_TEMP FMSP_V_PUC_RCH_MAF FMSP_V_PUC_RCH_DO2 FMSP_C_PUC_DCY_MAF FMSP_C_P_PUC_DLY FMSP_X_PUC_DLY FMSP_V_CL_IDL_DLY /end DEF_CHARACTERISTIC
 /begin OUT_MEASUREMENT fmsp_uo2_rdy fmsp_cl_en fmsp_cl_fac fmsp_cl_diag_fl fmsp_cl_fac_avg fmsp_cl_actv fmsp_puc_rch_met fmsp_puc_maf_int fmsp_puc_dcy_maf fmsp_p_puc_dly fmsp_cl_pos_p_hld fmsp_cl_neg_p_hld fmsp_do2_rdy fmsp_cl_ext_stat fmsp_nrm_afr fmsp_sto_afr fmsp_ln_tm fmsp_rch_tm fmsp_cp_conc_stat /end OUT_MEASUREMENT
/end FUNCTION
/begin FUNCTION fmsp_cut ""
 /begin DEF_CHARACTERISTIC FMSP_C_PUC_RUN_MIN FMSP_C_PUC_PRK_RUN_MIN FMSP_C_PUC_MED_VSPD_MAP FMSP_C_PUC_AC_ON_MAP FMSP_C_PUC_AC_OFF_MAP FMSP_V_PUC_NORM_MAP_HYS FMSP_V_PUC_STRCT_MAP_HYS FMSP_V_PUC_PRK_MAP_THR FMSP_M_PUC_TCC_ESPD FMSP_M_PUC_HYB_TCC_ESPD FMSP_M_PUC_ECO_TCC_ESPD FMSP_M_PUC_HYB_ESPD FMSP_C_PUC_PN_ACON_ESPD FMSP_C_PUC_PN_ACOFF_ESPD FMSP_V_PUC_PRK_MAP_HYS FMSP_M_PUC_DR_ACON_ESPD FMSP_M_PUC_DR_ACOFF_ESPD FMSP_M_PUC_ECO_DR_ACON_ESPD FMSP_M_PUC_ECO_DR_ACOFF_ESPD FMSP_V_PUC_USE_TCC_ESPD FMSP_V_PUC_ESPD_GR_HI_THR FMSP_V_PUC_NORM_TCC_ESPD_HYS FMSP_V_PUC_ECO_NORM_TCC_ESPD_HYS FMSP_V_PUC_NORM_HI_GR_ESPD_HYS FMSP_V_PUC_ECO_NORM_HI_GR_ESPD_HYS FMSP_V_PUC_NORM_LO_GR_ESPD_HYS FMSP_V_PUC_ECO_NORM_LO_GR_ESPD_HYS FMSP_V_PUC_STRCT_TCC_ESPD_HYS FMSP_V_PUC_ECO_STRCT_TCC_ESPD_HYS FMSP_V_PUC_STRCT_HI_GR_ESPD_HYS FMSP_V_PUC_ECO_STRCT_HI_GR_ESPD_HYS FMSP_V_PUC_STRCT_LO_GR_ESPD_HYS FMSP_V_PUC_ECO_STRCT_LO_GR_ESPD_HYS FMSP_V_PUC_ESPD_CP_BIAS FMSP_V_PUC_CP_BIAS_IAT_MIN FMSP_V_PUC_CP_BIAS_CONC_THR FMSP_V_PUC_HYB_IDL_ESPD_BIAS FMSP_V_PUC_IDL_ESPD_BIAS FMSP_V_PUC_VSPD_THR_HI FMSP_V_PUC_VSPD_THR_LO FMSP_V_PUC_VSPD_MIN FMSP_C_PUC_THRO_THR FMSP_V_PUC_THRO_HYS FMSP_V_PUC_PRK_ESPD_HYS FMSP_C_PUC_EN_DLY FMSP_V_PUC_EXT_DUR_MIN FMSP_V_FCO_ESPD_HI FMSP_V_FCO_ESPD_LO FMSP_V_FCO_VSPD_HI FMSP_V_FCO_VSPD_LO FMSP_V_PN_FCO_ESPD_HI FMSP_V_PN_FCO_ESPD_LO FMSP_V_PN_FCO_RUN_MIN FMSP_V_ETC_FCO_ESPD FMSP_V_ETC_FCO_FLW FMSP_M_FCO_ACTV_CYL_DLY FMSP_V_FCO_HYB_CYL_EXT_EN_ESPD FMSP_V_FCO_ACON_CYL_EXT_EN_ESPD FMSP_V_FCO_ACOFF_CYL_EXT_EN_ESPD FMSP_V_FCO_CYL_EXT_EN_TP FMSP_V_FCO_HYB_CYL_EXT_EN_TP FMSP_C_FCO_ACTV_PN_CYL_DLY FMSP_C_FCO_CYL_EXT_DLY_PN FMSP_M_FCO_CYL_EXT_DLY_CLS FMSP_M_FCO_CYL_EXT_DLY_OPN FMSP_V_PRK_PUC_RMP_EXT_EN FMSP_V_PRK_PUC_RMP_EXT_ECT FMSP_V_PUC_MAP_STBL_DLY /end DEF_CHARACTERISTIC
 /begin OUT_MEASUREMENT fmsp_fwd_gear fmsp_puc_espd_thr_typ fmsp_puc_en fmsp_puc_met fmsp_puc_coast_ext fmsp_puc_map_ext fmsp_puc_espd_ext fmsp_cyl_tot_on fmsp_puc_throt_ext fmsp_puc_map_met fmsp_puc_espd_met fmsp_puc_throt_met fmsp_puc_run_met fmsp_puc_hi_vspd_met fmsp_fuel_cut fmsp_puc_med_vspd_met fmsp_puc_prk_met fmsp_puc_on_dur fmsp_puc_off_dur fmsp_fco_clr_en fmsp_fco_espd_hi fmsp_fco_vspd_hi fmsp_fco_pn_espd_hi fmsp_fco_etc_en fmsp_fco_st fmsp_fco_ext_ref fmsp_fco_actv_ref fmsp_puc_hyb_ext fmsp_puc_cyl_ext_conds_met fmsp_puc_en_stat fmsp_puc_decltch_ext /end OUT_MEASUREMENT
/end FUNCTION
/begin RECORD_LAYOUT __UBYTE_S FNC_VALUES 1 UBYTE COLUMN_DIR DIRECT /end RECORD_LAYOUT
/begin RECORD_LAYOUT __UWORD_S FNC_VALUES 1 UWORD COLUMN_DIR DIRECT /end RECORD_LAYOUT
/begin RECORD_LAYOUT __SWORD_S FNC_VALUES 1 SWORD COLUMN_DIR DIRECT /end RECORD_LAYOUT
/begin RECORD_LAYOUT __SLONG_S FNC_VALUES 1 SLONG COLUMN_DIR DIRECT /end RECORD_LAYOUT
/begin RECORD_LAYOUT SSV__UWORD_S AXIS_PTS_X 1 UWORD INDEX_INCR DIRECT /end RECORD_LAYOUT
/begin RECORD_LAYOUT SSV__SWORD_S AXIS_PTS_X 1 SWORD INDEX_INCR DIRECT /end RECORD_LAYOUT
/end MODULE
/end PROJECT
