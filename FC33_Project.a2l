ASAP2_VERSION 1 60
/begin PROJECT FC33 ""
/begin HEADER "" VERSION "1.0" /end HEADER
/begin MODULE FC33 ""
/begin MOD_COMMON "" BYTE_ORDER MSB_FIRST ALIGNMENT_LONG 2 ALIGNMENT_WORD 1 /end MOD_COMMON
/begin MEASUREMENT tq_flyw_torq_raw_sp "Raw flywheel torque setpoint include clutch torque setpoint and idle torque setpoint." SWORD u_tq 0 0 -2048 2047.9375 ECU_ADDRESS 0x400050DA /end MEASUREMENT
/begin MEASUREMENT tq_cltch_torq_raw_sp "Raw clutch torque setpoint." SWORD u_tq 0 0 -2048 2047.9375 ECU_ADDRESS 0x400050DA /end MEASUREMENT
/begin MEASUREMENT tq_cltch_sp_pct "Raw internal clutch torque as a percentage of maximum absolute clutch torque." UWORD u_pct 0 0 0.0 199.996948242187 ECU_ADDRESS 0x4000DA4E /end MEASUREMENT
/begin MEASUREMENT tq_cltch_torq_min_lmt "Percentage of raw internal clutch torque is at a minimum limitation." UBYTE b_true 0 0 0.0 1.0 BIT_MASK 0x4 ECU_ADDRESS 0x400050DA FORMAT "%1.0" /end MEASUREMENT
/begin MEASUREMENT tq_cltch_torq_raw_sp_filt "Raw filted clutch torque setpoint." SWORD u_tq 0 0 -2048 2047.9375 ECU_ADDRESS 0x400050DA /end MEASUREMENT
/begin MEASUREMENT tq_tpo_mx_torq_fac_eco "Max tip out torque limit factor in ECO mode." UWORD u_fac_2 0 0 0.0 1.999969482421875 ECU_ADDRESS 0x4000DA4E FORMAT "%4.3" /end MEASUREMENT
/begin MEASUREMENT tq_tpo_mx_lmt "Tip out torque is enabled when torque below this value." SWORD u_tq 0 0 -2048 2047.9375 ECU_ADDRESS 0x400050DA /end MEASUREMENT
/begin MEASUREMENT tq_tpo_mn_torq_fac_eco "Min tip out torque limit factor in ECO mode." UWORD u_fac_2 0 0 0.0 1.999969482421875 ECU_ADDRESS 0x4000DA4E FORMAT "%4.3" /end MEASUREMENT
/begin MEASUREMENT tq_tpo_mn_lmt "Tip out torque is disabled when torque below this value." SWORD u_tq 0 0 -2048 2047.9375 ECU_ADDRESS 0x400050DA /end MEASUREMENT
/begin MEASUREMENT tq_tpo_torq "Tip out clutch torque limit." SWORD u_tq 0 0 -2048 2047.9375 ECU_ADDRESS 0x400050DA /end MEASUREMENT
/begin MEASUREMENT tq_cltch2flyw_ofst "Clutch torque to flywheel torque offset." SWORD u_tq 0 0 -2048 2047.9375 ECU_ADDRESS 0x400050DA /end MEASUREMENT
/begin MEASUREMENT tq_tc_loss_torq "Torque convertor torque loss." SWORD u_tq 0 0 -2048 2047.9375 ECU_ADDRESS 0x400050DA /end MEASUREMENT
/begin MEASUREMENT tq_cpuc_actv "Clutch fuel cut off active." UBYTE b_true 0 0 0.00 1.00 BIT_MASK 0x1 ECU_ADDRESS 0x400050DA FORMAT "%1.0" /end MEASUREMENT
/begin MEASUREMENT tq_tpo_filt_fac_eco "Tip out filter factor in ECO mode." UWORD u_fac_2 0 0 0.0 1.999969482421875 ECU_ADDRESS 0x4000DA4E FORMAT "%4.3" /end MEASUREMENT
/begin MEASUREMENT tq_tpo_up "Tip out torque clamp up." UBYTE b_true 0 0 0.00 1.00 BIT_MASK 0x1 ECU_ADDRESS 0x400050DA FORMAT "%1.0" /end MEASUREMENT
/begin MEASUREMENT tq_tpo_dcy_fn "Tip out torque decay finish." UBYTE b_true 0 0 0.00 1.00 BIT_MASK 0x1 ECU_ADDRESS 0x400050DA FORMAT "%1.0" /end MEASUREMENT
/begin MEASUREMENT tq_cltch_torq_sp "Clutch torque setpoint after tip out filter." SWORD u_tq 0 0 -2048 2047.9375 ECU_ADDRESS 0x400050DA /end MEASUREMENT
/begin MEASUREMENT tq_flyw_torq_sp "Flywheel torque setpoint after tip in filter." SWORD u_tq 0 0 -2048 2047.9375 ECU_ADDRESS 0x400050DA /end MEASUREMENT
/begin MEASUREMENT tq_trns_pump_torq "Transmission pump torque loss." SWORD u_tq 0 0 -2048 2047.9375 ECU_ADDRESS 0x400050DA /end MEASUREMENT
/begin MEASUREMENT tq_alt_torq "Alternator torque." SWORD u_tq 0 0 -2048 2047.9375 ECU_ADDRESS 0x400050DA /end MEASUREMENT
/begin MEASUREMENT tq_lch_flyw_torq "Launch flywheel torque in TCM launch state to limit raw flywheel torque setpoint min." SWORD u_tq 0 0 -2048 2047.9375 ECU_ADDRESS 0x400050DA /end MEASUREMENT
/begin MEASUREMENT tq_tpi_lch_met "Tip in control launch condition met." UBYTE b_true 0 0 0.00 1.00 BIT_MASK 0x1 ECU_ADDRESS 0x400050DA FORMAT "%1.0" /end MEASUREMENT
/begin MEASUREMENT tq_vr_pps_filt "filted virtual pps percent include cruise" UWORD u_pct 0 0 0.0 199.996948242187 ECU_ADDRESS 0x4000DA4E /end MEASUREMENT
/begin MEASUREMENT tq_vr_pps_dlt "Virtual pedal position delta." UWORD u_pct 0 0 0.0 199.996948242187 ECU_ADDRESS 0x4000DA4E /end MEASUREMENT
/begin MEASUREMENT tq_tpi_torq_fac_g1 "Tip in torque factor in gear 1 for enable,disable,post-disable threshold." UWORD u_fac_2 0 0 0.0 1.999969482421875 ECU_ADDRESS 0x4000DA4E FORMAT "%4.3" /end MEASUREMENT
/begin MEASUREMENT tq_drv_torq_sp_pct "Driver torque setpoint as pecentage of max torque." UWORD u_pct 0 0 0.0 199.996948242187 ECU_ADDRESS 0x4000DA4E /end MEASUREMENT
/begin MEASUREMENT tq_tpi_hld_fn "Tip in torque hold finished." UBYTE b_true 0 0 0.00 1.00 BIT_MASK 0x1 ECU_ADDRESS 0x400050DA FORMAT "%1.0" /end MEASUREMENT
/begin MEASUREMENT tq_tpi_enbl_torq "Tip in enable torque." SWORD u_tq 0 0 -2048 2047.9375 ECU_ADDRESS 0x400050DA /end MEASUREMENT
/begin MEASUREMENT tq_tpi_hld_enbl "Tip in hold enable." UBYTE b_true 0 0 0.00 1.00 BIT_MASK 0x1 ECU_ADDRESS 0x400050DA FORMAT "%1.0" /end MEASUREMENT
/begin MEASUREMENT tq_tpi_hld_pps_tm "Tip in hold pedal position timer." UWORD u_2x_tmr 0 0 0 1023.984375 ECU_ADDRESS 0x4000DA4E SYMBOL_LINK "tq_tpi_hld_pps_tm" 4 /end MEASUREMENT
/begin MEASUREMENT tq_tpi_tm "Tip in timer." UWORD u_2x_tmr 0 0 0 1023.984375 ECU_ADDRESS 0x4000DA4E /end MEASUREMENT
/begin MEASUREMENT tq_tpi_lvspd_coast_met "Low vehicle speed coast condition met." UBYTE b_true 0 0 0.00 1.00 BIT_MASK 0x1 ECU_ADDRESS 0x400050DA FORMAT "%1.0" /end MEASUREMENT
/begin MEASUREMENT tq_tpi_gear "Gear information for tip in function use." UBYTE u_tq_gr_typ 0 0 0 10 ECU_ADDRESS 0x4000DA4E FORMAT "%1.0" /end MEASUREMENT
/begin MEASUREMENT tq_veh_gr_st_sp "Gear setpoint." UBYTE u_tq_gr_typ 0 0 0 10 ECU_ADDRESS 0x4000DA4E FORMAT "%1.0" /end MEASUREMENT
/begin MEASUREMENT tq_tpi_dsbl_fac_t "Tip in control disable torque temperature factor." UWORD u_fac_2 0 0 0.0 1.999969482421875 ECU_ADDRESS 0x4000DA4E FORMAT "%4.3" /end MEASUREMENT
/begin MEASUREMENT tq_tpi_enbl_eco_fac "Tip in enable torque ECO mode factor." UWORD u_fac_2 0 0 0.0 1.999969482421875 ECU_ADDRESS 0x4000DA4E FORMAT "%4.3" /end MEASUREMENT
/begin MEASUREMENT tq_tpi_dsbl_eco_fac "Tip in disable torque ECO mode factor." UWORD u_fac_2 0 0 0.0 1.999969482421875 ECU_ADDRESS 0x4000DA4E FORMAT "%4.3" /end MEASUREMENT
/begin MEASUREMENT tq_tpi_pdsbl_eco_fac "Tip in post disable torque ECO mode factor." UWORD u_fac_2 0 0 0.0 1.999969482421875 ECU_ADDRESS 0x4000DA4E FORMAT "%4.3" /end MEASUREMENT
/begin MEASUREMENT tq_tpi_dsbl_torq "Tip in disable torque." SWORD u_tq 0 0 -2048 2047.9375 ECU_ADDRESS 0x400050DA /end MEASUREMENT
/begin MEASUREMENT tq_tpi_pdsbl_torq "Tip in post disable torque." SWORD u_tq 0 0 -2048 2047.9375 ECU_ADDRESS 0x400050DA /end MEASUREMENT
/begin MEASUREMENT tq_tpi_rmp_enbl "Tip in  ramp enable." UBYTE b_true 0 0 0.00 1.00 BIT_MASK 0x1 ECU_ADDRESS 0x400050DA FORMAT "%1.0" /end MEASUREMENT
/begin MEASUREMENT tq_tpi_rmp_eco_fac "Tip in ramp factor in ECO mode." UWORD u_fac_2 0 0 0.0 1.999969482421875 ECU_ADDRESS 0x4000DA4E FORMAT "%4.3" /end MEASUREMENT
/begin MEASUREMENT tq_tpi_rmp_stp "Tip in ramp step." SWORD u_tq 0 0 -2048 2047.9375 ECU_ADDRESS 0x400050DA /end MEASUREMENT
/begin MEASUREMENT tq_tpi_flyw_torq_sp "Flywheel torque setpoint after tip in step." SWORD u_tq 0 0 -2048 2047.9375 ECU_ADDRESS 0x400050DA /end MEASUREMENT
/begin MEASUREMENT tq_tpi_hld "Tip in holding." UBYTE b_true 0 0 0.00 1.00 BIT_MASK 0x1 ECU_ADDRESS 0x400050DA FORMAT "%1.0" /end MEASUREMENT
/begin MEASUREMENT tq_tpi_hld_tm "Tip in hold timer." UWORD u_2x_tmr 0 0 0 1023.984375 ECU_ADDRESS 0x4000DA4E SYMBOL_LINK "tq_tpi_hld_tm" 2 /end MEASUREMENT
/begin MEASUREMENT tq_tpi_filter "Tip in filter." UWORD u_filter 0 0 0 0.9999847412109375 ECU_ADDRESS 0x400052D4 FORMAT "%10.9" /end MEASUREMENT
/begin MEASUREMENT tq_trans_torq_rt "Actual transmission torque transfer ratio,received from TCM in the torque phase of the TCM shift process." UWORD u_fac_32 0 0 0 31.99951171875 ECU_ADDRESS 0x400052D4 FORMAT "%4.2" /end MEASUREMENT
/begin MEASUREMENT tq_shft_torq_met "Shifting torque control condition met." UBYTE b_true 0 0 0.00 1.00 BIT_MASK 0x1 ECU_ADDRESS 0x400050DA FORMAT "%1.0" /end MEASUREMENT
/begin MEASUREMENT tq_tpi_filter_fac_enbl "Tip in filter factor enable.Only enabled when soaktime is small and intake air temperature is low." UBYTE b_true 0 0 0.00 1.00 BIT_MASK 0x1 ECU_ADDRESS 0x400050DA FORMAT "%1.0" /end MEASUREMENT
/begin MEASUREMENT tq_tpi_filter_eco_fac "Tip in filter factor in ECO mode." UWORD u_fac_2 0 0 0.0 1.999969482421875 ECU_ADDRESS 0x4000DA4E FORMAT "%4.3" /end MEASUREMENT
/begin MEASUREMENT tq_add_sp "final additional torq setpoint" SWORD u_tq_1024 0 0 -1024.0 1023.96875 ECU_ADDRESS 0x4000DA4E FORMAT "%6.2" /end MEASUREMENT
/begin MEASUREMENT tq_add_sp_max "max limit of final additional torq setpoint" SWORD u_tq_1024 0 0 -1024.0 1023.96875 ECU_ADDRESS 0x4000DA4E FORMAT "%6.2" /end MEASUREMENT
/begin MEASUREMENT tq_add_cls_thro_met "true means close throttle mode of additional torq conditions met" UBYTE b_true 0 0 0.00 1.00 BIT_MASK 0x1 ECU_ADDRESS 0x400050DA FORMAT "%1.0" /end MEASUREMENT
/begin MEASUREMENT tq_add_idl_sp "raw additional torq setpoint when in idle mode" SWORD u_tq_1024 0 0 -1024.0 1023.96875 ECU_ADDRESS 0x4000DA4E FORMAT "%6.2" /end MEASUREMENT
/begin MEASUREMENT tq_add_sp_raw "raw additional torq setpoint" SWORD u_tq_1024 0 0 -1024.0 1023.96875 ECU_ADDRESS 0x4000DA4E FORMAT "%6.2" /end MEASUREMENT
/begin MEASUREMENT tq_add_sp_rmp "additional torq setpoint after ramp control" SWORD u_tq_1024 0 0 -1024.0 1023.96875 ECU_ADDRESS 0x4000DA4E FORMAT "%6.2" /end MEASUREMENT
/begin MEASUREMENT knck_knk_ctrl_cfg "knock control configuration status" UBYTE b_true 0 0 0.00 1.00 BIT_MASK 0x1 ECU_ADDRESS 0x400050DA FORMAT "%1.0" /end MEASUREMENT
/begin MEASUREMENT knck_knk_en "knock control enable status" UBYTE b_true 0 0 0.00 1.00 BIT_MASK 0x1 ECU_ADDRESS 0x400050DA FORMAT "%1.0" /end MEASUREMENT
/begin MEASUREMENT knck_vvt_knk_stat "VVT Knock control active status" UBYTE b_true 0 0 0.00 1.00 BIT_MASK 0x1 ECU_ADDRESS 0x400050DA FORMAT "%1.0" /end MEASUREMENT
/begin MEASUREMENT knck_vlt_raw1 "raw knock intensity signal from Filter frequency 1" UWORD u_ad_volt 0 0 0 4.9999237060546875 ECU_ADDRESS 0x4000440A FORMAT "%5.4" /end MEASUREMENT
/begin MEASUREMENT knck_vlt_raw2 "raw knock intensity signal from Filter frequency 2" UWORD u_ad_volt 0 0 0 4.9999237060546875 ECU_ADDRESS 0x4000440A FORMAT "%5.4" SYMBOL_LINK "knck_vlt_raw2" 2 /end MEASUREMENT
/begin MEASUREMENT knck_vlt_raw3 "raw knock intensity signal from Filter frequency 3" UWORD u_ad_volt 0 0 0 4.9999237060546875 ECU_ADDRESS 0x4000440A FORMAT "%4.3" SYMBOL_LINK "knck_vlt_raw3" 4 /end MEASUREMENT
/begin MEASUREMENT knck_knks_int "knock intensity combined from three Filter frequency" UWORD u_pct 0 0 0.0 199.9969482421875 ECU_ADDRESS 0x4000440A /end MEASUREMENT
/begin MEASUREMENT knck_knks_filted_int "filter average knock intensity combined from three Filter frequency" UWORD u_pct 0 0 0.0 199.9969482421875 ECU_ADDRESS 0x4000440A /end MEASUREMENT
/begin MEASUREMENT knck_knks_int_dlt "delta value between knck_knks_int and knck_knks_filted_int used to calculate knock threshold" UWORD u_pct 0 0 0.0 199.9969482421875 ECU_ADDRESS 0x4000440A /end MEASUREMENT
/begin MEASUREMENT knck_det_thr_cyl1 "knock detect threshold" UWORD u_pct 0 0 0.0 199.9969482421875 ECU_ADDRESS 0x4000440A /end MEASUREMENT
/begin MEASUREMENT knck_det_thr_cyl2 "knock detect threshold" UWORD u_pct 0 0 0.0 199.9969482421875 ECU_ADDRESS 0x4000440A SYMBOL_LINK "knck_det_thr_cyl2" 2 /end MEASUREMENT
/begin MEASUREMENT knck_det_thr_cyl3 "knock intensity threshold for cylinder3" UWORD u_pct 0 0 0.0 199.9969482421875 ECU_ADDRESS 0x4000440A SYMBOL_LINK "knck_det_thr_cyl3" 4 /end MEASUREMENT
/begin MEASUREMENT knck_det_thr_cyl4 "knock intensity threshold for cylinder4" UWORD u_pct 0 0 0.0 199.9969482421875 ECU_ADDRESS 0x4000440A SYMBOL_LINK "knck_det_thr_cyl4" 6 /end MEASUREMENT
/begin MEASUREMENT knck_knk_det "true means knock of engine detected" UBYTE b_true 0 0 0.00 1.00 BIT_MASK 0x1 ECU_ADDRESS 0x4000440A FORMAT "%1.0" /end MEASUREMENT
/begin MEASUREMENT knck_iga_fast_rtd_cyl1 "Fast IGA knock retard for cylinder 0" SWORD u_iga 0 0 -256.0 255.9921875 ECU_ADDRESS 0x40004686 FORMAT "%4.2" /end MEASUREMENT
/begin MEASUREMENT knck_iga_fast_rtd_cyl2 "Fast IGA knock retard for cylinder 1" SWORD u_iga 0 0 -256.0 255.9921875 ECU_ADDRESS 0x40004686 FORMAT "%4.2" SYMBOL_LINK "knck_iga_fast_rtd_cyl2" 2 /end MEASUREMENT
/begin MEASUREMENT knck_iga_fast_rtd_cyl3 "Fast IGA knock retard for cylinder 2" SWORD u_iga 0 0 -256.0 255.9921875 ECU_ADDRESS 0x40004686 FORMAT "%4.2" SYMBOL_LINK "knck_iga_fast_rtd_cyl3" 4 /end MEASUREMENT
/begin MEASUREMENT knck_iga_fast_rtd_cyl4 "Fast IGA knock retard for cylinder 3" SWORD u_iga 0 0 -256.0 255.9921875 ECU_ADDRESS 0x40004686 FORMAT "%4.2" SYMBOL_LINK "knck_iga_fast_rtd_cyl4" 6 /end MEASUREMENT
/begin MEASUREMENT knck_iga_adp_rtd_cyl1 "adaption IGA knock retard for cylinder 0" SWORD u_iga 0 0 -256.0 255.9921875 ECU_ADDRESS 0x40004686 FORMAT "%4.2" /end MEASUREMENT
/begin MEASUREMENT knck_iga_adp_rtd_cyl2 "adaption IGA knock retard for cylinder 1" SWORD u_iga 0 0 -256.0 255.9921875 ECU_ADDRESS 0x40004686 FORMAT "%4.2" SYMBOL_LINK "knck_iga_adp_rtd_cyl2" 2 /end MEASUREMENT
/begin MEASUREMENT knck_iga_adp_rtd_cyl3 "adaption IGA knock retard for cylinder 2" SWORD u_iga 0 0 -256.0 255.9921875 ECU_ADDRESS 0x40004686 FORMAT "%4.2" SYMBOL_LINK "knck_iga_adp_rtd_cyl3" 4 /end MEASUREMENT
/begin MEASUREMENT knck_iga_adp_rtd_cyl4 "adaption IGA knock retard for cylinder 3" SWORD u_iga 0 0 -256.0 255.9921875 ECU_ADDRESS 0x40004686 FORMAT "%4.2" SYMBOL_LINK "knck_iga_adp_rtd_cyl4" 6 /end MEASUREMENT
/begin MEASUREMENT knck_iga_tot_rtd_cyl1 "final IGA knock retard for cylinder 0" SWORD u_iga 0 0 -256.0 255.9921875 ECU_ADDRESS 0x40004686 FORMAT "%4.2" /end MEASUREMENT
/begin MEASUREMENT knck_iga_tot_rtd_cyl2 "final IGA knock retard for cylinder 1" SWORD u_iga 0 0 -256.0 255.9921875 ECU_ADDRESS 0x40004686 FORMAT "%4.2" SYMBOL_LINK "knck_iga_tot_rtd_cyl2" 2 /end MEASUREMENT
/begin MEASUREMENT knck_iga_tot_rtd_cyl3 "final IGA knock retard for cylinder 2" SWORD u_iga 0 0 -256.0 255.9921875 ECU_ADDRESS 0x40004686 FORMAT "%4.2" SYMBOL_LINK "knck_iga_tot_rtd_cyl3" 4 /end MEASUREMENT
/begin MEASUREMENT knck_iga_tot_rtd_cyl4 "final IGA knock retard for cylinder 3" SWORD u_iga 0 0 -256.0 255.9921875 ECU_ADDRESS 0x40004686 FORMAT "%4.2" SYMBOL_LINK "knck_iga_tot_rtd_cyl4" 6 /end MEASUREMENT
/begin MEASUREMENT knck_knk_conds_met "true means knock control enable conditions met" UBYTE b_true 0 0 0.00 1.00 BIT_MASK 0x1 ECU_ADDRESS 0x40004244 FORMAT "%1.0" /end MEASUREMENT
/begin MEASUREMENT knck_knk_dis_err_stat "true means knock control disable due to sensor error" UBYTE b_true 0 0 0.00 1.00 BIT_MASK 0x1 ECU_ADDRESS 0x40004244 FORMAT "%1.0" /end MEASUREMENT
/begin MEASUREMENT knck_err_pass_tmr "knock sensor error pass timer to determinate knck_knk_dis_err_stat" UWORD u_1s_tmr 0 0 0.00 65535.00 ECU_ADDRESS 0x400040F2 /end MEASUREMENT
/begin MEASUREMENT knck_imep_filt "filtered IMEP_MBT used in knock control" UWORD u_kPa_0_4096 0 0 0.0 4095.9375 ECU_ADDRESS 0x4000451C /end MEASUREMENT
/begin MEASUREMENT knck_trans_st "transient state of knock control" UBYTE u_knck_trans_st 0 0 0 6 ECU_ADDRESS 0x400052D4 FORMAT "%1.0" /end MEASUREMENT
/begin MEASUREMENT knck_det_thr_excd "True means knock detection threshold exceeded" UBYTE b_true 0 0 0.00 1.00 BIT_MASK 0x1 ECU_ADDRESS 0x40004244 FORMAT "%1.0" /end MEASUREMENT
/begin MEASUREMENT knck_iga_tot_rtd_avg "Average total knock retard over all the cylinders" SWORD u_iga 0 0 -256.0 255.9921875 ECU_ADDRESS 0x40004686 FORMAT "%4.2" /end MEASUREMENT
/begin MEASUREMENT extc_cat_prot_en "catalyst temp hi" UBYTE b_true 0 0 0.00 1.00 BIT_MASK 0x1 ECU_ADDRESS 0x4000440A FORMAT "%1.0" /end MEASUREMENT
/begin MEASUREMENT extc_exh_prot_en "catalyst temp hi" UBYTE b_true 0 0 0.00 1.00 BIT_MASK 0x1 ECU_ADDRESS 0x4000440A FORMAT "%1.0" /end MEASUREMENT
/begin MEASUREMENT extc_cat_t_egr_bias "EGR bias of CAT temp calculation" SWORD u_deg_C_n2048_p2048 0 0 -2048 2047.9375 ECU_ADDRESS 0x4000DA4E /end MEASUREMENT
/begin MEASUREMENT extc_cat_t_nv "catalyst temp" SWORD u_deg_C_n2048_p2048 0 0 -2048 2047.9375 ECU_ADDRESS 0x4000DA4E /end MEASUREMENT
/begin MEASUREMENT extc_mnfd_ovr_t "exhaust manifold over temp delta" SWORD u_deg_C_n2048_p2048 0 0 -2048 2047.9375 ECU_ADDRESS 0x4000DA4E /end MEASUREMENT
/begin MEASUREMENT extc_no_afr_mnfd_t_filt "exhaust manifold temp without airfuel term" SWORD u_deg_C_n2048_p2048 0 0 -2048 2047.9375 ECU_ADDRESS 0x4000DA4E /end MEASUREMENT
/begin MEASUREMENT extc_puc_dis_stat "true means disable PUC due to CAT temp high" UBYTE b_true 0 0 0.00 1.00 BIT_MASK 0x40 ECU_ADDRESS 0x400050DA FORMAT "%1.0" /end MEASUREMENT
/begin MEASUREMENT extc_cat_ht_ig_req "catalyst heat ignition req" UBYTE b_true 0 0 0.00 1.00 BIT_MASK 0x1 ECU_ADDRESS 0x4000440A FORMAT "%1.0" /end MEASUREMENT
/begin MEASUREMENT extc_cat_ht_ig_fn "catalyst heat ignition finish" UBYTE b_true 0 0 0.00 1.00 BIT_MASK 0x1 ECU_ADDRESS 0x4000440A FORMAT "%1.0" /end MEASUREMENT
/begin MEASUREMENT evac_dc "purge duty cycle." UWORD u_pct 0 0 0.0 100 ECU_ADDRESS 0x4000440A /end MEASUREMENT
/begin MEASUREMENT evac_cp_fm_pct "purge fuel mass percent" UWORD u_pct 0 0 0 199.996948242187 ECU_ADDRESS 0x4000DA4E FORMAT "%4.1" /end MEASUREMENT
/begin MEASUREMENT evac_cp_conc_lrn_stat "true means concentration of canister purge has been learned" UBYTE b_true 0 0 0.00 1.00 BIT_MASK 0x40 ECU_ADDRESS 0x400050DA FORMAT "%1.0" /end MEASUREMENT
/begin MEASUREMENT evac_cp_conc "concentration of canister purge" UWORD u_pct 0 0 0.0 199.996948242187 ECU_ADDRESS 0x4000DA4E FORMAT "%6.2" /end MEASUREMENT
/begin MEASUREMENT evac_cp_idx "Canister purge index." UWORD u_cnts 0 0 0.00 65535.00 ECU_ADDRESS 0x4000440A FORMAT "%5.0" /end MEASUREMENT
/begin MEASUREMENT evac_sys_stat "Canister purge system states." UBYTE u_purge_stat 0 0 0 4 ECU_ADDRESS 0x400017C8 FORMAT "%1.0" /end MEASUREMENT
/begin MEASUREMENT evac_cp_fuel_flw "Canister purge fuel flow." UWORD u_g_per_sec_16 0 0 0.0 15.999756 ECU_ADDRESS 0x4000DA4E /end MEASUREMENT
/begin MEASUREMENT evac_cp_conc_mod "Canister purge concentration mode." UBYTE u_purge_conc_mode 0 0 0 2 ECU_ADDRESS 0x400017C8 FORMAT "%1.0" /end MEASUREMENT
/begin MEASUREMENT evac_cp_pct "Canister purge percent." UWORD u_pct 0 0 0.0 199.996948242187 ARRAY_SIZE 25 ECU_ADDRESS 0x4000DA4E FORMAT "%6.2" /end MEASUREMENT
/begin MEASUREMENT evac_enbl "Canister purge enable." UBYTE b_true 0 0 0.00 1.00 BIT_MASK 0x1 ECU_ADDRESS 0x400050DA FORMAT "%1.0" /end MEASUREMENT
/begin MEASUREMENT evac_diag_actv "Some diagnosis active to affect purge control, eg.purge diag or catalyst diag." UBYTE b_true 0 0 0.00 1.00 BIT_MASK 0x1 ECU_ADDRESS 0x400050DA FORMAT "%1.0" /end MEASUREMENT
/begin MEASUREMENT evac_off_dly_puc_tm "PUC duration time used for purge control." UWORD u_8x_tmr 0 0 0.0 4095.9375 ECU_ADDRESS 0x4000DA4E FORMAT "%5.3" SYMBOL_LINK "evac_off_dly_puc_tm" 2 /end MEASUREMENT
/begin MEASUREMENT evac_cp_conc_lo "Canister purge concentration low." UBYTE b_true 0 0 0.00 1.00 BIT_MASK 0x1 ECU_ADDRESS 0x400050DA FORMAT "%1.0" /end MEASUREMENT
/begin MEASUREMENT evac_cp_ol_osc "Canister purge open loop for O2 consumption active." UBYTE b_true 0 0 0.00 1.00 BIT_MASK 0x1 ECU_ADDRESS 0x400050DA FORMAT "%1.0" /end MEASUREMENT
/begin MEASUREMENT evac_cp_conc_lo_dly_tm "Canister purge concentration low delay timer." UWORD u_8x_tmr 0 0 0.0 4095.9375 ECU_ADDRESS 0x4000DA4E FORMAT "%5.3" /end MEASUREMENT
/begin MEASUREMENT evac_cp_conc_lo_tm "Canister purge concentration low duration timer." UWORD u_8x_tmr 0 0 0.0 4095.9375 ECU_ADDRESS 0x4000DA4E FORMAT "%5.3" SYMBOL_LINK "evac_cp_conc_lo_tm" 4 /end MEASUREMENT
/begin MEASUREMENT evac_cp_bst_enbl "Canister purge boost state enable." UBYTE b_true 0 0 0.00 1.00 BIT_MASK 0x1 ECU_ADDRESS 0x400050DA FORMAT "%1.0" /end MEASUREMENT
/begin MEASUREMENT evac_cp_bst_tm "Canister purge boost state timer." UWORD u_8x_tmr 0 0 0.0 4095.9375 ECU_ADDRESS 0x4000DA4E FORMAT "%5.3" SYMBOL_LINK "evac_cp_bst_tm" 4 /end MEASUREMENT
/begin MEASUREMENT evac_pf_pct "Canister purge fuel percent." UWORD u_pct 0 0 0.0 199.996948242187 ECU_ADDRESS 0x4000DA4E FORMAT "%6.2" /end MEASUREMENT
/begin MEASUREMENT evac_cp_lrn_dn "Canister purge learn down condition met." UBYTE b_true 0 0 0.00 1.00 BIT_MASK 0x1 ECU_ADDRESS 0x400050DA FORMAT "%1.0" /end MEASUREMENT
/begin MEASUREMENT evac_cp_lrn_up "Canister purge learn up condition met." UBYTE b_true 0 0 0.00 1.00 BIT_MASK 0x1 ECU_ADDRESS 0x400050DA FORMAT "%1.0" /end MEASUREMENT
/begin MEASUREMENT evac_cp_air_flw "Canister purge air flow." UWORD u_g_per_sec_64 0 0 0.0 63.9990234375 ECU_ADDRESS 0x4000DA4E /end MEASUREMENT
/begin MEASUREMENT evac_pf_inc_dsbl "Increase purge fuel disable because the final pulse width is short,purge add will make inject pulse width too short." UBYTE b_true 0 0 0.00 1.00 BIT_MASK 0x1 ECU_ADDRESS 0x400050DA FORMAT "%1.0" /end MEASUREMENT
/begin MEASUREMENT evac_pf_dec_enbl "Decrease purge fuel enable because the final pulse width is extreme short,purge has to decrease to make inject pulse width longer." UBYTE b_true 0 0 0.00 1.00 BIT_MASK 0x1 ECU_ADDRESS 0x400050DA FORMAT "%1.0" /end MEASUREMENT
/begin MEASUREMENT evac_diag_ctrl_mod "Purge control diagnostic control mode." UWORD u_purge_diag_ctrl_mod 0 0 0 3 ECU_ADDRESS 0x4000DA4E FORMAT "%5.2" /end MEASUREMENT
/begin MEASUREMENT evac_cp_ms_flw "Canister purge mass flow." UWORD u_g_per_sec_16 0 0 0.0 15.999756 ECU_ADDRESS 0x4000DA4E /end MEASUREMENT
/begin MEASUREMENT evac_pf_inc_inh "Purge fuel increase inhibit." UBYTE b_true 0 0 0.00 1.00 BIT_MASK 0x1 ECU_ADDRESS 0x400050DA FORMAT "%1.0" /end MEASUREMENT
/begin MEASUREMENT evac_pf_cl_lrn_actv "Purge fuel close loop mode step learn active." UBYTE b_true 0 0 0.00 1.00 BIT_MASK 0x1 ECU_ADDRESS 0x400050DA FORMAT "%1.0" /end MEASUREMENT
/begin MEASUREMENT evac_cp_conc_hi "Purge concentration is high,use high limit." UBYTE b_true 0 0 0.00 1.00 BIT_MASK 0x1 ECU_ADDRESS 0x400050DA FORMAT "%1.0" /end MEASUREMENT
/begin MEASUREMENT evac_cp_flw "Canister purge flow include air flow and fuel flow." UWORD u_g_per_sec_64 0 0 0.0 63.9990234375 ECU_ADDRESS 0x4000DA4E /end MEASUREMENT
/begin MEASUREMENT evac_cp_flw_raw "Raw canister purge flow include air flow and fuel flow." UWORD u_g_per_sec_64 0 0 0.0 63.9990234375 ECU_ADDRESS 0x4000DA4E /end MEASUREMENT
/begin MEASUREMENT evac_mx_cp_flw_met "Max purge flow condition met." UBYTE b_true 0 0 0.00 1.00 BIT_MASK 0x1 ECU_ADDRESS 0x400050DA FORMAT "%1.0" /end MEASUREMENT
/begin MEASUREMENT evac_mx_cp_flw "Max purge flow." UWORD u_g_per_sec_64 0 0 0.0 63.9990234375 ECU_ADDRESS 0x4000DA4E /end MEASUREMENT
/begin MEASUREMENT evac_mx_cp_flw_dly_tm "Max purge flow delay time." UWORD u_8x_tmr 0 0 0.0 4095.9375 ECU_ADDRESS 0x4000DA4E FORMAT "%5.3" /end MEASUREMENT
/begin MEASUREMENT evac_cp_flw_unlmt "Unlimited canister purge flow include air flow and fuel flow." UWORD u_g_per_sec_64 0 0 0.0 63.9990234375 ECU_ADDRESS 0x4000DA4E /end MEASUREMENT
/begin MEASUREMENT evac_mn_cp_flw "Min purge flow." UWORD u_g_per_sec_64 0 0 0.0 63.9990234375 ECU_ADDRESS 0x4000DA4E /end MEASUREMENT
/begin MEASUREMENT evac_cp_vlv_den_fac "evac_cp_vlv_den_fac" UWORD u_fac_8 0 0 0.0 7.9998779296875 ECU_ADDRESS 0x4000DA4E FORMAT "%5.4" /end MEASUREMENT
/begin MEASUREMENT evac_cp_lrn_adp_inh "Fuel adaption learning is inhibited when purge fuel is large enough." UBYTE b_true 0 0 0.00 1.00 BIT_MASK 0x1 ECU_ADDRESS 0x400050DA FORMAT "%1.0" /end MEASUREMENT
/begin MEASUREMENT evac_cp_flw_rt "Purge flow ratio to determine inhibit fuel adaption learning." UWORD u_pct 0 0 0.0 199.996948242187 ECU_ADDRESS 0x4000DA4E FORMAT "%6.2" /end MEASUREMENT
/begin MEASUREMENT evac_accu_cp_ms_flw "Accumulated purge mass flow during concentration transition." UWORD u_gram_16 0 0 0.0 15.999755859375 ECU_ADDRESS 0x4000DA4E FORMAT "%5.2" /end MEASUREMENT
/begin MEASUREMENT evac_cp_conc_trans_strt "Transition start purge concentration." UWORD u_pct 0 0 0.0 199.996948242187 ECU_ADDRESS 0x4000DA4E FORMAT "%6.2" /end MEASUREMENT
/begin MEASUREMENT evac_cp_conc_stp "Canister purge concentration update step." SWORD u_pct_1 0 0 -50 49.9984741210937 ECU_ADDRESS 0x40004EA0 FORMAT "%4.1" /end MEASUREMENT
/begin MEASUREMENT evac_cp_conc_can_nv "Purge concentration in canister mode stored in NVRAM." UWORD u_pct 0 0 0.0 199.996948242187 ECU_ADDRESS 0x4000DA4E FORMAT "%6.2" /end MEASUREMENT
/begin MEASUREMENT evac_cp_conc_tank_nv "Purge concentration in tank mode stored in NVRAM." UWORD u_pct 0 0 0.0 199.996948242187 ECU_ADDRESS 0x4000DA4E FORMAT "%6.2" /end MEASUREMENT
/begin MEASUREMENT evac_cp_rt_lo_tm "Purge ratio low duration timer." UWORD u_8x_tmr 0 0 0.0 4095.9375 ECU_ADDRESS 0x4000DA4E FORMAT "%5.3" SYMBOL_LINK "evac_cp_rt_lo_tm" 2 /end MEASUREMENT
/begin MEASUREMENT evac_diag_pg_ctrl_st "Canister purge diag states" UBYTE u_purge_diag_ctrl_mod 0 0 0 4 ECU_ADDRESS 0x400017C8 FORMAT "%1.0" /end MEASUREMENT
/begin MEASUREMENT evac_lmt_flt_actv "Fault actived and limit purge diagnostic." UBYTE b_true 0 0 0.00 1.00 BIT_MASK 0x1 ECU_ADDRESS 0x400033EF FORMAT "%1.0" /end MEASUREMENT
/begin MEASUREMENT evac_trip_lmt_flt_actv "Fault actived and limit purge diagnostic in this key cycle." UBYTE b_true 0 0 0.00 1.00 BIT_MASK 0x1 ECU_ADDRESS 0x400033EF FORMAT "%1.0" /end MEASUREMENT
/begin MEASUREMENT hyb_auto_stp_stat "true means engine currently in auto-stop hybrid status" UBYTE b_true 0 0 0.00 1.00 BIT_MASK 0x1 ECU_ADDRESS 0x400050DA FORMAT "%1.0" /end MEASUREMENT
/begin MEASUREMENT hyb_auto_strt_stat "TRUE means current engine run is started by hybrid auto-start" UBYTE b_true 0 0 0.00 1.00 BIT_MASK 0x1 ECU_ADDRESS 0x400050DA FORMAT "%1.0" /end MEASUREMENT
/begin MEASUREMENT hyb_fco_req "true means fuel cut off is requested by hybrid control" UBYTE b_true 0 0 0.00 1.00 BIT_MASK 0x1 ECU_ADDRESS 0x400050DA FORMAT "%1.0" /end MEASUREMENT
/begin MEASUREMENT hyb_fco_dur "fuel cutoff duration" UWORD u_500m_tmr 0 0 0 32767.5 ECU_ADDRESS 0x40004EA0 FORMAT "%6.1" /end MEASUREMENT
/begin MEASUREMENT hyb_eng_stop_dur "fuel cutoff duration" UWORD u_1x_tmr 0 0 0 511.9921875 ECU_ADDRESS 0x40004EA0 FORMAT "%5.2" /end MEASUREMENT
/begin AXIS_PTS ENSC_X_PS_P "" 0x65E4A sys_ps_p SSV__UWORD_S 0 u_kPa_0_32768 5 0 32767.5 DEPOSIT ABSOLUTE SYMBOL_LINK "ENSC_X_PS_P" 2 /end AXIS_PTS
/begin AXIS_PTS AFM_X_AIR_FLW_B "axis of air airflow" 0x0002006C afm_frsh_air_flw SSV__UWORD_S 0 u_g_per_sec 17 0 511.9921875 DEPOSIT ABSOLUTE SYMBOL_LINK "AFM_X_AIR_FLW_B" 2 /end AXIS_PTS
/begin CHARACTERISTIC TQ_V_MIN_TORQ_THRSH_PCT "The percentage of clutch torque threshold below which the pedal is considered closed." VALUE 0x0002038C __UWORD_S 0 u_pct 0 199.996948242187 /end CHARACTERISTIC
/begin CHARACTERISTIC TQ_V_MIN_TORQ_HYST_PCT "The percentage of clutch torque threshold beyond which the pedal is considered open." VALUE 0x0002038C __UWORD_S 0 u_pct 0 199.996948242187 /end CHARACTERISTIC
/begin AXIS_PTS TQ_X_TPO_ESPD "engine speed breakpoint" 0x0002006C sys_eng_spd SSV__UWORD_S 0 u_espd 11 0.000000 8191.875000 FORMAT "%5.1" DEPOSIT ABSOLUTE SYMBOL_LINK "TQ_X_TPO_ESPD" 2 /end AXIS_PTS
/begin CHARACTERISTIC TQ_V_DRVLN_USED "Driveline state used to determine MT trans engaged." VALUE 0x0002038C __UBYTE_S 0 b_true 0 1 FORMAT "%1.0" /end CHARACTERISTIC
/begin CHARACTERISTIC TQ_M_TPO_MX_LMT_SPRT "Max tip out clutch torque in sport mode based on engine speed and gear." MAP 0x00020320 __SWORD_S 0 u_tq -2048 2047.9375 FORMAT "%5.2" SYMBOL_LINK "TQ_M_TPO_MX_LMT_SPRT" 4
 /begin AXIS_DESCR FIX_AXIS tq_veh_gr_st u_tq_gr_typ 11 0 10 /begin FIX_AXIS_PAR_LIST 0 1 2 3 4 5 6 7 8 9 10 /end FIX_AXIS_PAR_LIST /end AXIS_DESCR
 /begin AXIS_DESCR COM_AXIS sys_eng_spd u_espd 11 0.0 8191.875000 AXIS_PTS_REF TQ_X_TPO_ESPD /end AXIS_DESCR
/end CHARACTERISTIC
/begin CHARACTERISTIC TQ_C_TPO_MX_FAC_SPRT "Max tip out clutch torque coolant factor in sport mode." CURVE 0x2A3EC __UWORD_S 0 u_fac_2 0 1.999969482421875 FORMAT "%4.3" SYMBOL_LINK "TQ_C_TPO_MX_FAC_SPRT" 2
 /begin AXIS_DESCR FIX_AXIS sys_ect u_deg_C 15 -40 128
  /begin FIX_AXIS_PAR_LIST -5120 -3584 -2048 -512 1024 2560 4096 5632 7168 8704 10240 11776 13312 14848 16384 /end FIX_AXIS_PAR_LIST
 /end AXIS_DESCR
/end CHARACTERISTIC
/begin CHARACTERISTIC TQ_M_TPO_MX_LMT "Max tip out clutch torque based on engine speed and gear." MAP 0x00020320 __SWORD_S 0 u_tq -2048 2047.9375 FORMAT "%5.2" SYMBOL_LINK "TQ_M_TPO_MX_LMT" 4
 /begin AXIS_DESCR FIX_AXIS tq_veh_gr_st u_tq_gr_typ 11 0 10 /begin FIX_AXIS_PAR_LIST 0 1 2 3 4 5 6 7 8 9 10 /end FIX_AXIS_PAR_LIST /end AXIS_DESCR
 /begin AXIS_DESCR COM_AXIS sys_eng_spd u_espd 11 0.0 8191.875000 AXIS_PTS_REF TQ_X_TPO_ESPD /end AXIS_DESCR
/end CHARACTERISTIC
/begin CHARACTERISTIC TQ_C_TPO_MX_FAC "Max tip out clutch torque coolant factor." CURVE 0x2A3EC __UWORD_S 0 u_fac_2 0 1.999969482421875 FORMAT "%4.3" SYMBOL_LINK "TQ_C_TPO_MX_FAC" 2
 /begin AXIS_DESCR FIX_AXIS sys_ect u_deg_C 15 -40 128
  /begin FIX_AXIS_PAR_LIST -5120 -3584 -2048 -512 1024 2560 4096 5632 7168 8704 10240 11776 13312 14848 16384 /end FIX_AXIS_PAR_LIST
 /end AXIS_DESCR
/end CHARACTERISTIC
/begin CHARACTERISTIC TQ_V_CLTCH_TORQ_RAW_SP_FILT "Raw clutch torque setpoint filter." VALUE 0x0002038C __UWORD_S 0 u_filter 0 0.9999847412109375 FORMAT "%10.9" /end CHARACTERISTIC
/begin AXIS_PTS TQ_X_CLTCH_TORQ "clutch torque breakpoint" 0x0002006C tq_cltch_torq_raw_sp_filt SSV__SWORD_S 0 u_tq 11 -2048 2047.9375 DEPOSIT ABSOLUTE SYMBOL_LINK "TQ_X_CLTCH_TORQ" 2 /end AXIS_PTS
/begin CHARACTERISTIC TQ_C_TPO_MX_CLTCH_TORQ_FAC "Raw clutch torque factor for Max tip out clutch torque." CURVE 0x2A3EC __UWORD_S 0 u_fac_2 0 1.999969482421875 FORMAT "%4.3" SYMBOL_LINK "TQ_C_TPO_MX_CLTCH_TORQ_FAC" 2
 /begin AXIS_DESCR COM_AXIS tq_cltch_torq_raw_sp_filt u_tq 11 -2048 2047.9375 AXIS_PTS_REF TQ_X_CLTCH_TORQ /end AXIS_DESCR
/end CHARACTERISTIC
/begin CHARACTERISTIC TQ_M_TPO_MN_LMT_SPRT "Min tip out clutch torque in sport mode based on engine speed and gear." MAP 0x00020320 __SWORD_S 0 u_tq -2048 2047.9375 FORMAT "%5.2" SYMBOL_LINK "TQ_M_TPO_MN_LMT_SPRT" 4
 /begin AXIS_DESCR FIX_AXIS tq_veh_gr_st u_tq_gr_typ 11 0 10 /begin FIX_AXIS_PAR_LIST 0 1 2 3 4 5 6 7 8 9 10 /end FIX_AXIS_PAR_LIST /end AXIS_DESCR
 /begin AXIS_DESCR COM_AXIS sys_eng_spd u_espd 11 0.0 8191.875000 AXIS_PTS_REF TQ_X_TPO_ESPD /end AXIS_DESCR
/end CHARACTERISTIC
/begin CHARACTERISTIC TQ_C_TPO_MN_FAC_SPRT "Min tip out clutch torque coolant factor in sport mode." CURVE 0x2A3EC __UWORD_S 0 u_fac_2 0 1.999969482421875 FORMAT "%4.3" SYMBOL_LINK "TQ_C_TPO_MN_FAC_SPRT" 2
 /begin AXIS_DESCR FIX_AXIS sys_ect u_deg_C 15 -40 128
  /begin FIX_AXIS_PAR_LIST -5120 -3584 -2048 -512 1024 2560 4096 5632 7168 8704 10240 11776 13312 14848 16384 /end FIX_AXIS_PAR_LIST
 /end AXIS_DESCR
/end CHARACTERISTIC
/begin CHARACTERISTIC TQ_M_TPO_MN_LMT "Min tip out clutch torque based on engine speed and gear." MAP 0x00020320 __SWORD_S 0 u_tq -2048 2047.9375 FORMAT "%5.2" SYMBOL_LINK "TQ_M_TPO_MN_LMT" 4
 /begin AXIS_DESCR FIX_AXIS tq_veh_gr_st u_tq_gr_typ 11 0 10 /begin FIX_AXIS_PAR_LIST 0 1 2 3 4 5 6 7 8 9 10 /end FIX_AXIS_PAR_LIST /end AXIS_DESCR
 /begin AXIS_DESCR COM_AXIS sys_eng_spd u_espd 11 0.0 8191.875000 AXIS_PTS_REF TQ_X_TPO_ESPD /end AXIS_DESCR
/end CHARACTERISTIC
/begin CHARACTERISTIC TQ_C_TPO_MN_FAC "Min tip out clutch torque coolant factor." CURVE 0x2A3EC __UWORD_S 0 u_fac_2 0 1.999969482421875 FORMAT "%4.3" SYMBOL_LINK "TQ_C_TPO_MN_FAC" 2
 /begin AXIS_DESCR FIX_AXIS sys_ect u_deg_C 15 -40 128
  /begin FIX_AXIS_PAR_LIST -5120 -3584 -2048 -512 1024 2560 4096 5632 7168 8704 10240 11776 13312 14848 16384 /end FIX_AXIS_PAR_LIST
 /end AXIS_DESCR
/end CHARACTERISTIC
/begin CHARACTERISTIC TQ_V_TRNS_PUMP_ACC "True:Transmission pump torque loss is included in accessory torque.   False:Transmission pump torque loss is calculate independent." VALUE 0x0002038C __UBYTE_S 0 b_true 0 1 FORMAT "%1.0" /end CHARACTERISTIC
/begin CHARACTERISTIC TQ_V_ALT_ACC "True: tq_alt_torq included in tq_aux_torq; False:tq_alt_torq included in flywheel torque." VALUE 0x0002038C __UBYTE_S 0 b_true 0 1 FORMAT "%1.0" /end CHARACTERISTIC
/begin CHARACTERISTIC TQ_V_TPO_PN_DECLTCH "Using PN filter in tip out function when clutch pedal is depressed." VALUE 0x0002038C __UBYTE_S 0 b_true 0 1 FORMAT "%1.0" /end CHARACTERISTIC
/begin CHARACTERISTIC TQ_V_TPO_CLTCH_PUC "Using tq_cpuc_actv to cancel tip out when clutch pedal depressed cancel function is enable." VALUE 0x0002038C __UBYTE_S 0 b_true 0 1 FORMAT "%1.0" /end CHARACTERISTIC
/begin CHARACTERISTIC TQ_V_TPO_CANCL_DECLTCH "Clutch pedal depressed cancel tip out function is enable." VALUE 0x0002038C __UBYTE_S 0 b_true 0 1 FORMAT "%1.0" /end CHARACTERISTIC
/begin CHARACTERISTIC TQ_C_DP_FILT_PN "Tip out torque filter in PN gear." CURVE 0x2A3EC __UWORD_S 0 u_filter 0 0.9999847412109375 FORMAT "%10.9" SYMBOL_LINK "TQ_C_DP_FILT_PN" 2
 /begin AXIS_DESCR COM_AXIS sys_eng_spd u_espd 11 0.0 8191.875000 AXIS_PTS_REF TQ_X_TPO_ESPD /end AXIS_DESCR
/end CHARACTERISTIC
/begin CHARACTERISTIC TQ_M_DP_FILT_SPRT "Tip out torque filter in gear in sport mode." MAP 0x00020320 __UWORD_S 0 u_filter 0 0.9999847412109375 FORMAT "%10.9" SYMBOL_LINK "TQ_M_DP_FILT_SPRT" 4
 /begin AXIS_DESCR FIX_AXIS NO_INPUT_QUANTITY u_tq_gr_typ 8 0 7 /begin FIX_AXIS_PAR_LIST 0 1 2 3 4 5 6 7 /end FIX_AXIS_PAR_LIST /end AXIS_DESCR
 /begin AXIS_DESCR COM_AXIS sys_eng_spd u_espd 11 0.0 8191.875000 AXIS_PTS_REF TQ_X_TPO_ESPD /end AXIS_DESCR
/end CHARACTERISTIC
/begin CHARACTERISTIC TQ_M_DP_FILT "Tip out torque filter in gear." MAP 0x00020320 __UWORD_S 0 u_filter 0 0.9999847412109375 FORMAT "%10.9" SYMBOL_LINK "TQ_M_DP_FILT" 4
 /begin AXIS_DESCR FIX_AXIS NO_INPUT_QUANTITY u_tq_gr_typ 8 0 7 /begin FIX_AXIS_PAR_LIST 0 1 2 3 4 5 6 7 /end FIX_AXIS_PAR_LIST /end AXIS_DESCR
 /begin AXIS_DESCR COM_AXIS sys_eng_spd u_espd 11 0.0 8191.875000 AXIS_PTS_REF TQ_X_TPO_ESPD /end AXIS_DESCR
/end CHARACTERISTIC
/begin CHARACTERISTIC TQ_C_TPO_FILT_FAC_ECO "Tip out filter factor in ECO mode." CURVE 0x2A3EC __UWORD_S 0 u_fac_2 0 1.999969482421875 FORMAT "%4.3"
 /begin AXIS_DESCR FIX_AXIS NO_INPUT_QUANTITY u_tq_gr_typ 8 0 7 /begin FIX_AXIS_PAR_LIST 0 1 2 3 4 5 6 7 /end FIX_AXIS_PAR_LIST /end AXIS_DESCR
/end CHARACTERISTIC
/begin CHARACTERISTIC TQ_M_TPO_LO_HLD "Tip out torque limit in low limit hold time." MAP 0x00020320 __UWORD_S 0 u_2x_tmr 0 1023.984375 SYMBOL_LINK "TQ_M_TPO_LO_HLD" 4
 /begin AXIS_DESCR FIX_AXIS tq_veh_gr_st u_tq_gr_typ 11 0 10 /begin FIX_AXIS_PAR_LIST 0 1 2 3 4 5 6 7 8 9 10 /end FIX_AXIS_PAR_LIST /end AXIS_DESCR
 /begin AXIS_DESCR COM_AXIS sys_eng_spd u_espd 11 0.0 8191.875000 AXIS_PTS_REF TQ_X_TPO_ESPD /end AXIS_DESCR
/end CHARACTERISTIC
/begin CHARACTERISTIC TQ_M_TPO_LO_STP "Tip out torque low limit ramp step." MAP 0x00020320 __UWORD_S 0 u_fac_2048 0 2047.96875 SYMBOL_LINK "TQ_M_TPO_LO_STP" 4
 /begin AXIS_DESCR FIX_AXIS tq_veh_gr_st u_tq_gr_typ 11 0 10 /begin FIX_AXIS_PAR_LIST 0 1 2 3 4 5 6 7 8 9 10 /end FIX_AXIS_PAR_LIST /end AXIS_DESCR
 /begin AXIS_DESCR COM_AXIS sys_eng_spd u_espd 11 0.0 8191.875000 AXIS_PTS_REF TQ_X_TPO_ESPD /end AXIS_DESCR
/end CHARACTERISTIC
/begin CHARACTERISTIC TQ_V_TPO_DB "Tip out torque deadband." VALUE 0x0002038C __SWORD_S 0 u_tq -2048 2047.9375 FORMAT "%5.2" /end CHARACTERISTIC
/begin CHARACTERISTIC TQ_V_TPI_LCH_MX_VSPD "Tip in control launch max vehicle speed." VALUE 0x0002038C __UWORD_S 0 u_vspd 0 511.9921875 FORMAT "%4.1" /end CHARACTERISTIC
/begin CHARACTERISTIC TQ_C_VR_PPS_FILT "Virtual pedal position filter." CURVE 0x2A3EC __UWORD_S 0 u_filter 0 0.9999847412109375 FORMAT "%10.9" SYMBOL_LINK "TQ_C_VR_PPS_FILT" 2
 /begin AXIS_DESCR COM_AXIS tq_vr_pps u_pct 5 0 199.996948242187 AXIS_PTS_REF TQ_X_PPS_FILT /end AXIS_DESCR
/end CHARACTERISTIC
/begin AXIS_PTS TQ_X_PPS_FILT "virtual pedal position breakpoint" 0x0002006C tq_vr_pps SSV__UWORD_S 0 u_pct 5 0 199.996948242187 DEPOSIT ABSOLUTE SYMBOL_LINK "TQ_X_PPS_FILT" 2 /end AXIS_PTS
/begin AXIS_PTS TQ_X_PPS_DLT "virtual pedal position breakpoint" 0x0002006C tq_vr_pps_dlt SSV__UWORD_S 0 u_pct 5 0 199.996948242187 DEPOSIT ABSOLUTE SYMBOL_LINK "TQ_X_PPS_DLT" 2 /end AXIS_PTS
/begin CHARACTERISTIC TQ_C_TPI_TORQ_FAC_G1 "Tip in torque factor in gear 1 for enable,disable,post-disable threshold." CURVE 0x2A3EC __UWORD_S 0 u_fac_2 0 1.999969482421875 FORMAT "%4.3" SYMBOL_LINK "TQ_C_TPI_TORQ_FAC_G1" 2
 /begin AXIS_DESCR COM_AXIS tq_vr_pps_dlt u_pct 5 0 199.996948242187 AXIS_PTS_REF TQ_X_PPS_DLT /end AXIS_DESCR
/end CHARACTERISTIC
/begin CHARACTERISTIC TQ_C_TPI_RST_TMR "The relative torque threshold to reset tip in control timer.When driver relative torque setpoint lower than this,reset tip in timer." CURVE 0x2A3EC __UWORD_S 0 u_pct 0 199.996948242187
 /begin AXIS_DESCR FIX_AXIS NO_INPUT_QUANTITY u_vh_mod 2 0 1 /begin FIX_AXIS_PAR_LIST 0 1 /end FIX_AXIS_PAR_LIST /end AXIS_DESCR
/end CHARACTERISTIC
/begin CHARACTERISTIC TQ_V_TPI_HLD_PPS_TM "Tip in hold pedal position time threshold." VALUE 0x0002038C __UWORD_S 0 u_2x_tmr 0 1023.984375 /end CHARACTERISTIC
/begin CHARACTERISTIC TQ_V_TPI_HLD_PPS "Tip in hold pedal position threshold." VALUE 0x0002038C __UWORD_S 0 u_pct 0 199.996948242187 /end CHARACTERISTIC
/begin CHARACTERISTIC TQ_V_TPI_HLD_VSPD "Tip in hold vehicle speed threshold." VALUE 0x0002038C __UWORD_S 0 u_vspd 0 511.9921875 FORMAT "%4.1" /end CHARACTERISTIC
/begin CHARACTERISTIC TQ_V_TPI_ENBL_ALL_SRC "Tip in function is enable in all torque source." VALUE 0x0002038C __UBYTE_S 0 b_true 0 1 FORMAT "%1.0" /end CHARACTERISTIC
/begin CHARACTERISTIC TQ_V_TPI_LVSPD_HI "Low vehicle speed coast conditions high threshold." VALUE 0x0002038C __UWORD_S 0 u_vspd 0 511.9921875 FORMAT "%4.1" /end CHARACTERISTIC
/begin CHARACTERISTIC TQ_V_TPI_LVSPD_LO "Low vehicle speed coast conditions low threshold." VALUE 0x0002038C __UWORD_S 0 u_vspd 0 511.9921875 FORMAT "%4.1" /end CHARACTERISTIC
/begin CHARACTERISTIC TQ_V_TPI_DSBL_FAC_AXIS "Tip in disable torque temperature factor table axis selection.True:intake temperature.False:ambient air density correction." VALUE 0x0002038C __UBYTE_S 0 b_true 0 1 FORMAT "%1.0" /end CHARACTERISTIC
/begin CHARACTERISTIC TQ_M_TPI_DSBL_FAC_T "Tip in disable torque temperature factor." MAP 0x00020320 __UBYTE_S 0 u_fac_2_b 0 1.9921875 FORMAT "%4.3" SYMBOL_LINK "TQ_M_TPI_DSBL_FAC_T" 3
 /begin AXIS_DESCR FIX_AXIS tq_veh_gr_st u_tq_gr_typ 8 0 7 /begin FIX_AXIS_PAR_LIST 0 1 2 3 4 5 6 7 /end FIX_AXIS_PAR_LIST /end AXIS_DESCR
 /begin AXIS_DESCR FIX_AXIS NO_INPUT_QUANTITY u_cnts 7 0 6 /begin FIX_AXIS_PAR_LIST 0 1 2 3 4 5 6 /end FIX_AXIS_PAR_LIST /end AXIS_DESCR
/end CHARACTERISTIC
/begin AXIS_PTS TQ_X_TPI_ESPD "Tip in enable torque engine speed breakpoint" 0x0002006C sys_eng_spd SSV__UWORD_S 0 u_espd 7 0 8191.875000 FORMAT "%5.1" DEPOSIT ABSOLUTE SYMBOL_LINK "TQ_X_TPI_ESPD" 2 /end AXIS_PTS
/begin CHARACTERISTIC TQ_M_TPI_ENBL_G1 "Tip in enable torque in gear 1 and reverse gear." MAP 0x00020320 __SWORD_S 0 u_tq -2048 2047.9375 FORMAT "%5.2" SYMBOL_LINK "TQ_M_TPI_ENBL_G1" 4
 /begin AXIS_DESCR COM_AXIS sys_eng_spd u_espd 7 0 8191.875000 AXIS_PTS_REF TQ_X_TPI_ESPD /end AXIS_DESCR
 /begin AXIS_DESCR COM_AXIS tq_vr_pps u_pct 5 0 199.996948242187 AXIS_PTS_REF TQ_X_PPS_FILT /end AXIS_DESCR
/end CHARACTERISTIC
/begin CHARACTERISTIC TQ_M_TPI_ENBL_G2 "Tip in enable torque in gear 2." MAP 0x00020320 __SWORD_S 0 u_tq -2048 2047.9375 FORMAT "%5.2" SYMBOL_LINK "TQ_M_TPI_ENBL_G2" 4
 /begin AXIS_DESCR COM_AXIS sys_eng_spd u_espd 7 0 8191.875000 AXIS_PTS_REF TQ_X_TPI_ESPD /end AXIS_DESCR
 /begin AXIS_DESCR COM_AXIS tq_vr_pps u_pct 5 0 199.996948242187 AXIS_PTS_REF TQ_X_PPS_FILT /end AXIS_DESCR
/end CHARACTERISTIC
/begin CHARACTERISTIC TQ_M_TPI_ENBL_G3 "Tip in enable torque in gear 3." MAP 0x00020320 __SWORD_S 0 u_tq -2048 2047.9375 FORMAT "%5.2" SYMBOL_LINK "TQ_M_TPI_ENBL_G3" 4
 /begin AXIS_DESCR COM_AXIS sys_eng_spd u_espd 7 0 8191.875000 AXIS_PTS_REF TQ_X_TPI_ESPD /end AXIS_DESCR
 /begin AXIS_DESCR COM_AXIS tq_vr_pps u_pct 5 0 199.996948242187 AXIS_PTS_REF TQ_X_PPS_FILT /end AXIS_DESCR
/end CHARACTERISTIC
/begin CHARACTERISTIC TQ_M_TPI_ENBL_G4 "Tip in enable torque in gear 4." MAP 0x00020320 __SWORD_S 0 u_tq -2048 2047.9375 FORMAT "%5.2" SYMBOL_LINK "TQ_M_TPI_ENBL_G4" 4
 /begin AXIS_DESCR COM_AXIS sys_eng_spd u_espd 7 0 8191.875000 AXIS_PTS_REF TQ_X_TPI_ESPD /end AXIS_DESCR
 /begin AXIS_DESCR COM_AXIS tq_vr_pps u_pct 5 0 199.996948242187 AXIS_PTS_REF TQ_X_PPS_FILT /end AXIS_DESCR
/end CHARACTERISTIC
/begin CHARACTERISTIC TQ_M_TPI_ENBL_G5 "Tip in enable torque in gear 5." MAP 0x00020320 __SWORD_S 0 u_tq -2048 2047.9375 FORMAT "%5.2" SYMBOL_LINK "TQ_M_TPI_ENBL_G5" 4
 /begin AXIS_DESCR COM_AXIS sys_eng_spd u_espd 7 0 8191.875000 AXIS_PTS_REF TQ_X_TPI_ESPD /end AXIS_DESCR
 /begin AXIS_DESCR COM_AXIS tq_vr_pps u_pct 5 0 199.996948242187 AXIS_PTS_REF TQ_X_PPS_FILT /end AXIS_DESCR
/end CHARACTERISTIC
/begin CHARACTERISTIC TQ_M_TPI_ENBL_G6 "Tip in enable torque in gear 6." MAP 0x00020320 __SWORD_S 0 u_tq -2048 2047.9375 FORMAT "%5.2" SYMBOL_LINK "TQ_M_TPI_ENBL_G6" 4
 /begin AXIS_DESCR COM_AXIS sys_eng_spd u_espd 7 0 8191.875000 AXIS_PTS_REF TQ_X_TPI_ESPD /end AXIS_DESCR
 /begin AXIS_DESCR COM_AXIS tq_vr_pps u_pct 5 0 199.996948242187 AXIS_PTS_REF TQ_X_PPS_FILT /end AXIS_DESCR
/end CHARACTERISTIC
/begin CHARACTERISTIC TQ_M_TPI_ENBL_G7 "Tip in enable torque in gear 7." MAP 0x00020320 __SWORD_S 0 u_tq -2048 2047.9375 FORMAT "%5.2" SYMBOL_LINK "TQ_M_TPI_ENBL_G7" 4
 /begin AXIS_DESCR COM_AXIS sys_eng_spd u_espd 7 0 8191.875000 AXIS_PTS_REF TQ_X_TPI_ESPD /end AXIS_DESCR
 /begin AXIS_DESCR COM_AXIS tq_vr_pps u_pct 5 0 199.996948242187 AXIS_PTS_REF TQ_X_PPS_FILT /end AXIS_DESCR
/end CHARACTERISTIC
/begin CHARACTERISTIC TQ_M_TPI_ENBL_G8 "Tip in enable torque in gear 8." MAP 0x00020320 __SWORD_S 0 u_tq -2048 2047.9375 FORMAT "%5.2" SYMBOL_LINK "TQ_M_TPI_ENBL_G8" 4
 /begin AXIS_DESCR COM_AXIS sys_eng_spd u_espd 7 0 8191.875000 AXIS_PTS_REF TQ_X_TPI_ESPD /end AXIS_DESCR
 /begin AXIS_DESCR COM_AXIS tq_vr_pps u_pct 5 0 199.996948242187 AXIS_PTS_REF TQ_X_PPS_FILT /end AXIS_DESCR
/end CHARACTERISTIC
/begin CHARACTERISTIC TQ_M_TPI_ENBL_PN "Tip in enable torque in gear PN." MAP 0x00020320 __SWORD_S 0 u_tq -2048 2047.9375 FORMAT "%5.2" SYMBOL_LINK "TQ_M_TPI_ENBL_PN" 4
 /begin AXIS_DESCR COM_AXIS sys_eng_spd u_espd 7 0 8191.875000 AXIS_PTS_REF TQ_X_TPI_ESPD /end AXIS_DESCR
 /begin AXIS_DESCR COM_AXIS tq_vr_pps u_pct 5 0 199.996948242187 AXIS_PTS_REF TQ_X_PPS_FILT /end AXIS_DESCR
/end CHARACTERISTIC
/begin CHARACTERISTIC TQ_M_TPI_DSBL_G1 "Tip in enable torque in gear 1 and reverse gear." MAP 0x00020320 __SWORD_S 0 u_tq -2048 2047.9375 FORMAT "%5.2" SYMBOL_LINK "TQ_M_TPI_DSBL_G1" 4
 /begin AXIS_DESCR COM_AXIS sys_eng_spd u_espd 7 0 8191.875000 AXIS_PTS_REF TQ_X_TPI_ESPD /end AXIS_DESCR
 /begin AXIS_DESCR COM_AXIS tq_vr_pps u_pct 5 0 199.996948242187 AXIS_PTS_REF TQ_X_PPS_FILT /end AXIS_DESCR
/end CHARACTERISTIC
/begin CHARACTERISTIC TQ_M_TPI_DSBL_G2 "Tip in enable torque in gear 2." MAP 0x00020320 __SWORD_S 0 u_tq -2048 2047.9375 FORMAT "%5.2" SYMBOL_LINK "TQ_M_TPI_DSBL_G2" 4
 /begin AXIS_DESCR COM_AXIS sys_eng_spd u_espd 7 0 8191.875000 AXIS_PTS_REF TQ_X_TPI_ESPD /end AXIS_DESCR
 /begin AXIS_DESCR COM_AXIS tq_vr_pps u_pct 5 0 199.996948242187 AXIS_PTS_REF TQ_X_PPS_FILT /end AXIS_DESCR
/end CHARACTERISTIC
/begin CHARACTERISTIC TQ_M_TPI_DSBL_G3 "Tip in enable torque in gear 3." MAP 0x00020320 __SWORD_S 0 u_tq -2048 2047.9375 FORMAT "%5.2" SYMBOL_LINK "TQ_M_TPI_DSBL_G3" 4
 /begin AXIS_DESCR COM_AXIS sys_eng_spd u_espd 7 0 8191.875000 AXIS_PTS_REF TQ_X_TPI_ESPD /end AXIS_DESCR
 /begin AXIS_DESCR COM_AXIS tq_vr_pps u_pct 5 0 199.996948242187 AXIS_PTS_REF TQ_X_PPS_FILT /end AXIS_DESCR
/end CHARACTERISTIC
/begin CHARACTERISTIC TQ_M_TPI_DSBL_G4 "Tip in enable torque in gear 4." MAP 0x00020320 __SWORD_S 0 u_tq -2048 2047.9375 FORMAT "%5.2" SYMBOL_LINK "TQ_M_TPI_DSBL_G4" 4
 /begin AXIS_DESCR COM_AXIS sys_eng_spd u_espd 7 0 8191.875000 AXIS_PTS_REF TQ_X_TPI_ESPD /end AXIS_DESCR
 /begin AXIS_DESCR COM_AXIS tq_vr_pps u_pct 5 0 199.996948242187 AXIS_PTS_REF TQ_X_PPS_FILT /end AXIS_DESCR
/end CHARACTERISTIC
/begin CHARACTERISTIC TQ_M_TPI_DSBL_G5 "Tip in enable torque in gear 5." MAP 0x00020320 __SWORD_S 0 u_tq -2048 2047.9375 FORMAT "%5.2" SYMBOL_LINK "TQ_M_TPI_DSBL_G5" 4
 /begin AXIS_DESCR COM_AXIS sys_eng_spd u_espd 7 0 8191.875000 AXIS_PTS_REF TQ_X_TPI_ESPD /end AXIS_DESCR
 /begin AXIS_DESCR COM_AXIS tq_vr_pps u_pct 5 0 199.996948242187 AXIS_PTS_REF TQ_X_PPS_FILT /end AXIS_DESCR
/end CHARACTERISTIC
/begin CHARACTERISTIC TQ_M_TPI_DSBL_G6 "Tip in enable torque in gear 6." MAP 0x00020320 __SWORD_S 0 u_tq -2048 2047.9375 FORMAT "%5.2" SYMBOL_LINK "TQ_M_TPI_DSBL_G6" 4
 /begin AXIS_DESCR COM_AXIS sys_eng_spd u_espd 7 0 8191.875000 AXIS_PTS_REF TQ_X_TPI_ESPD /end AXIS_DESCR
 /begin AXIS_DESCR COM_AXIS tq_vr_pps u_pct 5 0 199.996948242187 AXIS_PTS_REF TQ_X_PPS_FILT /end AXIS_DESCR
/end CHARACTERISTIC
/begin CHARACTERISTIC TQ_M_TPI_DSBL_G7 "Tip in enable torque in gear 7." MAP 0x00020320 __SWORD_S 0 u_tq -2048 2047.9375 FORMAT "%5.2" SYMBOL_LINK "TQ_M_TPI_DSBL_G7" 4
 /begin AXIS_DESCR COM_AXIS sys_eng_spd u_espd 7 0 8191.875000 AXIS_PTS_REF TQ_X_TPI_ESPD /end AXIS_DESCR
 /begin AXIS_DESCR COM_AXIS tq_vr_pps u_pct 5 0 199.996948242187 AXIS_PTS_REF TQ_X_PPS_FILT /end AXIS_DESCR
/end CHARACTERISTIC
/begin CHARACTERISTIC TQ_M_TPI_DSBL_G8 "Tip in enable torque in gear 8." MAP 0x00020320 __SWORD_S 0 u_tq -2048 2047.9375 FORMAT "%5.2" SYMBOL_LINK "TQ_M_TPI_DSBL_G8" 4
 /begin AXIS_DESCR COM_AXIS sys_eng_spd u_espd 7 0 8191.875000 AXIS_PTS_REF TQ_X_TPI_ESPD /end AXIS_DESCR
 /begin AXIS_DESCR COM_AXIS tq_vr_pps u_pct 5 0 199.996948242187 AXIS_PTS_REF TQ_X_PPS_FILT /end AXIS_DESCR
/end CHARACTERISTIC
/begin CHARACTERISTIC TQ_M_TPI_DSBL_PN "Tip in enable torque in gear PN." MAP 0x00020320 __SWORD_S 0 u_tq -2048 2047.9375 FORMAT "%5.2" SYMBOL_LINK "TQ_M_TPI_DSBL_PN" 4
 /begin AXIS_DESCR COM_AXIS sys_eng_spd u_espd 7 0 8191.875000 AXIS_PTS_REF TQ_X_TPI_ESPD /end AXIS_DESCR
 /begin AXIS_DESCR COM_AXIS tq_vr_pps u_pct 5 0 199.996948242187 AXIS_PTS_REF TQ_X_PPS_FILT /end AXIS_DESCR
/end CHARACTERISTIC
/begin CHARACTERISTIC TQ_M_TPI_ENBL_BIAS_AC "Tip in enable torque AC bias,only used when AC on." MAP 0x00020320 __SWORD_S 0 u_tq -2048 2047.9375 FORMAT "%5.2"
 /begin AXIS_DESCR FIX_AXIS tq_veh_gr_st u_tq_gr_typ 11 0 10 /begin FIX_AXIS_PAR_LIST 0 1 2 3 4 5 6 7 8 9 10 /end FIX_AXIS_PAR_LIST /end AXIS_DESCR
 /begin AXIS_DESCR COM_AXIS sys_eng_spd u_espd 7 0 8191.875000 AXIS_PTS_REF TQ_X_TPI_ESPD /end AXIS_DESCR
/end CHARACTERISTIC
/begin CHARACTERISTIC TQ_M_TPI_DSBL_BIAS_AC "Tip in disable torque AC bias,only used when AC on." MAP 0x00020320 __SWORD_S 0 u_tq -2048 2047.9375 FORMAT "%5.2"
 /begin AXIS_DESCR FIX_AXIS tq_veh_gr_st u_tq_gr_typ 11 0 10 /begin FIX_AXIS_PAR_LIST 0 1 2 3 4 5 6 7 8 9 10 /end FIX_AXIS_PAR_LIST /end AXIS_DESCR
 /begin AXIS_DESCR COM_AXIS sys_eng_spd u_espd 7 0 8191.875000 AXIS_PTS_REF TQ_X_TPI_ESPD /end AXIS_DESCR
/end CHARACTERISTIC
/begin CHARACTERISTIC TQ_C_TPI_ENBL_FAC_SPRT "Tip in enable torque factor in sport mode.(non-forward gear lookup gear 1 item)." CURVE 0x2A3EC __UWORD_S 0 u_fac_2 0 1.999969482421875 FORMAT "%4.3"
 /begin AXIS_DESCR FIX_AXIS NO_INPUT_QUANTITY u_tq_gr_typ 8 0 7 /begin FIX_AXIS_PAR_LIST 0 1 2 3 4 5 6 7 /end FIX_AXIS_PAR_LIST /end AXIS_DESCR
/end CHARACTERISTIC
/begin CHARACTERISTIC TQ_C_TPI_DSBL_FAC_SPRT "Tip in disable torque factor in sport mode.(non-forward gear lookup gear 1 item)." CURVE 0x2A3EC __UWORD_S 0 u_fac_2 0 1.999969482421875 FORMAT "%4.3"
 /begin AXIS_DESCR FIX_AXIS NO_INPUT_QUANTITY u_tq_gr_typ 8 0 7 /begin FIX_AXIS_PAR_LIST 0 1 2 3 4 5 6 7 /end FIX_AXIS_PAR_LIST /end AXIS_DESCR
/end CHARACTERISTIC
/begin CHARACTERISTIC TQ_M_TPI_PDSBL_G1 "Tip in post disable torque in gear 1 and non-forward gear." MAP 0x00020320 __SWORD_S 0 u_tq -2048 2047.9375 FORMAT "%5.2" SYMBOL_LINK "TQ_M_TPI_PDSBL_G1" 4
 /begin AXIS_DESCR COM_AXIS sys_eng_spd u_espd 7 0 8191.875000 AXIS_PTS_REF TQ_X_TPI_ESPD /end AXIS_DESCR
 /begin AXIS_DESCR COM_AXIS tq_vr_pps u_pct 5 0 199.996948242187 AXIS_PTS_REF TQ_X_PPS_FILT /end AXIS_DESCR
/end CHARACTERISTIC
/begin CHARACTERISTIC TQ_V_TPI_PDSBL_FAC_SPRT "Tip in post disable torque factor in sport mode.Only used in gear 1 and non-forward gear." VALUE 0x0002038C __UWORD_S 0 u_fac_2 0 1.999969482421875 FORMAT "%4.3" /end CHARACTERISTIC
/begin CHARACTERISTIC TQ_C_TPI_VSPD_MN "Tip in enable min vehicle speed." CURVE 0x2A3EC __UWORD_S 0 u_vspd 0 511.9921875 FORMAT "%4.1"
 /begin AXIS_DESCR FIX_AXIS NO_INPUT_QUANTITY u_gr_mod 2 0 1 /begin FIX_AXIS_PAR_LIST 0 1 /end FIX_AXIS_PAR_LIST /end AXIS_DESCR
/end CHARACTERISTIC
/begin CHARACTERISTIC TQ_V_TPI_PN_ENBL "Tip in control is enabled in PN gear,if it is false,tip in control is disabled in PN gear." VALUE 0x0002038C __UBYTE_S 0 b_true 0 1 FORMAT "%1.0" /end CHARACTERISTIC
/begin CHARACTERISTIC TQ_V_TPI_SHFT_ENBL "Tip in control is enabled when transimission shifting,if it is false,tip in control is disabled when transimission shifting." VALUE 0x0002038C __UBYTE_S 0 b_true 0 1 FORMAT "%1.0" /end CHARACTERISTIC
/begin CHARACTERISTIC TQ_V_TPI_CLTCH_EN "Tip in control is only enabled when clutch released if it is true.Or tip in control is enabled all clutch states when it is false." VALUE 0x0002038C __UBYTE_S 0 b_true 0 1 FORMAT "%1.0" /end CHARACTERISTIC
/begin CHARACTERISTIC TQ_V_TPI_LCH_DSBL "Tip in control is disabled when launch state is met in MT vehicle." VALUE 0x0002038C __UBYTE_S 0 b_true 0 1 FORMAT "%1.0" /end CHARACTERISTIC
/begin AXIS_PTS TQ_X_TPI_RMP_STP "Tip in ramp step breakpoint" 0x0002006C tq_flyw_torq_raw_sp SSV__SWORD_S 0 u_tq 11 -2048 2047.9375 FORMAT "%5.2" DEPOSIT ABSOLUTE SYMBOL_LINK "TQ_X_TPI_RMP_STP" 2 /end AXIS_PTS
/begin CHARACTERISTIC TQ_M_TPI_RMP_STP_G1 "Tip in ramp step in gear 1." MAP 0x00020320 __SWORD_S 0 u_tq -2048 2047.9375 FORMAT "%5.2" SYMBOL_LINK "TQ_M_TPI_RMP_STP_G1" 4
 /begin AXIS_DESCR COM_AXIS tq_flyw_torq_raw_sp u_tq 11 -2048 2047.9375 AXIS_PTS_REF TQ_X_TPI_RMP_STP /end AXIS_DESCR
 /begin AXIS_DESCR FIX_AXIS sys_eng_spd u_espd 11 0 8191.875000
  /begin FIX_AXIS_PAR_LIST 6400 9600 12800 16000 19200 22400 25600 28800 32000 35200 38400 /end FIX_AXIS_PAR_LIST
 /end AXIS_DESCR
/end CHARACTERISTIC
/begin CHARACTERISTIC TQ_M_TPI_RMP_STP_G2 "Tip in ramp step in gear 2." MAP 0x00020320 __SWORD_S 0 u_tq -2048 2047.9375 FORMAT "%5.2" SYMBOL_LINK "TQ_M_TPI_RMP_STP_G2" 4
 /begin AXIS_DESCR COM_AXIS tq_flyw_torq_raw_sp u_tq 11 -2048 2047.9375 AXIS_PTS_REF TQ_X_TPI_RMP_STP /end AXIS_DESCR
 /begin AXIS_DESCR FIX_AXIS sys_eng_spd u_espd 11 0 8191.875000
  /begin FIX_AXIS_PAR_LIST 6400 9600 12800 16000 19200 22400 25600 28800 32000 35200 38400 /end FIX_AXIS_PAR_LIST
 /end AXIS_DESCR
/end CHARACTERISTIC
/begin CHARACTERISTIC TQ_M_TPI_RMP_STP_G3 "Tip in ramp step in gear 3." MAP 0x00020320 __SWORD_S 0 u_tq -2048 2047.9375 FORMAT "%5.2" SYMBOL_LINK "TQ_M_TPI_RMP_STP_G3" 4
 /begin AXIS_DESCR COM_AXIS tq_flyw_torq_raw_sp u_tq 11 -2048 2047.9375 AXIS_PTS_REF TQ_X_TPI_RMP_STP /end AXIS_DESCR
 /begin AXIS_DESCR FIX_AXIS sys_eng_spd u_espd 11 0 8191.875000
  /begin FIX_AXIS_PAR_LIST 6400 9600 12800 16000 19200 22400 25600 28800 32000 35200 38400 /end FIX_AXIS_PAR_LIST
 /end AXIS_DESCR
/end CHARACTERISTIC
/begin CHARACTERISTIC TQ_M_TPI_RMP_STP_G4 "Tip in ramp step in gear 4." MAP 0x00020320 __SWORD_S 0 u_tq -2048 2047.9375 FORMAT "%5.2" SYMBOL_LINK "TQ_M_TPI_RMP_STP_G4" 4
 /begin AXIS_DESCR COM_AXIS tq_flyw_torq_raw_sp u_tq 11 -2048 2047.9375 AXIS_PTS_REF TQ_X_TPI_RMP_STP /end AXIS_DESCR
 /begin AXIS_DESCR FIX_AXIS sys_eng_spd u_espd 11 0 8191.875000
  /begin FIX_AXIS_PAR_LIST 6400 9600 12800 16000 19200 22400 25600 28800 32000 35200 38400 /end FIX_AXIS_PAR_LIST
 /end AXIS_DESCR
/end CHARACTERISTIC
/begin CHARACTERISTIC TQ_M_TPI_RMP_STP_G5 "Tip in ramp step in gear 5." MAP 0x00020320 __SWORD_S 0 u_tq -2048 2047.9375 FORMAT "%5.2" SYMBOL_LINK "TQ_M_TPI_RMP_STP_G5" 4
 /begin AXIS_DESCR COM_AXIS tq_flyw_torq_raw_sp u_tq 11 -2048 2047.9375 AXIS_PTS_REF TQ_X_TPI_RMP_STP /end AXIS_DESCR
 /begin AXIS_DESCR FIX_AXIS sys_eng_spd u_espd 11 0 8191.875000
  /begin FIX_AXIS_PAR_LIST 6400 9600 12800 16000 19200 22400 25600 28800 32000 35200 38400 /end FIX_AXIS_PAR_LIST
 /end AXIS_DESCR
/end CHARACTERISTIC
/begin CHARACTERISTIC TQ_M_TPI_RMP_STP_G6 "Tip in ramp step in gear 6." MAP 0x00020320 __SWORD_S 0 u_tq -2048 2047.9375 FORMAT "%5.2" SYMBOL_LINK "TQ_M_TPI_RMP_STP_G6" 4
 /begin AXIS_DESCR COM_AXIS tq_flyw_torq_raw_sp u_tq 11 -2048 2047.9375 AXIS_PTS_REF TQ_X_TPI_RMP_STP /end AXIS_DESCR
 /begin AXIS_DESCR FIX_AXIS sys_eng_spd u_espd 11 0 8191.875000
  /begin FIX_AXIS_PAR_LIST 6400 9600 12800 16000 19200 22400 25600 28800 32000 35200 38400 /end FIX_AXIS_PAR_LIST
 /end AXIS_DESCR
/end CHARACTERISTIC
/begin CHARACTERISTIC TQ_M_TPI_RMP_STP_G7 "Tip in ramp step in gear 7." MAP 0x00020320 __SWORD_S 0 u_tq -2048 2047.9375 FORMAT "%5.2" SYMBOL_LINK "TQ_M_TPI_RMP_STP_G7" 4
 /begin AXIS_DESCR COM_AXIS tq_flyw_torq_raw_sp u_tq 11 -2048 2047.9375 AXIS_PTS_REF TQ_X_TPI_RMP_STP /end AXIS_DESCR
 /begin AXIS_DESCR FIX_AXIS sys_eng_spd u_espd 11 0 8191.875000
  /begin FIX_AXIS_PAR_LIST 6400 9600 12800 16000 19200 22400 25600 28800 32000 35200 38400 /end FIX_AXIS_PAR_LIST
 /end AXIS_DESCR
/end CHARACTERISTIC
/begin CHARACTERISTIC TQ_M_TPI_RMP_STP_G8 "Tip in ramp step in gear 8." MAP 0x00020320 __SWORD_S 0 u_tq -2048 2047.9375 FORMAT "%5.2" SYMBOL_LINK "TQ_M_TPI_RMP_STP_G8" 4
 /begin AXIS_DESCR COM_AXIS tq_flyw_torq_raw_sp u_tq 11 -2048 2047.9375 AXIS_PTS_REF TQ_X_TPI_RMP_STP /end AXIS_DESCR
 /begin AXIS_DESCR FIX_AXIS sys_eng_spd u_espd 11 0 8191.875000
  /begin FIX_AXIS_PAR_LIST 6400 9600 12800 16000 19200 22400 25600 28800 32000 35200 38400 /end FIX_AXIS_PAR_LIST
 /end AXIS_DESCR
/end CHARACTERISTIC
/begin CHARACTERISTIC TQ_M_TPI_RMP_STP_PN "Tip in ramp step in gear PN." MAP 0x00020320 __SWORD_S 0 u_tq -2048 2047.9375 FORMAT "%5.2" SYMBOL_LINK "TQ_M_TPI_RMP_STP_PN" 4
 /begin AXIS_DESCR COM_AXIS tq_flyw_torq_raw_sp u_tq 11 -2048 2047.9375 AXIS_PTS_REF TQ_X_TPI_RMP_STP /end AXIS_DESCR
 /begin AXIS_DESCR FIX_AXIS sys_eng_spd u_espd 11 0 8191.875000
  /begin FIX_AXIS_PAR_LIST 6400 9600 12800 16000 19200 22400 25600 28800 32000 35200 38400 /end FIX_AXIS_PAR_LIST
 /end AXIS_DESCR
/end CHARACTERISTIC
/begin CHARACTERISTIC TQ_M_TPI_RMP_STP_G1_SPRT "Tip in ramp step in gear 1 in sport mode." MAP 0x00020320 __SWORD_S 0 u_tq -2048 2047.9375 FORMAT "%5.2" SYMBOL_LINK "TQ_M_TPI_RMP_STP_G1_SPRT" 4
 /begin AXIS_DESCR COM_AXIS tq_flyw_torq_raw_sp u_tq 11 -2048 2047.9375 AXIS_PTS_REF TQ_X_TPI_RMP_STP /end AXIS_DESCR
 /begin AXIS_DESCR FIX_AXIS sys_eng_spd u_espd 11 0 8191.875000
  /begin FIX_AXIS_PAR_LIST 6400 9600 12800 16000 19200 22400 25600 28800 32000 35200 38400 /end FIX_AXIS_PAR_LIST
 /end AXIS_DESCR
/end CHARACTERISTIC
/begin CHARACTERISTIC TQ_M_TPI_RMP_STP_G2_SPRT "Tip in ramp step in gear 2 in sport mode." MAP 0x00020320 __SWORD_S 0 u_tq -2048 2047.9375 FORMAT "%5.2" SYMBOL_LINK "TQ_M_TPI_RMP_STP_G2_SPRT" 4
 /begin AXIS_DESCR COM_AXIS tq_flyw_torq_raw_sp u_tq 11 -2048 2047.9375 AXIS_PTS_REF TQ_X_TPI_RMP_STP /end AXIS_DESCR
 /begin AXIS_DESCR FIX_AXIS sys_eng_spd u_espd 11 0 8191.875000
  /begin FIX_AXIS_PAR_LIST 6400 9600 12800 16000 19200 22400 25600 28800 32000 35200 38400 /end FIX_AXIS_PAR_LIST
 /end AXIS_DESCR
/end CHARACTERISTIC
/begin CHARACTERISTIC TQ_M_TPI_RMP_STP_G3_SPRT "Tip in ramp step in gear 3 in sport mode." MAP 0x00020320 __SWORD_S 0 u_tq -2048 2047.9375 FORMAT "%5.2" SYMBOL_LINK "TQ_M_TPI_RMP_STP_G3_SPRT" 4
 /begin AXIS_DESCR COM_AXIS tq_flyw_torq_raw_sp u_tq 11 -2048 2047.9375 AXIS_PTS_REF TQ_X_TPI_RMP_STP /end AXIS_DESCR
 /begin AXIS_DESCR FIX_AXIS sys_eng_spd u_espd 11 0 8191.875000
  /begin FIX_AXIS_PAR_LIST 6400 9600 12800 16000 19200 22400 25600 28800 32000 35200 38400 /end FIX_AXIS_PAR_LIST
 /end AXIS_DESCR
/end CHARACTERISTIC
/begin CHARACTERISTIC TQ_M_TPI_RMP_STP_G4_SPRT "Tip in ramp step in gear 4 in sport mode." MAP 0x00020320 __SWORD_S 0 u_tq -2048 2047.9375 FORMAT "%5.2" SYMBOL_LINK "TQ_M_TPI_RMP_STP_G4_SPRT" 4
 /begin AXIS_DESCR COM_AXIS tq_flyw_torq_raw_sp u_tq 11 -2048 2047.9375 AXIS_PTS_REF TQ_X_TPI_RMP_STP /end AXIS_DESCR
 /begin AXIS_DESCR FIX_AXIS sys_eng_spd u_espd 11 0 8191.875000
  /begin FIX_AXIS_PAR_LIST 6400 9600 12800 16000 19200 22400 25600 28800 32000 35200 38400 /end FIX_AXIS_PAR_LIST
 /end AXIS_DESCR
/end CHARACTERISTIC
/begin CHARACTERISTIC TQ_M_TPI_RMP_STP_G5_SPRT "Tip in ramp step in gear 5 in sport mode." MAP 0x00020320 __SWORD_S 0 u_tq -2048 2047.9375 FORMAT "%5.2" SYMBOL_LINK "TQ_M_TPI_RMP_STP_G5_SPRT" 4
 /begin AXIS_DESCR COM_AXIS tq_flyw_torq_raw_sp u_tq 11 -2048 2047.9375 AXIS_PTS_REF TQ_X_TPI_RMP_STP /end AXIS_DESCR
 /begin AXIS_DESCR FIX_AXIS sys_eng_spd u_espd 11 0 8191.875000
  /begin FIX_AXIS_PAR_LIST 6400 9600 12800 16000 19200 22400 25600 28800 32000 35200 38400 /end FIX_AXIS_PAR_LIST
 /end AXIS_DESCR
/end CHARACTERISTIC
/begin CHARACTERISTIC TQ_M_TPI_RMP_STP_G6_SPRT "Tip in ramp step in gear 6 in sport mode." MAP 0x00020320 __SWORD_S 0 u_tq -2048 2047.9375 FORMAT "%5.2" SYMBOL_LINK "TQ_M_TPI_RMP_STP_G6_SPRT" 4
 /begin AXIS_DESCR COM_AXIS tq_flyw_torq_raw_sp u_tq 11 -2048 2047.9375 AXIS_PTS_REF TQ_X_TPI_RMP_STP /end AXIS_DESCR
 /begin AXIS_DESCR FIX_AXIS sys_eng_spd u_espd 11 0 8191.875000
  /begin FIX_AXIS_PAR_LIST 6400 9600 12800 16000 19200 22400 25600 28800 32000 35200 38400 /end FIX_AXIS_PAR_LIST
 /end AXIS_DESCR
/end CHARACTERISTIC
/begin CHARACTERISTIC TQ_M_TPI_RMP_STP_G7_SPRT "Tip in ramp step in gear 7 in sport mode." MAP 0x00020320 __SWORD_S 0 u_tq -2048 2047.9375 FORMAT "%5.2" SYMBOL_LINK "TQ_M_TPI_RMP_STP_G7_SPRT" 4
 /begin AXIS_DESCR COM_AXIS tq_flyw_torq_raw_sp u_tq 11 -2048 2047.9375 AXIS_PTS_REF TQ_X_TPI_RMP_STP /end AXIS_DESCR
 /begin AXIS_DESCR FIX_AXIS sys_eng_spd u_espd 11 0 8191.875000
  /begin FIX_AXIS_PAR_LIST 6400 9600 12800 16000 19200 22400 25600 28800 32000 35200 38400 /end FIX_AXIS_PAR_LIST
 /end AXIS_DESCR
/end CHARACTERISTIC
/begin CHARACTERISTIC TQ_M_TPI_RMP_STP_G8_SPRT "Tip in ramp step in gear 8 in sport mode." MAP 0x00020320 __SWORD_S 0 u_tq -2048 2047.9375 FORMAT "%5.2" SYMBOL_LINK "TQ_M_TPI_RMP_STP_G8_SPRT" 4
 /begin AXIS_DESCR COM_AXIS tq_flyw_torq_raw_sp u_tq 11 -2048 2047.9375 AXIS_PTS_REF TQ_X_TPI_RMP_STP /end AXIS_DESCR
 /begin AXIS_DESCR FIX_AXIS sys_eng_spd u_espd 11 0 8191.875000
  /begin FIX_AXIS_PAR_LIST 6400 9600 12800 16000 19200 22400 25600 28800 32000 35200 38400 /end FIX_AXIS_PAR_LIST
 /end AXIS_DESCR
/end CHARACTERISTIC
/begin CHARACTERISTIC TQ_V_TPI_LCH_VSPD "Tip in launch max vehicle speed." VALUE 0x0002038C __UWORD_S 0 u_vspd 0 511.9921875 FORMAT "%4.1" /end CHARACTERISTIC
/begin CHARACTERISTIC TQ_M_TPI_RMP_STP_BIAS_AC "Tip in ramp step bias when AC on." MAP 0x00020320 __SWORD_S 0 u_tq -2048 2047.9375 FORMAT "%5.2" SYMBOL_LINK "TQ_M_TPI_RMP_STP_BIAS_AC" 4
 /begin AXIS_DESCR COM_AXIS tq_flyw_torq_raw_sp u_tq 11 -2048 2047.9375 AXIS_PTS_REF TQ_X_TPI_RMP_STP /end AXIS_DESCR
 /begin AXIS_DESCR FIX_AXIS sys_eng_spd u_espd 11 0 8191.875000
  /begin FIX_AXIS_PAR_LIST 6400 9600 12800 16000 19200 22400 25600 28800 32000 35200 38400 /end FIX_AXIS_PAR_LIST
 /end AXIS_DESCR
/end CHARACTERISTIC
/begin CHARACTERISTIC TQ_C_TPI_RMP_STP_FAC_AC "Tip in ramp step factor." CURVE 0x2A3EC __UWORD_S 0 u_fac_8 0 7.9998779296875 FORMAT "%3.2"
 /begin AXIS_DESCR FIX_AXIS tq_veh_gr_st u_tq_gr_typ 11 0 10 /begin FIX_AXIS_PAR_LIST 0 1 2 3 4 5 6 7 8 9 10 /end FIX_AXIS_PAR_LIST /end AXIS_DESCR
/end CHARACTERISTIC
/begin CHARACTERISTIC TQ_C_TPI_RMP_STP_FAC "Tip in ramp step factor." CURVE 0x2A3EC __UWORD_S 0 u_fac_8 0 7.9998779296875 FORMAT "%3.2" SYMBOL_LINK "TQ_C_TPI_RMP_STP_FAC" 2
 /begin AXIS_DESCR FIX_AXIS NO_INPUT_QUANTITY u_2x_tmr 9 0 64 /begin FIX_AXIS_PAR_LIST 0 8 16 24 32 40 48 56 64 /end FIX_AXIS_PAR_LIST /end AXIS_DESCR
/end CHARACTERISTIC
/begin CHARACTERISTIC TQ_C_TPI_RMP_STP_FAC_CST "Tip in ramp step factor when coast condition met." CURVE 0x2A3EC __UWORD_S 0 u_fac_8 0 7.9998779296875 FORMAT "%3.2"
 /begin AXIS_DESCR FIX_AXIS NO_INPUT_QUANTITY u_tq_gr_typ 3 0 2 /begin FIX_AXIS_PAR_LIST 0 1 2 /end FIX_AXIS_PAR_LIST /end AXIS_DESCR
/end CHARACTERISTIC
/begin CHARACTERISTIC TQ_M_TPI_HLD_TM "Tip in hold time when hold allowed in gear 1." MAP 0x00020320 __UWORD_S 0 u_2x_tmr 0 1023.984375 SYMBOL_LINK "TQ_M_TPI_HLD_TM" 4
 /begin AXIS_DESCR COM_AXIS tq_vr_pps_dlt u_pct 5 0 199.996948242187 AXIS_PTS_REF TQ_X_PPS_DLT /end AXIS_DESCR
 /begin AXIS_DESCR COM_AXIS tq_vr_pps u_pct 5 0 199.996948242187 AXIS_PTS_REF TQ_X_PPS_FILT /end AXIS_DESCR
/end CHARACTERISTIC
/begin CHARACTERISTIC TQ_V_SHFT_TORQ_PPS_MX "Shifting torque control pedal position max limit." VALUE 0x0002038C __UWORD_S 0 u_pct 0 199.996948242187 /end CHARACTERISTIC
/begin CHARACTERISTIC TQ_V_SHFT_TORQ_PPS_MN "Shifting torque control pedal position min limit." VALUE 0x0002038C __UWORD_S 0 u_pct 0 199.996948242187 /end CHARACTERISTIC
/begin CHARACTERISTIC TQ_V_TPI_LCH_USE_G1 "Tip in filter gear use gear 1 when in launch condition." VALUE 0x0002038C __UBYTE_S 0 b_true 0 1 FORMAT "%1.0" /end CHARACTERISTIC
/begin CHARACTERISTIC TQ_M_TPI_FILTER "Tip in filter when AC off." MAP 0x00020320 __UWORD_S 0 u_filter 0 0.9999847412109375 FORMAT "%10.9"
 /begin AXIS_DESCR FIX_AXIS tq_veh_gr_st u_tq_gr_typ 11 0 10 /begin FIX_AXIS_PAR_LIST 0 1 2 3 4 5 6 7 8 9 10 /end FIX_AXIS_PAR_LIST /end AXIS_DESCR
 /begin AXIS_DESCR COM_AXIS tq_vr_pps u_pct 5 0 199.996948242187 AXIS_PTS_REF TQ_X_PPS_FILT /end AXIS_DESCR
/end CHARACTERISTIC
/begin CHARACTERISTIC TQ_M_TPI_FILTER_AC "Tip in filter when AC on." MAP 0x00020320 __UWORD_S 0 u_filter 0 0.9999847412109375 FORMAT "%10.9"
 /begin AXIS_DESCR FIX_AXIS tq_veh_gr_st u_tq_gr_typ 11 0 10 /begin FIX_AXIS_PAR_LIST 0 1 2 3 4 5 6 7 8 9 10 /end FIX_AXIS_PAR_LIST /end AXIS_DESCR
 /begin AXIS_DESCR COM_AXIS tq_vr_pps u_pct 5 0 199.996948242187 AXIS_PTS_REF TQ_X_PPS_FILT /end AXIS_DESCR
/end CHARACTERISTIC
/begin CHARACTERISTIC TQ_V_TPI_FILTER_FAC_IAT "Tip in filter factor enable IAT threshold.IAT<this cal,then enable factor." VALUE 0x0002038C __SWORD_S 0 u_deg_C -256 255.9921875 /end CHARACTERISTIC
/begin CHARACTERISTIC TQ_V_TPI_FILTER_FAC_SKTM "Tip in filter factor enable soaktime threshold.soaktime<this cal,then enable factor." VALUE 0x0002038C __UWORD_S 0 u_min 0 65535 /end CHARACTERISTIC
/begin CHARACTERISTIC TQ_M_TPI_FILTER_FAC "Tip in filter factor." MAP 0x00020320 __UWORD_S 0 u_fac_2 0 1.999969482421875 FORMAT "%4.3"
 /begin AXIS_DESCR FIX_AXIS NO_INPUT_QUANTITY u_tq_gr_typ 8 0 7 /begin FIX_AXIS_PAR_LIST 0 1 2 3 4 5 6 7 /end FIX_AXIS_PAR_LIST /end AXIS_DESCR
 /begin AXIS_DESCR FIX_AXIS sys_ect u_deg_C 6 -30 100 /begin FIX_AXIS_PAR_LIST -3840 0 3840 7680 11520 12800 /end FIX_AXIS_PAR_LIST /end AXIS_DESCR
/end CHARACTERISTIC
/begin CHARACTERISTIC TQ_C_TPI_FILTER_FAC_SPRT "Tip in filter factor when sport mode active." CURVE 0x2A3EC __UWORD_S 0 u_fac_2 0 1.999969482421875 FORMAT "%4.3"
 /begin AXIS_DESCR FIX_AXIS NO_INPUT_QUANTITY u_tq_gr_typ 8 0 7 /begin FIX_AXIS_PAR_LIST 0 1 2 3 4 5 6 7 /end FIX_AXIS_PAR_LIST /end AXIS_DESCR
/end CHARACTERISTIC
/begin CHARACTERISTIC TQ_V_TPI_LCH_NO_FILTER "True:Tip in filter is not used when launch condition met." VALUE 0x0002038C __UBYTE_S 0 b_true 0 1 FORMAT "%1.0" /end CHARACTERISTIC
/begin CHARACTERISTIC TQ_C_ADD_PUC "base additional torq when in PUC mode" CURVE 0x37FBC __SBYTE_S 0 u_tq_b -64 63.5 FORMAT "%3.1" SYMBOL_LINK "TQ_C_ADD_PUC" 2
 /begin AXIS_DESCR COM_AXIS ensc_espd_dev u_espd 19 -4096 4095.875 AXIS_PTS_REF TQ_X_ADD_ESPD_DEV /end AXIS_DESCR
/end CHARACTERISTIC
/begin AXIS_PTS TQ_X_ADD_ESPD_DEV "" 0x291C4 ensc_espd_dev SSV__SWORD_S 0 u_espd 19 -4096 4095.875 FORMAT "%6.2" DEPOSIT ABSOLUTE SYMBOL_LINK "TQ_X_ADD_ESPD_DEV" 2 /end AXIS_PTS
/begin CHARACTERISTIC TQ_C_ADD_PUC_MAX "max additional torq when PUC enable" CURVE 0x37FBC __UBYTE_S 0 u_tq_b_256 0 255 SYMBOL_LINK "TQ_C_ADD_PUC_MAX" 2
 /begin AXIS_DESCR COM_AXIS ensc_espd_dev u_espd 19 -4096 4095.875 AXIS_PTS_REF TQ_X_ADD_ESPD_DEV /end AXIS_DESCR
/end CHARACTERISTIC
/begin CHARACTERISTIC TQ_V_ADD_PUC_CFG "True means enable bias of additional torq when in PUC mode" VALUE 0x0002038C __UBYTE_S 0 b_true 0 1 FORMAT "%1.0" /end CHARACTERISTIC
/begin CHARACTERISTIC TQ_V_ADD_CLS_THRO_CFG "True means enable bias of additional torq when in close throttle mode" VALUE 0x0002038C __UBYTE_S 0 b_true 0 1 FORMAT "%1.0" /end CHARACTERISTIC
/begin CHARACTERISTIC TQ_C_ADD_CLS_THRO "base additional torq when in close throttle mode" CURVE 0x37FBC __SBYTE_S 0 u_tq_b -64 63.5 FORMAT "%3.1" SYMBOL_LINK "TQ_C_ADD_CLS_THRO" 2
 /begin AXIS_DESCR COM_AXIS ensc_espd_dev u_espd 19 -4096 4095.875 AXIS_PTS_REF TQ_X_ADD_ESPD_DEV /end AXIS_DESCR
/end CHARACTERISTIC
/begin CHARACTERISTIC TQ_C_ADD_CLS_THRO_MAX "max additional torq when PUC enable" CURVE 0x37FBC __UBYTE_S 0 u_tq_b_256 0 255 SYMBOL_LINK "TQ_C_ADD_CLS_THRO_MAX" 2
 /begin AXIS_DESCR COM_AXIS ensc_espd_dev u_espd 19 -4096 4095.875 AXIS_PTS_REF TQ_X_ADD_ESPD_DEV /end AXIS_DESCR
/end CHARACTERISTIC
/begin CHARACTERISTIC TQ_C_ADD_IDL_MAX "max additional torq when in idle mode" CURVE 0x37FBC __UBYTE_S 0 u_tq_b_256 0 255 SYMBOL_LINK "TQ_C_ADD_IDL_MAX" 2
 /begin AXIS_DESCR COM_AXIS ensc_espd_dev u_espd 19 -4096 4095.875 AXIS_PTS_REF TQ_X_ADD_ESPD_DEV_A /end AXIS_DESCR
/end CHARACTERISTIC
/begin AXIS_PTS TQ_X_ADD_ESPD_DEV_A "" 0x291C4 ensc_espd_dev SSV__SWORD_S 0 u_espd 19 -4096 4095.875 FORMAT "%6.2" DEPOSIT ABSOLUTE SYMBOL_LINK "TQ_X_ADD_ESPD_DEV_A" 2 /end AXIS_PTS
/begin CHARACTERISTIC TQ_C_ADD_IDL_MIN "min additional torq when in idle mode" CURVE 0x37FBC __UBYTE_S 0 u_tq_b 0 127.5 SYMBOL_LINK "TQ_C_ADD_IDL_MIN" 2
 /begin AXIS_DESCR COM_AXIS ensc_espd_dev u_espd 19 -4096 4095.875 AXIS_PTS_REF TQ_X_ADD_ESPD_DEV_A /end AXIS_DESCR
/end CHARACTERISTIC
/begin CHARACTERISTIC TQ_V_ADD_IDL_AC_BIAS "additional torq bias when AC clutch ON" VALUE 0x0002038C __SWORD_S 0 u_tq_1024 -1024 1023.96875 FORMAT "%6.2" /end CHARACTERISTIC
/begin CHARACTERISTIC TQ_V_ADD_IDL_AC_BIAS_TRANS "additional torq bias when AC conditions met but AC clutch OFF" VALUE 0x0002038C __SWORD_S 0 u_tq_1024 -1024 1023.96875 FORMAT "%6.2" /end CHARACTERISTIC
/begin CHARACTERISTIC TQ_C_ADD_IDL "additional torq when in idle mode with engine coolant temperature" CURVE 0x2A3EC __UBYTE_S 0 u_tq_b 0 127.5 SYMBOL_LINK "TQ_C_ADD_IDL" 2
 /begin AXIS_DESCR FIX_AXIS sys_ect u_deg_C 15 -40 128
  /begin FIX_AXIS_PAR_LIST -5120 -3584 -2048 -512 1024 2560 4096 5632 7168 8704 10240 11776 13312 14848 16384 /end FIX_AXIS_PAR_LIST
 /end AXIS_DESCR
/end CHARACTERISTIC
/begin CHARACTERISTIC TQ_C_ADD_IDL_IAT_BIAS "additional torq IAT bias" CURVE 0x37FBC __UBYTE_S 0 u_tq_b_32 0 31.875 SYMBOL_LINK "TQ_C_ADD_IDL_IAT_BIAS" 2
 /begin AXIS_DESCR COM_AXIS sys_iat u_deg_C 11 -256 255.9921875 AXIS_PTS_REF TQ_X_ADD_IAT /end AXIS_DESCR
/end CHARACTERISTIC
/begin AXIS_PTS TQ_X_ADD_IAT "axis of intake air temperature." 0x0002006C sys_iat SSV__SWORD_S 0 u_deg_C 11 -256 255.9921875 DEPOSIT ABSOLUTE SYMBOL_LINK "TQ_X_ADD_IAT" 2 /end AXIS_PTS
/begin CHARACTERISTIC TQ_C_ADD_AMP_BIAS "additional torq amp bias" CURVE 0x37FBC __SWORD_S 0 u_tq_256 -128 127.998046875 FORMAT "%5.2" SYMBOL_LINK "TQ_C_ADD_AMP_BIAS" 2
 /begin AXIS_DESCR COM_AXIS sys_amp u_kPa_0_256 5 0.000000 255.99609375 AXIS_PTS_REF TQ_X_ADD_AMP /end AXIS_DESCR
/end CHARACTERISTIC
/begin AXIS_PTS TQ_X_ADD_AMP "amp breakpoint" 0x0002006C sys_amp SSV__UWORD_S 0 u_kPa_0_256 5 0.000000 255.99609375 FORMAT "%4.1" DEPOSIT ABSOLUTE SYMBOL_LINK "TQ_X_ADD_AMP" 2 /end AXIS_PTS
/begin CHARACTERISTIC TQ_V_ADD_INC_STP_IDL "increase step of additional torq when in idle mode" VALUE 0x0002038C __SWORD_S 0 u_tq_1024 -1024 1023.96875 FORMAT "%6.2" /end CHARACTERISTIC
/begin CHARACTERISTIC TQ_C_ADD_DEC_STP_IDL "decrease step of additional torq when in idle mode" CURVE 0x37FBC __SWORD_S 0 u_tq_1024 -1024 1023.96875 FORMAT "%6.2" SYMBOL_LINK "TQ_C_ADD_DEC_STP_IDL" 2
 /begin AXIS_DESCR COM_AXIS NO_INPUT_QUANTITY u_fac_n4_p4 11 -4.000000 3.9998779296875 AXIS_PTS_REF TQ_X_ADD_RATIO /end AXIS_DESCR
/end CHARACTERISTIC
/begin AXIS_PTS TQ_X_ADD_RATIO "" 0x0002006C NO_INPUT_QUANTITY SSV__SWORD_S 0 u_fac_n4_p4 11 -4.000000 3.9998779296875 FORMAT "%5.4" DEPOSIT ABSOLUTE SYMBOL_LINK "TQ_X_ADD_RATIO" 2 /end AXIS_PTS
/begin CHARACTERISTIC TQ_V_ADD_INC_STP "increase step of additional torq" VALUE 0x0002038C __SWORD_S 0 u_tq_1024 -1024 1023.96875 FORMAT "%6.2" /end CHARACTERISTIC
/begin CHARACTERISTIC TQ_V_ADD_DEC_STP "decrease step of additional torq" VALUE 0x0002038C __SWORD_S 0 u_tq_1024 -1024 1023.96875 FORMAT "%6.2" /end CHARACTERISTIC
/begin CHARACTERISTIC TQ_V_ADD_IDL_DEC_DLY "decrease delay of additional torq when in idle mode" VALUE 0x0002038C __UWORD_S 0 u_2x_tmr 0.0 1023.984375 /end CHARACTERISTIC
/begin CHARACTERISTIC TQ_C_ADD_RMP_STP_FAC "factor used to calculate additional torq ramp step" CURVE 0x000200B0 __UWORD_S 0 u_fac_1 0 0.999984741210937 SYMBOL_LINK "TQ_C_ADD_RMP_STP_FAC" 2
 /begin AXIS_DESCR FIX_AXIS NO_INPUT_QUANTITY u_tq_1024 11 -16 16 /begin FIX_AXIS_PAR_LIST -512 -256 -128 -64 -32 0 32 64 128 256 512 /end FIX_AXIS_PAR_LIST /end AXIS_DESCR
/end CHARACTERISTIC
/begin CHARACTERISTIC TQ_C_ADD_MN_IDL_WRM "Minimum additional torque in idle warmup mode" CURVE 0x000200B0 __UBYTE_S 0 u_tq_b_256 0 255 FORMAT "%3.0" SYMBOL_LINK "TQ_C_ADD_MN_IDL_WRM" 2
 /begin AXIS_DESCR COM_AXIS ensc_espd_dev u_espd_n4096_p4096 19 -4096 4095.875 AXIS_PTS_REF TQ_X_ADD_ESPD_DEV_A /end AXIS_DESCR
/end CHARACTERISTIC
/begin AXIS_PTS TQ_X_ESPD_L "engine speed breakpoint" 0x0002006C sys_eng_spd SSV__UWORD_S 0 u_espd 13 0.000000 8191.875000 FORMAT "%5.1" DEPOSIT ABSOLUTE SYMBOL_LINK "TQ_X_ESPD_L" 2 /end AXIS_PTS
/begin CHARACTERISTIC TQ_V_ADD_PS_ACTV_TQ "Steady state additional torque when power steering is active for applications with set only a power steering pressure switch." VALUE 0x2DD38 __SWORD_S 0 u_tq_256 -128 127.998046875 FORMAT "%5.2" /end CHARACTERISTIC
/begin CHARACTERISTIC TQ_V_ADD_PS_INIT_TQ "Inital additional torque when power steering is active." VALUE 0x2DD38 __SWORD_S 0 u_tq_256 -128 127.998046875 FORMAT "%5.2" /end CHARACTERISTIC
/begin CHARACTERISTIC TQ_M_POC_DSBL_TPI "Reference period count after which the POC control is disabled within tip in mode." MAP 0x00020320 __UWORD_S 0 u_cnts 0 65535 FORMAT "%5.0"
 /begin AXIS_DESCR FIX_AXIS tq_veh_gr_st u_tq_gr_typ 11 0 10 /begin FIX_AXIS_PAR_LIST 0 1 2 3 4 5 6 7 8 9 10 /end FIX_AXIS_PAR_LIST /end AXIS_DESCR
 /begin AXIS_DESCR COM_AXIS sys_eng_spd u_espd 13 0 8191.875 AXIS_PTS_REF TQ_X_ESPD_L /end AXIS_DESCR
/end CHARACTERISTIC
/begin CHARACTERISTIC TQ_M_POC_DSBL_TPO "Reference period count after which the POC control is disabled within tip out mode." MAP 0x00020320 __UWORD_S 0 u_cnts 0 65535 FORMAT "%5.0"
 /begin AXIS_DESCR FIX_AXIS tq_veh_gr_st u_tq_gr_typ 11 0 10 /begin FIX_AXIS_PAR_LIST 0 1 2 3 4 5 6 7 8 9 10 /end FIX_AXIS_PAR_LIST /end AXIS_DESCR
 /begin AXIS_DESCR COM_AXIS sys_eng_spd u_espd 13 0 8191.875 AXIS_PTS_REF TQ_X_ESPD_L /end AXIS_DESCR
/end CHARACTERISTIC
/begin CHARACTERISTIC TQ_C_ADD_PS_ACTV_TQ "Steady state additional torque when power steering is active for applications with set only a power steering pressure sensor." CURVE 0x000200B0 __SWORD_S 0 u_tq_256 -128 127.998046875 FORMAT "%5.2" SYMBOL_LINK "TQ_C_ADD_PS_ACTV_TQ" 2
 /begin AXIS_DESCR COM_AXIS NO_INPUT_QUANTITY u_kPa_0_32768 5 0 32767.5 AXIS_PTS_REF ENSC_X_PS_P /end AXIS_DESCR
/end CHARACTERISTIC
/begin CHARACTERISTIC HYB_V_EXTC_STOP_DIS_CFG "hybrid auto stop disable by EXTC config" VALUE 0x0002038C __UBYTE_S 0 u_hyb_extc_dis_cfg 0 3 FORMAT "%1.0" /end CHARACTERISTIC
/begin CHARACTERISTIC EXTC_V_COP_CFG "catalyst overheating prevention configuration" VALUE 0x0002038C __UBYTE_S 0 b_enable 0 1 FORMAT "%5.2" /end CHARACTERISTIC
/begin CHARACTERISTIC EXTC_V_EXH_PROT_CFG "exh temp prevention configuration" VALUE 0x0002038C __UBYTE_S 0 b_enable 0 1 FORMAT "%5.2" /end CHARACTERISTIC
/begin CHARACTERISTIC EXTC_V_CAT_T_EGR_FAC "factor of EGR percent to calculate bias of CAT temp" VALUE 0x0002038C __UWORD_S 0 u_fac_16 0 15.999756 /end CHARACTERISTIC
/begin CHARACTERISTIC EXTC_V_CAT_HT_ECT_MIN "CAT heat enble ect min" VALUE 0x0002038C __SWORD_S 0 u_deg_C -256 255.9921875 /end CHARACTERISTIC
/begin CHARACTERISTIC EXTC_V_CAT_HT_ECT_MAX "CAT heat enble ect max" VALUE 0x0002038C __SWORD_S 0 u_deg_C -256 255.9921875 /end CHARACTERISTIC
/begin CHARACTERISTIC EXTC_V_CAT_HT_IAT_MIN "CAT heat enble iat min" VALUE 0x0002038C __SWORD_S 0 u_deg_C -256 255.9921875 /end CHARACTERISTIC
/begin CHARACTERISTIC EXTC_V_CAT_HT_IAT_MAX "CAT heat enble iat max" VALUE 0x0002038C __SWORD_S 0 u_deg_C -256 255.9921875 /end CHARACTERISTIC
/begin CHARACTERISTIC EXTC_V_HT_IG_EXT_ESPD "catalyst heat ignition exit engine speed" VALUE 0x0002038C __UWORD_S 0 u_espd 0 8191.875000 FORMAT "%6.2" /end CHARACTERISTIC
/begin CHARACTERISTIC EXTC_V_CAT_HI_DIS_ESPD "catalyst temp high disable engine speed" VALUE 0x0002038C __UWORD_S 0 u_espd 0 8191.875000 FORMAT "%6.2" /end CHARACTERISTIC
/begin CHARACTERISTIC EXTC_C_HT_EXT_INT_THR "cat heat exit int thr" CURVE 0x000200B0 __UWORD_S 0 u_cnts 0 65535 FORMAT "%5.0" SYMBOL_LINK "EXTC_C_HT_EXT_INT_THR" 2
 /begin AXIS_DESCR FIX_AXIS sys_ect u_deg_C 17 -40 120
  /begin FIX_AXIS_PAR_LIST -5120 -3840 -2560 -1280 0 1280 2560 3840 5120 6400 7680 8960 10240 11520 12800 14080 15360 /end FIX_AXIS_PAR_LIST
 /end AXIS_DESCR
/end CHARACTERISTIC
/begin CHARACTERISTIC EXTC_V_HT_INT_BIAS "CAT heat int ect bias" VALUE 0x0002038C __SWORD_S 0 u_deg_C -256 255.9921875 /end CHARACTERISTIC
/begin CHARACTERISTIC EXTC_V_HT_INT_FAC "cat heat int cal factor" VALUE 0x0002038C __UWORD_S 0 u_fac_2 0 1.999969482421875 FORMAT "%4.3" /end CHARACTERISTIC
/begin CHARACTERISTIC EXTC_V_HT_IG_EN_ESPD "catalyst heat ignition enable engine speed max" VALUE 0x0002038C __UWORD_S 0 u_espd 0 8191.875000 FORMAT "%6.2" /end CHARACTERISTIC
/begin CHARACTERISTIC EXTC_V_HT_IG_EN_VAC_HI "CAT heat ignition enable vacuum high" VALUE 0x0002038C __SWORD_S 0 u_kPa_128n_128p -128 127.99609375 /end CHARACTERISTIC
/begin CHARACTERISTIC EXTC_V_HT_IG_EN_VAC_LO "CAT heat ignition enable vacuum low" VALUE 0x0002038C __SWORD_S 0 u_kPa_128n_128p -128 127.99609375 /end CHARACTERISTIC
/begin CHARACTERISTIC EXTC_M_CAT_T_BASE "cat temp base" MAP 0x00020320 __SWORD_S 0 u_deg_C_n2048_p2048 -2048 2047.9375 SYMBOL_LINK "EXTC_M_CAT_T_BASE" 4
 /begin AXIS_DESCR FIX_AXIS tq_imep_ref u_kPa_0_4096 33 0 3200
  /begin FIX_AXIS_PAR_LIST 0 1600 3200 4800 6400 8000 9600 11200 12800 14400 16000 17600 19200 20800 22400 24000 25600 27200 28800 30400 32000 33600 35200 36800 38400 40000 41600 43200 44800 46400 48000 49600 51200 /end FIX_AXIS_PAR_LIST
 /end AXIS_DESCR
 /begin AXIS_DESCR FIX_AXIS sys_eng_spd u_espd 17 0 6400
  /begin FIX_AXIS_PAR_LIST 0 3200 6400 9600 12800 16000 19200 22400 25600 28800 32000 35200 38400 41600 44800 48000 51200 /end FIX_AXIS_PAR_LIST
 /end AXIS_DESCR
/end CHARACTERISTIC
/begin CHARACTERISTIC EXTC_C_CAT_T_AF_TRM "cat temp airfuel term" CURVE 0x000200B0 __SWORD_S 0 u_deg_C_n2048_p2048 -2048 2047.9375 SYMBOL_LINK "EXTC_C_CAT_T_AF_TRM" 2
 /begin AXIS_DESCR COM_AXIS fmsp_af_sp u_afr 17 0 31.99951171875 AXIS_PTS_REF EXTC_X_AF_A /end AXIS_DESCR
/end CHARACTERISTIC
/begin AXIS_PTS EXTC_X_AF_A "airfuel ratio breakpoint" 0x0002006C fmsp_af_sp SSV__UWORD_S 0 u_afr 17 0 31.99951171875 DEPOSIT ABSOLUTE SYMBOL_LINK "EXTC_X_AF_A" 2 /end AXIS_PTS
/begin CHARACTERISTIC EXTC_M_CAT_T_VSPD_TRM "cat temp vehicle speed term" MAP 0x00020320 __SWORD_S 0 u_deg_C_n2048_p2048 -2048 2047.9375 SYMBOL_LINK "EXTC_M_CAT_T_VSPD_TRM" 4
 /begin AXIS_DESCR FIX_AXIS sys_veh_spd u_vspd 17 0 256
  /begin FIX_AXIS_PAR_LIST 0 2048 4096 6144 8192 10240 12288 14336 16384 18432 20480 22528 24576 26624 28672 30720 32768 /end FIX_AXIS_PAR_LIST
 /end AXIS_DESCR
 /begin AXIS_DESCR COM_AXIS sys_iat u_deg_C 8 -256 255.9921875 AXIS_PTS_REF EXTC_X_IAT_A /end AXIS_DESCR
/end CHARACTERISTIC
/begin AXIS_PTS EXTC_X_IAT_A "axis of intake air temperature." 0x0002006C sys_iat SSV__SWORD_S 0 u_deg_C 8 -256 255.9921875 DEPOSIT ABSOLUTE SYMBOL_LINK "EXTC_X_IAT_A" 2 /end AXIS_PTS
/begin CHARACTERISTIC EXTC_C_CAT_T_DEC_FIL "cat temp decrease filter" CURVE 0x000200B0 __UWORD_S 0 u_filter 0 0.9999847412109375 FORMAT "%5.4" SYMBOL_LINK "EXTC_C_CAT_T_DEC_FIL" 2
 /begin AXIS_DESCR COM_AXIS afm_air_flw u_g_per_sec 17 0.000000 511.992188 AXIS_PTS_REF AFM_X_AIR_FLW_B /end AXIS_DESCR
/end CHARACTERISTIC
/begin CHARACTERISTIC EXTC_C_CAT_T_INC_FIL "cat temp increase filter" CURVE 0x000200B0 __UWORD_S 0 u_filter 0 0.9999847412109375 FORMAT "%5.4" SYMBOL_LINK "EXTC_C_CAT_T_INC_FIL" 2
 /begin AXIS_DESCR COM_AXIS afm_air_flw u_g_per_sec 17 0.000000 511.992188 AXIS_PTS_REF AFM_X_AIR_FLW_B /end AXIS_DESCR
/end CHARACTERISTIC
/begin CHARACTERISTIC EXTC_C_CAT_T_SP_DEC_FIL "cat temp setpoint decrease filter" CURVE 0x000200B0 __UWORD_S 0 u_filter 0 0.9999847412109375 FORMAT "%5.4" SYMBOL_LINK "EXTC_C_CAT_T_SP_DEC_FIL" 2
 /begin AXIS_DESCR COM_AXIS afm_air_flw u_g_per_sec 17 0.000000 511.992188 AXIS_PTS_REF AFM_X_AIR_FLW_B /end AXIS_DESCR
/end CHARACTERISTIC
/begin CHARACTERISTIC EXTC_C_CAT_T_SP_INC_FIL "cat temp setpoint increase filter" CURVE 0x000200B0 __UWORD_S 0 u_filter 0 0.9999847412109375 FORMAT "%5.4" SYMBOL_LINK "EXTC_C_CAT_T_SP_INC_FIL" 2
 /begin AXIS_DESCR COM_AXIS afm_air_flw u_g_per_sec 17 0.000000 511.992188 AXIS_PTS_REF AFM_X_AIR_FLW_B /end AXIS_DESCR
/end CHARACTERISTIC
/begin CHARACTERISTIC EXTC_M_CAT_T_IG_TRM "cat temp ignition retard term" MAP 0x00020320 __SWORD_S 0 u_deg_C_n2048_p2048 -2048 2047.9375 SYMBOL_LINK "EXTC_M_CAT_T_IG_TRM" 4
 /begin AXIS_DESCR FIX_AXIS ig_avg_rtd_ref u_iga 9 0 24 /begin FIX_AXIS_PAR_LIST 0 384 768 1152 1536 1920 2304 2688 3072 /end FIX_AXIS_PAR_LIST /end AXIS_DESCR
 /begin AXIS_DESCR FIX_AXIS sys_eng_spd u_espd 9 0 6400 /begin FIX_AXIS_PAR_LIST 0 6400 12800 19200 25600 32000 38400 44800 51200 /end FIX_AXIS_PAR_LIST /end AXIS_DESCR
/end CHARACTERISTIC
/begin CHARACTERISTIC EXTC_V_HI_LD_TPS_THR "high load condition tps thr" VALUE 0x0002038C __UWORD_S 0 u_pct 0 199.996948 /end CHARACTERISTIC
/begin CHARACTERISTIC EXTC_V_HI_LD_ESPD_THR "high load condition engine speed thr" VALUE 0x0002038C __UWORD_S 0 u_espd 0 8191.875000 FORMAT "%5.1" /end CHARACTERISTIC
/begin CHARACTERISTIC EXTC_V_HI_LD_EN_DLY "high load condition enable delay" VALUE 0x0002038C __UBYTE_S 0 u_16x_tmr 0 8191.875 /end CHARACTERISTIC
/begin CHARACTERISTIC EXTC_V_CAT_T_GRD1 "cat protect temp grade1" VALUE 0x0002038C __SWORD_S 0 u_deg_C_n2048_p2048 -2048 2047.9375 /end CHARACTERISTIC
/begin CHARACTERISTIC EXTC_V_CAT_T_GRD2 "cat protect temp grade2" VALUE 0x0002038C __SWORD_S 0 u_deg_C_n2048_p2048 -2048 2047.9375 /end CHARACTERISTIC
/begin CHARACTERISTIC EXTC_V_CAT_T_GRD3 "cat protect temp grade3" VALUE 0x0002038C __SWORD_S 0 u_deg_C_n2048_p2048 -2048 2047.9375 /end CHARACTERISTIC
/begin CHARACTERISTIC EXTC_V_CAT_T_GRD4 "cat protect temp grade4" VALUE 0x0002038C __SWORD_S 0 u_deg_C_n2048_p2048 -2048 2047.9375 /end CHARACTERISTIC
/begin CHARACTERISTIC EXTC_C_CAT_PROT_AF "cat protect airfuel" CURVE 0x000200B0 __UWORD_S 0 u_afr 0 31.99951171875 SYMBOL_LINK "EXTC_C_CAT_PROT_AF" 2
 /begin AXIS_DESCR FIX_AXIS NO_INPUT_QUANTITY u_deg_C_n2048_p2048 33 0 512
  /begin FIX_AXIS_PAR_LIST 0 256 512 768 1024 1280 1536 1792 2048 2304 2560 2816 3072 3328 3584 3840 4096 4352 4608 4864 5120 5376 5632 5888 6144 6400 6656 6912 7168 7424 7680 7936 8192 /end FIX_AXIS_PAR_LIST
 /end AXIS_DESCR
/end CHARACTERISTIC
/begin CHARACTERISTIC EXTC_V_CAT_HT_VSPD_MAX "cat heat enable vehicle speed max" VALUE 0x0002038C __UWORD_S 0 u_vspd 0 511.9921875 FORMAT "%5.1" /end CHARACTERISTIC
/begin CHARACTERISTIC EXTC_V_CAT_HT_IMEP_MAX "cat heat enable imep max" VALUE 0x0002038C __UWORD_S 0 u_kPa_0_4096 0 4095.9375 /end CHARACTERISTIC
/begin CHARACTERISTIC EXTC_V_CAT_HT_PPS_ECT_THR "keyon ect thr for cat heat enable pps thr high/low selection" VALUE 0x0002038C __SWORD_S 0 u_deg_C -256 255.9921875 /end CHARACTERISTIC
/begin CHARACTERISTIC EXTC_V_CAT_HT_PPS_LO_MAX "cat heat enable low ect pps max" VALUE 0x0002038C __UWORD_S 0 u_pct 0 199.996948 /end CHARACTERISTIC
/begin CHARACTERISTIC EXTC_V_CAT_HT_PPS_HI_MAX "cat heat enable high ect pps max" VALUE 0x0002038C __UWORD_S 0 u_pct 0 199.996948 /end CHARACTERISTIC
/begin CHARACTERISTIC EXTC_V_MNFD_PROT_T "exhaust manifold protect temp" VALUE 0x0002038C __SWORD_S 0 u_deg_C_n2048_p2048 -2048 2047.9375 /end CHARACTERISTIC
/begin CHARACTERISTIC EXTC_V_MNFD_PROT_T_HYS "exhaust manifold protect temp hys" VALUE 0x0002038C __SWORD_S 0 u_deg_C_n2048_p2048 -2048 2047.9375 /end CHARACTERISTIC
/begin CHARACTERISTIC EXTC_V_MNFD_PROT_DWN_T "exhaust manifold protect counts decrease temp" VALUE 0x0002038C __SWORD_S 0 u_deg_C_n2048_p2048 -2048 2047.9375 /end CHARACTERISTIC
/begin CHARACTERISTIC EXTC_V_MNFD_OVR_T "exhaust manifold protect over heat temp" VALUE 0x0002038C __SWORD_S 0 u_deg_C_n2048_p2048 -2048 2047.9375 /end CHARACTERISTIC
/begin CHARACTERISTIC EXTC_C_MNFD_T_INC_FIL "exhaust manifold temp increase filter" CURVE 0x000200B0 __UWORD_S 0 u_filter 0 0.9999847412109375 FORMAT "%5.4" SYMBOL_LINK "EXTC_C_MNFD_T_INC_FIL" 2
 /begin AXIS_DESCR COM_AXIS afm_air_flw u_g_per_sec 17 0.000000 511.992188 AXIS_PTS_REF AFM_X_AIR_FLW_B /end AXIS_DESCR
/end CHARACTERISTIC
/begin CHARACTERISTIC EXTC_C_MNFD_T_DEC_FIL "exhaust manifold temp decrease filter" CURVE 0x000200B0 __UWORD_S 0 u_filter 0 0.9999847412109375 FORMAT "%5.4" SYMBOL_LINK "EXTC_C_MNFD_T_DEC_FIL" 2
 /begin AXIS_DESCR COM_AXIS afm_air_flw u_g_per_sec 17 0.000000 511.992188 AXIS_PTS_REF AFM_X_AIR_FLW_B /end AXIS_DESCR
/end CHARACTERISTIC
/begin CHARACTERISTIC EXTC_C_MNFD_T_SP_DEC_FIL "exhaust manifold temp setpoint decrease filter" CURVE 0x000200B0 __UWORD_S 0 u_filter 0 0.9999847412109375 FORMAT "%5.4" SYMBOL_LINK "EXTC_C_MNFD_T_SP_DEC_FIL" 2
 /begin AXIS_DESCR COM_AXIS afm_air_flw u_g_per_sec 17 0.000000 511.992188 AXIS_PTS_REF AFM_X_AIR_FLW_B /end AXIS_DESCR
/end CHARACTERISTIC
/begin CHARACTERISTIC EXTC_C_MNFD_T_SP_INC_FIL "exhaust manifold temp setpoint increase filter" CURVE 0x000200B0 __UWORD_S 0 u_filter 0 0.9999847412109375 FORMAT "%5.4" SYMBOL_LINK "EXTC_C_MNFD_T_SP_INC_FIL" 2
 /begin AXIS_DESCR COM_AXIS afm_air_flw u_g_per_sec 17 0.000000 511.992188 AXIS_PTS_REF AFM_X_AIR_FLW_B /end AXIS_DESCR
/end CHARACTERISTIC
/begin CHARACTERISTIC EXTC_C_MNFD_PROT_AF "exhaust manifold protect airfuel" CURVE 0x000200B0 __UWORD_S 0 u_afr 0 31.99951171875 SYMBOL_LINK "EXTC_C_MNFD_PROT_AF" 2
 /begin AXIS_DESCR FIX_AXIS extc_mnfd_ovr_t u_deg_C_n2048_p2048 33 0 512
  /begin FIX_AXIS_PAR_LIST 0 256 512 768 1024 1280 1536 1792 2048 2304 2560 2816 3072 3328 3584 3840 4096 4352 4608 4864 5120 5376 5632 5888 6144 6400 6656 6912 7168 7424 7680 7936 8192 /end FIX_AXIS_PAR_LIST
 /end AXIS_DESCR
/end CHARACTERISTIC
/begin CHARACTERISTIC EXTC_V_CAT_CLS_HLD_EN_IMEP "cat temp close pedal hold enable imep" VALUE 0x0002038C __UWORD_S 0 u_kPa_0_4096 0 4095.9375 FORMAT "%4.3" /end CHARACTERISTIC
/begin CHARACTERISTIC EXTC_V_CAT_CLS_HLD_EXT_IMEP "cat temp close pedal hold exit imep" VALUE 0x0002038C __UWORD_S 0 u_kPa_0_4096 0 4095.9375 FORMAT "%4.3" /end CHARACTERISTIC
/begin CHARACTERISTIC EXTC_V_CAT_CLS_HLD_EN_PPS "cat temp close pedal hold enable pedal pos" VALUE 0x0002038C __UWORD_S 0 u_kPa_0_4096 0 4095.9375 FORMAT "%4.3" /end CHARACTERISTIC
/begin CHARACTERISTIC EXTC_V_CAT_CLS_HLD_IMEP_DLY "cat temp close pedal hold iemp met delay" VALUE 0x0002038C __UWORD_S 0 u_16x_tmr 0 8191.875 /end CHARACTERISTIC
/begin CHARACTERISTIC EXTC_V_CAT_CLS_HLD_DUR "cat temp close pedal hold duration" VALUE 0x0002038C __UWORD_S 0 u_16x_tmr 0 8191.875 /end CHARACTERISTIC
/begin CHARACTERISTIC EXTC_V_PUC_DIS_CAT_T "puc disable cat temp" VALUE 0x0002038C __SWORD_S 0 u_deg_C_n2048_p2048 -2048 2047.9375 /end CHARACTERISTIC
/begin CHARACTERISTIC EXTC_V_PUC_DIS_CAT_T_HYS "puc disable cat temp hys" VALUE 0x0002038C __SWORD_S 0 u_deg_C_n2048_p2048 -2048 2047.9375 /end CHARACTERISTIC
/begin CHARACTERISTIC EXTC_V_CAT_T_OVR_CNTS "cat temp over condition met counts" VALUE 0x0002038C __UWORD_S 0 u_cnts 0 65535 FORMAT "%5.0" /end CHARACTERISTIC
/begin CHARACTERISTIC EXTC_V_MNFD_T_OVR_CNTS "manifold temp over condition met counts" VALUE 0x0002038C __UWORD_S 0 u_cnts 0 65535 FORMAT "%5.0" /end CHARACTERISTIC
/begin CHARACTERISTIC EXTC_C_CAT_T_OVR_INC_STP "cat temp over counts increase step" CURVE 0x000200B0 __UWORD_S 0 u_cnts 0 65535 FORMAT "%5.0" SYMBOL_LINK "EXTC_C_CAT_T_OVR_INC_STP" 2
 /begin AXIS_DESCR COM_AXIS NO_INPUT_QUANTITY u_deg_C_n2048_p2048 9 0 2047.9375 AXIS_PTS_REF EXTC_X_CAT_T_DELTA_A /end AXIS_DESCR
/end CHARACTERISTIC
/begin AXIS_PTS EXTC_X_CAT_T_DELTA_A "axis of cat over temp above thr" 0x0002006C NO_INPUT_QUANTITY SSV__SWORD_S 0 u_deg_C_n2048_p2048 9 0 2047.9375 DEPOSIT ABSOLUTE SYMBOL_LINK "EXTC_X_CAT_T_DELTA_A" 2 /end AXIS_PTS
/begin CHARACTERISTIC EXTC_C_CAT_T_OVR_DEC_STP "cat temp over counts decrease step" CURVE 0x000200B0 __UWORD_S 0 u_cnts 0 65535 FORMAT "%5.0" SYMBOL_LINK "EXTC_C_CAT_T_OVR_DEC_STP" 2
 /begin AXIS_DESCR COM_AXIS NO_INPUT_QUANTITY u_deg_C_n2048_p2048 9 0 2047.9375 AXIS_PTS_REF EXTC_X_CAT_T_DELTA_B /end AXIS_DESCR
/end CHARACTERISTIC
/begin AXIS_PTS EXTC_X_CAT_T_DELTA_B "axis of cat over temp below thr" 0x0002006C NO_INPUT_QUANTITY SSV__SWORD_S 0 u_deg_C_n2048_p2048 9 0 2047.9375 DEPOSIT ABSOLUTE SYMBOL_LINK "EXTC_X_CAT_T_DELTA_B" 2 /end AXIS_PTS
/begin CHARACTERISTIC EXTC_C_MNFD_T_OVR_INC_STP "manifold temp over counts increase step" CURVE 0x000200B0 __UWORD_S 0 u_cnts 0 65535 FORMAT "%5.0" SYMBOL_LINK "EXTC_C_MNFD_T_OVR_INC_STP" 2
 /begin AXIS_DESCR COM_AXIS NO_INPUT_QUANTITY u_deg_C_n2048_p2048 9 0 2047.9375 AXIS_PTS_REF EXTC_X_MNFD_T_DELTA_A /end AXIS_DESCR
/end CHARACTERISTIC
/begin AXIS_PTS EXTC_X_MNFD_T_DELTA_A "axis of manifold over temp above thr" 0x0002006C NO_INPUT_QUANTITY SSV__SWORD_S 0 u_deg_C_n2048_p2048 9 0 2047.9375 DEPOSIT ABSOLUTE SYMBOL_LINK "EXTC_X_MNFD_T_DELTA_A" 2 /end AXIS_PTS
/begin CHARACTERISTIC EXTC_C_MNFD_T_OVR_DEC_STP "manifold temp over counts decrease step" CURVE 0x000200B0 __UWORD_S 0 u_cnts 0 65535 FORMAT "%5.0" SYMBOL_LINK "EXTC_C_MNFD_T_OVR_DEC_STP" 2
 /begin AXIS_DESCR COM_AXIS NO_INPUT_QUANTITY u_deg_C_n2048_p2048 9 0 2047.9375 AXIS_PTS_REF EXTC_X_MNFD_T_DELTA_B /end AXIS_DESCR
/end CHARACTERISTIC
/begin AXIS_PTS EXTC_X_MNFD_T_DELTA_B "axis of manifold over temp below thr" 0x0002006C NO_INPUT_QUANTITY SSV__SWORD_S 0 u_deg_C_n2048_p2048 9 0 2047.9375 DEPOSIT ABSOLUTE SYMBOL_LINK "EXTC_X_MNFD_T_DELTA_B" 2 /end AXIS_PTS
/begin CHARACTERISTIC EXTC_V_HYB_CAT_DIS_EXT_CNTS "auto stop disable by cat temp exit over counts" VALUE 0x0002038C __UWORD_S 0 u_cnts 0 65535 FORMAT "%5.0" /end CHARACTERISTIC
/begin CHARACTERISTIC EXTC_V_HYB_MNFD_DIS_EXT_CNTS "auto stop disable by manifold temp exit over counts" VALUE 0x0002038C __UWORD_S 0 u_cnts 0 65535 FORMAT "%5.0" /end CHARACTERISTIC
/begin CHARACTERISTIC EXTC_V_CAT_LIGHT_ST_CFG "cat light off state evaluated method config" VALUE 0x0002038C __UBYTE_S 0 u_extc_lt_cfg 0 2 FORMAT "%1.0" /end CHARACTERISTIC
/begin CHARACTERISTIC EXTC_C_CAT_LIGHT_ECT_INT "cat light off state evaluation ect int thr" CURVE 0x000200B0 __UWORD_S 0 u_cnts 0 65535 FORMAT "%5.0" SYMBOL_LINK "EXTC_C_CAT_LIGHT_ECT_INT" 2
 /begin AXIS_DESCR FIX_AXIS sys_ect u_deg_C 17 -40 120
  /begin FIX_AXIS_PAR_LIST -5120 -3840 -2560 -1280 0 1280 2560 3840 5120 6400 7680 8960 10240 11520 12800 14080 15360 /end FIX_AXIS_PAR_LIST
 /end AXIS_DESCR
/end CHARACTERISTIC
/begin CHARACTERISTIC EXTC_C_CAT_LIGHT_FLW_INT "cat light off state evaluation airflow int thr" CURVE 0x000200B0 __UWORD_S 0 u_gram 0 4095.9375 FORMAT "%5.1" SYMBOL_LINK "EXTC_C_CAT_LIGHT_FLW_INT" 2
 /begin AXIS_DESCR FIX_AXIS sys_keyon_ect u_deg_C 17 -40 120
  /begin FIX_AXIS_PAR_LIST -5120 -3840 -2560 -1280 0 1280 2560 3840 5120 6400 7680 8960 10240 11520 12800 14080 15360 /end FIX_AXIS_PAR_LIST
 /end AXIS_DESCR
/end CHARACTERISTIC
/begin CHARACTERISTIC EXTC_V_CAT_LIGHT_ST_T "cat light off state evaluation temp" VALUE 0x0002038C __SWORD_S 0 u_deg_C_n2048_p2048 -2048 2047.9375 /end CHARACTERISTIC
/begin CHARACTERISTIC KNCK_V_CTRL_CFG "knock control configuration" VALUE 0x0002038C __UBYTE_S 0 b_enable 0 1 FORMAT "%5.2" /end CHARACTERISTIC
/begin CHARACTERISTIC KNCK_C_FIL_FRQ1 "Knock signal Filter Frequency1" CURVE 0x0002038C __ULONG_S 0 u_coef_l 0 4294967295
 /begin AXIS_DESCR FIX_AXIS NO_INPUT_QUANTITY u_cnts 9 0 255 /begin FIX_AXIS_PAR_LIST 0 1 2 3 4 5 6 7 8 /end FIX_AXIS_PAR_LIST /end AXIS_DESCR
/end CHARACTERISTIC
/begin CHARACTERISTIC KNCK_C_FIL_FRQ2 "Knock signal Filter Frequency2" CURVE 0x0002038C __ULONG_S 0 u_coef_l 0 4294967295
 /begin AXIS_DESCR FIX_AXIS NO_INPUT_QUANTITY u_cnts 9 0 255 /begin FIX_AXIS_PAR_LIST 0 1 2 3 4 5 6 7 8 /end FIX_AXIS_PAR_LIST /end AXIS_DESCR
/end CHARACTERISTIC
/begin CHARACTERISTIC KNCK_C_FIL_FRQ3 "Knock signal Filter Frequency3" CURVE 0x0002038C __ULONG_S 0 u_coef_l 0 4294967295
 /begin AXIS_DESCR FIX_AXIS NO_INPUT_QUANTITY u_cnts 9 0 255 /begin FIX_AXIS_PAR_LIST 0 1 2 3 4 5 6 7 8 /end FIX_AXIS_PAR_LIST /end AXIS_DESCR
/end CHARACTERISTIC
/begin CHARACTERISTIC KNCK_M_WT_FIL_FRQ1 "weight factor of filter frequency1 knock signal£¬to calculate knock intensity" MAP 0x00020320 __UWORD_S 0 u_fac_2 0 1.999969482421875 FORMAT "%6.5" SYMBOL_LINK "KNCK_M_WT_FIL_FRQ1" 4
 /begin AXIS_DESCR FIX_AXIS sys_eng_spd u_espd 16 400 6400
  /begin FIX_AXIS_PAR_LIST 3200 6400 9600 12800 16000 19200 22400 25600 28800 32000 35200 38400 41600 44800 48000 51200 /end FIX_AXIS_PAR_LIST
 /end AXIS_DESCR
 /begin AXIS_DESCR FIX_AXIS tq_imep_ref u_kPa_0_4096 6 500 3000 /begin FIX_AXIS_PAR_LIST 4000 8000 12000 16000 20000 24000 /end FIX_AXIS_PAR_LIST /end AXIS_DESCR
/end CHARACTERISTIC
/begin CHARACTERISTIC KNCK_M_WT_FIL_FRQ2 "weight factor of filter frequency2 knock signal£¬to calculate knock intensity" MAP 0x00020320 __UWORD_S 0 u_fac_2 0 1.999969482421875 FORMAT "%6.5" SYMBOL_LINK "KNCK_M_WT_FIL_FRQ2" 4
 /begin AXIS_DESCR FIX_AXIS sys_eng_spd u_espd 16 400 6400
  /begin FIX_AXIS_PAR_LIST 3200 6400 9600 12800 16000 19200 22400 25600 28800 32000 35200 38400 41600 44800 48000 51200 /end FIX_AXIS_PAR_LIST
 /end AXIS_DESCR
 /begin AXIS_DESCR FIX_AXIS tq_imep_ref u_kPa_0_4096 6 500 3000 /begin FIX_AXIS_PAR_LIST 4000 8000 12000 16000 20000 24000 /end FIX_AXIS_PAR_LIST /end AXIS_DESCR
/end CHARACTERISTIC
/begin CHARACTERISTIC KNCK_M_WT_FIL_FRQ3 "weight factor of filter frequency3 knock signal£¬to calculate knock intensity" MAP 0x00020320 __UWORD_S 0 u_fac_2 0 1.999969482421875 FORMAT "%6.5" SYMBOL_LINK "KNCK_M_WT_FIL_FRQ3" 4
 /begin AXIS_DESCR FIX_AXIS sys_eng_spd u_espd 16 400 6400
  /begin FIX_AXIS_PAR_LIST 3200 6400 9600 12800 16000 19200 22400 25600 28800 32000 35200 38400 41600 44800 48000 51200 /end FIX_AXIS_PAR_LIST
 /end AXIS_DESCR
 /begin AXIS_DESCR FIX_AXIS tq_imep_ref u_kPa_0_4096 6 500 3000 /begin FIX_AXIS_PAR_LIST 4000 8000 12000 16000 20000 24000 /end FIX_AXIS_PAR_LIST /end AXIS_DESCR
/end CHARACTERISTIC
/begin CHARACTERISTIC KNCK_V_CAM_FAIL_CFG "True means execute default IGA retard when CAM fault active" VALUE 0x0002038C __UBYTE_S 0 b_enable 0 1 FORMAT "%5.2" /end CHARACTERISTIC
/begin CHARACTERISTIC KNCK_V_IGA_RTD_DFT "default IGA retard value when related sensor fault active" VALUE 0x0002038C __SWORD_S 0 u_iga -256 255.9921875 /end CHARACTERISTIC
/begin CHARACTERISTIC KNCK_C_RAW_VLT_MAX "Max Integrated voltage from konck sensor" CURVE 0x0002038C __UWORD_S 0 u_volt_32 0 31.99951171875 FORMAT "%4.2"
 /begin AXIS_DESCR FIX_AXIS NO_INPUT_QUANTITY u_cnts 3 0 2 /begin FIX_AXIS_PAR_LIST 0 1 2 /end FIX_AXIS_PAR_LIST /end AXIS_DESCR
/end CHARACTERISTIC
/begin CHARACTERISTIC KNCK_C_RAW_VLT_MIN "Min Integrated voltage from konck sensor" CURVE 0x0002038C __UWORD_S 0 u_volt_32 0 31.99951171875 FORMAT "%5.2"
 /begin AXIS_DESCR FIX_AXIS NO_INPUT_QUANTITY u_cnts 3 0 2 /begin FIX_AXIS_PAR_LIST 0 1 2 /end FIX_AXIS_PAR_LIST /end AXIS_DESCR
/end CHARACTERISTIC
/begin CHARACTERISTIC KNCK_V_EN_ECT_MIN "Engine coolant temperature Threshold to enable knock control" VALUE 0x0002038C __SWORD_S 0 u_deg_C -256 255.9921875 /end CHARACTERISTIC
/begin CHARACTERISTIC KNCK_V_EN_ENG_RTM_MIN "Engine runtime threshold to enable knock control" VALUE 0x0002038C __UWORD_S 0 u_1s_tmr 0 65535 /end CHARACTERISTIC
/begin CHARACTERISTIC KNCK_V_EN_ESPD_MIN "Engine speed threshold to enable knock control" VALUE 0x0002038C __UWORD_S 0 u_espd 0.0 8191.875 FORMAT "%6.2" /end CHARACTERISTIC
/begin CHARACTERISTIC KNCK_C_EN_IMEP_MIN "IMEP threshold to enable knock control" CURVE 0x0002038C __UWORD_S 0 u_kPa_0_4096 0 4095.9375 SYMBOL_LINK "KNCK_C_EN_IMEP_MIN" 2
 /begin AXIS_DESCR FIX_AXIS sys_eng_spd u_espd 16 400 6400
  /begin FIX_AXIS_PAR_LIST 3200 6400 9600 12800 16000 19200 22400 25600 28800 32000 35200 38400 41600 44800 48000 51200 /end FIX_AXIS_PAR_LIST
 /end AXIS_DESCR
/end CHARACTERISTIC
/begin CHARACTERISTIC KNCK_V_IMEP_FIL "filter coefficient of IMEP used to determine transient status" VALUE 0x0002038C __UWORD_S 0 u_filter 0 0.9999847412109375 FORMAT "%10.9" /end CHARACTERISTIC
/begin CHARACTERISTIC KNCK_V_WIN_EN "when set true, hardware output of knock measurement window will be enable" VALUE 0x0002038C __UBYTE_S 0 b_enable 0 1 FORMAT "%5.2" /end CHARACTERISTIC
/begin CHARACTERISTIC KNCK_M_WIN_STRT_ANG "Beginning of measurement knock window" MAP 0x00020320 __SWORD_S 0 u_crk_ang_a -512 511.984375 SYMBOL_LINK "KNCK_M_WIN_STRT_ANG" 4
 /begin AXIS_DESCR COM_AXIS tq_imep_ref u_kPa_0_4096 13 0 4095.937500 AXIS_PTS_REF KNCK_X_IMEP /end AXIS_DESCR
 /begin AXIS_DESCR FIX_AXIS sys_eng_spd u_espd 15 800 6400
  /begin FIX_AXIS_PAR_LIST 6400 9600 12800 16000 19200 22400 25600 28800 32000 35200 38400 41600 44800 48000 51200 /end FIX_AXIS_PAR_LIST
 /end AXIS_DESCR
/end CHARACTERISTIC
/begin AXIS_PTS KNCK_X_IMEP "" 0x0002006C tq_imep_ref SSV__UWORD_S 0 u_kPa_0_4096 13 0 4095.937500 DEPOSIT ABSOLUTE SYMBOL_LINK "KNCK_X_IMEP" 2 /end AXIS_PTS
/begin CHARACTERISTIC KNCK_C_WIN_DUR "Duration of measurement knock window" CURVE 0x000200B0 __SWORD_S 0 u_crk_ang_a -512 511.984375 FORMAT "%6.3" SYMBOL_LINK "KNCK_C_WIN_DUR" 2
 /begin AXIS_DESCR FIX_AXIS sys_eng_spd u_espd 16 400 6400
  /begin FIX_AXIS_PAR_LIST 3200 6400 9600 12800 16000 19200 22400 25600 28800 32000 35200 38400 41600 44800 48000 51200 /end FIX_AXIS_PAR_LIST
 /end AXIS_DESCR
/end CHARACTERISTIC
/begin CHARACTERISTIC KNCK_V_GAIN_ESPD_HI "engine speed threshlod above which low gain of knock signal is used, when currently high gain" VALUE 0x0002038C __UWORD_S 0 u_espd 0.0 8191.875 FORMAT "%6.2" /end CHARACTERISTIC
/begin CHARACTERISTIC KNCK_V_GAIN_ESPD_LO "engine speed threshlod below which high gain of knock signal is used, when currently low gain" VALUE 0x0002038C __UWORD_S 0 u_espd 0.0 8191.875 FORMAT "%6.2" /end CHARACTERISTIC
/begin CHARACTERISTIC KNCK_V_GAIN_FAC "factor multiplied to low gain of knock signal" VALUE 0x0002038C __UWORD_S 0 u_fac_8 0 7.9998779296875 FORMAT "%3.2" /end CHARACTERISTIC
/begin CHARACTERISTIC KNCK_M_KNK_THR_FAC_HI "knock threshold factor used when IMEP above KNCK_C_THR_FAC_IMEP_HI" MAP 0x36504 __UWORD_S 0 u_fac_128 0 127.998046875 FORMAT "%5.3" SYMBOL_LINK "KNCK_M_KNK_THR_FAC_HI" 4
 /begin AXIS_DESCR FIX_AXIS NO_INPUT_QUANTITY u_cnts 4 0 255 /begin FIX_AXIS_PAR_LIST 1 2 3 4 /end FIX_AXIS_PAR_LIST /end AXIS_DESCR
 /begin AXIS_DESCR FIX_AXIS sys_eng_spd u_espd 16 400 6400
  /begin FIX_AXIS_PAR_LIST 3200 6400 9600 12800 16000 19200 22400 25600 28800 32000 35200 38400 41600 44800 48000 51200 /end FIX_AXIS_PAR_LIST
 /end AXIS_DESCR
/end CHARACTERISTIC
/begin CHARACTERISTIC KNCK_M_KNK_THR_FAC_MID "knock threshold factor used when IMEP between KNCK_C_THR_FAC_IMEP_LO and KNCK_C_THR_FAC_IMEP_HI" MAP 0x36504 __UWORD_S 0 u_fac_128 0 127.998046875 FORMAT "%5.3" SYMBOL_LINK "KNCK_M_KNK_THR_FAC_MID" 4
 /begin AXIS_DESCR FIX_AXIS NO_INPUT_QUANTITY u_cnts 4 0 255 /begin FIX_AXIS_PAR_LIST 1 2 3 4 /end FIX_AXIS_PAR_LIST /end AXIS_DESCR
 /begin AXIS_DESCR FIX_AXIS sys_eng_spd u_espd 16 400 6400
  /begin FIX_AXIS_PAR_LIST 3200 6400 9600 12800 16000 19200 22400 25600 28800 32000 35200 38400 41600 44800 48000 51200 /end FIX_AXIS_PAR_LIST
 /end AXIS_DESCR
/end CHARACTERISTIC
/begin CHARACTERISTIC KNCK_M_KNK_THR_FAC_LO "knock threshold factor used when IMEP below KNCK_C_THR_FAC_IMEP_LO" MAP 0x36504 __UWORD_S 0 u_fac_128 0 127.998046875 FORMAT "%5.3" SYMBOL_LINK "KNCK_M_KNK_THR_FAC_LO" 4
 /begin AXIS_DESCR FIX_AXIS NO_INPUT_QUANTITY u_cnts 4 0 255 /begin FIX_AXIS_PAR_LIST 1 2 3 4 /end FIX_AXIS_PAR_LIST /end AXIS_DESCR
 /begin AXIS_DESCR FIX_AXIS sys_eng_spd u_espd 16 400 6400
  /begin FIX_AXIS_PAR_LIST 3200 6400 9600 12800 16000 19200 22400 25600 28800 32000 35200 38400 41600 44800 48000 51200 /end FIX_AXIS_PAR_LIST
 /end AXIS_DESCR
/end CHARACTERISTIC
/begin CHARACTERISTIC KNCK_C_HVY_KNK_BIAS "knock threshold bias used to detect extreme knock of engine" CURVE 0x375CE __UWORD_S 0 u_pct 0 199.996948 SYMBOL_LINK "KNCK_C_HVY_KNK_BIAS" 2
 /begin AXIS_DESCR FIX_AXIS sys_eng_spd u_espd 16 400 6400
  /begin FIX_AXIS_PAR_LIST 3200 6400 9600 12800 16000 19200 22400 25600 28800 32000 35200 38400 41600 44800 48000 51200 /end FIX_AXIS_PAR_LIST
 /end AXIS_DESCR
/end CHARACTERISTIC
/begin CHARACTERISTIC KNCK_C_IMEP_LO_THR "IMEP threshold to select knock threshold factor table between low and middle" CURVE 0x375CE __UWORD_S 0 u_kPa_0_4096 0 4095.9375 SYMBOL_LINK "KNCK_C_IMEP_LO_THR" 2
 /begin AXIS_DESCR FIX_AXIS sys_eng_spd u_espd 16 400 6400
  /begin FIX_AXIS_PAR_LIST 3200 6400 9600 12800 16000 19200 22400 25600 28800 32000 35200 38400 41600 44800 48000 51200 /end FIX_AXIS_PAR_LIST
 /end AXIS_DESCR
/end CHARACTERISTIC
/begin CHARACTERISTIC KNCK_C_IMEP_HI_THR "IMEP threshold to select knock threshold factor table between high and middle" CURVE 0x375CE __UWORD_S 0 u_kPa_0_4096 0 4095.9375 SYMBOL_LINK "KNCK_C_IMEP_HI_THR" 2
 /begin AXIS_DESCR FIX_AXIS sys_eng_spd u_espd 16 400 6400
  /begin FIX_AXIS_PAR_LIST 3200 6400 9600 12800 16000 19200 22400 25600 28800 32000 35200 38400 41600 44800 48000 51200 /end FIX_AXIS_PAR_LIST
 /end AXIS_DESCR
/end CHARACTERISTIC
/begin CHARACTERISTIC KNCK_V_RTD_MAX "Max IGA retard of knock control" VALUE 0x36F6C __SWORD_S 0 u_iga -256 255.9921875 /end CHARACTERISTIC
/begin CHARACTERISTIC KNCK_V_FST_RTD_MAX "Max IGA fast retard of knock control" VALUE 0x36F6C __SWORD_S 0 u_iga -256 255.9921875 /end CHARACTERISTIC
/begin CHARACTERISTIC KNCK_C_FST_RTD_STP "fast IGA retard step of knock ignition angle control" CURVE 0x375CE __SWORD_S 0 u_iga -256 255.9921875 FORMAT "%4.2" SYMBOL_LINK "KNCK_C_FST_RTD_STP" 2
 /begin AXIS_DESCR FIX_AXIS sys_eng_spd u_espd 16 400 6400
  /begin FIX_AXIS_PAR_LIST 3200 6400 9600 12800 16000 19200 22400 25600 28800 32000 35200 38400 41600 44800 48000 51200 /end FIX_AXIS_PAR_LIST
 /end AXIS_DESCR
/end CHARACTERISTIC
/begin CHARACTERISTIC KNCK_C_FST_RTD_EXT_DLY "fast IGA retard exit interval of knock ignition angle control" CURVE 0x375CE __UWORD_S 0 u_2x_tmr 0 1023.984375 SYMBOL_LINK "KNCK_C_FST_RTD_EXT_DLY" 2
 /begin AXIS_DESCR FIX_AXIS sys_eng_spd u_espd 16 400 6400
  /begin FIX_AXIS_PAR_LIST 3200 6400 9600 12800 16000 19200 22400 25600 28800 32000 35200 38400 41600 44800 48000 51200 /end FIX_AXIS_PAR_LIST
 /end AXIS_DESCR
/end CHARACTERISTIC
/begin CHARACTERISTIC KNCK_V_FST_RTD_EXT_STP "fast IGA retard exit step of knock ignition angle control" VALUE 0x36F6C __SWORD_S 0 u_iga -256 255.9921875 FORMAT "%4.2" /end CHARACTERISTIC
/begin CHARACTERISTIC KNCK_C_ADP_RTD_STP "adaption IGA retard step of knock ignition angle control" CURVE 0x375CE __SWORD_S 0 u_iga -256 255.9921875 FORMAT "%4.2" SYMBOL_LINK "KNCK_C_ADP_RTD_STP" 2
 /begin AXIS_DESCR FIX_AXIS sys_eng_spd u_espd 16 400 6400
  /begin FIX_AXIS_PAR_LIST 3200 6400 9600 12800 16000 19200 22400 25600 28800 32000 35200 38400 41600 44800 48000 51200 /end FIX_AXIS_PAR_LIST
 /end AXIS_DESCR
/end CHARACTERISTIC
/begin CHARACTERISTIC KNCK_C_ADP_RTD_MAX "Max IGA adaption retard of knock control" CURVE 0x375CE __SWORD_S 0 u_iga -256 255.9921875 FORMAT "%4.2"
 /begin AXIS_DESCR FIX_AXIS NO_INPUT_QUANTITY u_cnts 15 0 14 /begin FIX_AXIS_PAR_LIST 0 1 2 3 4 5 6 7 8 9 10 11 12 13 14 /end FIX_AXIS_PAR_LIST /end AXIS_DESCR
/end CHARACTERISTIC
/begin CHARACTERISTIC KNCK_C_ADP_RTD_EXT_DLY "adaption IGA retard exit interval of knock ignition angle control" CURVE 0x375CE __UWORD_S 0 u_2x_tmr 0 1023.984375
 /begin AXIS_DESCR FIX_AXIS NO_INPUT_QUANTITY u_cnts 15 0 14 /begin FIX_AXIS_PAR_LIST 0 1 2 3 4 5 6 7 8 9 10 11 12 13 14 /end FIX_AXIS_PAR_LIST /end AXIS_DESCR
/end CHARACTERISTIC
/begin CHARACTERISTIC KNCK_V_ADP_RTD_EXT_STP "adaption IGA retard exit step of knock ignition angle control" VALUE 0x36F6C __SWORD_S 0 u_iga -256 255.9921875 FORMAT "%4.2" /end CHARACTERISTIC
/begin CHARACTERISTIC KNCK_V_ERR_PASS_TIM_MIN "MIN time to re-enable konck control when knock sensor diag was passed" VALUE 0x3F57C __UWORD_S 0 u_1s_tmr 0.0 65535 /end CHARACTERISTIC
/begin CHARACTERISTIC KNCK_V_KNKS_INT_DLT_INIT "Mean Absolute Deviation of knock intensity signal initialization value" VALUE 0x2DD38 __UWORD_S 0 u_pct 0 199.996948 FORMAT "%6.3" /end CHARACTERISTIC
/begin CHARACTERISTIC KNCK_C_KNKS_FILT_INT_INIT "filtered average knock intensity initialization value" CURVE 0x383C2 __UWORD_S 0 u_pct 0 199.996948 FORMAT "%6.3"
 /begin AXIS_DESCR FIX_AXIS NO_INPUT_QUANTITY u_knck_cyl_frq 12 0 11 /begin FIX_AXIS_PAR_LIST 0 1 2 3 4 5 6 7 8 9 10 11 /end FIX_AXIS_PAR_LIST /end AXIS_DESCR
/end CHARACTERISTIC
/begin CHARACTERISTIC KNCK_V_TRANS_VVT_DEV_THR "VVT deviation threshold between VVT actual and sp position above which will enable transient knock control" VALUE 0x0002038C __UWORD_S 0 u_cam_ang_hi 0 63.9990234375 FORMAT "%3.1" /end CHARACTERISTIC
/begin CHARACTERISTIC KNCK_V_TRANS_ESPD_INC_THR "engine speed increase threshold to determinate knock transient state" VALUE 0x37FA6 __SWORD_S 0 u_espd -4096.0 4095.875 FORMAT "%6.2" /end CHARACTERISTIC
/begin CHARACTERISTIC KNCK_V_TRANS_ESPD_DEC_THR "engine speed decrease threshold to determinate knock transient state" VALUE 0x37FA6 __SWORD_S 0 u_espd -4096.0 4095.875 FORMAT "%6.2" /end CHARACTERISTIC
/begin CHARACTERISTIC KNCK_V_TRANS_TPS_INC_THR "TPS increase threshold to determinate knock transient state" VALUE 0x2886C __SWORD_S 0 u_pct_s -200 199.993896484375 /end CHARACTERISTIC
/begin CHARACTERISTIC KNCK_V_TRANS_TPS_DEC_THR "TPS decrease threshold to determinate knock transient state" VALUE 0x2886C __SWORD_S 0 u_pct_s -200 199.993896484375 /end CHARACTERISTIC
/begin CHARACTERISTIC KNCK_V_TRANS_IMEP_DEV_THR "IMEP deviation threshold between tq_imep_ref and knck_imep_filt to determinate knock transient state" VALUE 0x0002038C __UWORD_S 0 u_kPa_0_4096 0 4095.937500 /end CHARACTERISTIC
/begin CHARACTERISTIC KNCK_V_TRANS_ST_HLD_DUR "hold duration of knock transient state after transient conditions not meet" VALUE 0x0002038C __UWORD_S 0 u_2x_tmr 0 1023.984375 /end CHARACTERISTIC
/begin CHARACTERISTIC KNCK_V_INT_FILT_SS "filter coeff of knock intensity when espd and tps steady state" VALUE 0x0002038C __UWORD_S 0 u_filter 0 0.9999847412109375 FORMAT "%5.4" /end CHARACTERISTIC
/begin CHARACTERISTIC KNCK_V_INT_FILT_DEC "filter coeff of knock intensity when espd or tps is decreasing" VALUE 0x0002038C __UWORD_S 0 u_filter 0 0.9999847412109375 FORMAT "%5.4" /end CHARACTERISTIC
/begin CHARACTERISTIC KNCK_V_INT_FILT_INC "filter coeff of knock intensity when espd or tps is increasing" VALUE 0x0002038C __UWORD_S 0 u_filter 0 0.9999847412109375 FORMAT "%5.4" /end CHARACTERISTIC
/begin CHARACTERISTIC KNCK_C_THR_FAC_TRANS_BIAS_ESPD "bias of knock threshold factor when transient state due to espd" CURVE 0x000200B0 __UWORD_S 0 u_fac_128 0 127.998046875 FORMAT "%5.3" SYMBOL_LINK "KNCK_C_THR_FAC_TRANS_BIAS_ESPD" 2
 /begin AXIS_DESCR FIX_AXIS sys_eng_spd u_espd 16 400 6400
  /begin FIX_AXIS_PAR_LIST 3200 6400 9600 12800 16000 19200 22400 25600 28800 32000 35200 38400 41600 44800 48000 51200 /end FIX_AXIS_PAR_LIST
 /end AXIS_DESCR
/end CHARACTERISTIC
/begin CHARACTERISTIC KNCK_C_THR_FAC_TRANS_BIAS_TPS "bias of knock threshold factor when transient state due to TPS" CURVE 0x000200B0 __UWORD_S 0 u_fac_128 0 127.998046875 FORMAT "%5.3" SYMBOL_LINK "KNCK_C_THR_FAC_TRANS_BIAS_TPS" 2
 /begin AXIS_DESCR FIX_AXIS sys_eng_spd u_espd 16 400 6400
  /begin FIX_AXIS_PAR_LIST 3200 6400 9600 12800 16000 19200 22400 25600 28800 32000 35200 38400 41600 44800 48000 51200 /end FIX_AXIS_PAR_LIST
 /end AXIS_DESCR
/end CHARACTERISTIC
/begin CHARACTERISTIC KNCK_M_INT_DLT_MAX "max limit of knck_knks_int_dlt" MAP 0x00020320 __UWORD_S 0 u_pct 0 199.996948 FORMAT "%6.3" SYMBOL_LINK "KNCK_M_INT_DLT_MAX" 4
 /begin AXIS_DESCR COM_AXIS tq_imep_ref u_kPa_0_4096 3 0.000000 4095.937500 AXIS_PTS_REF KNCK_X_IMEP_A /end AXIS_DESCR
 /begin AXIS_DESCR FIX_AXIS sys_eng_spd u_espd 20 400 8000
  /begin FIX_AXIS_PAR_LIST 3200 6400 9600 12800 16000 19200 22400 25600 28800 32000 35200 38400 41600 44800 48000 51200 54400 57600 60800 64000 /end FIX_AXIS_PAR_LIST
 /end AXIS_DESCR
/end CHARACTERISTIC
/begin CHARACTERISTIC KNCK_M_INT_DLT_MIN "min limit of knck_knks_int_dlt" MAP 0x00020320 __UWORD_S 0 u_pct 0 199.996948 FORMAT "%6.3" SYMBOL_LINK "KNCK_M_INT_DLT_MIN" 4
 /begin AXIS_DESCR COM_AXIS tq_imep_ref u_kPa_0_4096 3 0.000000 4095.937500 AXIS_PTS_REF KNCK_X_IMEP_A /end AXIS_DESCR
 /begin AXIS_DESCR FIX_AXIS sys_eng_spd u_espd 20 400 8000
  /begin FIX_AXIS_PAR_LIST 3200 6400 9600 12800 16000 19200 22400 25600 28800 32000 35200 38400 41600 44800 48000 51200 54400 57600 60800 64000 /end FIX_AXIS_PAR_LIST
 /end AXIS_DESCR
/end CHARACTERISTIC
/begin AXIS_PTS KNCK_X_IMEP_A "" 0x0002006C tq_imep_ref SSV__UWORD_S 0 u_kPa_0_4096 3 0 4095.937500 DEPOSIT ABSOLUTE SYMBOL_LINK "KNCK_X_IMEP_A" 2 /end AXIS_PTS
/begin CHARACTERISTIC KNCK_V_INT_DLT_ESPD_THR "engine speed threshold above which knck_knks_int_dlt update will be enabled" VALUE 0x0002038C __UWORD_S 0 u_espd 0 8191.875 FORMAT "%6.2" /end CHARACTERISTIC
/begin CHARACTERISTIC KNCK_V_INT_DLT_IMEP_THR "IMEP threshold above which knck_knks_int_dlt update will be enabled" VALUE 0x0002038C __UWORD_S 0 u_kPa_0_4096 0 4095.937500 /end CHARACTERISTIC
/begin CHARACTERISTIC KNCK_V_INT_DLT_FIL "filter coeff to calculate knck_knks_int_dlt" VALUE 0x0002038C __UWORD_S 0 u_filter 0 0.9999847412109375 FORMAT "%5.4" /end CHARACTERISTIC
/begin CHARACTERISTIC KNCK_V_INT_FILT_FAC "corrected factor of knock intensity filter coeff used when knock currently present" VALUE 0x0002038C __UWORD_S 0 u_fac_1 0 0.999984741210937 /end CHARACTERISTIC
/begin CHARACTERISTIC KNCK_C_KNKS_FILT_INT_MIN "min limit of filtered average knock intensity-knck_knks_filted_int" CURVE 0x383C2 __UWORD_S 0 u_pct 0 199.996948 FORMAT "%6.3"
 /begin AXIS_DESCR FIX_AXIS NO_INPUT_QUANTITY u_knck_cyl_frq 12 0 11 /begin FIX_AXIS_PAR_LIST 0 1 2 3 4 5 6 7 8 9 10 11 /end FIX_AXIS_PAR_LIST /end AXIS_DESCR
/end CHARACTERISTIC
/begin CHARACTERISTIC KNCK_V_ADP_RTD_INIT_ECT_THR "coolant threshold below which will enable adp retard factor when initialization" VALUE 0x0002038C __SWORD_S 0 u_deg_C -256 255.9921875 /end CHARACTERISTIC
/begin CHARACTERISTIC KNCK_C_ADP_RTD_INIT_FAC "coolant factor used to calculate adp retard when Key On initialization" CURVE 0x000200B0 __UWORD_S 0 u_fac_1 0 0.999984741210937 SYMBOL_LINK "KNCK_C_ADP_RTD_INIT_FAC" 2
 /begin AXIS_DESCR FIX_AXIS sys_ect u_deg_C 6 -40 110 /begin FIX_AXIS_PAR_LIST -5120 -1280 2560 6400 10240 14080 /end FIX_AXIS_PAR_LIST /end AXIS_DESCR
/end CHARACTERISTIC
/begin CHARACTERISTIC KNCK_V_ADP_CELL_ESPD_BND1 "engine speed boundary 1 of knock adaption retard cell" VALUE 0x0002038C __UWORD_S 0 u_espd 0 8191.875 FORMAT "%6.2" /end CHARACTERISTIC
/begin CHARACTERISTIC KNCK_V_ADP_CELL_ESPD_BND2 "engine speed boundary 2 of knock adaption retard cell" VALUE 0x0002038C __UWORD_S 0 u_espd 0 8191.875 FORMAT "%6.2" /end CHARACTERISTIC
/begin CHARACTERISTIC KNCK_V_ADP_CELL_ESPD_BND3 "engine speed boundary 3 of knock adaption retard cell" VALUE 0x0002038C __UWORD_S 0 u_espd 0 8191.875 FORMAT "%6.2" /end CHARACTERISTIC
/begin CHARACTERISTIC KNCK_V_ADP_CELL_ESPD_BND4 "engine speed boundary 4 of knock adaption retard cell" VALUE 0x0002038C __UWORD_S 0 u_espd 0 8191.875 FORMAT "%6.2" /end CHARACTERISTIC
/begin CHARACTERISTIC KNCK_C_ADP_CELL_IMEP_BND1 "imep boundary 1 of knock adaption retard cell" CURVE 0x000200B0 __UWORD_S 0 u_kPa_0_4096 0 4095.937500 SYMBOL_LINK "KNCK_C_ADP_CELL_IMEP_BND1" 2
 /begin AXIS_DESCR FIX_AXIS sys_eng_spd u_espd 16 400 6400
  /begin FIX_AXIS_PAR_LIST 3200 6400 9600 12800 16000 19200 22400 25600 28800 32000 35200 38400 41600 44800 48000 51200 /end FIX_AXIS_PAR_LIST
 /end AXIS_DESCR
/end CHARACTERISTIC
/begin CHARACTERISTIC KNCK_C_ADP_CELL_IMEP_BND2 "imep boundary 2 of knock adaption retard cell" CURVE 0x000200B0 __UWORD_S 0 u_kPa_0_4096 0 4095.937500 SYMBOL_LINK "KNCK_C_ADP_CELL_IMEP_BND2" 2
 /begin AXIS_DESCR FIX_AXIS sys_eng_spd u_espd 16 400 6400
  /begin FIX_AXIS_PAR_LIST 3200 6400 9600 12800 16000 19200 22400 25600 28800 32000 35200 38400 41600 44800 48000 51200 /end FIX_AXIS_PAR_LIST
 /end AXIS_DESCR
/end CHARACTERISTIC
/begin CHARACTERISTIC KNCK_V_ADP_RTD_ECT_THR "coolant threshold above which can enable adp iga retard" VALUE 0x0002038C __SWORD_S 0 u_deg_C -256 255.9921875 /end CHARACTERISTIC
/begin CHARACTERISTIC KNCK_V_ADP_RTD_TRANS_DIS "True means disable adp iga retard when knock transient mode active" VALUE 0x0002038C __UBYTE_S 0 b_true 0 1 FORMAT "%1.0" /end CHARACTERISTIC
/begin CHARACTERISTIC KNCK_V_FST_QK_EXT_THR "Fast IGA knock retard threshold above which to enable quick exit of fast retard" VALUE 0x0002038C __SWORD_S 0 u_iga -256 255.9921875 FORMAT "%4.2" /end CHARACTERISTIC
/begin CHARACTERISTIC KNCK_C_FST_RTD_LMT_DEV "deviation with average fast retard to get low limit of individual cycle fast retard" CURVE 0x000200B0 __SWORD_S 0 u_iga -256 255.9921875 FORMAT "%4.2" SYMBOL_LINK "KNCK_C_FST_RTD_LMT_DEV" 2
 /begin AXIS_DESCR FIX_AXIS sys_eng_spd u_espd 16 400 6400
  /begin FIX_AXIS_PAR_LIST 3200 6400 9600 12800 16000 19200 22400 25600 28800 32000 35200 38400 41600 44800 48000 51200 /end FIX_AXIS_PAR_LIST
 /end AXIS_DESCR
/end CHARACTERISTIC
/begin CHARACTERISTIC KNCK_C_FST_RTD_QK_EXT_STP "fast IGA retard quick exit step of knock ignition angle control" CURVE 0x000200B0 __SWORD_S 0 u_iga -256 255.9921875 FORMAT "%4.2" SYMBOL_LINK "KNCK_C_FST_RTD_QK_EXT_STP" 2
 /begin AXIS_DESCR FIX_AXIS sys_eng_spd u_espd 16 400 6400
  /begin FIX_AXIS_PAR_LIST 3200 6400 9600 12800 16000 19200 22400 25600 28800 32000 35200 38400 41600 44800 48000 51200 /end FIX_AXIS_PAR_LIST
 /end AXIS_DESCR
/end CHARACTERISTIC
/begin CHARACTERISTIC KNCK_V_ADP_RTD_EXT_ESPD_THR "engine speed threshold above which adp iga retard can be exit" VALUE 0x0002038C __UWORD_S 0 u_espd 0 8191.875 FORMAT "%6.2" /end CHARACTERISTIC
/begin CHARACTERISTIC KNCK_C_ADP_RTD_LMT_DEV "deviation with average ADP retard to get low limit of individual cycle adp retard" CURVE 0x000200B0 __SWORD_S 0 u_iga -256 255.9921875 FORMAT "%4.2" SYMBOL_LINK "KNCK_C_ADP_RTD_LMT_DEV" 2
 /begin AXIS_DESCR FIX_AXIS sys_eng_spd u_espd 16 400 6400
  /begin FIX_AXIS_PAR_LIST 3200 6400 9600 12800 16000 19200 22400 25600 28800 32000 35200 38400 41600 44800 48000 51200 /end FIX_AXIS_PAR_LIST
 /end AXIS_DESCR
/end CHARACTERISTIC
/begin CHARACTERISTIC KNCK_V_ADP_RTD_RUN_MIN "Min engine runtime adp retard can be applied" VALUE 0x232DC __UWORD_S 0 u_1s_tmr 0 65535 /end CHARACTERISTIC
/begin CHARACTERISTIC KNCK_V_ADP_RTD_STP_HVY_BIAS "heavy knock bias of adaption IGA retard step" VALUE 0x0002038C __SWORD_S 0 u_iga -256 255.9921875 FORMAT "%4.2" /end CHARACTERISTIC
/begin CHARACTERISTIC KNCK_V_FST_RTD_STP_HVY_BIAS "heavy knock bias of fast IGA retard step" VALUE 0x0002038C __SWORD_S 0 u_iga -256 255.9921875 FORMAT "%4.2" /end CHARACTERISTIC
/begin CHARACTERISTIC EVAC_C_MANI_DLY "Transport delay as purge gas crosses the intake manifold. " CURVE 0x000200B0 __UWORD_S 0 u_fac_32 0 31.99951171875 FORMAT "%5.3" SYMBOL_LINK "EVAC_C_MANI_DLY" 2
 /begin AXIS_DESCR FIX_AXIS sys_eng_spd u_espd 17 0 8191.875
  /begin FIX_AXIS_PAR_LIST 0 3200 6400 9600 12800 16000 19200 22400 25600 28800 32000 35200 38400 41600 44800 48000 51200 /end FIX_AXIS_PAR_LIST
 /end AXIS_DESCR
/end CHARACTERISTIC
/begin CHARACTERISTIC EVAC_V_VLT_HI "Enable purge control iginition voltage high limit." VALUE 0x0002038C __UWORD_S 0 u_volt_32 0 31.99951171875 FORMAT "%4.2" /end CHARACTERISTIC
/begin CHARACTERISTIC EVAC_V_VLT_LO "Enable purge control iginition voltage low limit." VALUE 0x0002038C __UWORD_S 0 u_volt_32 0 31.99951171875 FORMAT "%4.2" /end CHARACTERISTIC
/begin CHARACTERISTIC EVAC_V_ECT_LO "Enable purge control coolant temperature low limit." VALUE 0x0002038C __SWORD_S 0 u_deg_C -256 255.9921875 /end CHARACTERISTIC
/begin CHARACTERISTIC EVAC_V_IAT_LO "Enable purge control intake air temperature low limit." VALUE 0x0002038C __SWORD_S 0 u_deg_C -256 255.9921875 /end CHARACTERISTIC
/begin CHARACTERISTIC EVAC_V_AFR_DSBL "Purge system state set OFF when AFR richer than this cal." VALUE 0x0002038C __UWORD_S 0 u_afr 0 31.99951171875 FORMAT "%5.0" /end CHARACTERISTIC
/begin CHARACTERISTIC EVAC_V_OFF_DLY_PUC "Purge system state set OFF when PUC duration longer than this cal." VALUE 0x0002038C __UWORD_S 0 u_8x_tmr 0.0 4095.9375 FORMAT "%5.3" /end CHARACTERISTIC
/begin CHARACTERISTIC EVAC_V_OP_ACTV "Purge system use OpenLoop when purge system enable." VALUE 0x2886C __UBYTE_S 0 b_true 0 1 FORMAT "%1.0" BIT_MASK 0x01 /end CHARACTERISTIC
/begin CHARACTERISTIC EVAC_V_OP_ACTV_ECT_THRSH "Purge system use OpenLoop coolant temperature threshold when purge system enable." VALUE 0x0002038C __SWORD_S 0 u_deg_C -256 255.9921875 /end CHARACTERISTIC
/begin CHARACTERISTIC EVAC_V_OP_ACTV_POW_AFR "Purge system use OpenLoop when power AFR active." VALUE 0x2886C __UBYTE_S 0 b_true 0 1 FORMAT "%1.0" BIT_MASK 0x01 /end CHARACTERISTIC
/begin CHARACTERISTIC EVAC_V_OP_ACTV_EMOT "Purge system use OpenLoop when exhaust manifold over temperature active." VALUE 0x2886C __UBYTE_S 0 b_true 0 1 FORMAT "%1.0" BIT_MASK 0x01 /end CHARACTERISTIC
/begin CHARACTERISTIC EVAC_V_OP_ACTV_COT "Purge system use OpenLoop when catalyst over temperature active." VALUE 0x2886C __UBYTE_S 0 b_true 0 1 FORMAT "%1.0" BIT_MASK 0x01 /end CHARACTERISTIC
/begin CHARACTERISTIC EVAC_V_OP_ACTV_OSC "Purge system use OpenLoop when O2 consumption active." VALUE 0x2886C __UBYTE_S 0 b_true 0 1 FORMAT "%1.0" BIT_MASK 0x01 /end CHARACTERISTIC
/begin CHARACTERISTIC EVAC_V_CONC_LO_ENBL "Purge concentration low threshold to enable purge valve control." VALUE 0x0002038C __UWORD_S 0 u_pct 0 199.996948 FORMAT "%4.1" /end CHARACTERISTIC
/begin CHARACTERISTIC EVAC_V_CONC_LO_DLY "Purge concentration low delay time threshold." VALUE 0x0002038C __UWORD_S 0 u_8x_tmr 0.0 4095.9375 FORMAT "%5.3" /end CHARACTERISTIC
/begin CHARACTERISTIC EVAC_C_CONC_LO_DURATION "Purge concentration low duration limit." CURVE 0x000200B0 __UWORD_S 0 u_8x_tmr 0.0 4095.9375 FORMAT "%5.2" SYMBOL_LINK "EVAC_C_CONC_LO_DURATION" 2
 /begin AXIS_DESCR FIX_AXIS sys_iat u_deg_C 11 -256 255.9921875 /begin FIX_AXIS_PAR_LIST 0 640 1280 1920 2560 3200 3840 4480 5120 5760 6400 /end FIX_AXIS_PAR_LIST /end AXIS_DESCR
/end CHARACTERISTIC
/begin CHARACTERISTIC EVAC_V_CL_VAC_THRSH "Vacuum threshold below which purge duty cycle may not be incremented in closed loop purge." VALUE 0x0002038C __SWORD_S 0 u_kPa_128n_128p -128 127.99609375 /end CHARACTERISTIC
/begin CHARACTERISTIC EVAC_V_BST_TM "Canister purge boost state timer threshold." VALUE 0x0002038C __UWORD_S 0 u_8x_tmr 0.0 4095.9375 FORMAT "%5.3" /end CHARACTERISTIC
/begin CHARACTERISTIC EVAC_V_CL_ECT_THRSH "Coolant temperature threshold for selecting short or long delays to enable closed loop purge.This is intended to give flexibility in not starting closed loop purge until the catalyst is warm." VALUE 0x0002038C __SWORD_S 0 u_deg_C -256 255.9921875 /end CHARACTERISTIC
/begin CHARACTERISTIC EVAC_V_CL_DLY_HI "Run time delay to enable purge close loop when coolant temperature is high." VALUE 0x232DC __UBYTE_S 0 u_1s_tmr 0 255 /end CHARACTERISTIC
/begin CHARACTERISTIC EVAC_V_CL_DLY_LO "Run time delay to enable purge close loop when coolant temperature is low." VALUE 0x232DC __UBYTE_S 0 u_1s_tmr 0 255 /end CHARACTERISTIC
/begin CHARACTERISTIC EVAC_V_BST_VAC_MX "Manifold Vacuum must be below this value for EVAC_V_BST_TM for EVAP system to consider the engine to be in a boosted state." VALUE 0x0002038C __SWORD_S 0 u_kPa_128n_128p -128 127.99609375 /end CHARACTERISTIC
/begin CHARACTERISTIC EVAC_V_STP_FAC "Purge step up or step down factor when concentration is learned." VALUE 0x2004E __UWORD_S 0 u_fac_64 0.0 63.9990234375 /end CHARACTERISTIC
/begin CHARACTERISTIC EVAC_C_PF_DN_STP "Purge fuel down step size." CURVE 0x000200B0 __UWORD_S 0 u_pct_6p25 0.0 6.24 FORMAT "%5.4" SYMBOL_LINK "EVAC_C_PF_DN_STP" 2
 /begin AXIS_DESCR FIX_AXIS afm_air_flw u_g_per_sec 17 0 511.992188
  /begin FIX_AXIS_PAR_LIST 0 2048 4096 6144 8192 10240 12288 14336 16384 18432 20480 22528 24576 26624 28672 30720 32768 /end FIX_AXIS_PAR_LIST
 /end AXIS_DESCR
/end CHARACTERISTIC
/begin CHARACTERISTIC EVAC_C_PF_LMT_UN_LRN "Purge fuel limit when concentration is not learned." CURVE 0x000200B0 __UWORD_S 0 u_pct 0.0 199.996948 FORMAT "%4.1" SYMBOL_LINK "EVAC_C_PF_LMT_UN_LRN" 2
 /begin AXIS_DESCR FIX_AXIS fmsp_adp_area u_cnts 26 0 25
  /begin FIX_AXIS_PAR_LIST 0 1 2 3 4 5 6 7 8 9 10 11 12 13 14 15 16 17 18 19 20 21 22 23 24 25 /end FIX_AXIS_PAR_LIST
 /end AXIS_DESCR
/end CHARACTERISTIC
/begin CHARACTERISTIC EVAC_C_PF_LMT_LRN "Purge fuel limit when concentration is learned." CURVE 0x000200B0 __UWORD_S 0 u_pct 0.0 199.996948 FORMAT "%4.1" SYMBOL_LINK "EVAC_C_PF_LMT_LRN" 2
 /begin AXIS_DESCR FIX_AXIS fmsp_adp_area u_cnts 26 0 25
  /begin FIX_AXIS_PAR_LIST 0 1 2 3 4 5 6 7 8 9 10 11 12 13 14 15 16 17 18 19 20 21 22 23 24 25 /end FIX_AXIS_PAR_LIST
 /end AXIS_DESCR
/end CHARACTERISTIC
/begin CHARACTERISTIC EVAC_V_OP_PF_STP "Purge fuel open loop step." VALUE 0x2004E __UWORD_S 0 u_pct_6p25 0.0 6.24 FORMAT "%5.4" /end CHARACTERISTIC
/begin CHARACTERISTIC EVAC_C_CP_FLW_LMT "Purge air flow limit." CURVE 0x000200B0 __UWORD_S 0 u_g_per_sec_64 0.0 63.9990234375 SYMBOL_LINK "EVAC_C_CP_FLW_LMT" 2
 /begin AXIS_DESCR FIX_AXIS afm_air_flw u_g_per_sec 8 0 511.9921875 /begin FIX_AXIS_PAR_LIST 0 256 384 512 768 1024 1536 2047 /end FIX_AXIS_PAR_LIST /end AXIS_DESCR
/end CHARACTERISTIC
/begin CHARACTERISTIC EVAC_M_DC_LMT_IDL "Purge duty cycle limit in idle state." MAP 0x36504 __UWORD_S 0 u_pct 0 199.996948 FORMAT "%4.1" SYMBOL_LINK "EVAC_M_DC_LMT_IDL" 4
 /begin AXIS_DESCR COM_AXIS sys_iat u_deg_C 7 -256 255.9921875 AXIS_PTS_REF EVAC_X_IAT /end AXIS_DESCR
 /begin AXIS_DESCR COM_AXIS sys_ect u_deg_C 7 -256 255.9921875 AXIS_PTS_REF EVAC_X_ECT /end AXIS_DESCR
/end CHARACTERISTIC
/begin AXIS_PTS EVAC_X_IAT "intake air temperature breakpoint" 0x0002006C sys_iat SSV__SWORD_S 0 u_deg_C 7 -256 255.9921875 DEPOSIT ABSOLUTE SYMBOL_LINK "EVAC_X_IAT" 2 /end AXIS_PTS
/begin AXIS_PTS EVAC_X_ECT "engine coolant temperature breakpoint" 0x0002006C sys_ect SSV__SWORD_S 0 u_deg_C 7 -256 255.9921875 DEPOSIT ABSOLUTE SYMBOL_LINK "EVAC_X_ECT" 2 /end AXIS_PTS
/begin CHARACTERISTIC EVAC_V_PF_INC_DSBL "Delivered fuel pulse width/min fuel pulse width less than this cal,increase purge fuel set true in diagnostic mode or close loop mode." VALUE 0x2004E __UWORD_S 0 u_fac_2 0.0 1.999969482421875 FORMAT "%6.5" /end CHARACTERISTIC
/begin CHARACTERISTIC EVAC_V_PF_DEC_ENBL "Delivered fuel pulse width/min fuel pulse width less than this cal,decrease purge fuel set true in diagnostic mode or close loop mode." VALUE 0x2004E __UWORD_S 0 u_fac_2 0.0 1.999969482421875 FORMAT "%6.5" /end CHARACTERISTIC
/begin CHARACTERISTIC EVAC_V_DIAG_MSFLW_DN_STP "Purge diagnostic mass flow control mode purge fuel learn down step." VALUE 0x2004E __UWORD_S 0 u_pct_6p25 0.0 6.24 FORMAT "%5.4" /end CHARACTERISTIC
/begin CHARACTERISTIC EVAC_C_DIAG_MSFLW_STP_FAC "Purge diagnostic mass flow control mode purge fuel learn step factor." CURVE 0x000200B0 __UWORD_S 0 u_pct 0.0 199.996948 FORMAT "%4.1" SYMBOL_LINK "EVAC_C_DIAG_MSFLW_STP_FAC" 2
 /begin AXIS_DESCR FIX_AXIS NO_INPUT_QUANTITY u_g_per_sec_2n_2p 17 -2 1.99993896484375
  /begin FIX_AXIS_PAR_LIST -6553.6 -4915.2 -3276.8 -1638.4 -1310.72 -983.04 -655.36 -327.68 0 327.68 655.36 983.04 1310.72 1638.4 3276.8 4915.2 6553.6 /end FIX_AXIS_PAR_LIST
 /end AXIS_DESCR
/end CHARACTERISTIC
/begin CHARACTERISTIC EVAC_V_FMSP_FAC_DEC_THRSH "Fuel close loop factor threshold to decrease purge fuel." VALUE 0x2004E __UWORD_S 0 u_fac_2 0.0 1.999969482421875 FORMAT "%6.5" /end CHARACTERISTIC
/begin CHARACTERISTIC EVAC_V_DEC_LN_TM_THRSH "O2 lean duration less than this cal,learn down may met." VALUE 0x0002038C __UWORD_S 0 u_2x_tmr 0 1023.984375 /end CHARACTERISTIC
/begin CHARACTERISTIC EVAC_V_DIAG_MSFLW_UP_STP "Purge diagnostic mass flow control mode purge fuel learn up step." VALUE 0x2004E __UWORD_S 0 u_pct_6p25 0.0 6.24 FORMAT "%5.4" /end CHARACTERISTIC
/begin CHARACTERISTIC EVAC_V_DIAG_MSFLW_DLT "Deadband for Purge_Massflow when in DIAG_CONTROL and controlling based on MASSFLOW." VALUE 0x2004E __UWORD_S 0 u_g_per_sec_2n_2p -2 1.99993896484375 /end CHARACTERISTIC
/begin CHARACTERISTIC EVAC_V_FMSP_FAC_INC_THRSH_LO "Fuel close loop factor low threshold to increase purge fuel." VALUE 0x2004E __UWORD_S 0 u_fac_2 0.0 1.999969482421875 FORMAT "%6.5" /end CHARACTERISTIC
/begin CHARACTERISTIC EVAC_V_FMSP_FAC_INC_THRSH_HI "Fuel close loop factor high threshold to increase purge fuel." VALUE 0x2004E __UWORD_S 0 u_fac_2 0.0 1.999969482421875 FORMAT "%6.5" /end CHARACTERISTIC
/begin CHARACTERISTIC EVAC_V_INC_LN_TM_THRSH "O2 lean duration less than this cal,learn up may met." VALUE 0x0002038C __UWORD_S 0 u_2x_tmr 0 1023.984375 /end CHARACTERISTIC
/begin CHARACTERISTIC EVAC_V_INC_RCH_TM_THRSH "O2 rich duration less than this cal,learn up may met." VALUE 0x0002038C __UWORD_S 0 u_2x_tmr 0 1023.984375 FORMAT "%5.2" /end CHARACTERISTIC
/begin CHARACTERISTIC EVAC_C_PF_UP_STP "Purge fuel up step." CURVE 0x000200B0 __UWORD_S 0 u_pct_6p25 0.0 6.24 FORMAT "%5.4" SYMBOL_LINK "EVAC_C_PF_UP_STP" 2
 /begin AXIS_DESCR FIX_AXIS NO_INPUT_QUANTITY u_g_per_sec 17 0 511.9921875
  /begin FIX_AXIS_PAR_LIST 0 2048 4096 6144 8192 10240 12288 14336 16384 18432 20480 22528 24576 26624 28672 30720 32755 /end FIX_AXIS_PAR_LIST
 /end AXIS_DESCR
/end CHARACTERISTIC
/begin CHARACTERISTIC EVAC_C_PF_UP_STP_FAC "Purge fuel up step factor." VALUE 0x2004E __UWORD_S 0 u_fac_64 0.0 63.9990234375 /end CHARACTERISTIC
/begin CHARACTERISTIC EVAC_M_VAC_RT_INC_THRSH "If Tank Vacuum Rate is less than this threshold,purge might be increased by the step up term.If Tank Vacuum Rate is greater than the sum of this threshold and deadband,purge might be decreased." MAP 0x36504 __SWORD_S 0 u_kPaSec_c -8 7.999755859375 FORMAT "%3.2" SYMBOL_LINK "EVAC_M_VAC_RT_INC_THRSH" 4
 /begin AXIS_DESCR FIX_AXIS evam_flv_mmv u_pct_1 17 0 99.9984741210937
  /begin FIX_AXIS_PAR_LIST 0 4096 8192 12288 16384 20480 24576 28672 32768 36864 40960 45056 49152 53248 57344 61440 65535 /end FIX_AXIS_PAR_LIST
 /end AXIS_DESCR
 /begin AXIS_DESCR FIX_AXIS evam_tank_vac_err u_kPa_8n_8p 9 -8 7.999755859375 /begin FIX_AXIS_PAR_LIST 0 2560 5120 7680 10240 12800 15360 17920 20480 /end FIX_AXIS_PAR_LIST /end AXIS_DESCR
/end CHARACTERISTIC
/begin CHARACTERISTIC EVAC_V_VAC_RT_INC_THRSH_DB "Purge tank vacuum rate threshold deadband." VALUE 0x0002038C __SWORD_S 0 u_kPaSec_c -8 7.999755859375 FORMAT "%3.2" /end CHARACTERISTIC
/begin CHARACTERISTIC EVAC_V_DIAG_VAC_DN_STP "Purge diagnostic tank vacuum control mode purge fuel learn down step." VALUE 0x2004E __UWORD_S 0 u_pct_6p25 0.0 6.24 FORMAT "%5.4" /end CHARACTERISTIC
/begin CHARACTERISTIC EVAC_V_DIAG_VAC_UP_STP "Purge diagnostic tank vacuum control mode purge fuel learn up step." VALUE 0x2004E __UWORD_S 0 u_pct_6p25 0.0 6.24 FORMAT "%5.4" /end CHARACTERISTIC
/begin CHARACTERISTIC EVAC_C_DIAG_PF_LMT "Purge fuel limit in diagnostic mode." CURVE 0x000200B0 __UWORD_S 0 u_pct 0.0 199.996948 FORMAT "%4.1" SYMBOL_LINK "EVAC_C_DIAG_PF_LMT" 2
 /begin AXIS_DESCR FIX_AXIS fmsp_adp_area u_cnts 26 0 25
  /begin FIX_AXIS_PAR_LIST 0 1 2 3 4 5 6 7 8 9 10 11 12 13 14 15 16 17 18 19 20 21 22 23 24 25 /end FIX_AXIS_PAR_LIST
 /end AXIS_DESCR
/end CHARACTERISTIC
/begin CHARACTERISTIC EVAC_V_PF_DEC_FAC "Purge fuel decrease factor when inhibit increase." VALUE 0x0002038C __UWORD_S 0 u_pct 0 199.996948242187 /end CHARACTERISTIC
/begin CHARACTERISTIC EVAC_V_PF_RMP_FAC "Purge fuel ramp off mode step down factor in diagnostic mode." VALUE 0x0002038C __UWORD_S 0 u_fac_4 0 3.99993896484375 FORMAT "%3.2" /end CHARACTERISTIC
/begin CHARACTERISTIC EVAC_V_CONC_HI "Purge concentration high threshold." VALUE 0x0002038C __UWORD_S 0 u_pct 0 199.996948242187 /end CHARACTERISTIC
/begin CHARACTERISTIC EVAC_V_CONC_LO "Purge concentration low threshold." VALUE 0x0002038C __UWORD_S 0 u_pct 0 199.996948242187 /end CHARACTERISTIC
/begin CHARACTERISTIC EVAC_V_PF_LMT_DB "Purge fuel limit deadband." VALUE 0x0002038C __UWORD_S 0 u_pct 0 199.996948242187 /end CHARACTERISTIC
/begin CHARACTERISTIC EVAC_C_PF_LMT_HI_CONC "Purge fuel limit when high concentration." CURVE 0x000200B0 __UWORD_S 0 u_pct 0.0 199.996948 FORMAT "%4.1" SYMBOL_LINK "EVAC_C_PF_LMT_HI_CONC" 2
 /begin AXIS_DESCR FIX_AXIS fmsp_adp_area u_cnts 26 0 25
  /begin FIX_AXIS_PAR_LIST 0 1 2 3 4 5 6 7 8 9 10 11 12 13 14 15 16 17 18 19 20 21 22 23 24 25 /end FIX_AXIS_PAR_LIST
 /end AXIS_DESCR
/end CHARACTERISTIC
/begin CHARACTERISTIC EVAC_V_PF_INC_DSBL_BST "Delivered fuel pulse width/min fuel pulse width less than this cal,increase purge fuel set true in boost mode." VALUE 0x2004E __UWORD_S 0 u_fac_2 0.0 1.999969482421875 FORMAT "%6.5" /end CHARACTERISTIC
/begin CHARACTERISTIC EVAC_V_PF_DEC_ENBL_BST "Delivered fuel pulse width/min fuel pulse width less than this cal,decrease purge fuel set true in boost mode." VALUE 0x2004E __UWORD_S 0 u_fac_2 0.0 1.999969482421875 FORMAT "%6.5" /end CHARACTERISTIC
/begin CHARACTERISTIC EVAC_V_FMSP_FAC_DEC_THRSH_BST "Fuel close loop factor threshold to decrease purge fuel in boost mode." VALUE 0x2004E __UWORD_S 0 u_fac_2 0.0 1.999969482421875 FORMAT "%6.5" /end CHARACTERISTIC
/begin CHARACTERISTIC EVAC_V_DEC_LN_TM_THRSH_BST "O2 lean duration less than this cal in boost mode,learn down may met." VALUE 0x0002038C __UWORD_S 0 u_2x_tmr 0 1023.984375 /end CHARACTERISTIC
/begin CHARACTERISTIC EVAC_V_FMSP_FAC_INC_THRSH_LO_BST "Fuel close loop factor low threshold to increase purge fuel in boost mode." VALUE 0x2004E __UWORD_S 0 u_fac_2 0.0 1.999969482421875 FORMAT "%6.5" /end CHARACTERISTIC
/begin CHARACTERISTIC EVAC_V_FMSP_FAC_INC_THRSH_HI_BST "Fuel close loop factor high threshold to increase purge fuel in boost mode." VALUE 0x2004E __UWORD_S 0 u_fac_2 0.0 1.999969482421875 FORMAT "%6.5" /end CHARACTERISTIC
/begin CHARACTERISTIC EVAC_V_INC_LN_TM_THRSH_BST "O2 lean duration less than this cal in boost mode,learn up may met." VALUE 0x0002038C __UWORD_S 0 u_2x_tmr 0 1023.984375 /end CHARACTERISTIC
/begin CHARACTERISTIC EVAC_V_INC_RCH_TM_THRSH_BST "O2 rich duration less than this cal in boost mode,learn up may met." VALUE 0x0002038C __UWORD_S 0 u_2x_tmr 0 1023.984375 /end CHARACTERISTIC
/begin CHARACTERISTIC EVAC_C_PF_LMT_BST "Purge fuel limit when in boost mode either concentration is learned or unlearned." CURVE 0x000200B0 __UWORD_S 0 u_pct 0.0 199.996948 FORMAT "%4.1" SYMBOL_LINK "EVAC_C_PF_LMT_BST" 2
 /begin AXIS_DESCR FIX_AXIS fmsp_adp_area u_cnts 26 0 25
  /begin FIX_AXIS_PAR_LIST 0 1 2 3 4 5 6 7 8 9 10 11 12 13 14 15 16 17 18 19 20 21 22 23 24 25 /end FIX_AXIS_PAR_LIST
 /end AXIS_DESCR
/end CHARACTERISTIC
/begin CHARACTERISTIC EVAC_V_DEN_FAC "Purge density factor." VALUE 0x0002038C __UWORD_S 0 u_fac_4 0 3.99993896484375 FORMAT "%3.2" /end CHARACTERISTIC
/begin CHARACTERISTIC EVAC_V_MX_CP_FLW_ENBL "Max purge flow enable." VALUE 0x0002038C __UBYTE_S 0 b_true 0 1 FORMAT "%1.0" /end CHARACTERISTIC
/begin CHARACTERISTIC EVAC_V_MX_CP_FLW_AIR_THRSH "Max purge flow enable air flow threshold." VALUE 0x0002038C __UWORD_S 0 u_g_per_sec 0 511.9921875 /end CHARACTERISTIC
/begin CHARACTERISTIC EVAC_V_MX_CP_FLW_PR_THRSH "Max purge flow enable pressure ratio threshold(Manifold pressure/ purge pressure)." VALUE 0x2004E __UWORD_S 0 u_fac_2 0.0 1.999969482421875 FORMAT "%6.5" /end CHARACTERISTIC
/begin CHARACTERISTIC EVAC_V_MX_CP_FLW_ESPD_THRSH "Max purge flow enable engine speed threshold." VALUE 0x0002038C __UWORD_S 0 u_espd 0 8191.875000 FORMAT "%5.1" /end CHARACTERISTIC
/begin CHARACTERISTIC EVAC_V_MX_CP_FLW_VSPD_THRSH "Max purge flow enable vehicle speed threshold." VALUE 0x0002038C __UWORD_S 0 u_vspd 0 511.9921875 FORMAT "%4.1" /end CHARACTERISTIC
/begin CHARACTERISTIC EVAC_C_MX_CP_FLW_FAC "Max purge flow factor." CURVE 0x000200B0 __UWORD_S 0 u_fac_2 0 1.999969482421875 FORMAT "%4.3" SYMBOL_LINK "EVAC_C_MX_CP_FLW_FAC" 2
 /begin AXIS_DESCR COM_AXIS afm_air_flw u_g_per_sec 5 0 511.992188 AXIS_PTS_REF EVAC_X_AIRFLOW /end AXIS_DESCR
/end CHARACTERISTIC
/begin AXIS_PTS EVAC_X_AIRFLOW "air flow breakpoint" 0x0002006C afm_air_flw SSV__UWORD_S 0 u_g_per_sec 5 0 511.992188 DEPOSIT ABSOLUTE SYMBOL_LINK "EVAC_X_AIRFLOW" 2 /end AXIS_PTS
/begin CHARACTERISTIC EVAC_V_MX_CP_FLW_DLY "Max purge flow delay." VALUE 0x0002038C __UWORD_S 0 u_8x_tmr 0 4095.9375 FORMAT "%5.3" /end CHARACTERISTIC
/begin CHARACTERISTIC EVAC_C_MX_CP_FLW_DLT "Max purge flow change rate in one loop." CURVE 0x000200B0 __UWORD_S 0 u_g_per_sec 0 511.992188 SYMBOL_LINK "EVAC_C_MX_CP_FLW_DLT" 2
 /begin AXIS_DESCR FIX_AXIS afm_air_flw u_g_per_sec 8 0 511.992188 /begin FIX_AXIS_PAR_LIST 0 256 384 512 768 1024 1536 2047 /end FIX_AXIS_PAR_LIST /end AXIS_DESCR
/end CHARACTERISTIC
/begin CHARACTERISTIC EVAC_C_CP_VLV_PR_FAC "Purge valve pressure ratio factor." CURVE 0x000200B0 __UWORD_S 0 u_fac_2 0 1.999969482421875 FORMAT "%4.3" SYMBOL_LINK "EVAC_C_CP_VLV_PR_FAC" 2
 /begin AXIS_DESCR FIX_AXIS afm_pr_map2purg u_fac_2 15 0 1.999969482421875 FORMAT "%5.2"
  /begin FIX_AXIS_PAR_LIST 9830 14417 17039 18939 21626 24313 26705 28442 29753 30736 31522 32079 32440 32702 32768 /end FIX_AXIS_PAR_LIST
 /end AXIS_DESCR
/end CHARACTERISTIC
/begin CHARACTERISTIC EVAC_V_MN_DC "Min purge duty cycle." VALUE 0x0002038C __UWORD_S 0 u_pct 0 199.996948242187 /end CHARACTERISTIC
/begin CHARACTERISTIC EVAC_V_ADP_INH_THRSH "Fuel adaption factor learning is inhibited if the purge fuel ratio is beyond this threshold." VALUE 0x0002038C __UWORD_S 0 u_pct 0 199.996948242187 /end CHARACTERISTIC
/begin CHARACTERISTIC EVAC_V_CONC_FILTER_OL "Purge concentration filter when in purge open loop mode." VALUE 0x0002038C __UWORD_S 0 u_filter 0 0.9999847412109375 FORMAT "%4.3" /end CHARACTERISTIC
/begin CHARACTERISTIC EVAC_V_CONC_STBL "Accumulated purge mass flow beyond which will set concentration transtion mode end." VALUE 0x0002038C __UWORD_S 0 u_gram_16 0 15.999755859375 FORMAT "%5.2" /end CHARACTERISTIC
/begin CHARACTERISTIC EVAC_V_CONC_STP_FAC "Purge concentration updated step factor." VALUE 0x2004E __UWORD_S 0 u_fac_2 0.0 1.999969482421875 FORMAT "%6.5" /end CHARACTERISTIC
/begin CHARACTERISTIC EVAC_V_CONC_STP_MX "Purge concentration updated step max limit." VALUE 0x0002038C __SWORD_S 0 u_pct_1 -50 49.9984741210937 FORMAT "%4.2" /end CHARACTERISTIC
/begin CHARACTERISTIC EVAC_C_CONC_SP_BST "Purge concentration setpoint when in boost purge mode." CURVE 0x000200B0 __UWORD_S 0 u_pct 0.0 199.996948 FORMAT "%4.1" SYMBOL_LINK "EVAC_C_CONC_SP_BST" 2
 /begin AXIS_DESCR FIX_AXIS sys_iat u_deg_C 11 -256 255.9921875 /begin FIX_AXIS_PAR_LIST 0 640 1280 1920 2560 3200 3840 4480 5120 5760 6400 /end FIX_AXIS_PAR_LIST /end AXIS_DESCR
/end CHARACTERISTIC
/begin CHARACTERISTIC EVAC_C_CONC_FILTER_BST "Purge concentration filter when in purge boost mode." CURVE 0x000200B0 __UWORD_S 0 u_filter 0.0 0.9999847412109375 FORMAT "%4.3" SYMBOL_LINK "EVAC_C_CONC_FILTER_BST" 2
 /begin AXIS_DESCR FIX_AXIS evac_cp_flw u_g_per_sec_64 9 0 63.9990234375 /begin FIX_AXIS_PAR_LIST 0 256 512 768 1024 1280 1536 1792 2048 /end FIX_AXIS_PAR_LIST /end AXIS_DESCR
/end CHARACTERISTIC
/begin CHARACTERISTIC EVAC_V_MS_FLW_LRN_THRSH "Purge mass flow which is below this amount for EVAC_V_LO_PURG_RT_TM concentration needs to be relearned.Learned flag will be reset." VALUE 0x0002038C __UWORD_S 0 u_g_per_sec_16 0.0 15.999756 /end CHARACTERISTIC
/begin CHARACTERISTIC EVAC_V_LO_PURG_RT_TM "Low purge ratio time which will relearn purge concentration." VALUE 0x0002038C __UWORD_S 0 u_8x_tmr 0 4095.9375 FORMAT "%5.3" /end CHARACTERISTIC
/begin CHARACTERISTIC EVAC_V_CONC_INIT "Initial purge concentration value when purge low and reset purge concentration." VALUE 0x0002038C __UWORD_S 0 u_pct 0 199.996948242187 /end CHARACTERISTIC
/begin CHARACTERISTIC EVAC_V_PF_THRSH "Purge fuel threshold to set concentration learned flag." VALUE 0x0002038C __UWORD_S 0 u_pct 0 199.996948242187 /end CHARACTERISTIC
/begin CHARACTERISTIC EVAC_V_CP_MS_FLW_THRSH "Purge mass flow threshold to set concentration learned flag." VALUE 0x0002038C __UWORD_S 0 u_g_per_sec_16 0.0 15.999756 /end CHARACTERISTIC
/begin CHARACTERISTIC EVAC_V_CONC_BLD_FLT "Filter for the purge concentration manifold blending." VALUE 0x0002038C __UWORD_S 0 u_filter 0 0.9999847412109375 FORMAT "%10.9" /end CHARACTERISTIC
/begin CHARACTERISTIC EVAC_V_INT_DIFF_THRSH "Threshold for Fuel Integrator multiplier separation to limit purge flow because of purge distribution problems." VALUE 0x20D9A __UWORD_S 0 u_fac_2 0 1.999969482421875 FORMAT "%4.3" /end CHARACTERISTIC
/begin CHARACTERISTIC EVAC_V_BST_INT_DIFF_THRSH "For Boosted Conditions,Threshold for Fuel Integrator multiplier separation to limit purge flow because of purge distribution problems." VALUE 0x20D9A __UWORD_S 0 u_fac_2 0 1.999969482421875 FORMAT "%4.3" /end CHARACTERISTIC
/begin CHARACTERISTIC EVAC_V_LO_FREQ_ESPD_LO_THRSH "RPM Threshold (lower hysteresis) for determining if the Purge solenoid\should run at the low or high frequency. If the RPM is below this value, purge runs at the\low frequency." VALUE 0x22FCE __UWORD_S 0 u_espd 0 8191.875000 FORMAT "%6.2" /end CHARACTERISTIC
/begin CHARACTERISTIC EVAC_V_LO_FREQ_ESPD_HI_THRSH "RPM Threshold (upper hysteresis) for determining if the Purge solenoid\should run at the low or high frequency. If the RPM is above this value, purge runs at the\high frequency." VALUE 0x22FCE __UWORD_S 0 u_espd 0 8191.875000 FORMAT "%6.2" /end CHARACTERISTIC
/begin CHARACTERISTIC EVAC_V_LO_FREQ_ESPD_LO_DC "Duty cycle threshold (lower hysteresis) to select output frequency." VALUE 0x0002038C __UWORD_S 0 u_pct 0 199.996948 FORMAT "%4.3" /end CHARACTERISTIC
/begin CHARACTERISTIC EVAC_V_LO_FREQ_ESPD_HI_DC "Duty cycle threshold (upper hysteresis) to select output frequency." VALUE 0x0002038C __UWORD_S 0 u_pct 0 199.996948 FORMAT "%4.3" /end CHARACTERISTIC
/begin CHARACTERISTIC EVAC_V_SLND_FREQ_LO "Desired Normal Purge solenoid frequency." VALUE 0x0002038C __UWORD_S 0 u_hz_16384 0 16383.75 /end CHARACTERISTIC
/begin CHARACTERISTIC EVAC_V_SLND_FREQ_HI "Desired Normal Purge solenoid frequency." VALUE 0x0002038C __UWORD_S 0 u_hz_16384 0 16383.75 /end CHARACTERISTIC
/begin CHARACTERISTIC EVAC_V_LV_OLP "If fraction of O2 already depleted determined by min of FO2DB1FR,FO2DB2FR is greater then this calibration, OL Purge will remain for the rest of the current O2 depletion event regardless of O2 sensor voltage." VALUE 0x20D9A __UWORD_S 0 u_fac_2 0 1.999969482421875 FORMAT "%4.3" /end CHARACTERISTIC
/begin CHARACTERISTIC EVAC_V_F02_LN_THRSH "Front O2 sensor voltage  threshold below which TooLean Timer will start to increment when Open Loop Purge is active during O2 Depletion." VALUE 0x21C28 __UWORD_S 0 u_volt_32 0 31.99951171875 FORMAT "%4.2" /end CHARACTERISTIC
/begin CHARACTERISTIC EVAC_V_F02_RCH_THRSH "Front O2 sensor voltage  threshold which must be exceeded within some time to avoid shutting off OL Purge during O2 Depletion." VALUE 0x21C28 __UWORD_S 0 u_volt_32 0 31.99951171875 FORMAT "%4.2" /end CHARACTERISTIC
/begin CHARACTERISTIC EVAC_V_LN_TM_FAC "" VALUE 0x20D9A __UWORD_S 0 u_fac_8192 0 8191.875 SYMBOL_LINK "EVAC_V_LV_OLP" 0 /end CHARACTERISTIC
/begin CHARACTERISTIC EVAC_V_FO2_RCH_TM "Time limit within which  front oxygen sensor voltage must exceed EVAC_V_F02_RCH_THRSH.Otherwise, OL Purge is disabled for the remainder of the current O2 Depletion Event." VALUE 0x0002038C __UWORD_S 0 u_8x_tmr 0.0 4095.9375 FORMAT "%5.2" /end CHARACTERISTIC
/begin CHARACTERISTIC EVAC_M_HYB_CONC_INIT_DLT "If purge concentration learn is FALSE,purge concentration will be set to an initial value from this table when purging resumes after a hybrid idle stop." MAP 0x00020320 __UWORD_S 0 u_pct 0 199.996948 SYMBOL_LINK "EVAC_M_HYB_CONC_INIT_DLT" 4
 /begin AXIS_DESCR COM_AXIS NO_INPUT_QUANTITY u_deg_C 5 -256.0 255.9921875 AXIS_PTS_REF EVAC_X_AMB_T /end AXIS_DESCR
 /begin AXIS_DESCR COM_AXIS NO_INPUT_QUANTITY u_8x_tmr 5 0 4095.9375 AXIS_PTS_REF EVAC_X_STP_TM /end AXIS_DESCR
/end CHARACTERISTIC
/begin AXIS_PTS EVAC_X_AMB_T "ambient temperature breakpoint" 0x0002006C NO_INPUT_QUANTITY SSV__SWORD_S 0 u_deg_C 5 -256 255.9921875 DEPOSIT ABSOLUTE SYMBOL_LINK "EVAC_X_AMB_T" 2 /end AXIS_PTS
/begin AXIS_PTS EVAC_X_STP_TM "Stop time breakpoint" 0x0002006C NO_INPUT_QUANTITY SSV__UWORD_S 0 u_8x_tmr 5 0 4095.9375 FORMAT "%7.3" DEPOSIT ABSOLUTE SYMBOL_LINK "EVAC_X_STP_TM" 2 /end AXIS_PTS
/begin CHARACTERISTIC EVAC_V_HYB_LONG_STP_THRSH "Time after which an idle stop is considered so long that post-idle stop shortened purge re-start delays are no longer allowed,and normal IC engine re-start delays are used." VALUE 0x0002038C __UWORD_S 0 u_8x_tmr 0.0 4095.9375 FORMAT "%5.2" /end CHARACTERISTIC
/begin CHARACTERISTIC EVAC_V_HYB_CL_DLY_LO "Minimum run time to enable closed loop purge after a hybrid idle stop when the coolant temperature is less than a threshold." VALUE 0x232DC __UBYTE_S 0 u_1s_tmr 0 255 FORMAT "%3.0" /end CHARACTERISTIC
/begin CHARACTERISTIC EVAC_V_HYB_CL_DLY_HI "Minimum run time to enable closed loop purge after a hybrid idle stop when the coolant temperature is greater than a calibration. " VALUE 0x232DC __UBYTE_S 0 u_1s_tmr 0 255 FORMAT "%3.0" /end CHARACTERISTIC
/begin CHARACTERISTIC EVAC_C_CONC_CHNG_DLY "Additional time to delay purge concentration purge updates based on Manifold transport time. " CURVE 0x375CE __UWORD_S 0 u_2x_tmr 0 1023.984375 SYMBOL_LINK "EVAC_C_CONC_CHNG_DLY" 2
 /begin AXIS_DESCR FIX_AXIS NO_INPUT_QUANTITY u_fac_2 17 0.75 1.25
  /begin FIX_AXIS_PAR_LIST 24576 25600 26624 27648 28672 29696 30720 31744 32768 33792 34816 35840 36864 37888 38912 39936 40960 /end FIX_AXIS_PAR_LIST
 /end AXIS_DESCR
/end CHARACTERISTIC
/begin CHARACTERISTIC EVAC_V_IAT_LO_IDL "Enable purge control intake air temperature low limit when in idle." VALUE 0x0002038C __SWORD_S 0 u_deg_C -256 255.9921875 /end CHARACTERISTIC
/begin CHARACTERISTIC EVAC_V_LV_CONC_HI_THRSH "Above this threshold, purge concentration is considered to be high for determination of increase vacuum." VALUE 0x2DD38 __UWORD_S 0 u_pct 0 199.996948 FORMAT "%6.3" /end CHARACTERISTIC
/*--------------GPF IO-------------------------*/
/begin COMPU_METHOD u_ad_volt "ad voltage" RAT_FUNC "%6.4" "V" COEFFS 0.0 1.0 0.000000 0.0 0.0 0.0000762939453125 /end COMPU_METHOD
/begin COMPU_METHOD u_volt_32 "voltage" RAT_FUNC "%6.4" "V" COEFFS 0.0 1.0 0.000000 0.0 0.0 0.00048828125 /end COMPU_METHOD
/begin COMPU_METHOD u_kPa_0_256 "press" RAT_FUNC "%5.2" "kPa" COEFFS 0.0 1.0 0.000000 0.0 0.0 0.00390625 /end COMPU_METHOD
/begin COMPU_METHOD u_kPa_0_32768 "press" RAT_FUNC "%6.1" "kPa" COEFFS 0.0 1.0 0.000000 0.0 0.0 0.5 /end COMPU_METHOD
/begin COMPU_METHOD u_kPa_8n_8p "press" RAT_FUNC "%6.5" "kPa" COEFFS 0.0 1.0 0.000000 0.0 0.0 0.000244140625 /end COMPU_METHOD
/begin COMPU_METHOD u_kPa_128n_128p "press" RAT_FUNC "%5.2" "kPa" COEFFS 0.0 1.0 0.000000 0.0 0.0 0.00390625 /end COMPU_METHOD
/begin COMPU_METHOD u_kPaSec_c "press" RAT_FUNC "%5.2" "kPa/s" COEFFS 0.0 1.0 0.000000 0.0 0.0 0.000244140625 /end COMPU_METHOD
/begin COMPU_METHOD u_fac_2048 "factor" RAT_FUNC "%5.1" "fac" COEFFS 0.0 1.0 0.000000 0.0 0.0 0.03125 /end COMPU_METHOD
/begin COMPU_METHOD u_fac_128 "factor" RAT_FUNC "%5.2" "fac" COEFFS 0.0 1.0 0.000000 0.0 0.0 0.001953125 /end COMPU_METHOD
/begin COMPU_METHOD u_fac_64 "factor" RAT_FUNC "%4.2" "fac" COEFFS 0.0 1.0 0.000000 0.0 0.0 0.0009765625 /end COMPU_METHOD
/begin COMPU_METHOD u_fac_32 "factor" RAT_FUNC "%8.6" "fac" COEFFS 0.0 1.0 0.000000 0.0 0.0 0.00048828125 /end COMPU_METHOD
/begin COMPU_METHOD u_fac_16 "factor" RAT_FUNC "%5.3" "fac" COEFFS 0.0 1.0 0.000000 0.0 0.0 0.000244140625 /end COMPU_METHOD
/begin COMPU_METHOD u_fac_8 "factor" RAT_FUNC "%8.7" "fac" COEFFS 0.0 1.0 0.000000 0.0 0.0 0.0001220703125 /end COMPU_METHOD
/begin COMPU_METHOD u_fac_4 "factor" RAT_FUNC "%5.4" "fac" COEFFS 0.0 1.0 0.000000 0.0 0.0 0.00006103515625 /end COMPU_METHOD
/begin COMPU_METHOD u_fac_2 "factor" RAT_FUNC "%3.2" "fac" COEFFS 0.0 1.0 0.000000 0.0 0.0 0.000030517578125 /end COMPU_METHOD
/begin COMPU_METHOD u_fac_1 "factor" RAT_FUNC "%4.3" "fac" COEFFS 0.0 1.0 0.000000 0.0 0.0 0.0000152587890625 /end COMPU_METHOD
/begin COMPU_METHOD u_fac_2_b "factor" RAT_FUNC "%3.2" "fac" COEFFS 0.0 1.0 0.000000 0.0 0.0 0.0078125 /end COMPU_METHOD
/begin COMPU_METHOD u_fac_n4_p4 "factor" RAT_FUNC "%3.2" "fac" COEFFS 0.0 1.0 0.000000 0.0 0.0 0.0001220703125 /end COMPU_METHOD
/begin COMPU_METHOD u_deg_C "degC" RAT_FUNC "%5.2" "¡æ" COEFFS 0.0 1.0 0.0 0.0 0.0 0.0078125 /end COMPU_METHOD
/begin COMPU_METHOD u_deg_C_n2048_p2048 "degC" RAT_FUNC "%5.1" "¡æ" COEFFS 0.0 1.0 0.0 0.0 0.0 0.0625 /end COMPU_METHOD
/begin COMPU_METHOD u_filter "filter" RAT_FUNC "%11.10" "coef" COEFFS 0.0 1.0 0.0 0.0 0.0 0.0000152587890625 /end COMPU_METHOD
/begin COMPU_METHOD u_cnts "counts" RAT_FUNC "%3.0" "cnts" COEFFS 0.0 1.0 0.0 0.0 0.0 1.0 /end COMPU_METHOD
/begin COMPU_METHOD u_min "min timer" RAT_FUNC "%5.0" "min" COEFFS 0.0 1.0 0.0 0.0 0.0 1.00 /end COMPU_METHOD
/begin COMPU_METHOD u_1x_tmr "7.81 timer" RAT_FUNC "%4.3" "s" COEFFS 0.0 1.0 0.0 0.0 0.0 0.0078125 /end COMPU_METHOD
/begin COMPU_METHOD u_2x_tmr "15.6 timer" RAT_FUNC "%6.2" "s" COEFFS 0.0 1.0 0.0 0.0 0.0 0.015625 /end COMPU_METHOD
/begin COMPU_METHOD u_8x_tmr "62.5 timer" RAT_FUNC "%6.2" "s" COEFFS 0.0 1.0 0.0 0.0 0.0 0.0625 /end COMPU_METHOD
/begin COMPU_METHOD u_16x_tmr "125 timer" RAT_FUNC "%5.1" "s" COEFFS 0.0 1.0 0.0 0.0 0.0 0.125 /end COMPU_METHOD
/begin COMPU_METHOD u_1s_tmr "1 sec timer" RAT_FUNC "%5.0" "s" COEFFS 0.0 1.0 0.0 0.0 0.0 1.0 /end COMPU_METHOD
/begin COMPU_METHOD u_500m_tmr "500ms timer" RAT_FUNC "%5.0" "s" COEFFS 0.0 1.0 0.0 0.0 0.0 0.5 /end COMPU_METHOD
/begin COMPU_METHOD u_tq_1024 "torque" RAT_FUNC "%5.1" "Nm" COEFFS 0.0 1.0 0.000000 0.0 0.0 0.03125 /end COMPU_METHOD
/begin COMPU_METHOD u_knck_trans_st "" TAB_VERB "%6.3" "" COMPU_TAB_REF u_knck_trans_st /end COMPU_METHOD
/begin COMPU_VTAB u_knck_trans_st "" TAB_VERB 7 0 "NONE" 1 "IMEP_DEV" 2 "DEC_ESPD" 3 "INC_ESPD" 4 "DEC_TPS" 5 "INC_TPS" 6 "VVT_Large_ERR" /end COMPU_VTAB
/begin COMPU_METHOD u_knck_cyl_frq "" TAB_VERB "%6.3" "" COMPU_TAB_REF u_knck_cyl_frq /end COMPU_METHOD
/begin COMPU_VTAB u_knck_cyl_frq "" TAB_VERB 12 0 "cyl1_frq1" 1 "cyl1_frq2" 2 "cyl1_frq3" 3 "cyl2_frq1" 4 "cyl2_frq2" 5 "cyl2_frq3" 6 "cyl3_frq1" 7 "cyl3_frq2" 8 "cyl3_frq3" 9 "cyl4_frq1" 10 "cyl4_frq2" 11 "cyl4_frq3" /end COMPU_VTAB
/begin COMPU_METHOD b_true "" TAB_VERB "%6.3" "" COMPU_TAB_REF b_true /end COMPU_METHOD
/begin COMPU_VTAB b_true "" TAB_VERB 2 0 "FALSE" 1 "TRUE" /end COMPU_VTAB
/begin COMPU_METHOD b_enable "" TAB_VERB "%6.3" "" COMPU_TAB_REF b_enable /end COMPU_METHOD
/begin COMPU_VTAB b_enable "" TAB_VERB 2 0 "DISABLE" 1 "ENABLE" /end COMPU_VTAB
/begin COMPU_METHOD u_espd "engine speed" RAT_FUNC "%5.2" "rpm" COEFFS 0.0 1.0 0.000000 0.0 0.0 0.125 /end COMPU_METHOD
/begin COMPU_METHOD u_vspd "vehicle speed" RAT_FUNC "%5.2" "kph" COEFFS 0.0 1.0 0.000000 0.0 0.0 0.0078125 /end COMPU_METHOD
/begin COMPU_METHOD u_pct "percentage" RAT_FUNC "%5.2" "%" COEFFS 0.0 1.0 0.000000 0.0 0.0 0.0030517578125 /end COMPU_METHOD
/begin COMPU_METHOD u_pct_1 "percentage" RAT_FUNC "%5.2" "%" COEFFS 0.0 1.0 0.000000 0.0 0.0 0.00152587890625 /end COMPU_METHOD
/begin COMPU_METHOD u_pct_s "percentage" RAT_FUNC "%5.2" "%" COEFFS 0.0 1.0 0.000000 0.0 0.0 0.006103515625 /end COMPU_METHOD
/begin COMPU_METHOD u_g_per_sec "g per second" RAT_FUNC "%5.2" "g/s" COEFFS 0.0 1.0 0.000000 0.0 0.0 0.0078125 /end COMPU_METHOD
/begin COMPU_METHOD u_g_per_sec_64 "g per second" RAT_FUNC "%5.2" "g/s" COEFFS 0.0 1.0 0.000000 0.0 0.0 0.0009765625 /end COMPU_METHOD
/begin COMPU_METHOD u_afr "airfuel" RAT_FUNC "%3.1" "Ratio" COEFFS 0.0 1.0 0.000000 0.0 0.0 0.00048828125 /end COMPU_METHOD
/begin COMPU_METHOD u_kPa_0_4096 "IMEP" RAT_FUNC "%6.2" "kPa" COEFFS 0.0 1.0 0.000000 0.0 0.0 0.0625 /end COMPU_METHOD
/begin COMPU_METHOD u_iga "ignition angle" RAT_FUNC "%3.1" "Deg" COEFFS 0.0 1.0 0.000000 0.0 0.0 0.0078125 /end COMPU_METHOD
/begin COMPU_METHOD u_cam_ang_hi "cam angle high res" RAT_FUNC "%4.2" "Deg" COEFFS 0.0 1.0 0.000000 0.0 0.0 0.0009765625 /end COMPU_METHOD
/begin COMPU_METHOD u_tq "torque" RAT_FUNC "%5.1" "Nm" COEFFS 0.0 1.0 0.000000 0.0 0.0 0.0625 /end COMPU_METHOD
/begin COMPU_METHOD u_gram "gram" RAT_FUNC "%6.2" "g" COEFFS 0.0 1.0 0.000000 0.0 0.0 0.0625 /end COMPU_METHOD
/begin COMPU_METHOD x_volt "Voltage" RAT_FUNC "%4.2" "V" COEFFS 0.0 1.0 0.0 0.0 0.0 1.0 /end COMPU_METHOD
/begin COMPU_METHOD x_press "pressure" RAT_FUNC "%5.2" "kPa" COEFFS 0.0 1.0 0.0 0.0 0.0 1.0 /end COMPU_METHOD
/begin COMPU_METHOD x_afr "airfuel" RAT_FUNC "%5.2" "Ratio" COEFFS 0.0 1.0 0.0 0.0 0.0 1.0 /end COMPU_METHOD
/begin COMPU_METHOD x_espd "engine speed" RAT_FUNC "%6.2" "rpm" COEFFS 0.0 1.0 0.0 0.0 0.0 1.0 /end COMPU_METHOD
/begin COMPU_METHOD u_coef_l "filter constant" RAT_FUNC "%10.0" "cnt" COEFFS 0.0 1.0 0.0 0.0 0.0 1.0 /end COMPU_METHOD
/begin COMPU_METHOD u_crk_ang_a "crankshaft angle" RAT_FUNC "%6.4" "Deg" COEFFS 0.0 1.0 0.000000 0.0 0.0 0.015625 /end COMPU_METHOD
/begin COMPU_METHOD u_espd_n4096_p4096 "engine speed" RAT_FUNC "%6.2" "rpm" COEFFS 0.0 1.0 0.0 0.0 0.0 0.125 /end COMPU_METHOD
/begin COMPU_METHOD u_tq_gr_typ "" TAB_VERB "%5.0" "" COMPU_TAB_REF u_tq_gr_typ /end COMPU_METHOD
/begin COMPU_VTAB u_tq_gr_typ "" TAB_VERB 11 0 "GEAR_1" 1 "GEAR_2" 2 "GEAR_3" 3 "GEAR_4" 4 "GEAR_5" 5 "GEAR_6" 6 "GEAR_7" 7 "GEAR_8" 8 "UNKNOWN" 9 "PN" 10 "R" /end COMPU_VTAB
/begin COMPU_METHOD u_extc_lt_cfg "" TAB_VERB "%6.3" "" COMPU_TAB_REF u_extc_lt_cfg /end COMPU_METHOD
/begin COMPU_VTAB u_extc_lt_cfg "" TAB_VERB 3 0 "UNUSE" 1 "USE_INT" 2 "MODEL_TEMP" /end COMPU_VTAB
/begin COMPU_METHOD u_hyb_extc_dis_cfg "" TAB_VERB "%6.3" "" COMPU_TAB_REF u_hyb_extc_dis_cfg /end COMPU_METHOD
/begin COMPU_VTAB u_hyb_extc_dis_cfg "" TAB_VERB 4 0 "UNUSE" 1 "USE_CAT_TEMP" 2 "USE_EXH_TEMP" 3 "USE_CAT_EXH" /end COMPU_VTAB
/begin COMPU_METHOD u_vh_mod "" TAB_VERB "%4.0" "" COMPU_TAB_REF u_vh_mod /end COMPU_METHOD
/begin COMPU_VTAB u_vh_mod "" TAB_VERB 2 0 "Normal" 1 "Sport" /end COMPU_VTAB
/begin COMPU_METHOD u_gr_mod "" TAB_VERB "%4.0" "" COMPU_TAB_REF u_gr_mod /end COMPU_METHOD
/begin COMPU_VTAB u_gr_mod "" TAB_VERB 2 0 "InGear" 1 "PN" /end COMPU_VTAB
/begin COMPU_METHOD u_tq_b "torque" RAT_FUNC "%4.1" "Nm" COEFFS 0.0 1.0 0.000000 0.0 0.0 0.5 /end COMPU_METHOD
/begin COMPU_METHOD u_tq_b_256 "torque" RAT_FUNC "%4.1" "Nm" COEFFS 0.0 1.0 0.000000 0.0 0.0 1 /end COMPU_METHOD
/begin COMPU_METHOD u_tq_b_32 "torque" RAT_FUNC "%4.2" "Nm" COEFFS 0.0 1.0 0.000000 0.0 0.0 0.125 /end COMPU_METHOD
/begin COMPU_METHOD u_tq_256 "torque" RAT_FUNC "%6.3" "Nm" COEFFS 0.0 1.0 0.000000 0.0 0.0 0.00390625 /end COMPU_METHOD
/begin COMPU_METHOD u_purge_stat "" TAB_VERB "%4.0" "" COMPU_TAB_REF u_purge_stat /end COMPU_METHOD
/begin COMPU_VTAB u_purge_stat "" TAB_VERB 5 0 "PurgeOff" 1 "PurgeOpenLoop" 2 "DiagnosisState" 3 "PurgeCloseLoop" 4 "PurgeBoost" /end COMPU_VTAB
/begin COMPU_METHOD u_g_per_sec_16 "g per second" RAT_FUNC "%5.2" "g/s" COEFFS 0.0 1.0 0.000000 0.0 0.0 0.000244140625 /end COMPU_METHOD
/begin COMPU_METHOD u_purge_conc_mode "" TAB_VERB "%4.0" "" COMPU_TAB_REF u_purge_conc_mode /end COMPU_METHOD
/begin COMPU_VTAB u_purge_conc_mode "" TAB_VERB 3 0 "Tank" 1 "Canister" 2 "Transition" /end COMPU_VTAB
/begin COMPU_METHOD u_pct_6p25 "percentage" RAT_FUNC "%5.2" "%" COEFFS 0.0 1.0 0.000000 0.0 0.0 0.000095367431640625 /end COMPU_METHOD
/begin COMPU_METHOD u_purge_diag_ctrl_mod "" TAB_VERB "%4.0" "" COMPU_TAB_REF u_purge_diag_ctrl_mod /end COMPU_METHOD
/begin COMPU_VTAB u_purge_diag_ctrl_mod "" TAB_VERB 4 0 "Inactive" 1 "RampOff" 2 "TankVacuum" 3 "MassFlow" /end COMPU_VTAB
/begin COMPU_METHOD u_g_per_sec_2n_2p "g per second" RAT_FUNC "%5.4" "g/s" COEFFS 0.0 1.0 0.000000 0.0 0.0 0.00006103515625 /end COMPU_METHOD
/begin COMPU_METHOD u_gram_16 "factor" RAT_FUNC "%5.3" "g" COEFFS 0.0 1.0 0.000000 0.0 0.0 0.000244140625 /end COMPU_METHOD
/begin COMPU_METHOD u_hz_16384 "Hz" RAT_FUNC "%7.2" "Hz" COEFFS 0.0 1.0 0.000000 0.0 0.0 0.25 /end COMPU_METHOD
/begin COMPU_METHOD u_fac_8192 "factor" RAT_FUNC "%7.3" "fac" COEFFS 0.0 1.0 0.000000 0.0 0.0 0.125 /end COMPU_METHOD
/begin FUNCTION tq_drivablity ""
 /begin DEF_CHARACTERISTIC TQ_V_MIN_TORQ_THRSH_PCT TQ_V_MIN_TORQ_HYST_PCT TQ_V_DRVLN_USED TQ_M_TPO_MX_LMT_SPRT TQ_C_TPO_MX_FAC_SPRT TQ_M_TPO_MX_LMT TQ_C_TPO_MX_FAC TQ_V_CLTCH_TORQ_RAW_SP_FILT TQ_C_TPO_MX_CLTCH_TORQ_FAC TQ_M_TPO_MN_LMT_SPRT TQ_C_TPO_MN_FAC_SPRT TQ_M_TPO_MN_LMT TQ_C_TPO_MN_FAC TQ_V_TRNS_PUMP_ACC TQ_V_ALT_ACC TQ_V_TPO_PN_DECLTCH TQ_V_TPO_CLTCH_PUC TQ_V_TPO_CANCL_DECLTCH TQ_C_DP_FILT_PN TQ_M_DP_FILT_SPRT TQ_M_DP_FILT TQ_C_TPO_FILT_FAC_ECO TQ_M_TPO_LO_HLD TQ_M_TPO_LO_STP TQ_V_TPO_DB TQ_V_TPI_LCH_MX_VSPD TQ_C_VR_PPS_FILT TQ_C_TPI_TORQ_FAC_G1 TQ_C_TPI_RST_TMR TQ_V_TPI_HLD_PPS_TM TQ_V_TPI_HLD_PPS TQ_V_TPI_HLD_VSPD TQ_V_TPI_ENBL_ALL_SRC TQ_V_TPI_LVSPD_HI TQ_V_TPI_LVSPD_LO TQ_V_TPI_DSBL_FAC_AXIS TQ_M_TPI_DSBL_FAC_T TQ_M_TPI_ENBL_G1 TQ_M_TPI_ENBL_G2 TQ_M_TPI_ENBL_G3 TQ_M_TPI_ENBL_G4 TQ_M_TPI_ENBL_G5 TQ_M_TPI_ENBL_G6 TQ_M_TPI_ENBL_G7 TQ_M_TPI_ENBL_G8 TQ_M_TPI_ENBL_PN TQ_M_TPI_DSBL_G1 TQ_M_TPI_DSBL_G2 TQ_M_TPI_DSBL_G3 TQ_M_TPI_DSBL_G4 TQ_M_TPI_DSBL_G5 TQ_M_TPI_DSBL_G6 TQ_M_TPI_DSBL_G7 TQ_M_TPI_DSBL_G8 TQ_M_TPI_DSBL_PN TQ_M_TPI_ENBL_BIAS_AC TQ_M_TPI_DSBL_BIAS_AC TQ_C_TPI_ENBL_FAC_SPRT TQ_C_TPI_DSBL_FAC_SPRT TQ_M_TPI_PDSBL_G1 TQ_V_TPI_PDSBL_FAC_SPRT TQ_C_TPI_VSPD_MN TQ_V_TPI_PN_ENBL TQ_V_TPI_SHFT_ENBL TQ_V_TPI_CLTCH_EN TQ_V_TPI_LCH_DSBL TQ_M_TPI_RMP_STP_G1 TQ_M_TPI_RMP_STP_G2 TQ_M_TPI_RMP_STP_G3 TQ_M_TPI_RMP_STP_G4 TQ_M_TPI_RMP_STP_G5 TQ_M_TPI_RMP_STP_G6 TQ_M_TPI_RMP_STP_G7 TQ_M_TPI_RMP_STP_G8 TQ_M_TPI_RMP_STP_PN TQ_M_TPI_RMP_STP_G1_SPRT TQ_M_TPI_RMP_STP_G2_SPRT TQ_M_TPI_RMP_STP_G3_SPRT TQ_M_TPI_RMP_STP_G4_SPRT TQ_M_TPI_RMP_STP_G5_SPRT TQ_M_TPI_RMP_STP_G6_SPRT TQ_M_TPI_RMP_STP_G7_SPRT TQ_M_TPI_RMP_STP_G8_SPRT TQ_V_TPI_LCH_VSPD TQ_M_TPI_RMP_STP_BIAS_AC TQ_C_TPI_RMP_STP_FAC_AC TQ_C_TPI_RMP_STP_FAC TQ_C_TPI_RMP_STP_FAC_CST TQ_M_TPI_HLD_TM TQ_V_SHFT_TORQ_PPS_MX TQ_V_SHFT_TORQ_PPS_MN TQ_V_TPI_LCH_USE_G1 TQ_M_TPI_FILTER TQ_M_TPI_FILTER_AC TQ_V_TPI_FILTER_FAC_IAT TQ_V_TPI_FILTER_FAC_SKTM TQ_M_TPI_FILTER_FAC TQ_C_TPI_FILTER_FAC_SPRT TQ_V_TPI_LCH_NO_FILTER TQ_M_POC_DSBL_TPI TQ_M_POC_DSBL_TPO /end DEF_CHARACTERISTIC
 /begin OUT_MEASUREMENT tq_flyw_torq_raw_sp tq_cltch_torq_raw_sp tq_cltch_sp_pct tq_cltch_torq_min_lmt tq_cltch_torq_raw_sp_filt tq_tpo_mx_torq_fac_eco tq_tpo_mx_lmt tq_tpo_mn_torq_fac_eco tq_tpo_mn_lmt tq_tpo_torq tq_cltch2flyw_ofst tq_tc_loss_torq tq_cpuc_actv tq_tpo_filt_fac_eco tq_tpo_up tq_tpo_dcy_fn tq_cltch_torq_sp tq_flyw_torq_sp tq_trns_pump_torq tq_alt_torq tq_lch_flyw_torq tq_tpi_lch_met tq_vr_pps_filt tq_vr_pps_dlt tq_tpi_torq_fac_g1 tq_drv_torq_sp_pct tq_tpi_hld_fn tq_tpi_enbl_torq tq_tpi_hld_enbl tq_tpi_hld_pps_tm tq_tpi_tm tq_tpi_hld_tm tq_tpi_lvspd_coast_met tq_tpi_gear tq_veh_gr_st_sp tq_tpi_dsbl_fac_t tq_tpi_enbl_eco_fac tq_tpi_dsbl_eco_fac tq_tpi_pdsbl_eco_fac tq_tpi_dsbl_torq tq_tpi_pdsbl_torq tq_tpi_rmp_enbl tq_tpi_rmp_eco_fac tq_tpi_rmp_stp tq_tpi_flyw_torq_sp tq_tpi_hld tq_tpi_filter tq_trans_torq_rt tq_shft_torq_met tq_tpi_filter_fac_enbl tq_tpi_filter_eco_fac /end OUT_MEASUREMENT
/end FUNCTION
/begin FUNCTION tq_add "additional torque"
 /begin DEF_CHARACTERISTIC TQ_V_ADD_PUC_CFG TQ_C_ADD_PUC TQ_X_ADD_ESPD_DEV TQ_C_ADD_PUC_MAX TQ_V_ADD_CLS_THRO_CFG TQ_C_ADD_CLS_THRO TQ_C_ADD_CLS_THRO_MAX TQ_C_ADD_IDL_MAX TQ_X_ADD_ESPD_DEV_A TQ_C_ADD_IDL_MIN TQ_V_ADD_IDL_AC_BIAS TQ_V_ADD_IDL_AC_BIAS_TRANS TQ_C_ADD_IDL TQ_C_ADD_IDL_IAT_BIAS TQ_X_ADD_IAT TQ_X_ADD_AMP TQ_C_ADD_AMP_BIAS TQ_V_ADD_INC_STP_IDL TQ_X_ADD_RATIO TQ_C_ADD_DEC_STP_IDL TQ_V_ADD_INC_STP TQ_V_ADD_DEC_STP TQ_V_ADD_IDL_DEC_DLY TQ_C_ADD_RMP_STP_FAC TQ_C_ADD_MN_IDL_WRM TQ_V_ADD_PS_ACTV_TQ TQ_V_ADD_PS_INIT_TQ TQ_C_ADD_PS_ACTV_TQ /end DEF_CHARACTERISTIC
 /begin OUT_MEASUREMENT tq_add_sp tq_add_sp_max tq_add_cls_thro_met tq_add_idl_sp tq_add_sp_raw tq_add_sp_rmp /end OUT_MEASUREMENT
/end FUNCTION
/begin FUNCTION tq "torque" /begin SUB_FUNCTION tq_general tq_axis tq_drivablity tq_add /end SUB_FUNCTION /end FUNCTION
/begin FUNCTION hyb "hybrid" /begin DEF_CHARACTERISTIC HYB_V_EXTC_STOP_DIS_CFG /end DEF_CHARACTERISTIC
 /begin OUT_MEASUREMENT hyb_auto_stp_stat hyb_auto_strt_stat hyb_fco_req hyb_fco_dur hyb_eng_stop_dur /end OUT_MEASUREMENT
/end FUNCTION
/begin FUNCTION extc "exhaust temp control"
 /begin DEF_CHARACTERISTIC EXTC_V_COP_CFG EXTC_V_CAT_T_EGR_FAC EXTC_V_CAT_HT_ECT_MIN EXTC_V_CAT_HT_ECT_MAX EXTC_V_CAT_HT_IAT_MIN EXTC_V_CAT_HT_IAT_MAX EXTC_V_EXH_PROT_CFG EXTC_V_HT_IG_EXT_ESPD EXTC_C_HT_EXT_INT_THR EXTC_V_HT_INT_BIAS EXTC_V_HT_INT_FAC EXTC_V_HT_IG_EN_ESPD EXTC_V_HT_IG_EN_VAC_HI EXTC_V_CAT_HI_DIS_ESPD EXTC_V_HT_IG_EN_VAC_LO EXTC_M_CAT_T_BASE EXTC_C_CAT_T_AF_TRM EXTC_X_AF_A EXTC_M_CAT_T_VSPD_TRM EXTC_X_IAT_A EXTC_C_CAT_T_DEC_FIL EXTC_C_CAT_T_INC_FIL EXTC_C_CAT_T_SP_DEC_FIL EXTC_C_CAT_T_SP_INC_FIL EXTC_M_CAT_T_IG_TRM EXTC_V_HI_LD_TPS_THR EXTC_V_HI_LD_ESPD_THR EXTC_V_HI_LD_EN_DLY EXTC_V_CAT_T_GRD1 EXTC_V_CAT_T_GRD2 EXTC_V_CAT_T_GRD3 EXTC_V_CAT_T_GRD4 EXTC_C_CAT_PROT_AF EXTC_V_CAT_HT_VSPD_MAX EXTC_V_CAT_HT_IMEP_MAX EXTC_V_CAT_HT_PPS_ECT_THR EXTC_V_CAT_HT_PPS_LO_MAX EXTC_V_CAT_HT_PPS_HI_MAX EXTC_V_MNFD_PROT_T EXTC_V_MNFD_PROT_T_HYS EXTC_V_MNFD_PROT_DWN_T EXTC_V_MNFD_OVR_T EXTC_C_MNFD_T_INC_FIL EXTC_C_MNFD_T_DEC_FIL EXTC_C_MNFD_T_SP_DEC_FIL EXTC_C_MNFD_T_SP_INC_FIL EXTC_C_MNFD_PROT_AF EXTC_V_CAT_CLS_HLD_EN_IMEP EXTC_V_CAT_CLS_HLD_EXT_IMEP EXTC_V_CAT_CLS_HLD_EN_PPS EXTC_V_CAT_CLS_HLD_IMEP_DLY EXTC_V_CAT_CLS_HLD_DUR EXTC_V_PUC_DIS_CAT_T EXTC_V_PUC_DIS_CAT_T_HYS EXTC_V_CAT_T_OVR_CNTS EXTC_V_MNFD_T_OVR_CNTS EXTC_C_CAT_T_OVR_INC_STP EXTC_X_CAT_T_DELTA_A EXTC_C_CAT_T_OVR_DEC_STP EXTC_X_CAT_T_DELTA_B EXTC_C_MNFD_T_OVR_INC_STP EXTC_X_MNFD_T_DELTA_A EXTC_C_MNFD_T_OVR_DEC_STP EXTC_X_MNFD_T_DELTA_B EXTC_V_HYB_CAT_DIS_EXT_CNTS EXTC_V_HYB_MNFD_DIS_EXT_CNTS EXTC_V_CAT_LIGHT_ST_CFG EXTC_C_CAT_LIGHT_ECT_INT EXTC_C_CAT_LIGHT_FLW_INT EXTC_V_CAT_LIGHT_ST_T /end DEF_CHARACTERISTIC
 /begin OUT_MEASUREMENT extc_cat_prot_en extc_exh_prot_en extc_cat_t_egr_bias extc_cat_t_nv extc_mnfd_ovr_t extc_no_afr_mnfd_t_filt extc_puc_dis_stat extc_cat_ht_ig_req extc_cat_ht_ig_fn /end OUT_MEASUREMENT
/end FUNCTION
/begin FUNCTION knck_general ""
 /begin DEF_CHARACTERISTIC KNCK_V_CTRL_CFG KNCK_C_FIL_FRQ1 KNCK_C_FIL_FRQ2 KNCK_C_FIL_FRQ3 KNCK_M_WT_FIL_FRQ1 KNCK_M_WT_FIL_FRQ2 KNCK_M_WT_FIL_FRQ3 KNCK_V_CAM_FAIL_CFG KNCK_C_RAW_VLT_MAX KNCK_C_RAW_VLT_MIN KNCK_V_EN_ECT_MIN KNCK_V_EN_ENG_RTM_MIN KNCK_V_EN_ESPD_MIN KNCK_C_EN_IMEP_MIN KNCK_V_IMEP_FIL KNCK_V_WIN_EN KNCK_V_ERR_PASS_TIM_MIN /end DEF_CHARACTERISTIC
 /begin OUT_MEASUREMENT knck_vvt_knk_stat knck_knk_en knck_knk_ctrl_cfg knck_vlt_raw1 knck_vlt_raw2 knck_vlt_raw3 knck_knk_conds_met knck_knk_dis_err_stat knck_err_pass_tmr knck_imep_filt /end OUT_MEASUREMENT
/end FUNCTION
/begin FUNCTION knck_det ""
 /begin DEF_CHARACTERISTIC KNCK_C_WIN_DUR KNCK_V_GAIN_ESPD_HI KNCK_V_GAIN_ESPD_LO KNCK_V_GAIN_FAC KNCK_M_KNK_THR_FAC_HI KNCK_M_KNK_THR_FAC_MID KNCK_M_KNK_THR_FAC_LO KNCK_C_HVY_KNK_BIAS KNCK_C_IMEP_LO_THR KNCK_C_IMEP_HI_THR KNCK_V_KNKS_INT_DLT_INIT KNCK_C_KNKS_FILT_INT_INIT KNCK_C_THR_FAC_TRANS_BIAS_TPS KNCK_C_THR_FAC_TRANS_BIAS_ESPD KNCK_V_INT_FILT_INC KNCK_V_INT_FILT_DEC KNCK_V_INT_FILT_SS KNCK_V_TRANS_ST_HLD_DUR KNCK_V_TRANS_IMEP_DEV_THR KNCK_V_TRANS_TPS_DEC_THR KNCK_V_TRANS_TPS_INC_THR KNCK_V_TRANS_ESPD_DEC_THR KNCK_V_TRANS_ESPD_INC_THR KNCK_V_TRANS_VVT_DEV_THR KNCK_M_INT_DLT_MAX KNCK_M_INT_DLT_MIN KNCK_X_IMEP_A KNCK_V_INT_DLT_IMEP_THR KNCK_V_INT_DLT_ESPD_THR KNCK_V_INT_DLT_FIL KNCK_V_INT_FILT_FAC KNCK_C_KNKS_FILT_INT_MIN KNCK_X_IMEP KNCK_M_WIN_STRT_ANG /end DEF_CHARACTERISTIC
 /begin OUT_MEASUREMENT knck_det_thr_cyl1 knck_det_thr_cyl2 knck_det_thr_cyl3 knck_det_thr_cyl4 knck_knk_det knck_knks_int knck_knks_filted_int knck_knks_int_dlt knck_trans_st knck_det_thr_excd /end OUT_MEASUREMENT
/end FUNCTION
/begin FUNCTION knck_ctrl ""
 /begin DEF_CHARACTERISTIC KNCK_V_RTD_MAX KNCK_V_FST_RTD_MAX KNCK_C_FST_RTD_STP KNCK_C_FST_RTD_EXT_DLY KNCK_V_FST_RTD_EXT_STP KNCK_C_ADP_RTD_STP KNCK_C_ADP_RTD_MAX KNCK_C_ADP_RTD_EXT_DLY KNCK_V_ADP_RTD_EXT_STP KNCK_V_IGA_RTD_DFT KNCK_V_ADP_RTD_INIT_ECT_THR KNCK_C_ADP_RTD_INIT_FAC KNCK_V_ADP_CELL_ESPD_BND1 KNCK_V_ADP_CELL_ESPD_BND2 KNCK_V_ADP_CELL_ESPD_BND3 KNCK_V_ADP_CELL_ESPD_BND4 KNCK_C_ADP_CELL_IMEP_BND1 KNCK_C_ADP_CELL_IMEP_BND2 KNCK_V_ADP_RTD_ECT_THR KNCK_V_ADP_RTD_TRANS_DIS KNCK_V_FST_QK_EXT_THR KNCK_C_FST_RTD_LMT_DEV KNCK_C_FST_RTD_QK_EXT_STP KNCK_V_ADP_RTD_EXT_ESPD_THR KNCK_C_ADP_RTD_LMT_DEV KNCK_V_ADP_RTD_RUN_MIN KNCK_V_ADP_RTD_STP_HVY_BIAS KNCK_V_FST_RTD_STP_HVY_BIAS /end DEF_CHARACTERISTIC
 /begin OUT_MEASUREMENT knck_iga_fast_rtd_cyl1 knck_iga_fast_rtd_cyl2 knck_iga_fast_rtd_cyl3 knck_iga_fast_rtd_cyl4 knck_iga_adp_rtd_cyl1 knck_iga_adp_rtd_cyl2 knck_iga_adp_rtd_cyl3 knck_iga_adp_rtd_cyl4 knck_iga_tot_rtd_cyl1 knck_iga_tot_rtd_cyl2 knck_iga_tot_rtd_cyl3 knck_iga_tot_rtd_cyl4 knck_iga_tot_rtd_avg /end OUT_MEASUREMENT
/end FUNCTION
/begin FUNCTION knck "" /begin SUB_FUNCTION knck_general knck_det knck_ctrl /end SUB_FUNCTION /end FUNCTION
/begin FUNCTION evac "evaporative system control"
 /begin DEF_CHARACTERISTIC EVAC_C_MANI_DLY EVAC_V_VLT_HI EVAC_V_VLT_LO EVAC_V_ECT_LO EVAC_V_IAT_LO EVAC_V_AFR_DSBL EVAC_V_OFF_DLY_PUC EVAC_V_OP_ACTV EVAC_V_OP_ACTV_ECT_THRSH EVAC_V_OP_ACTV_POW_AFR EVAC_V_OP_ACTV_EMOT EVAC_V_OP_ACTV_COT EVAC_V_OP_ACTV_OSC EVAC_V_CONC_LO_ENBL EVAC_V_CONC_LO_DLY EVAC_C_CONC_LO_DURATION EVAC_V_CL_VAC_THRSH EVAC_V_BST_TM EVAC_V_CL_ECT_THRSH EVAC_V_CL_DLY_HI EVAC_V_CL_DLY_LO EVAC_V_BST_VAC_MX EVAC_V_STP_FAC EVAC_C_PF_DN_STP EVAC_C_PF_LMT_UN_LRN EVAC_C_PF_LMT_LRN EVAC_V_OP_PF_STP EVAC_C_CP_FLW_LMT EVAC_M_DC_LMT_IDL EVAC_V_PF_INC_DSBL EVAC_V_PF_DEC_ENBL EVAC_V_DIAG_MSFLW_DN_STP EVAC_C_DIAG_MSFLW_STP_FAC EVAC_V_FMSP_FAC_DEC_THRSH EVAC_V_DEC_LN_TM_THRSH EVAC_V_DIAG_MSFLW_UP_STP EVAC_V_DIAG_MSFLW_DLT EVAC_V_FMSP_FAC_INC_THRSH_LO EVAC_V_FMSP_FAC_INC_THRSH_HI EVAC_V_INC_LN_TM_THRSH EVAC_V_INC_RCH_TM_THRSH EVAC_C_PF_UP_STP EVAC_C_PF_UP_STP_FAC EVAC_M_VAC_RT_INC_THRSH EVAC_V_VAC_RT_INC_THRSH_DB EVAC_V_DIAG_VAC_DN_STP EVAC_V_DIAG_VAC_UP_STP EVAC_C_DIAG_PF_LMT EVAC_V_PF_DEC_FAC EVAC_V_PF_RMP_FAC EVAC_V_CONC_HI EVAC_V_CONC_LO EVAC_V_PF_LMT_DB EVAC_C_PF_LMT_HI_CONC EVAC_V_PF_INC_DSBL_BST EVAC_V_PF_DEC_ENBL_BST EVAC_V_FMSP_FAC_DEC_THRSH_BST EVAC_V_DEC_LN_TM_THRSH_BST EVAC_V_FMSP_FAC_INC_THRSH_LO_BST EVAC_V_FMSP_FAC_INC_THRSH_HI_BST EVAC_V_INC_LN_TM_THRSH_BST EVAC_V_INC_RCH_TM_THRSH_BST EVAC_C_PF_LMT_BST EVAC_V_DEN_FAC EVAC_V_MX_CP_FLW_ENBL EVAC_V_MX_CP_FLW_AIR_THRSH EVAC_V_MX_CP_FLW_PR_THRSH EVAC_V_MX_CP_FLW_ESPD_THRSH EVAC_V_MX_CP_FLW_VSPD_THRSH EVAC_C_MX_CP_FLW_FAC EVAC_V_MX_CP_FLW_DLY EVAC_C_MX_CP_FLW_DLT EVAC_C_CP_VLV_PR_FAC EVAC_V_MN_DC EVAC_V_ADP_INH_THRSH EVAC_V_CONC_FILTER_OL EVAC_V_CONC_STBL EVAC_V_CONC_STP_FAC EVAC_V_CONC_STP_MX EVAC_C_CONC_SP_BST EVAC_C_CONC_FILTER_BST EVAC_V_MS_FLW_LRN_THRSH EVAC_V_LO_PURG_RT_TM EVAC_V_CONC_INIT EVAC_V_PF_THRSH EVAC_V_CP_MS_FLW_THRSH EVAC_X_IAT EVAC_X_ECT EVAC_X_AIRFLOW EVAC_V_CONC_BLD_FLT EVAC_V_INT_DIFF_THRSH EVAC_V_BST_INT_DIFF_THRSH EVAC_V_LO_FREQ_ESPD_LO_THRSH EVAC_V_LO_FREQ_ESPD_HI_THRSH EVAC_V_LO_FREQ_ESPD_LO_DC EVAC_V_LO_FREQ_ESPD_HI_DC EVAC_V_SLND_FREQ_LO EVAC_V_SLND_FREQ_HI EVAC_V_LV_OLP EVAC_V_F02_LN_THRSH EVAC_V_F02_RCH_THRSH EVAC_V_LN_TM_FAC EVAC_V_FO2_RCH_TM EVAC_M_HYB_CONC_INIT_DLT EVAC_X_AMB_T EVAC_X_STP_TM EVAC_V_HYB_LONG_STP_THRSH EVAC_V_HYB_CL_DLY_LO EVAC_V_HYB_CL_DLY_HI EVAC_C_CONC_CHNG_DLY EVAC_V_IAT_LO_IDL EVAC_V_LV_CONC_HI_THRSH /end DEF_CHARACTERISTIC
 /begin OUT_MEASUREMENT evac_dc evac_cp_fm_pct evac_cp_conc_lrn_stat evac_cp_conc evac_cp_idx evac_sys_stat evac_cp_fuel_flw evac_cp_conc_mod evac_cp_pct evac_enbl evac_diag_actv evac_off_dly_puc_tm evac_cp_conc_lo evac_cp_ol_osc evac_cp_conc_lo_dly_tm evac_cp_conc_lo_tm evac_cp_bst_enbl evac_cp_bst_tm evac_pf_pct evac_cp_lrn_dn evac_cp_lrn_up evac_cp_air_flw evac_pf_inc_dsbl evac_pf_dec_enbl evac_diag_ctrl_mod evac_cp_ms_flw evac_pf_inc_inh evac_pf_cl_lrn_actv evac_cp_conc_hi evac_cp_flw evac_cp_flw_raw evac_mx_cp_flw_met evac_mx_cp_flw evac_mx_cp_flw_dly_tm evac_cp_flw_unlmt evac_mn_cp_flw evac_cp_vlv_den_fac evac_cp_lrn_adp_inh evac_cp_flw_rt evac_accu_cp_ms_flw evac_cp_conc_trans_strt evac_cp_conc_stp evac_cp_conc_can_nv evac_cp_conc_tank_nv evac_cp_rt_lo_tm evac_lmt_flt_actv evac_trip_lmt_flt_actv evac_diag_pg_ctrl_st /end OUT_MEASUREMENT
/end FUNCTION
/begin RECORD_LAYOUT __UBYTE_S FNC_VALUES 1 UBYTE COLUMN_DIR DIRECT /end RECORD_LAYOUT
/begin RECORD_LAYOUT __UWORD_S FNC_VALUES 1 UWORD COLUMN_DIR DIRECT /end RECORD_LAYOUT
/begin RECORD_LAYOUT __ULONG_S FNC_VALUES 1 ULONG COLUMN_DIR DIRECT /end RECORD_LAYOUT
/begin RECORD_LAYOUT __SBYTE_S FNC_VALUES 1 SBYTE COLUMN_DIR DIRECT /end RECORD_LAYOUT
/begin RECORD_LAYOUT __SWORD_S FNC_VALUES 1 SWORD COLUMN_DIR DIRECT /end RECORD_LAYOUT
/begin RECORD_LAYOUT SSV__UWORD_S AXIS_PTS_X 1 UWORD INDEX_INCR DIRECT /end RECORD_LAYOUT
/begin RECORD_LAYOUT SSV__SWORD_S AXIS_PTS_X 1 SWORD INDEX_INCR DIRECT /end RECORD_LAYOUT
/end MODULE
/end PROJECT
