/*RemoveTurbo*/
/*RemoveOBD*/
ASAP2_VERSION 1 60
/begin PROJECT FC33 ""
/begin HEADER "" VERSION "1.0" /end HEADER
/begin MODULE FC33 ""
/begin MOD_PAR "" VERSION "NA" VERSION "TURBO" CUSTOMER_NO "" USER "Who" PHONE_NO "110" CPU_TYPE "SPC564" ECU "FC33"
 /begin MEMORY_SEGMENT Code "" CODE FLASH INTERN 0x00010000 0x00008000 -1 -1 -1 -1 -1 /end MEMORY_SEGMENT
 /begin MEMORY_SEGMENT Code "" CODE FLASH INTERN 0x00040000 0x00020000 -1 -1 -1 -1 -1 /end MEMORY_SEGMENT
 /begin MEMORY_SEGMENT Code "" CODE FLASH INTERN 0x00080000 0x00100000 -1 -1 -1 -1 -1 /end MEMORY_SEGMENT
 /begin MEMORY_SEGMENT Code "" RESERVED FLASH INTERN 0x00020000 0x00000004 -1 -1 -1 -1 -1 /end MEMORY_SEGMENT
 /begin MEMORY_SEGMENT Code "" DATA FLASH INTERN 0x00020004 0x0001FFF8 -1 -1 -1 -1 -1 /end MEMORY_SEGMENT
 /begin MEMORY_SEGMENT Code "" RESERVED FLASH INTERN 0x0003FFFC 0x00000004 -1 -1 -1 -1 -1 /end MEMORY_SEGMENT
 /begin MEMORY_SEGMENT Code "" RESERVED FLASH INTERN 0x00060000 0x00000004 -1 -1 -1 -1 -1 /end MEMORY_SEGMENT
 /begin MEMORY_SEGMENT Code "" DATA FLASH INTERN 0x00060004 0x0001FFF8 -1 -1 -1 -1 -1 /end MEMORY_SEGMENT
 /begin MEMORY_SEGMENT Code "" RESERVED FLASH INTERN 0x0007FFFC 0x00000004 -1 -1 -1 -1 -1 /end MEMORY_SEGMENT
 /begin MEMORY_SEGMENT Data "" RESERVED RAM EXTERN 0x40010000 0x00000004 -1 -1 -1 -1 -1 /end MEMORY_SEGMENT
 /begin MEMORY_SEGMENT Data "" DATA RAM EXTERN 0x40010004 0x0001FFF8 -1 -1 -1 -1 -1 /end MEMORY_SEGMENT
 /begin MEMORY_SEGMENT Data "" RESERVED RAM EXTERN 0x4002FFFC 0x00000004 -1 -1 -1 -1 -1 /end MEMORY_SEGMENT
 /begin MEMORY_SEGMENT Ram "" VARIABLES RAM EXTERN 0x40000000 0x00016FFF -1 -1 -1 -1 -1 /end MEMORY_SEGMENT
 /begin MEMORY_SEGMENT Code "" RESERVED FLASH INTERN 0x00060000 0x00000004 -1 -1 -1 -1 -1 /end MEMORY_SEGMENT
 /begin MEMORY_SEGMENT non_cal "" OFFLINE_DATA FLASH INTERN 0x00060004 0x0001FFF8 -1 -1 -1 -1 -1 /end MEMORY_SEGMENT
 /begin MEMORY_SEGMENT Code "" RESERVED FLASH INTERN 0x0007FFFC 0x00000004 -1 -1 -1 -1 -1 /end MEMORY_SEGMENT
 /begin MEMORY_SEGMENT Code "" RESERVED FLASH INTERN 0x00020000 0x00000004 -1 -1 -1 -1 -1 /end MEMORY_SEGMENT
 /begin MEMORY_SEGMENT non_cal "" OFFLINE_DATA FLASH INTERN 0x00020004 0x0001FFF8 -1 -1 -1 -1 -1 /end MEMORY_SEGMENT
 /begin MEMORY_SEGMENT Code "" RESERVED FLASH INTERN 0x0003FFFC 0x00000004 -1 -1 -1 -1 -1 /end MEMORY_SEGMENT
/end MOD_PAR
/begin MOD_COMMON "" BYTE_ORDER MSB_FIRST ALIGNMENT_LONG 2 ALIGNMENT_WORD 1 /end MOD_COMMON
/begin IF_DATA ASAP1B_CCP /* Specific definition for CCP */
 /begin SOURCE "Segment  " 103 /* Scaling Unit: 103 = cylinder segment */ 1 /* Refresh rate = */ /* every cylinder combustion */ DISPLAY_IDENTIFIER DAQ0
  /begin QP_BLOB 0 LENGTH 0x14 CAN_ID_FIXED 0x7D5 RASTER 0 REDUCTION_ALLOWED FIRST_PID 0x00 /end QP_BLOB
 /end SOURCE
 /begin SOURCE "7.82ms" 1 782 /* Rate in Scaling Unit: 782 */ /* Refresh rate = 782 * 10 us = 7.82ms */ DISPLAY_IDENTIFIER DAQ1
  /begin QP_BLOB 1 LENGTH 0x14 CAN_ID_FIXED 0x7D6 RASTER 10 REDUCTION_ALLOWED FIRST_PID 0x14 /end QP_BLOB
 /end SOURCE
 /begin SOURCE "15.6ms" 1 1562 /* Rate in Scaling Unit: 1562 */ /* Refresh rate = 1562 * 10us = 15.62ms */ DISPLAY_IDENTIFIER DAQ2
  /begin QP_BLOB 2 LENGTH 0x14 CAN_ID_FIXED 0x7D7 RASTER 11 REDUCTION_ALLOWED FIRST_PID 0x28 /end QP_BLOB
 /end SOURCE
 /begin SOURCE "125ms" 3 125 /* Rate in Scaling Unit: 125 */ /* Refresh rate = 1 * 125 ms = 125ms */ DISPLAY_IDENTIFIER DAQ3
  /begin QP_BLOB 3 LENGTH 0x3A CAN_ID_FIXED 0x7D8 RASTER 25 REDUCTION_ALLOWED FIRST_PID 0x3C /end QP_BLOB
 /end SOURCE
 /begin RASTER "Segment   Trigger" "Seg" 0 103 /* Scaling Unit: 103 = cylinder segment */ 1 /* Refresh rate = */ /* every cylinder combustion */ /end RASTER
 /begin RASTER "AMAF Trigger" "1.00" 1 3 1 /* Refresh rate = 1 * 1 ms = 1ms */ /end RASTER
 /begin RASTER "3.91ms Trigger" "3.91" 2 1 391 /* Rate in Scaling Unit: 391 */ /* Refresh rate = 391 * 10 us = 3.91ms */ /end RASTER
 /begin RASTER "7.81ms Trigger" "7.81" 10 1 781 /* Rate in Scaling Unit: 781 */ /* Refresh rate = 781 * 10 us = 7.81ms */ /end RASTER
 /begin RASTER "15.62ms Trigger" "15.62" 11 1 1562 /* Rate in Scaling Unit: 1562 */ /* Refresh rate = 1562 * 10us = 15.62ms */ /end RASTER
 /begin RASTER "125ms Trigger" "125" 25 3 125 /* Rate in Scaling Unit: 125 */ /* Refresh rate = 1 * 125 ms = 125ms */ /end RASTER
 /begin SEED_KEY "" "" "" /end SEED_KEY
 /begin TP_BLOB 0x0201 /* CCP Version, High Byte: Version
Low Byte : subversion (dec.) */ 0x0202 /* Blob-Version, High Byte: Version
Low Byte : subversion (dec.) */ 0x7D0 /* CAN-Message ID for 'Transmitting to ECU (CRM)'
Bit31 = 1: extended Identifier
Bit31 = 0: standard Identifier */ 0x7D4 /* CAN-Message ID for 'Receiving from ECU (DTM)'
Bit31 = 1: extended Identifier
Bit31 = 0: standard Identifier */ 0x0000 /* Logical CCP-Address of the (station address) */ 0x2000 /* Logical CCP-Address of the (station address) */ 1 /* Byte order of Multiple-byte-items
1 = high Byte first, 2 = low byte first */ BAUDRATE 500000 SAMPLE_POINT 70 SAMPLE_RATE 1 BTL_CYCLES 16 SJW 2 SYNC_EDGE 0 DAQ_MODE 1 /* 1 = one DAQ per cycle */ CONSISTENCY 1 /* 1 = ODT consistant */ ADDRESS_EXTENSION 0 /* 0 = 1 extension per DAQ (not supported) */ RESUME_SUPPORTED /* necessary for ResumeBit support */ /* STORE_SUPPORTED */ /* Not supported */
  /begin CHECKSUM_PARAM 0x8001 /* checksum calculation procedure
standard types not yet defined,
if greater of equal 1000 : manufacturer specific */ 0x4000 /* Maximum block length used by an ASAP1a-CCP
command, for checksum calculation procedure */ CHECKSUM_CALCULATION ACTIVE_PAGE /end CHECKSUM_PARAM
  /begin DEFINED_PAGES 1 "Working page" 0 0x40010000 0x20000 /* To maintian one A2L file the start address of working page is defined as andorra configruation */ RAM /* this will be converted according to the actual type of instrumentation. */ RAM_INIT_BY_ECU DEFAULT /end DEFINED_PAGES
  /begin DEFINED_PAGES 2 "Reference page" 0 0x00020000 0x20000 2 "Reference page" 0 0x00060000 0x20000 FLASH DEFAULT /end DEFINED_PAGES
  OPTIONAL_CMD 0x0C /* SET_S_STATUS */ OPTIONAL_CMD 0x0D /* GET_S_STATUS */ OPTIONAL_CMD 0x0E /* Build Checksum */ OPTIONAL_CMD 0x11 /* SelectCal page */ OPTIONAL_CMD 0x19 /* Move */ /end TP_BLOB
/end IF_DATA
/begin MEASUREMENT hw_ect_vlt "engine coolant temperature sensor voltage" UWORD u_ad_volt 0 0 0 4.9999237060546875 ECU_ADDRESS 0x400050DA FORMAT "%4.3" /end MEASUREMENT
/begin MEASUREMENT hw_iat_vlt "intake air temperature sensor voltage" UWORD u_ad_volt 0 0 0 4.9999237060546875 ECU_ADDRESS 0x400050DA FORMAT "%4.3" SYMBOL_LINK "hw_an_vlt" 48 /end MEASUREMENT
/begin MEASUREMENT hw_bat_vlt "ignition key voltage" UWORD u_volt_32 0 0 0 31.99951171875 ECU_ADDRESS 0x400050DA FORMAT "%4.3" /end MEASUREMENT
/begin MEASUREMENT hw_bat_vlt_filt "ignition key voltage" UWORD u_volt_32 0 0 0 31.99951171875 ECU_ADDRESS 0x400050DA FORMAT "%4.3" /end MEASUREMENT
/begin MEASUREMENT hw_mpr_vlt "main power relay voltage" UWORD u_volt_32 0 0 0 31.99951171875 ECU_ADDRESS 0x400050DA FORMAT "%4.3" /end MEASUREMENT
/begin MEASUREMENT hw_mpr_vlt_raw "main power relay voltage" UWORD u_volt_32 0 0 0 31.99951171875 ECU_ADDRESS 0x400050DA FORMAT "%4.3" /end MEASUREMENT
/begin MEASUREMENT hw_map_vlt "manifold press sensor voltage" UWORD u_ad_volt 0 0 0 4.9999237060546875 ECU_ADDRESS 0x400050DA FORMAT "%4.3" SYMBOL_LINK "hw_an_vlt" 52 /end MEASUREMENT
/begin MEASUREMENT hw_bst_p_vlt "boost press sensor voltage" UWORD u_ad_volt 0 0 0 4.9999237060546875 ECU_ADDRESS 0x400050DA FORMAT "%4.3" SYMBOL_LINK "hw_an_vlt" 12 /end MEASUREMENT
/begin MEASUREMENT hw_brk_p_vlt "boost press sensor voltage" UWORD u_ad_volt 0 0 0 4.9999237060546875 ECU_ADDRESS 0x400050DA FORMAT "%4.3" SYMBOL_LINK "hw_brk_p_vlt" 122 /end MEASUREMENT
/begin MEASUREMENT hw_uo2_vlt "raw upstream o2 sensor voltage" UWORD u_ad_volt 0 0 0 4.9999237060546875 ECU_ADDRESS 0x400050DA FORMAT "%4.3" SYMBOL_LINK "hw_an_vlt" 64 /end MEASUREMENT
/begin MEASUREMENT hw_do2_vlt "raw downstream o2 sensor voltage" UWORD u_ad_volt 0 0 0 4.9999237060546875 ECU_ADDRESS 0x400050DA FORMAT "%4.3" SYMBOL_LINK "hw_an_vlt" 66 /end MEASUREMENT
/begin MEASUREMENT hw_amp_vlt "ambient pressure sensor voltage" UWORD u_ad_volt 0 0 0 4.9999237060546875 ECU_ADDRESS 0x400050DA FORMAT "%4.3" SYMBOL_LINK "hw_an_vlt" 14 /end MEASUREMENT
/begin MEASUREMENT hw_pps1_vlt "pedal position sensor1 voltage" UWORD u_ad_volt 0 0 0 4.9999237060546875 ECU_ADDRESS 0x400050DA FORMAT "%4.3" SYMBOL_LINK "hw_pps1_vlt" 94 /end MEASUREMENT
/begin MEASUREMENT hw_pps2_vlt "pedal position sensor1 voltage" UWORD u_ad_volt 0 0 0 4.9999237060546875 ECU_ADDRESS 0x400050DA FORMAT "%4.3" SYMBOL_LINK "hw_pps2_vlt" 98 /end MEASUREMENT
/begin MEASUREMENT hw_tps1_vlt "throttle position sensor1 voltage" UWORD u_ad_volt 0 0 0 4.9999237060546875 ECU_ADDRESS 0x400050DA FORMAT "%4.3" SYMBOL_LINK "hw_tps1_vlt" 108 /end MEASUREMENT
/begin MEASUREMENT hw_tps2_vlt "throttle position sensor1 voltage" UWORD u_ad_volt 0 0 0 4.9999237060546875 ECU_ADDRESS 0x400050DA FORMAT "%4.3" SYMBOL_LINK "hw_tps2_vlt" 110 /end MEASUREMENT
/begin MEASUREMENT hw_ac_temp_vlt "ac evap temp sensor voltage" UWORD u_ad_volt 0 0 0 4.9999237060546875 ECU_ADDRESS 0x400050DA FORMAT "%4.3" SYMBOL_LINK "hw_ac_temp_vlt" 120 /end MEASUREMENT
/begin MEASUREMENT hw_egr_out_t_vlt "egr out temp sensor voltage" UWORD u_ad_volt 0 0 0 4.9999237060546875 ECU_ADDRESS 0x400050DA FORMAT "%4.3" SYMBOL_LINK "hw_egr_out_t_vlt" 192 /end MEASUREMENT
/begin MEASUREMENT hw_tnkp_vlt "tank press sensor voltage" UWORD u_ad_volt 0 0 0 4.9999237060546875 ECU_ADDRESS 0x400050DA FORMAT "%4.3" SYMBOL_LINK "hw_an_vlt" 38 /end MEASUREMENT
/begin MEASUREMENT hw_eoi_pre "main injection eoi" UWORD u_crk_ang 0 0 0 1023.984375 ECU_ADDRESS 0x400050DA /end MEASUREMENT
/begin MEASUREMENT hw_eoi_main "main injection eoi" UWORD u_crk_ang 0 0 0 1023.984375 ECU_ADDRESS 0x400050DA /end MEASUREMENT
/begin MEASUREMENT hw_pow_eoi_bias "power injection eoi bias" UWORD u_crk_ang 0 0 0 1023.984375 ECU_ADDRESS 0x400050DA /end MEASUREMENT
/begin MEASUREMENT hw_eoi_post "post injection eoi" UWORD u_crk_ang 0 0 0 1023.984375 ECU_ADDRESS 0x400050DA /end MEASUREMENT
/begin MEASUREMENT hw_b1_intk_vvt_dc "bank1 intake vvt duty cycle" UWORD u_pct 0 0 0 199.996948242187 ECU_ADDRESS 0x400050DA /end MEASUREMENT
/begin MEASUREMENT hw_inj_flw "injecor flow" UWORD u_g_per_sec_64 0 0 0 63.9990234375 ECU_ADDRESS 0x400050DA /end MEASUREMENT
/begin MEASUREMENT hw_bst_t_vlt "boost temperature sensor voltage" UWORD u_ad_volt 0 0 0 4.9999237060546875 ECU_ADDRESS 0x400050DA FORMAT "%4.3" SYMBOL_LINK "hw_an_vlt" 16 /end MEASUREMENT
/begin MEASUREMENT hw_uo2_vlt_raw "upstream o2 sensor volt raw" UWORD u_volt_32 0 0 0 31.99951171875 ECU_ADDRESS 0x400050DA FORMAT "%5.2" SYMBOL_LINK "hw_o2_vlt_raw" 0 /end MEASUREMENT
/begin MEASUREMENT hw_do2_vlt_raw "downstream o2 sensor volt raw" UWORD u_volt_32 0 0 0 31.99951171875 ECU_ADDRESS 0x400050DA FORMAT "%5.2" SYMBOL_LINK "hw_o2_vlt_raw" 2 /end MEASUREMENT
/begin MEASUREMENT hw_uo2_ht_curr_vlt "uo2 heater current voltage" UWORD u_ad_volt 0 0 0 4.9999237060546875 ECU_ADDRESS 0x4000AA4C FORMAT "%4.3" SYMBOL_LINK "hw_an_vlt" 56 /end MEASUREMENT
/begin MEASUREMENT hw_do2_ht_curr_vlt "do2 heater current voltage" UWORD u_ad_volt 0 0 0 4.9999237060546875 ECU_ADDRESS 0x4000AA4E FORMAT "%4.3" SYMBOL_LINK "hw_an_vlt" 58 /end MEASUREMENT
/begin MEASUREMENT sys_ect "engine coolant temperature" SWORD u_deg_C 0 0 -256 255.9921875 ECU_ADDRESS 0x400050DA /end MEASUREMENT
/begin MEASUREMENT sys_iat "intake air temperature" SWORD u_deg_C 0 0 -256 255.9921875 ECU_ADDRESS 0x400050DA /end MEASUREMENT
/begin MEASUREMENT sys_ect_raw "raw engine coolant temperature" SWORD u_deg_C 0 0 -256 255.9921875 ECU_ADDRESS 0x400050DA /end MEASUREMENT
/begin MEASUREMENT sys_iat_raw "raw intake air temperature" SWORD u_deg_C 0 0 -256 255.9921875 ECU_ADDRESS 0x400050DA /end MEASUREMENT
/begin MEASUREMENT sys_bst_t_raw "raw boost air temperature" SWORD u_deg_C 0 0 -256 255.9921875 ECU_ADDRESS 0x400050DA /end MEASUREMENT
/begin MEASUREMENT sys_bst_t "boost air temperature" SWORD u_deg_C 0 0 -256 255.9921875 ECU_ADDRESS 0x400050DA /end MEASUREMENT
/begin MEASUREMENT sys_keyon_ect "key on engine coolant temperature" SWORD u_deg_C 0 0 -256 255.9921875 ECU_ADDRESS 0x400050DA /end MEASUREMENT
/begin MEASUREMENT sys_keyon_iat "key on intake air temperature" SWORD u_deg_C 0 0 -256 255.9921875 ECU_ADDRESS 0x400050DA /end MEASUREMENT
/begin MEASUREMENT sys_keyoff_ect_nv "key off engine coolant temperature" SWORD u_deg_C 0 0 -256 255.9921875 ECU_ADDRESS 0x400050DA /end MEASUREMENT
/begin MEASUREMENT sys_keyoff_iat_nv "key off intake air temperature" SWORD u_deg_C 0 0 -256 255.9921875 ECU_ADDRESS 0x400050DA /end MEASUREMENT
/begin MEASUREMENT sys_trp_iat_min_nv "trip intake air temperature min" SWORD u_deg_C 0 0 -256 255.9921875 ECU_ADDRESS 0x400050DA /end MEASUREMENT
/begin MEASUREMENT sys_ac_temp "ac evap temperature" SWORD u_deg_C 0 0 -256 255.9921875 ECU_ADDRESS 0x400050DA /end MEASUREMENT
/begin MEASUREMENT sys_egr_out_t "egr out temperature" SWORD u_deg_C 0 0 -256 255.9921875 ECU_ADDRESS 0x400050DA /end MEASUREMENT
/begin MEASUREMENT sys_veh_mov "vehicle moving" UBYTE b_true 0 0 0.00 1.00 BIT_MASK 0x1 ECU_ADDRESS 0x400050DA FORMAT "%1.0" /end MEASUREMENT
/begin MEASUREMENT sys_key_on "ignition key on" UBYTE b_true 0 0 0.00 1.00 BIT_MASK 0x1 ECU_ADDRESS 0x400050DA FORMAT "%1.0" /end MEASUREMENT
/begin MEASUREMENT sys_key_off "ignition key off" UBYTE b_true 0 0 0.00 1.00 BIT_MASK 0x1 ECU_ADDRESS 0x400050DA FORMAT "%1.0" /end MEASUREMENT
/begin MEASUREMENT sys_key_on_dur "key on duration" UWORD u_1x_tmr 0 0 0.0 511.9921875 ECU_ADDRESS 0x4000DA4E FORMAT "%5.2" SYMBOL_LINK "sys_key_on_dur" 34 /end MEASUREMENT
/begin MEASUREMENT sys_key_off_dur "key on duration" UWORD u_1x_tmr 0 0 0.0 511.9921875 ECU_ADDRESS 0x4000DA4E FORMAT "%5.2" SYMBOL_LINK "sys_key_off_dur" 4 /end MEASUREMENT
/begin MEASUREMENT sys_map "map updated every seg when run,else every loop" UWORD u_kPa_0_256 0 0 0 255.99609375 ECU_ADDRESS 0x400050DA /end MEASUREMENT
/begin MEASUREMENT sys_map_raw "raw map updated every seg when run,else every loop" UWORD u_kPa_0_256 0 0 0 255.99609375 ECU_ADDRESS 0x400050DA /end MEASUREMENT
/begin MEASUREMENT sys_map_seg "map based on segment" UWORD u_kPa_0_256 0 0 0 255.99609375 ECU_ADDRESS 0x400050DA /end MEASUREMENT
/begin MEASUREMENT sys_map_seg_raw "raw map based on segment" UWORD u_kPa_0_256 0 0 0 255.99609375 ECU_ADDRESS 0x400050DA /end MEASUREMENT
/begin MEASUREMENT sys_map_dflt "map default" UWORD u_kPa_0_256 0 0 0 255.99609375 ECU_ADDRESS 0x400050DA /end MEASUREMENT
/begin MEASUREMENT sys_map_amp "normalized map based on ambient pressure" UWORD u_kPa_0_256 0 0 0 255.99609375 ECU_ADDRESS 0x400050DA /end MEASUREMENT
/begin MEASUREMENT sys_im_vac "normalized map based on ambient pressure" UWORD u_kPa_128n_128p 0 0 -128 127.99609375 ECU_ADDRESS 0x400050DA /end MEASUREMENT
/begin MEASUREMENT sys_map_raw_amp "normalized raw map based on ambient pressure" UWORD u_kPa_0_256 0 0 0 255.99609375 ECU_ADDRESS 0x400050DA /end MEASUREMENT
/begin MEASUREMENT sys_amp_snsr_raw "raw ambient pressure measured by sensor" UWORD u_kPa_0_256 0 0 0 255.99609375 ECU_ADDRESS 0x400050DA /end MEASUREMENT
/begin MEASUREMENT sys_amp_snsr "ambient pressure measured by sensor" UWORD u_kPa_0_256 0 0 0 255.99609375 ECU_ADDRESS 0x400050DA /end MEASUREMENT
/begin MEASUREMENT sys_amp "ambient pressure" UWORD u_kPa_0_256 0 0 0 255.99609375 ECU_ADDRESS 0x400050DA /end MEASUREMENT
/begin MEASUREMENT sys_eng_spd "engine speed" UWORD u_espd 0 0 0 8191.875 ECU_ADDRESS 0x400050DA FORMAT "%6.2" /end MEASUREMENT
/begin MEASUREMENT sys_espd_avg "engine speed" UWORD u_espd 0 0 0 8191.875 ECU_ADDRESS 0x400050DA FORMAT "%6.2" /end MEASUREMENT
/begin MEASUREMENT sys_espd_delt "engine speed delta every segment" SWORD u_espd 0 0 -4096 4095.875 ECU_ADDRESS 0x400050DA FORMAT "%6.2" /end MEASUREMENT
/begin MEASUREMENT sys_eng_state "engine state" UBYTE u_state_eng 0 0 0.00 6.00 ECU_ADDRESS 0x400050DA FORMAT "%1.0" /end MEASUREMENT
/begin MEASUREMENT sys_veh_st "engine state" UBYTE u_state_veh 0 0 0.00 6.00 ECU_ADDRESS 0x400050DA FORMAT "%1.0" /end MEASUREMENT
/begin MEASUREMENT sys_run_dly_thr "engine run segment delay threshhold " UBYTE u_cnts 0 0 0.00 255.00 ECU_ADDRESS 0x400050DA FORMAT "%1.0" /end MEASUREMENT
/begin MEASUREMENT sys_run_dly_seg_cnts "engine run segment delay counts" UBYTE u_cnts 0 0 0.00 255.00 ECU_ADDRESS 0x400050DA FORMAT "%1.0" /end MEASUREMENT
/begin MEASUREMENT sys_st_run_espd_thr "engine start to run engine speed thr" UWORD u_espd 0 0 0 8191.875 ECU_ADDRESS 0x400050DA FORMAT "%6.2" /end MEASUREMENT
/begin MEASUREMENT sys_shut_dwn_en "engine shutdown condtions met" UBYTE b_true 0 0 0.00 1.00 BIT_MASK 0x1 ECU_ADDRESS 0x400050DA FORMAT "%1.0" /end MEASUREMENT
/begin MEASUREMENT sys_eng_rtm_nv "single engine runtime every trip" UWORD u_1s_tmr 0 0 0.0 65535.0 ECU_ADDRESS 0x4000DA4E /end MEASUREMENT
/begin MEASUREMENT sys_veh_rtm_nv "vehicle runtime" UWORD u_1s_tmr 0 0 0.0 65535.0 ECU_ADDRESS 0x4000DA4E SYMBOL_LINK "sys_eng_rtm_nv" 2 /end MEASUREMENT
/begin MEASUREMENT sys_eng_trt_nv "engine total runtime every trip" UWORD u_1s_tmr 0 0 0.0 65535.0 ECU_ADDRESS 0x4000DA4E SYMBOL_LINK "sys_eng_rtm_nv" 4 /end MEASUREMENT
/begin MEASUREMENT sys_eng_trt_lst_nv "engine total runtime last trip" UWORD u_1s_tmr 0 0 0.0 65535.0 ECU_ADDRESS 0x4000DA4E SYMBOL_LINK "sys_eng_trt_lst_nv" 4 /end MEASUREMENT
/begin MEASUREMENT sys_eng_rtm_lst_nv "single engine runtime last trip" UWORD u_1s_tmr 0 0 0.0 65535.0 ECU_ADDRESS 0x4000DA4E /end MEASUREMENT
/begin MEASUREMENT sys_veh_rtm_lst_nv "vehicle runtime last trip" UWORD u_1s_tmr 0 0 0.0 65535.0 ECU_ADDRESS 0x4000DA4E SYMBOL_LINK "sys_veh_rtm_lst_nv" 2 /end MEASUREMENT
/begin MEASUREMENT sys_pps1_pct_raw "pedal position1 percentage" UWORD u_pct 0 0 0.0 199.996948242187 ECU_ADDRESS 0x4000DA4E /end MEASUREMENT
/begin MEASUREMENT sys_pps2_pct_raw "pedal position2 percentage" UWORD u_pct 0 0 0.0 199.996948242187 ECU_ADDRESS 0x4000DA4E SYMBOL_LINK "sys_pps2_pct_raw" 2 /end MEASUREMENT
/begin MEASUREMENT sys_pps1_zero_nv "learned pps1 zero position" UWORD u_pct 0 0 0.0 199.996948242187 ECU_ADDRESS 0x4000DA4E /end MEASUREMENT
/begin MEASUREMENT sys_pps2_zero_nv "learned pps2 zero position" UWORD u_pct 0 0 0.0 199.996948242187 ECU_ADDRESS 0x4000DA4E SYMBOL_LINK "sys_pps2_zero_nv" 2 /end MEASUREMENT
/begin MEASUREMENT sys_pps1_pct "pedal zeroed position1 percentage" UWORD u_pct 0 0 0.0 199.996948242187 ECU_ADDRESS 0x4000DA4E /end MEASUREMENT
/begin MEASUREMENT sys_pps2_pct "pedal zeroed position2 percentage" UWORD u_pct 0 0 0.0 199.996948242187 ECU_ADDRESS 0x4000DA4E SYMBOL_LINK "sys_pps2_pct" 2 /end MEASUREMENT
/begin MEASUREMENT sys_pps_scaled "pedal zeroed position2 percentage" UWORD u_pct 0 0 0.0 199.996948242187 ECU_ADDRESS 0x4000DA4E /end MEASUREMENT
/begin MEASUREMENT sys_pps_scald_zero_nv "pedal zeroed position2 percentage" UWORD u_pct 0 0 0.0 199.996948242187 ECU_ADDRESS 0x4000DA4E /end MEASUREMENT
/begin MEASUREMENT sys_pps_pct "virtual pedal position" UWORD u_pct 0 0 0.0 199.996948242187 ECU_ADDRESS 0x4000DA4E /end MEASUREMENT
/begin MEASUREMENT sys_pps_corr_stat "pedal zeroed position2 percentage" UBYTE pps_corr_stat 0 0 0.0 1.0 ECU_ADDRESS 0x4000DA4E FORMAT "%4.2" /end MEASUREMENT
/begin MEASUREMENT sys_pps_vlt_stat "pedal zeroed position2 percentage" UBYTE pps_vlt_stat 0 0 0.0 3.0 ECU_ADDRESS 0x4000DA4E FORMAT "%4.2" /end MEASUREMENT
/begin MEASUREMENT sys_tps_pct "throttle position" UWORD u_pct 0 0 0.0 199.996948242187 ECU_ADDRESS 0x4000DA4E /end MEASUREMENT
/begin MEASUREMENT sys_tps_1x_lst "throttle position 1x last" UWORD u_pct 0 0 0.0 199.996948242187 ECU_ADDRESS 0x4000DA4E /end MEASUREMENT
/begin MEASUREMENT sys_tps_2x_lst "throttle position 2x last" UWORD u_pct 0 0 0.0 199.996948242187 ECU_ADDRESS 0x4000DA4E /end MEASUREMENT
/begin MEASUREMENT sys_uo2_vlt "upstream o2 sensor volt" UWORD u_volt_32 0 0 0 31.99951171875 ECU_ADDRESS 0x400050DA FORMAT "%5.2" SYMBOL_LINK "sys_o2_vlt" 0 /end MEASUREMENT
/begin MEASUREMENT sys_do2_vlt "downstream o2 sensor volt" UWORD u_volt_32 0 0 0 31.99951171875 ECU_ADDRESS 0x400050DA FORMAT "%5.2" SYMBOL_LINK "sys_o2_vlt" 2 /end MEASUREMENT
/begin MEASUREMENT sys_tps1_pct_raw "throttle position1 percentage ref to 5v" UWORD u_pct 0 0 0.0 199.996948242187 ECU_ADDRESS 0x4000DA4E /end MEASUREMENT
/begin MEASUREMENT sys_tps2_pct_raw "throttle position2 percentage ref to 5v" UWORD u_pct 0 0 0.0 199.996948242187 ECU_ADDRESS 0x4000DA4E /end MEASUREMENT
/begin MEASUREMENT sys_tps1_zero_nv "learned tps1 zero position" UWORD u_pct 0 0 0.0 199.996948242187 ECU_ADDRESS 0x4000DA4E /end MEASUREMENT
/begin MEASUREMENT sys_tps2_zero_nv "learned tps2 zero position" UWORD u_pct 0 0 0.0 199.996948242187 ECU_ADDRESS 0x4000DA4E /end MEASUREMENT
/begin MEASUREMENT sys_tps1_pct "throttle zeroed position1 percentage" UWORD u_pct 0 0 0.0 199.996948242187 ECU_ADDRESS 0x4000DA4E /end MEASUREMENT
/begin MEASUREMENT sys_tps2_pct "throttle zeroed position2 percentage" UWORD u_pct 0 0 0.0 199.996948242187 ECU_ADDRESS 0x4000DA4E /end MEASUREMENT
/begin MEASUREMENT sys_tps_scaled "scaled tps based on weighted tps" UWORD u_pct 0 0 0.0 199.996948242187 ECU_ADDRESS 0x4000DA4E /end MEASUREMENT
/begin MEASUREMENT sys_thro_cls "closed throttle" UBYTE b_true 0 0 0.00 1.00 BIT_MASK 0x1 ECU_ADDRESS 0x400050DA FORMAT "%1.0" /end MEASUREMENT
/begin MEASUREMENT sys_veh_spd "vehicle speed" UWORD u_vspd 0 0 0.0 511.9921875 ECU_ADDRESS 0x4000DA4E /end MEASUREMENT
/begin MEASUREMENT sys_vspd_raw "vehicle speed" UWORD u_vspd 0 0 0.0 511.9921875 ECU_ADDRESS 0x4000DA4E /end MEASUREMENT
/begin MEASUREMENT sys_vspd_pred "predict vehicle speed" UWORD u_vspd 0 0 0.0 511.9921875 ECU_ADDRESS 0x4000DA4E /end MEASUREMENT
/begin MEASUREMENT sys_vspd_accel "vehicle speed acceleration" SWORD u_vspd_per_sec 0 0 -64 63.998046875 ECU_ADDRESS 0x4000DA4E FORMAT "%5.2" /end MEASUREMENT
/begin MEASUREMENT sys_vspd_jerk "vehicle speed jerk" SWORD u_vspd_j 0 0 -32 31.9990234375 ECU_ADDRESS 0x4000DA4E /end MEASUREMENT
/begin MEASUREMENT sys_vspd_freq "vehicle speed frequency" UWORD u_freq_2048 0 0 0.0 2047.96875 ECU_ADDRESS 0x4000DA4E /end MEASUREMENT
/begin MEASUREMENT sys_vspd_period "vehicle speed period" UWORD u_millisec_2048 0 0 0.0 2047.96875 ECU_ADDRESS 0x4000DA4E /end MEASUREMENT
/begin MEASUREMENT sys_vspd_src "vehicle speed source" UBYTE u_vspd_src 0 0 0 7 ECU_ADDRESS 0x4000DA4E FORMAT "%1.0" /end MEASUREMENT
/begin MEASUREMENT sys_oil_t "enine oil temperature" SWORD u_deg_C 0 0 -256 255.9921875 ECU_ADDRESS 0x400050DA /end MEASUREMENT
/begin MEASUREMENT sys_oil_p "enine oil temperature" UWORD u_kPa_0_1024 0 0 0 1023.984375 ECU_ADDRESS 0x400050DA FORMAT "%5.1" /end MEASUREMENT
/begin MEASUREMENT sys_alt_pwm "alternator duty" SWORD u_pct_1 0 0 0 99.9984741210937 ECU_ADDRESS 0x400050DA /end MEASUREMENT
/begin MEASUREMENT sys_eng_ovr_ht "engine over heat" UBYTE b_true 0 0 0.00 1.00 BIT_MASK 0x1 ECU_ADDRESS 0x400050DA FORMAT "%1.0" /end MEASUREMENT
/begin MEASUREMENT sys_eng_rvs_turn "engine revers turn" UBYTE b_true 0 0 0.00 1.00 BIT_MASK 0x1 ECU_ADDRESS 0x400050DA FORMAT "%1.0" /end MEASUREMENT
/begin MEASUREMENT sys_flv_vlt "fuel level voltage" UWORD u_volt_32 0 0 0 31.99951171875 ECU_ADDRESS 0x400050DA FORMAT "%4.2" /end MEASUREMENT
/begin MEASUREMENT sys_flv_pct_raw "fuel level voltage percent" UWORD u_pct_1 0 0 0 99.9984741210937 ECU_ADDRESS 0x400050DA FORMAT "%4.1" /end MEASUREMENT
/begin MEASUREMENT sys_flv_pct "fuel level percent" UWORD u_pct_1 0 0 0 99.9984741210937 ECU_ADDRESS 0x400050DA FORMAT "%4.1" /end MEASUREMENT
/begin MEASUREMENT sys_mil_on "mil on" UBYTE b_true 0 0 0.00 1.00 BIT_MASK 0x1 ECU_ADDRESS 0x400050DA FORMAT "%1.0" /end MEASUREMENT
/begin MEASUREMENT sys_svs_on "svs on" UBYTE b_true 0 0 0.00 1.00 BIT_MASK 0x1 ECU_ADDRESS 0x400050DA FORMAT "%1.0" /end MEASUREMENT
/begin MEASUREMENT sys_mil_pwm "mil pwm duty" UWORD u_pct 0 0 0.0 199.996948242187 ECU_ADDRESS 0x4000DA4E /end MEASUREMENT
/begin MEASUREMENT sys_svs_pwm "svs pwm duty" UWORD u_pct 0 0 0.0 199.996948242187 ECU_ADDRESS 0x4000DA4E /end MEASUREMENT
/begin MEASUREMENT sys_ect_out_pwm "ECT pwm out duty" UWORD u_pct 0 0 0.0 199.996948242187 ECU_ADDRESS 0x4000DA4E /end MEASUREMENT
/begin MEASUREMENT sys_eco_req "eco mode request" UBYTE b_true 0 0 0.00 1.00 BIT_MASK 0x1 ECU_ADDRESS 0x400050DA FORMAT "%1.0" /end MEASUREMENT
/begin MEASUREMENT sys_ac_p "ac press" SWORD u_kPa_4096n_4096p 0 0 -4096 4095.875 ECU_ADDRESS 0x4000DA4E FORMAT "%5.2" /end MEASUREMENT
/begin MEASUREMENT sys_tank_p "tank press" SWORD u_kPa_8n_8p 0 0 -8 7.999755859375 ECU_ADDRESS 0x4000DA4E FORMAT "%3.2" /end MEASUREMENT
/begin MEASUREMENT sys_ps_p "power steer press" UWORD u_kPa_0_32768 0 0 0 32767.5 ECU_ADDRESS 0x4000DA4E /end MEASUREMENT
/begin MEASUREMENT sys_ps_actv "power steer active" UBYTE b_true 0 0 0.00 1.00 BIT_MASK 0x1 ECU_ADDRESS 0x400050DA FORMAT "%1.0" /end MEASUREMENT
/begin MEASUREMENT sys_ps_lrn_typ "vehicle speed source" UBYTE u_ps_lrn_typ 0 0 0 3 ECU_ADDRESS 0x4000DA4E FORMAT "%1.0" /end MEASUREMENT
/begin MEASUREMENT sys_ac_req "ac request active" UBYTE b_true 0 0 0.00 1.00 BIT_MASK 0x1 ECU_ADDRESS 0x400050DA FORMAT "%1.0" /end MEASUREMENT
/begin MEASUREMENT sys_brk_p "break pressure" UWORD u_kPa_0_256 0 0 0 255.99609375 ECU_ADDRESS 0x400050DA /end MEASUREMENT
/begin MEASUREMENT sys_strt_rly_st "starter relay state" UBYTE b_true 0 0 0.00 1.00 BIT_MASK 0x1 ECU_ADDRESS 0x400050DA FORMAT "%1.0" /end MEASUREMENT
/begin MEASUREMENT sys_hd_light_on "head light on" UBYTE b_true 0 0 0.00 1.00 BIT_MASK 0x1 ECU_ADDRESS 0x400050DA FORMAT "%1.0" /end MEASUREMENT
/begin MEASUREMENT sys_ac_p_hi_lo_actv "ac press high low switch active" UBYTE b_true 0 0 0.00 1.00 BIT_MASK 0x1 ECU_ADDRESS 0x400050DA FORMAT "%1.0" /end MEASUREMENT
/begin MEASUREMENT sys_bstp_vlt_pct "boost press voltage percent" UWORD u_pct_1 0 0 0.0 99.9984741210937 ECU_ADDRESS 0x4000DA4E /end MEASUREMENT
/begin MEASUREMENT sys_bst_p_seg "boost pressure segment" UWORD u_kPa_0_256 0 0 0 255.99609375 ECU_ADDRESS 0x400050DA /end MEASUREMENT
/begin MEASUREMENT sys_bst_p "boost pressure filtered" UWORD u_kPa_0_256 0 0 0 255.99609375 ECU_ADDRESS 0x400050DA /end MEASUREMENT
/begin MEASUREMENT sys_bst_p_raw "boost pressure raw" UWORD u_kPa_0_256 0 0 0 255.99609375 ECU_ADDRESS 0x400050DA /end MEASUREMENT
/begin MEASUREMENT sys_blwr_st "blower state" UBYTE u_blwr_st 0 0 0 4 ECU_ADDRESS 0x4000DA4E FORMAT "%1.0" /end MEASUREMENT
/begin MEASUREMENT sys_cltch_espd_acc "engine speed accelaration" UWORD u_espd_acc 0 0 0 32767.5 ECU_ADDRESS 0x400050DA /end MEASUREMENT
/begin MEASUREMENT sys_cltch_on "declutch active" UBYTE b_true 0 0 0.00 1.00 BIT_MASK 0x1 ECU_ADDRESS 0x400050DA FORMAT "%1.0" /end MEASUREMENT
/begin MEASUREMENT sys_cltch_in_espd "declutch enter engine speed" UWORD u_espd 0 0 0 8191.875 ECU_ADDRESS 0x400050DA FORMAT "%5.1" /end MEASUREMENT
/begin MEASUREMENT sys_cltch_on_det_tm "declutch detection duration" UWORD u_2x_tmr 0 0 0.0 1023.984375 ECU_ADDRESS 0x4000DA4E /end MEASUREMENT
/begin MEASUREMENT sys_cltch_on_tm "declutch active duration" UWORD u_2x_tmr 0 0 0.0 1023.984375 ECU_ADDRESS 0x4000DA4E SYMBOL_LINK "sys_cltch_on_tm" 2 /end MEASUREMENT
/begin MEASUREMENT sys_acc_swtch_on "acc switch on" UBYTE b_true 0 0 0.00 1.00 BIT_MASK 0x1 ECU_ADDRESS 0x400050DA FORMAT "%1.0" /end MEASUREMENT
/begin MEASUREMENT sys_acc_vlt "acc switch voltage" UWORD u_volt_32 0 0 0.0 31.99951171875 ECU_ADDRESS 0x4000DA4E FORMAT "%4.2" /end MEASUREMENT
/begin MEASUREMENT sys_acc_vlt_raw "acc switch voltage" UWORD u_volt_32 0 0 0.0 31.99951171875 ECU_ADDRESS 0x4000DA4E FORMAT "%4.2" /end MEASUREMENT
/begin MEASUREMENT sys_alt_dty_raw "alter duty raw" UWORD u_pct_1 0 0 0.0 99.9984741210937 ECU_ADDRESS 0x4000DA4E FORMAT "%4.2" /end MEASUREMENT
/begin MEASUREMENT sys_alt_dty "alter duty" UWORD u_pct_1 0 0 0.0 99.9984741210937 ECU_ADDRESS 0x4000DA4E FORMAT "%4.2" /end MEASUREMENT
/begin MEASUREMENT sys_brk1_actv "break switch 1 active" UBYTE b_true 0 0 0.00 1.00 BIT_MASK 0x1 ECU_ADDRESS 0x400050DA FORMAT "%1.0" /end MEASUREMENT
/begin MEASUREMENT sys_brk2_actv "break switch 1 active" UBYTE b_true 0 0 0.00 1.00 BIT_MASK 0x1 ECU_ADDRESS 0x400050DA FORMAT "%1.0" /end MEASUREMENT
/begin MEASUREMENT sys_ac_inst_nv "ac system install" UBYTE b_true 0 0 0.00 1.00 BIT_MASK 0x1 ECU_ADDRESS 0x400050DA FORMAT "%1.0" /end MEASUREMENT
/begin MEASUREMENT sys_trs_oil_t "trans oil temperature" SWORD u_deg_C 0 0 -256 255.9921875 ECU_ADDRESS 0x400050DA /end MEASUREMENT
/begin MEASUREMENT sys_trs_cld "cold trans" UBYTE b_true 0 0 0.00 1.00 BIT_MASK 0x1 ECU_ADDRESS 0x400050DA FORMAT "%1.0" /end MEASUREMENT
/begin MEASUREMENT sys_real_af "AFR from CAN af meter" UWORD u_afr 0 0 0.0 31.99951171875 ECU_ADDRESS 0x40002562 /end MEASUREMENT
/begin MEASUREMENT sys_tps_lrn_on_zero "throttle position zero when learn on" UWORD u_pct 0 0 0.0 199.996948242187 ECU_ADDRESS 0x4000DA4E /end MEASUREMENT
/begin MEASUREMENT sys_tps_free "free throttle position" UWORD u_pct_r 0 0 0.0 127.998046875 ECU_ADDRESS 0x4000DA4E /end MEASUREMENT
/begin MEASUREMENT sys_tps_nois_mot_vlt "throttle motor voltage for tps noise determine" UWORD u_volt_32 0 0 0.00 31.99951171875 ECU_ADDRESS 0x400050DA FORMAT "%4.2" /end MEASUREMENT
/begin MEASUREMENT sys_tps1_d "tps1 derivative" SWORD u_tps_d 0 0 -4096 4095.875 ECU_ADDRESS 0x400050DA /end MEASUREMENT
/begin MEASUREMENT sys_tps2_d "tps2 derivative" SWORD u_tps_d 0 0 -4096 4095.875 ECU_ADDRESS 0x400050DA /end MEASUREMENT
/begin MEASUREMENT sys_tps1_nois "tps1 noisy" UBYTE b_true 0 0 0 1.0 BIT_MASK 0x1 ECU_ADDRESS 0x400050DA FORMAT "%1.0" /end MEASUREMENT
/begin MEASUREMENT sys_tps2_nois "tps2 noisy" UBYTE b_true 0 0 0 1.0 BIT_MASK 0x1 ECU_ADDRESS 0x400050DA FORMAT "%1.0" /end MEASUREMENT
/begin MEASUREMENT sys_tps1_nois_ext_dly "tps1 noisy state exit delay" UWORD u_2x_tmr 0 0 0.00 1023.984375 ECU_ADDRESS 0x400050DA SYMBOL_LINK "sys_tps_tmr" 4 /end MEASUREMENT
/begin MEASUREMENT sys_tps2_nois_ext_dly "tps2 noisy state exit delay" UWORD u_2x_tmr 0 0 0.00 1023.984375 ECU_ADDRESS 0x400050DA SYMBOL_LINK "sys_tps_tmr" 6 /end MEASUREMENT
/begin MEASUREMENT sys_tps_ss "tps steady" UBYTE b_true 0 0 0 1.0 BIT_MASK 0x1 ECU_ADDRESS 0x400050DA FORMAT "%1.0" /end MEASUREMENT
/begin MEASUREMENT sys_tps_zero_lrn_tms "tps zero learn times" UBYTE u_cnts 0 0 0 255 ECU_ADDRESS 0x400050DA /end MEASUREMENT
/begin MEASUREMENT sys_tps_lrn_req "tps zero learn request" UBYTE b_true 0 0 0 1.0 BIT_MASK 0x1 ECU_ADDRESS 0x400050DA FORMAT "%1.0" /end MEASUREMENT
/begin MEASUREMENT sys_tps_lrn_en "tps zero learn enable" UBYTE b_true 0 0 0 1.0 BIT_MASK 0x1 ECU_ADDRESS 0x400050DA FORMAT "%1.0" /end MEASUREMENT
/begin MEASUREMENT sys_tps_lrn_rst "tps zero learn reset" UBYTE b_true 0 0 0 1.0 BIT_MASK 0x1 ECU_ADDRESS 0x400050DA FORMAT "%1.0" /end MEASUREMENT
/begin MEASUREMENT sys_tps_lrn_actv "tps zero learn active" UBYTE b_true 0 0 0 1.0 BIT_MASK 0x1 ECU_ADDRESS 0x400050DA FORMAT "%1.0" /end MEASUREMENT
/begin MEASUREMENT sys_tps1_zero_raw "throttle position zero raw" UWORD u_pct 0 0 0.0 199.996948242187 ECU_ADDRESS 0x4000DA4E /end MEASUREMENT
/begin MEASUREMENT sys_tps2_zero_raw "throttle position zero raw" UWORD u_pct 0 0 0.0 199.996948242187 ECU_ADDRESS 0x4000DA4E /end MEASUREMENT
/begin MEASUREMENT sys_tps_lrn_dur "tps learn duration" UWORD u_2x_tmr 0 0 0.00 1023.984375 ECU_ADDRESS 0x400050DA SYMBOL_LINK "sys_tps_tmr" 0 /end MEASUREMENT
/begin MEASUREMENT sys_tps_lrn_mov_dur "tps learn move duration" UWORD u_2x_tmr 0 0 0.00 1023.984375 ECU_ADDRESS 0x400050DA SYMBOL_LINK "sys_tps_tmr" 2 /end MEASUREMENT
/begin MEASUREMENT sys_tps_lrn_fn "tps zero learn finish" UBYTE b_true 0 0 0 1.0 BIT_MASK 0x1 ECU_ADDRESS 0x400050DA FORMAT "%1.0" /end MEASUREMENT
/begin MEASUREMENT sys_tps1_zero_lst "throttle position zero old" UWORD u_pct 0 0 0.0 199.996948242187 ECU_ADDRESS 0x4000DA4E /end MEASUREMENT
/begin MEASUREMENT sys_tps2_zero_lst "throttle position zero old" UWORD u_pct 0 0 0.0 199.996948242187 ECU_ADDRESS 0x4000DA4E /end MEASUREMENT
/begin MEASUREMENT sys_eng_turn "engine turning" UBYTE b_true 0 0 0 1.0 BIT_MASK 0x1 ECU_ADDRESS 0x400050DA FORMAT "%1.0" /end MEASUREMENT
/begin MEASUREMENT sys_amp_vlt_pct "amp voltage percent" UWORD u_pct_1 0 0 0.0 99.9984741210937 ECU_ADDRESS 0x4000DA4E /end MEASUREMENT
/begin MEASUREMENT sys_iat_vlt_pct "iat voltage percent" UWORD u_pct_1 0 0 0.0 99.9984741210937 ECU_ADDRESS 0x4000DA4E /end MEASUREMENT
/begin MEASUREMENT sys_bst_t_vlt_pct "boost temp voltage percent" UWORD u_pct_1 0 0 0.0 99.9984741210937 ECU_ADDRESS 0x4000DA4E /end MEASUREMENT
/begin MEASUREMENT sys_ac_temp_raw "ac temperature raw" SWORD u_deg_C 0 0 -256 255.9921875 ECU_ADDRESS 0x400050DA /end MEASUREMENT
/begin MEASUREMENT sys_amb_t "ambient temperature" SWORD u_deg_C 0 0 -256 255.9921875 ECU_ADDRESS 0x400050DA /end MEASUREMENT
/begin MEASUREMENT sys_rr_avg_espd "rough road average engine speed" UWORD u_espd 0 0 0 8191.875 ECU_ADDRESS 0x40004EA0 FORMAT "%5.1" /end MEASUREMENT
/begin MEASUREMENT sys_rr_avg_load "rough road average engine load" UWORD u_pct_1 0 0 0 99.9984741210937 ECU_ADDRESS 0x40004EA0 FORMAT "%4.2" /end MEASUREMENT
/begin MEASUREMENT sys_egr_pos_act "EGR actual position" UWORD u_pct 0 0 0.0 199.996948242187 ECU_ADDRESS 0x4000DA4E /end MEASUREMENT
/begin MEASUREMENT sys_cru_vspd "vehicle speed" UWORD u_vspd 0 0 0.00 511.9921875 ECU_ADDRESS 0x4000440A FORMAT "%4.1" /end MEASUREMENT
/begin MEASUREMENT sys_air_flap_pct "air flap open percent" UWORD u_pct_1 0 0 0.0 99.9984741210937 ECU_ADDRESS 0x4000DA4E FORMAT "%4.2" /end MEASUREMENT
/begin MEASUREMENT sys_decltch_stat "true means declutch is detected" UBYTE b_true 0 0 0.00 1.00 BIT_MASK 0x1 ECU_ADDRESS 0x400050DA FORMAT "%1.0" /end MEASUREMENT
/begin MEASUREMENT sys_uo2_ht_cur "uo2 heater current" UWORD u_amp_8 0 0 0.00 7.9998779296875 ECU_ADDRESS 0x40004ef4 FORMAT "%3.2" /end MEASUREMENT
/begin MEASUREMENT sys_do2_ht_cur "uo2 heater current" UWORD u_amp_8 0 0 0.00 7.9998779296875 ECU_ADDRESS 0x40004ef6 FORMAT "%3.2" /end MEASUREMENT
/begin MEASUREMENT sys_trip_refuel_tms "refuel times this trip" UBYTE u_cnts 0 0 0 255 ECU_ADDRESS 0x40004EA0 FORMAT "%5.0" /end MEASUREMENT
/begin MEASUREMENT sys_trip_refuel_typ "refuel update type" UBYTE u_refuel_typ 0 0 0 4 ECU_ADDRESS 0x40004EA0 FORMAT "%1.0" /end MEASUREMENT
/begin MEASUREMENT sys_trip_fc_hi "fuel consumption this trip" ULONG u_ul 0 0 0 134217727.96875 ECU_ADDRESS 0x40004EA0 FORMAT "%10.1" /end MEASUREMENT
/begin MEASUREMENT sys_veh_in_mfg "vehicle in manufactor" UBYTE b_true 0 0 0.00 1.00 ECU_ADDRESS 0x40004EA0 FORMAT "%1.0" /end MEASUREMENT
/begin MEASUREMENT sys_flv_pct_mmv "fuel level percent" UWORD u_pct_1 0 0 0 99.9984741210937 ECU_ADDRESS 0x400050DA FORMAT "%4.1" /end MEASUREMENT
/begin MEASUREMENT sys_vspd_simp_accel "simple vehicle speed acceleration" SWORD u_vspd_per_sec 0 0 -64 63.998046875 ECU_ADDRESS 0x4000DA4E FORMAT "%5.2" /end MEASUREMENT
/begin MEASUREMENT sys_amp_raw "ambient pressure without range limit" UWORD u_kPa_0_256 0 0 0 255.99609375 ECU_ADDRESS 0x400050DA /end MEASUREMENT
/begin MEASUREMENT sys_amp_updt_occr "amp update occured" UBYTE b_true 0 0 0.00 1.00 ECU_ADDRESS 0x40004EA0 FORMAT "%1.0" /end MEASUREMENT
/begin MEASUREMENT sys_pow_on_ect "power on ect" SWORD u_deg_C 0 0 -256 255.9921875 ECU_ADDRESS 0x4000DA4E /end MEASUREMENT
/begin MEASUREMENT sys_pps1_vlt_pct "pedal position1 voltage percentage" UWORD u_pct 0 0 0.0 199.996948242187 ECU_ADDRESS 0x4000DA4E SYMBOL_LINK "sys_pps_vlt_pct" 0 /end MEASUREMENT
/begin MEASUREMENT sys_pps2_vlt_pct "pedal position2 voltage percentage" UWORD u_pct 0 0 0.0 199.996948242187 ECU_ADDRESS 0x4000DA4E SYMBOL_LINK "sys_pps_vlt_pct" 2 /end MEASUREMENT
/begin MEASUREMENT sys_tps1_vlt_pct "throttle position1 voltage percentage" UWORD u_pct 0 0 0.0 199.996948242187 ECU_ADDRESS 0x4000DA4E /end MEASUREMENT
/begin MEASUREMENT sys_tps2_vlt_pct "throttle position2 voltage percentage" UWORD u_pct 0 0 0.0 199.996948242187 ECU_ADDRESS 0x4000DA4E /end MEASUREMENT
/begin MEASUREMENT sys_seg_cnts "segment counts" UWORD u_cnts 0 0 0.0 65535 ECU_ADDRESS 0x4000DA4E FORMAT "%5.0" /end MEASUREMENT
/begin MEASUREMENT sys_tps_flw_stbl "tps airflow stable" UBYTE b_true 0 0 0.00 1.00 ECU_ADDRESS 0x40004EA0 FORMAT "%1.0" /end MEASUREMENT
/begin MEASUREMENT sys_tps1_zero_tmp "learned tps1 zero position temp" UWORD u_pct 0 0 0.0 199.996948242187 ECU_ADDRESS 0x4000DA4E /end MEASUREMENT
/begin MEASUREMENT sys_tps2_zero_tmp "learned tps2 zero position temp" UWORD u_pct 0 0 0.0 199.996948242187 ECU_ADDRESS 0x4000DA4E /end MEASUREMENT
/begin MEASUREMENT sys_cyl_num "cylinder number" UBYTE u_cnts 0 0 0.00 255.00 ECU_ADDRESS 0x40004EA0 FORMAT "%1.0" /end MEASUREMENT
/begin MEASUREMENT sys_tcu_vspd "vehicle speed from TCU" UWORD u_vspd 0 0 0.0 511.9921875 ECU_ADDRESS 0x4000DA4E /end MEASUREMENT
/begin MEASUREMENT sys_vspd_raw_mmv "vehicle speed raw filtered" UWORD u_vspd 0 0 0.0 511.9921875 ECU_ADDRESS 0x4000DA4E /end MEASUREMENT
/begin MEASUREMENT sys_brk_lamp_dprsd "break lamp depressed" UBYTE b_true 0 0 0.00 1.00 ECU_ADDRESS 0x40004EA0 FORMAT "%1.0" /end MEASUREMENT
/begin MEASUREMENT sys_brk_sw_dprsd "break switch depressed" UBYTE b_true 0 0 0.00 1.00 ECU_ADDRESS 0x40004EA0 FORMAT "%1.0" /end MEASUREMENT
/begin MEASUREMENT sys_egr_vlt_pct_raw "egr position voltage percentage" UWORD u_pct 0 0 0.0 199.996948242187 ECU_ADDRESS 0x4000DA4E /end MEASUREMENT
/begin MEASUREMENT sys_vgis_mode "VIGS mode,If either sys_vgis1_stat or sys_vgis2_stat is TRUE, then sys_vgis_mode is TRUE. If both sys_vgis1_stat and sys_vgis2_stat are FALSE, then sys_vgis_mode is FALSE." UBYTE b_true 0 0 0.00 1.00 BIT_MASK 0x1 ECU_ADDRESS 0x40004CFC FORMAT "%1.0" /end MEASUREMENT
/begin MEASUREMENT sys_vgis1_stat "Indicating that the VGIS1 is enabled, regardless the solenoid configuration" UBYTE b_true 0 0 0.00 1.00 BIT_MASK 0x1 ECU_ADDRESS 0x40004CFA FORMAT "%1.0" /end MEASUREMENT
/begin MEASUREMENT sys_vgis2_stat "Indicating that the VGIS2 is enabled, regardless the solenoid configuration" UBYTE b_true 0 0 0.00 1.00 BIT_MASK 0x1 ECU_ADDRESS 0x40004CFA FORMAT "%1.0" /end MEASUREMENT
/begin MEASUREMENT sys_vgis1_area "VGIS1 area index" UBYTE u_vgis_area 0 0 0.00 6.00 ECU_ADDRESS 0x40004DC9 FORMAT "%1.0" /end MEASUREMENT
/begin MEASUREMENT sys_vgis2_area "VGIS2 area index" UBYTE u_vgis_area 0 0 0.00 6.00 ECU_ADDRESS 0x40004DC9 FORMAT "%1.0" /end MEASUREMENT
/begin MEASUREMENT sys_vgis1_moved "Flag indicate that VIGS1 has moved this trip" UBYTE b_true 0 0 0.00 1.00 BIT_MASK 0x1 ECU_ADDRESS 0x40004CFC FORMAT "%1.0" /end MEASUREMENT
/begin MEASUREMENT sys_vgis2_moved "Flag indicate that VIGS2 has moved this trip" UBYTE b_true 0 0 0.00 1.00 BIT_MASK 0x1 ECU_ADDRESS 0x40004CFC FORMAT "%1.0" /end MEASUREMENT
/begin MEASUREMENT sys_vgis1_hold_cnts "This counter increases when VGIS1 was not actived this trip" UBYTE u_cnts 0 0 0.00 255.00 ECU_ADDRESS 0x4000549A /end MEASUREMENT
/begin MEASUREMENT sys_vgis2_hold_cnts "This counter increases when VGIS2 was not actived this trip" UBYTE u_cnts 0 0 0.00 255.00 ECU_ADDRESS 0x4000549A /end MEASUREMENT
/begin MEASUREMENT sys_flv_mmv "fuel level mmv" UWORD u_pct_1 0 0 0.0 99.9984741210937 ECU_ADDRESS 0x4000DA4E FORMAT "%4.2" /end MEASUREMENT
/begin MEASUREMENT sys_flv_mmv_dly "fuel level mmv delay" UWORD u_16x_tmr 0 0 0.00 8191.875 ECU_ADDRESS 0x400050DA SYMBOL_LINK "sys_flv_tmr" 6 /end MEASUREMENT
/begin MEASUREMENT sys_refuel_strt_dly "refuel start delay" UWORD u_16x_tmr 0 0 0.00 8191.875 ECU_ADDRESS 0x400050DA SYMBOL_LINK "sys_flv_tmr" 4 /end MEASUREMENT
/begin MEASUREMENT sys_refuel_run_dly "refuel run check delay" UWORD u_16x_tmr 0 0 0.00 8191.875 ECU_ADDRESS 0x400050DA SYMBOL_LINK "sys_flv_tmr" 2 /end MEASUREMENT
/begin MEASUREMENT sys_refuel_det_dly "fuel level mmv delay" UWORD u_16x_tmr 0 0 0.00 8191.875 ECU_ADDRESS 0x400050DA SYMBOL_LINK "sys_flv_tmr" 2 /end MEASUREMENT
/begin MEASUREMENT sys_refuel_flv_dlt "refuel detection fuel level delta" UWORD u_pct_1 0 0 0.0 99.9984741210937 ECU_ADDRESS 0x4000DA4E FORMAT "%4.2" /end MEASUREMENT
/begin MEASUREMENT sys_flv_lst_trip "fuel level last trip" UWORD u_pct_1 0 0 0.0 99.9984741210937 ECU_ADDRESS 0x4000DA4E FORMAT "%4.2" /end MEASUREMENT
/begin MEASUREMENT sys_refuel_met "refuel detect condtions met" UBYTE b_true 0 0 0.00 1.00 BIT_MASK 0x1 ECU_ADDRESS 0x40004CFC FORMAT "%1.0" /end MEASUREMENT
/begin MEASUREMENT sys_refuel_min_flv "refuel detection fuel level min" UWORD u_pct_1 0 0 0.0 99.9984741210937 ECU_ADDRESS 0x4000DA4E FORMAT "%4.2" /end MEASUREMENT
/begin MEASUREMENT sys_cru_an_invld "cruise analog invalid" UBYTE b_true 0 0 0.00 1.00 BIT_MASK 0x1 ECU_ADDRESS 0x40004CFC FORMAT "%1.0" /end MEASUREMENT
/begin MEASUREMENT sys_cru_onoff_raw "cruise onoff switch raw state" UBYTE b_true 0 0 0.00 1.00 BIT_MASK 0x1 ECU_ADDRESS 0x40004CFC FORMAT "%1.0" /end MEASUREMENT
/begin MEASUREMENT sys_cru_cancl_raw "cruise cancel switch raw state" UBYTE b_true 0 0 0.00 1.00 BIT_MASK 0x1 ECU_ADDRESS 0x40004CFC FORMAT "%1.0" /end MEASUREMENT
/begin MEASUREMENT sys_cru_res_raw "cruise resume switch raw state" UBYTE b_true 0 0 0.00 1.00 BIT_MASK 0x1 ECU_ADDRESS 0x40004CFC FORMAT "%1.0" /end MEASUREMENT
/begin MEASUREMENT sys_cru_set_raw "cruise set switch raw state" UBYTE b_true 0 0 0.00 1.00 BIT_MASK 0x1 ECU_ADDRESS 0x40004CFC FORMAT "%1.0" /end MEASUREMENT
/begin MEASUREMENT sys_cru_dis_raw "cruise distance switch raw state" UBYTE b_true 0 0 0.00 1.00 BIT_MASK 0x1 ECU_ADDRESS 0x40004CFC FORMAT "%1.0" /end MEASUREMENT
/begin MEASUREMENT sys_cru_vsl_raw "cruise vehicle speed limit switch raw state" UBYTE b_true 0 0 0.00 1.00 BIT_MASK 0x1 ECU_ADDRESS 0x40004CFC FORMAT "%1.0" /end MEASUREMENT
/begin MEASUREMENT sys_cru_onoff_actv "cruise onoff switch active" UBYTE b_true 0 0 0.00 1.00 BIT_MASK 0x1 ECU_ADDRESS 0x40004CFC FORMAT "%1.0" /end MEASUREMENT
/begin MEASUREMENT sys_cru_cancl_actv "cruise cancel switch active" UBYTE b_true 0 0 0.00 1.00 BIT_MASK 0x1 ECU_ADDRESS 0x40004CFC FORMAT "%1.0" /end MEASUREMENT
/begin MEASUREMENT sys_cru_res_actv "cruise resume switch active" UBYTE b_true 0 0 0.00 1.00 BIT_MASK 0x1 ECU_ADDRESS 0x40004CFC FORMAT "%1.0" /end MEASUREMENT
/begin MEASUREMENT sys_cru_set_actv "cruise set switch active" UBYTE b_true 0 0 0.00 1.00 BIT_MASK 0x1 ECU_ADDRESS 0x40004CFC FORMAT "%1.0" /end MEASUREMENT
/begin MEASUREMENT sys_cru_dis_actv "cruise distance switch active" UBYTE b_true 0 0 0.00 1.00 BIT_MASK 0x1 ECU_ADDRESS 0x40004CFC FORMAT "%1.0" /end MEASUREMENT
/begin MEASUREMENT sys_cru_vsl_actv "cruise vehicle speed limit switch active" UBYTE b_true 0 0 0.00 1.00 BIT_MASK 0x1 ECU_ADDRESS 0x40004CFC FORMAT "%1.0" /end MEASUREMENT
/begin MEASUREMENT sys_trip_fc "trip fuel consumption" ULONG u_fc 0 0 0 67108863.984375 ECU_ADDRESS 0x40005536 /end MEASUREMENT
/begin MEASUREMENT sys_lock_odo "locked odometer" UWORD u_km 0 0 0.0 65535 ECU_ADDRESS 0x4000DA4E /end MEASUREMENT
/*-----------GPF IO------------------*/
/begin CHARACTERISTIC F_V_FMSP_EN "force fuel control enable" VALUE 0x0002038C __UBYTE_S 0 b_enable 0 1 FORMAT "%5.2" /end CHARACTERISTIC
/begin CHARACTERISTIC F_V_AF_EN "force fuel afr control enable" VALUE 0x0002038C __UBYTE_S 0 b_enable 0 1 FORMAT "%5.2" SYMBOL_LINK "F_V_AF_EN" 6 /end CHARACTERISTIC
/begin CHARACTERISTIC F_V_AF "force fuel afr value" VALUE 0x0002038C __UWORD_S 0 u_afr 0 31.99951171875 SYMBOL_LINK "F_V_AF" 8 /end CHARACTERISTIC
/begin CHARACTERISTIC F_V_IG_EN "force ignition control enable" VALUE 0x0002038C __UBYTE_S 0 b_enable 0 1 FORMAT "%5.2" /end CHARACTERISTIC
/begin CHARACTERISTIC F_V_IG_TD_EN "force ignition dwell time enable" VALUE 0x0002038C __UBYTE_S 0 b_enable 0 1 FORMAT "%5.2" SYMBOL_LINK "F_V_IG_TD_EN" 1 /end CHARACTERISTIC
/begin CHARACTERISTIC F_V_IG_TD "force ignition dwell time value" VALUE 0x0002038C __UWORD_S 0 u_millisec 0 1023.984375 FORMAT "%5.1" SYMBOL_LINK "F_V_IG_TD" 2 /end CHARACTERISTIC
/begin CHARACTERISTIC F_V_IGA_EN "force ignition control enable" VALUE 0x0002038C __UBYTE_S 0 b_enable 0 1 FORMAT "%5.2" SYMBOL_LINK "F_V_IGA_EN" 6 /end CHARACTERISTIC
/begin CHARACTERISTIC F_V_IGA "force ignition control value" VALUE 0x0002038C __SWORD_S 0 u_iga -256 255.9921875 SYMBOL_LINK "F_V_IGA" 8 /end CHARACTERISTIC
/begin CHARACTERISTIC F_C_IGA_CYL_EN "force ignition cylinder enable" VAL_BLK 0x0002038C __UBYTE_S 0 b_enable 0 1 FORMAT "%5.2" NUMBER 4 SYMBOL_LINK "F_C_IGA_CYL_EN" 10 /end CHARACTERISTIC
/begin CHARACTERISTIC F_V_IGA_CYL "force ignition cylinder value" VALUE 0x0002038C __SWORD_S 0 u_iga -256 255.9921875 SYMBOL_LINK "F_V_IGA_CYL" 14 /end CHARACTERISTIC
/begin CHARACTERISTIC F_V_VE_EN "force ve enable" VALUE 0x0002038C __UBYTE_S 0 b_enable 0 1 FORMAT "%5.2" /end CHARACTERISTIC
/begin CHARACTERISTIC F_V_VE_ACTV "force ve enable" VALUE 0x0002038C __UBYTE_S 0 b_enable 0 1 FORMAT "%5.2" SYMBOL_LINK "F_V_VE_ACTV" 1 /end CHARACTERISTIC
/begin CHARACTERISTIC F_V_VE "force ve value" VALUE 0x0002038C __UWORD_S 0 u_pct 0 199.99694824219 FORMAT "%3.1" SYMBOL_LINK "F_V_VE" 2 /end CHARACTERISTIC
/begin CHARACTERISTIC F_V_CP_EN "force purge enable" VALUE 0x0002038C __UBYTE_S 0 b_enable 0 1 FORMAT "%5.2" /end CHARACTERISTIC
/begin CHARACTERISTIC F_V_CP_DIAG_ACTV "force purge diag active" VALUE 0x0002038C __UBYTE_S 0 b_enable 0 1 FORMAT "%5.2" SYMBOL_LINK "F_V_CP_DIAG_ACTV" 1 /end CHARACTERISTIC
/begin CHARACTERISTIC F_V_CP_DIAG_OFF "force purge diag active" VALUE 0x0002038C __UBYTE_S 0 b_enable 0 1 FORMAT "%5.2" SYMBOL_LINK "F_V_CP_DIAG_OFF" 2 /end CHARACTERISTIC
/begin CHARACTERISTIC F_V_CP_PWM_ACTV "force purge diag active" VALUE 0x0002038C __UBYTE_S 0 b_enable 0 1 FORMAT "%5.2" SYMBOL_LINK "F_V_CP_PWM_ACTV" 3 /end CHARACTERISTIC
/begin CHARACTERISTIC F_V_CP_PWM "force ve value" VALUE 0x0002038C __UWORD_S 0 u_pct 0 199.99694824219 FORMAT "%3.1" SYMBOL_LINK "F_V_CP_PWM" 4 /end CHARACTERISTIC
/begin CHARACTERISTIC F_V_CP_FUEL_ACTV "force purge diag active" VALUE 0x0002038C __UBYTE_S 0 b_enable 0 1 FORMAT "%5.2" SYMBOL_LINK "F_V_CP_FUEL_ACTV" 6 /end CHARACTERISTIC
/begin CHARACTERISTIC F_V_CP_FUEL "force ve value" VALUE 0x0002038C __UWORD_S 0 u_pct 0 199.99694824219 FORMAT "%3.1" SYMBOL_LINK "F_V_CP_FUEL" 8 /end CHARACTERISTIC
/begin CHARACTERISTIC F_V_VVT_INTK_EN "force vvt intake sp enable" VALUE 0x0002038C __UBYTE_S 0 b_enable 0 1 FORMAT "%5.2" /end CHARACTERISTIC
/begin CHARACTERISTIC F_V_VVT_INTK "force vvt intk sp value" VALUE 0x0002038C __SWORD_S 0 u_iga -256 255.9921875 FORMAT "%4.1" SYMBOL_LINK "F_V_VVT_INTK" 2 /end CHARACTERISTIC
/begin CHARACTERISTIC F_V_VVT_EXH_EN "force vvt exhaust sp enable" VALUE 0x0002038C __UBYTE_S 0 b_enable 0 1 FORMAT "%5.2" /end CHARACTERISTIC
/begin CHARACTERISTIC F_V_VVT_EXH "force vvt exhaust sp value" VALUE 0x0002038C __SWORD_S 0 u_iga -256 255.9921875 FORMAT "%4.1" SYMBOL_LINK "F_V_VVT_EXH" 2 /end CHARACTERISTIC
/begin CHARACTERISTIC F_V_INTK_VVT_DC_EN "force vvt control dc enable" VALUE 0x0002038C __UBYTE_S 0 b_enable 0 1 FORMAT "%5.2" /end CHARACTERISTIC
/begin CHARACTERISTIC F_V_INTK_VVT_DC "force vvt intk dc value" VALUE 0x0002038C __SWORD_S 0 u_pct_s -200 199.993896484375 FORMAT "%4.1" SYMBOL_LINK "F_V_INTK_VVT_DC" 2 /end CHARACTERISTIC
/begin CHARACTERISTIC F_V_INTK_EXH_DC_EN "force vvt control dc enable" VALUE 0x0002038C __UBYTE_S 0 b_enable 0 1 FORMAT "%5.2" /end CHARACTERISTIC
/begin CHARACTERISTIC F_V_INTK_EXH_DC "force vvt intk dc value" VALUE 0x0002038C __SWORD_S 0 u_pct_s -200 199.993896484375 FORMAT "%4.1" SYMBOL_LINK "F_V_INTK_EXH_DC" 2 /end CHARACTERISTIC
/begin CHARACTERISTIC F_V_EGR_EN "force egr position setpoint enable" VALUE 0x0002038C __UBYTE_S 0 b_enable 0 1 FORMAT "%5.2" /end CHARACTERISTIC
/begin CHARACTERISTIC F_V_EGR_ACTV "force egr position setpoint active" VALUE 0x0002038C __UBYTE_S 0 b_enable 0 1 FORMAT "%5.2" SYMBOL_LINK "F_V_EGR_ACTV" 1 /end CHARACTERISTIC
/begin CHARACTERISTIC F_V_EGR_POS "force egr position setpoint value" VALUE 0x0002038C __UWORD_S 0 u_pct 0 199.99694824219 FORMAT "%3.1" SYMBOL_LINK "F_V_EGR_POS" 2 /end CHARACTERISTIC
/begin CHARACTERISTIC F_V_CLR_NV "clear nv" VALUE 0x0002038C __UBYTE_S 0 b_enable 0 1 FORMAT "%1.0" /end CHARACTERISTIC
/begin CHARACTERISTIC F_V_TB_ACTV "force turbo active." VALUE 0x0002038C __UBYTE_S 0 b_true 0 1 FORMAT "%5.2" SYMBOL_LINK "F_V_TB" 0 /end CHARACTERISTIC
/begin CHARACTERISTIC F_V_TB_ST "force turbo state." VALUE 0x0002038C __UBYTE_S 0 b_tb_st 0 3 FORMAT "%5.2" SYMBOL_LINK "F_V_TB" 1 /end CHARACTERISTIC
/begin CHARACTERISTIC F_V_TB_AB_SP "force turbo absolute setpoint." VALUE 0x0002038C __UWORD_S 0 u_pct_dc 0 199.996948 SYMBOL_LINK "F_V_TB" 2 /end CHARACTERISTIC
/begin CHARACTERISTIC F_V_TB_MOD_SP "force turbo modified setpoint." VALUE 0x0002038C __SWORD_S 0 u_pct_dc -100 99.996948 SYMBOL_LINK "F_V_TB" 4 /end CHARACTERISTIC
/begin CHARACTERISTIC F_V_TEL_EOL "force end of line tooth learn active" VALUE 0x0002038C __UBYTE_S 0 b_enable 0 1 FORMAT "%5.2" /end CHARACTERISTIC
/begin CHARACTERISTIC F_V_TEL_RST "force tooth learn rest at power up" VALUE 0x0002038C __UBYTE_S 0 b_enable 0 1 FORMAT "%5.2" /end CHARACTERISTIC
/begin CHARACTERISTIC INFO_C_CAL_ID "CAL ID used by J1979" VAL_BLK 0x000200B0 __UBYTE_S 0 u_cnts 0 255 NUMBER 16 /end CHARACTERISTIC
/begin CHARACTERISTIC INFO_V_CAL_RR_ID "CAL risk realse ID" VAL_BLK 0x000200B0 __UBYTE_S 0 u_cnts 0 255 NUMBER 8 /end CHARACTERISTIC
/begin CHARACTERISTIC INFO_V_HW_VER "ECU hardware version" VAL_BLK 0x000200B0 __UBYTE_S 0 u_cnts 0 255 NUMBER 4 /end CHARACTERISTIC
/begin CHARACTERISTIC HW_V_AMP_SNSR_CFG "ambient pressure sensor config" VALUE 0x0002038C __UBYTE_S 0 b_avail 0 1 FORMAT "%5.2" /end CHARACTERISTIC
/begin CHARACTERISTIC HW_V_TANK_P_SNSR_CFG "tank pressure sensor config" VALUE 0x0002038C __UBYTE_S 0 b_avail 0 1 FORMAT "%5.2" /end CHARACTERISTIC
/begin CHARACTERISTIC HW_V_VVT_CFG "vvt config" VALUE 0x0002038C __UBYTE_S 0 b_avail 0 1 FORMAT "%5.2" /end CHARACTERISTIC
/begin CHARACTERISTIC HW_V_O2_PMP_CFG "O2 pumping current configuration" VALUE 0x0002038C __UBYTE_S 0 b_enable 0 1 FORMAT "%5.2" /end CHARACTERISTIC
/begin CHARACTERISTIC HW_V_RO2_PMP_CFG "Rear O2 pumping current configuration" VALUE 0x0002038C __UBYTE_S 0 b_enable 0 1 FORMAT "%5.2" /end CHARACTERISTIC
/begin CHARACTERISTIC HW_V_CAM_EDGE_CFG "vvt cam pulse edge config" VALUE 0x0002038C __UBYTE_S 0 b_rising 0 1 FORMAT "%5.2" /end CHARACTERISTIC
/begin CHARACTERISTIC HW_V_CAM_PULS_CNTS "cam pulse edge counts" VALUE 0x0002038C __UBYTE_S 0 u_cnts 0 255 /end CHARACTERISTIC
/begin CHARACTERISTIC HW_V_PPS_CFG "pedal position config" VALUE 0x0002038C __UBYTE_S 0 b_pps 0 1 FORMAT "%5.2" /end CHARACTERISTIC
/begin CHARACTERISTIC HW_V_O2_HT_CFG "O2 heater config" VALUE 0x0002038C __UBYTE_S 0 u_ht_cfg 0 4 FORMAT "%5.2" /end CHARACTERISTIC
/begin CHARACTERISTIC HW_V_FUEL_RAIL_CFG "fuel rail config" VALUE 0x0002038C __UBYTE_S 0 b_f_rail 0 1 FORMAT "%5.2" /end CHARACTERISTIC
/begin CHARACTERISTIC HW_V_ECO_REQ_CFG "eco mode request config" VALUE 0x0002038C __UBYTE_S 0 b_eco_cfg 0 3 FORMAT "%3.0" /end CHARACTERISTIC
/begin CHARACTERISTIC HW_V_OBD_TYP "OBD type" VALUE 0x0002038C __UBYTE_S 0 u_obd_typ 0 255 FORMAT "%3.0" /end CHARACTERISTIC
/begin CHARACTERISTIC HW_V_LIN_TYP "LIN type" VALUE 0x0002038C __UBYTE_S 0 u_lin_typ 0 255 FORMAT "%3.0" /end CHARACTERISTIC
/begin CHARACTERISTIC HW_C_RTNLESS_INJ_FLW "injector flow" CURVE 0x000200B0 __UWORD_S 0 u_g_per_sec_64 0 63.9990234375 FORMAT "%5.3" SYMBOL_LINK "HW_C_RTNLESS_INJ_FLW" 2
 /begin AXIS_DESCR COM_AXIS NO_INPUT_QUANTITY u_kPa_1024n_1024p 17 -1024 1023.96875 AXIS_PTS_REF HW_X_IM_VAC_A /end AXIS_DESCR
/end CHARACTERISTIC
/begin AXIS_PTS HW_X_IM_VAC_A "intake manifold vacumm" 0x0002006C NO_INPUT_QUANTITY SSV__SWORD_S 0 u_kPa_1024n_1024p 17 -1024 1023.96875 FORMAT "%5.1" DEPOSIT ABSOLUTE SYMBOL_LINK "HW_X_IM_VAC_A" 2 /end AXIS_PTS
/begin CHARACTERISTIC HW_V_RECIRCU_INJ_FLW "injector flow" VALUE 0x0002038C __UWORD_S 0 u_g_per_sec_64 0 63.9990234375 FORMAT "%5.3" /end CHARACTERISTIC
/begin CHARACTERISTIC HW_C_RECIRCU_INJ_BIAS "injector open time" CURVE 0x000200B0 __UWORD_S 0 u_millisec 0 1023.984375 SYMBOL_LINK "HW_C_RECIRCU_INJ_BIAS" 2
 /begin AXIS_DESCR FIX_AXIS hw_bat_vlt u_volt_32 17 0 26
  /begin FIX_AXIS_PAR_LIST 0 3276 6553 9830 13107 16384 19660 22937 26214 29491 32768 36044 39321 42598 45875 49152 52428 /end FIX_AXIS_PAR_LIST
 /end AXIS_DESCR
/end CHARACTERISTIC
/begin CHARACTERISTIC HW_M_RTNLESS_INJ_BIAS "injector open time" MAP 0x000200B0 __UWORD_S 0 u_millisec 0 1023.984375 SYMBOL_LINK "HW_M_RTNLESS_INJ_BIAS" 4
 /begin AXIS_DESCR FIX_AXIS hw_bat_vlt u_volt_32 17 0 25.6
  /begin FIX_AXIS_PAR_LIST 0 3276 6553 9830 13107 16384 19660 22937 26214 29491 32768 36044 39321 42598 45875 49152 52428 /end FIX_AXIS_PAR_LIST
 /end AXIS_DESCR
 /begin AXIS_DESCR COM_AXIS NO_INPUT_QUANTITY u_kPa_1024n_1024p 11 -1024.000000 1023.968750 AXIS_PTS_REF HW_X_IM_VAC_B /end AXIS_DESCR
/end CHARACTERISTIC
/begin AXIS_PTS HW_X_IM_VAC_B "intake manifold vacumm" 0x0002006C NO_INPUT_QUANTITY SSV__SWORD_S 0 u_kPa_1024n_1024p 11 -1024 1023.96875 FORMAT "%5.1" DEPOSIT ABSOLUTE SYMBOL_LINK "HW_X_IM_VAC_B" 2 /end AXIS_PTS
/begin CHARACTERISTIC HW_V_UO2_HT_CURNT_FAC "upstream O2 heater current scaler" VALUE 0x0002038C __UWORD_S 0 u_fac_128 0 127.998046875 /end CHARACTERISTIC
/begin CHARACTERISTIC HW_V_DO2_HT_CURNT_FAC "upstream O2 heater current scaler" VALUE 0x0002038C __UWORD_S 0 u_fac_128 0 127.998046875 /end CHARACTERISTIC
/begin CHARACTERISTIC HW_V_INJ_SCH_ANGL "fuel injection schedule angle relative to segment event" VALUE 0x0002038C __UWORD_S 0 u_crk_ang 0 1023.984375 /end CHARACTERISTIC
/begin CHARACTERISTIC HW_C_EOI_ST_PRE "end of injection angle,engine start" CURVE 0x000200B0 __UWORD_S 0 u_crk_ang 0.0 1023.984375 SYMBOL_LINK "HW_C_EOI_ST_PRE" 2
 /begin AXIS_DESCR FIX_AXIS sys_ect u_deg_C 9 -40 152 /begin FIX_AXIS_PAR_LIST -5120 -2048 1024 4096 7168 10240 13312 16384 19456 /end FIX_AXIS_PAR_LIST /end AXIS_DESCR
/end CHARACTERISTIC
/begin CHARACTERISTIC HW_C_EOI_ST_MN "end of injection angle,engine start" CURVE 0x000200B0 __UWORD_S 0 u_crk_ang 0.0 1023.984375 SYMBOL_LINK "HW_C_EOI_ST_MN" 2
 /begin AXIS_DESCR FIX_AXIS sys_ect u_deg_C 9 -40 152 /begin FIX_AXIS_PAR_LIST -5120 -2048 1024 4096 7168 10240 13312 16384 19456 /end FIX_AXIS_PAR_LIST /end AXIS_DESCR
/end CHARACTERISTIC
/begin CHARACTERISTIC HW_C_EOI_RUN_PRE_ECT "end of injection angle,engine run" CURVE 0x000200B0 __SWORD_S 0 u_crk_ang -512 511.984375 SYMBOL_LINK "HW_C_EOI_RUN_PRE_ECT" 2
 /begin AXIS_DESCR FIX_AXIS sys_ect u_deg_C 9 -40 152 /begin FIX_AXIS_PAR_LIST -5120 -2048 1024 4096 7168 10240 13312 16384 19456 /end FIX_AXIS_PAR_LIST /end AXIS_DESCR
/end CHARACTERISTIC
/begin CHARACTERISTIC HW_C_EOI_RUN_MN_ECT "end of injection angle,engine run" CURVE 0x000200B0 __UWORD_S 0 u_crk_ang 0.0 1023.984375 SYMBOL_LINK "HW_C_EOI_RUN_MN_ECT" 2
 /begin AXIS_DESCR FIX_AXIS sys_ect u_deg_C 9 -40 152 /begin FIX_AXIS_PAR_LIST -5120 -2048 1024 4096 7168 10240 13312 16384 19456 /end FIX_AXIS_PAR_LIST /end AXIS_DESCR
/end CHARACTERISTIC
/begin CHARACTERISTIC HW_C_EOI_POST "end of injection angle,engine run" CURVE 0x000200B0 __UWORD_S 0 u_crk_ang 0.0 1023.984375 SYMBOL_LINK "HW_C_EOI_POST" 2
 /begin AXIS_DESCR FIX_AXIS sys_ect u_deg_C 9 -40 152 /begin FIX_AXIS_PAR_LIST -5120 -2048 1024 4096 7168 10240 13312 16384 19456 /end FIX_AXIS_PAR_LIST /end AXIS_DESCR
/end CHARACTERISTIC
/begin CHARACTERISTIC HW_M_EOI_RUN_PRE "end of injection angle based on engine speed and imep" MAP 0x00020320 __UWORD_S 0 u_crk_ang 0.0 1023.984375 SYMBOL_LINK "HW_M_EOI_RUN_PRE" 4
 /begin AXIS_DESCR COM_AXIS sys_eng_spd u_espd 15 0 8191.875 FORMAT "%6.2" AXIS_PTS_REF HW_X_ESPD_A /end AXIS_DESCR
 /begin AXIS_DESCR COM_AXIS tq_imep_ref u_kPa_0_4096 25 0.000000 4095.937500 AXIS_PTS_REF HW_X_IMEP_A /end AXIS_DESCR
/end CHARACTERISTIC
/begin CHARACTERISTIC HW_M_EOI_RUN_MN "end of injection angle based on engine speed and imep" MAP 0x00020320 __UWORD_S 0 u_crk_ang 0.0 1023.984375 SYMBOL_LINK "HW_M_EOI_RUN_MN" 4
 /begin AXIS_DESCR COM_AXIS sys_eng_spd u_espd 15 0 8191.875 FORMAT "%6.2" AXIS_PTS_REF HW_X_ESPD_A /end AXIS_DESCR
 /begin AXIS_DESCR COM_AXIS tq_imep_ref u_kPa_0_4096 25 0.000000 4095.937500 AXIS_PTS_REF HW_X_IMEP_A /end AXIS_DESCR
/end CHARACTERISTIC
/begin CHARACTERISTIC HW_M_EOI_RUN_PRE_VVT "end of injection angle based on engine speed and imep" MAP 0x00020320 __UWORD_S 0 u_crk_ang 0.0 1023.984375 SYMBOL_LINK "HW_M_EOI_RUN_PRE_VVT" 4
 /begin AXIS_DESCR COM_AXIS sys_eng_spd u_espd 15 0 8191.875 FORMAT "%6.2" AXIS_PTS_REF HW_X_ESPD_A /end AXIS_DESCR
 /begin AXIS_DESCR COM_AXIS tq_imep_ref u_kPa_0_4096 25 0.000000 4095.937500 AXIS_PTS_REF HW_X_IMEP_A /end AXIS_DESCR
/end CHARACTERISTIC
/begin CHARACTERISTIC HW_M_EOI_RUN_MN_VVT "end of injection angle based on engine speed and imep" MAP 0x00020320 __UWORD_S 0 u_crk_ang 0.0 1023.984375 SYMBOL_LINK "HW_M_EOI_RUN_MN_VVT" 4
 /begin AXIS_DESCR COM_AXIS sys_eng_spd u_espd 15 0 8191.875 FORMAT "%6.2" AXIS_PTS_REF HW_X_ESPD_A /end AXIS_DESCR
 /begin AXIS_DESCR COM_AXIS tq_imep_ref u_kPa_0_4096 25 0.000000 4095.937500 AXIS_PTS_REF HW_X_IMEP_A /end AXIS_DESCR
/end CHARACTERISTIC
/begin CHARACTERISTIC HW_V_EOI_VVT_FAC "factor of end of injection angle,mult at intk vvt position" VALUE 0x0002038C __UWORD_S 0 u_fac_2 0 1.999969482421875 FORMAT "%4.3" /end CHARACTERISTIC
/begin AXIS_PTS HW_X_ESPD_A "engine speed axis " 0x0002006C sys_eng_spd SSV__UWORD_S 0 u_espd 15 0 8191.875 FORMAT "%6.2" DEPOSIT ABSOLUTE SYMBOL_LINK "HW_X_ESPD_A" 2 /end AXIS_PTS
/begin AXIS_PTS HW_X_IMEP_A "ECT axis when temp hi" 0x0002006C tq_imep_ref SSV__UWORD_S 0 u_kPa_0_4096 25 0 4095.937500 DEPOSIT ABSOLUTE SYMBOL_LINK "HW_X_IMEP_A" 2 /end AXIS_PTS
/begin CHARACTERISTIC HW_C_EOI_POW_HI_SPD_BIAS "end of injection angle,power bias add on base" CURVE 0x000200B0 __UWORD_S 0 u_crk_ang 0.0 1023.984375 SYMBOL_LINK "HW_C_EOI_POW_HI_SPD_BIAS" 2
 /begin AXIS_DESCR FIX_AXIS sys_ect u_deg_C 10 -40 140 /begin FIX_AXIS_PAR_LIST -5120 -2560 0 2560 5120 7680 10240 12800 15360 17920 /end FIX_AXIS_PAR_LIST /end AXIS_DESCR
/end CHARACTERISTIC
/begin CHARACTERISTIC HW_C_EOI_POW_LO_SPD_BIAS "end of injection angle,power bias add on base" CURVE 0x000200B0 __UWORD_S 0 u_crk_ang 0.0 1023.984375 SYMBOL_LINK "HW_C_EOI_POW_LO_SPD_BIAS" 2
 /begin AXIS_DESCR FIX_AXIS sys_ect u_deg_C 10 -40 140 /begin FIX_AXIS_PAR_LIST -5120 -2560 0 2560 5120 7680 10240 12800 15360 17920 /end FIX_AXIS_PAR_LIST /end AXIS_DESCR
/end CHARACTERISTIC
/begin CHARACTERISTIC HW_V_SEG_ANG_TO_TDC "segment event angle before TDC" VALUE 0x0002038C __UWORD_S 0 u_crk_ang 0 1023.984375 /end CHARACTERISTIC
/begin CHARACTERISTIC HW_V_CAM_EVENT_ANG "segment event angle before TDC" VALUE 0x0002038C __UWORD_S 0 u_crk_ang 0 1023.984375 /end CHARACTERISTIC
/begin CHARACTERISTIC HW_V_SEG_TOOTH "segment event tooth num" VALUE 0x0002038C __UBYTE_S 0 u_cnts 0 58 FORMAT "%5.0" /end CHARACTERISTIC
/begin CHARACTERISTIC HW_V_1ST_CYL_CAM1_CFG "first cyl cam1 state config" VALUE 0x0002038C __UBYTE_S 0 b_true 0 1 FORMAT "%5.2" /end CHARACTERISTIC
/begin CHARACTERISTIC HW_V_1ST_CYL_CAM2_CFG "first cyl cam2 state config" VALUE 0x0002038C __UBYTE_S 0 b_true 0 1 FORMAT "%5.2" /end CHARACTERISTIC
/begin CHARACTERISTIC HW_V_EGR_CFG "EGR hardware configuration" VALUE 0x0002038C __UBYTE_S 0 b_egr_cfg 0 2 FORMAT "%5.2" /end CHARACTERISTIC
/begin CHARACTERISTIC HW_V_EGR_SYS_CFG "EGR system hardware configuration" VALUE 0x0002038C __UBYTE_S 0 b_egr_inst_cfg 0 3 FORMAT "%5.2" /end CHARACTERISTIC
/begin CHARACTERISTIC HW_V_EOI_POW_ESPD_HI "power eoi hi/lo engine speed thr" VALUE 0x0002038C __UWORD_S 0 u_espd 0 8191.875 FORMAT "%5.1" /end CHARACTERISTIC
/begin CHARACTERISTIC HW_V_EOI_POW_ESPD_LO "power eoi hi/lo engine speed thr" VALUE 0x0002038C __UWORD_S 0 u_espd 0 8191.875 FORMAT "%5.1" /end CHARACTERISTIC
/begin CHARACTERISTIC HW_V_FAN_PWM_FREQ "fan pwm freqency" VALUE 0x0002038C __UWORD_S 0 u_freq 0 16383.75 FORMAT "%7.2" /end CHARACTERISTIC
/begin CHARACTERISTIC HW_V_FAN_PWM_POL "fan pwm polarity" VALUE 0x0002038C __UBYTE_S 0 b_true 0 1 FORMAT "%5.2" /end CHARACTERISTIC
/begin CHARACTERISTIC HW_V_AC_P_SNSR_TYP "ac press sensor type" VALUE 0x0002038C __UBYTE_S 0 b_ac_p_typ 0 1 FORMAT "%1.0" /end CHARACTERISTIC
/begin CHARACTERISTIC HW_V_AC_INST "ac hardware install" VALUE 0x0002038C __UBYTE_S 0 b_true 0 1 FORMAT "%1.0" SYMBOL_LINK "HW_V_AC_CFG" 0 BIT_MASK 0x80 /end CHARACTERISTIC
/begin CHARACTERISTIC HW_V_ACREQ_CAN "ac request from can" VALUE 0x0002038C __UBYTE_S 0 b_true 0 1 FORMAT "%1.0" SYMBOL_LINK "HW_V_AC_CFG" 0 BIT_MASK 0x40 /end CHARACTERISTIC
/begin CHARACTERISTIC HW_V_AC_P_CAN "ac press from can" VALUE 0x0002038C __UBYTE_S 0 b_true 0 1 FORMAT "%1.0" SYMBOL_LINK "HW_V_AC_CFG" 0 BIT_MASK 0x10 /end CHARACTERISTIC
/begin CHARACTERISTIC HW_V_AC_CLTCH_CAN "ac clucth control by can" VALUE 0x0002038C __UBYTE_S 0 b_true 0 1 FORMAT "%1.0" SYMBOL_LINK "HW_V_AC_CFG" 0 BIT_MASK 0x08 /end CHARACTERISTIC
/begin CHARACTERISTIC HW_V_AC_T_CAN "ac evap temp from can" VALUE 0x0002038C __UBYTE_S 0 b_true 0 1 FORMAT "%1.0" SYMBOL_LINK "HW_V_AC_CFG" 0 BIT_MASK 0x04 /end CHARACTERISTIC
/begin CHARACTERISTIC HW_V_AC_T_SNSR "ac evap temp from sensor" VALUE 0x0002038C __UBYTE_S 0 b_true 0 1 FORMAT "%1.0" SYMBOL_LINK "HW_V_AC_CFG" 0 BIT_MASK 0x02 /end CHARACTERISTIC
/begin CHARACTERISTIC HW_V_EGR_T_INST "egr valve out temp installed" VALUE 0x0002038C __UBYTE_S 0 b_true 0 1 FORMAT "%1.0" BIT_MASK 0x04 /end CHARACTERISTIC
/begin CHARACTERISTIC HW_V_CAN_ENG_RVS_EN "engine revers from can enable" VALUE 0x0002038C __UBYTE_S 0 b_true 0 1 FORMAT "%1.0" BIT_MASK 0x80 /end CHARACTERISTIC
/begin CHARACTERISTIC HW_V_FLV_CFG "fuel level sensor config" VALUE 0x0002038C __UBYTE_S 0 u_flv_cfg 0 2 FORMAT "%5.2" /end CHARACTERISTIC
/begin CHARACTERISTIC HW_V_ECT_OUT_EN "ect pwm out enable" VALUE 0x0002038C __UBYTE_S 0 b_true 0 1 FORMAT "%1.0" /end CHARACTERISTIC
/begin CHARACTERISTIC HW_V_BLWR_CFG "blower config" VALUE 0x0002038C __UBYTE_S 0 u_blwr_cfg 0 3 FORMAT "%1.0" /end CHARACTERISTIC
/begin CHARACTERISTIC HW_V_VSPD_CFG "vehicle speed input config" VALUE 0x0002038C __UBYTE_S 0 u_vspd_cfg 0 3 FORMAT "%1.0" /end CHARACTERISTIC
/begin CHARACTERISTIC HW_V_WSPD_CFG "wheel speed input config" VALUE 0x0002038C __UBYTE_S 0 u_wspd_cfg 0 4 FORMAT "%1.0" /end CHARACTERISTIC
/begin CHARACTERISTIC HW_V_WSPD_CAN_CFG "can wheel speed source config" VALUE 0x0002038C __UBYTE_S 0 u_wspd_can_cfg 0 4 FORMAT "%1.0" /end CHARACTERISTIC
/begin CHARACTERISTIC HW_V_SPRT_MODE_CFG "sport mode input config" VALUE 0x0002038C __UBYTE_S 0 u_sprt_cfg 0 2 FORMAT "%1.0" /end CHARACTERISTIC
/begin CHARACTERISTIC HW_V_SPRT_SWTH_TYP "sport mode switch type" VALUE 0x0002038C __UBYTE_S 0 u_sprt_sw_typ 0 2 FORMAT "%1.0" /end CHARACTERISTIC
/begin CHARACTERISTIC HW_V_ECM_CAL_ST "ecm is in calibration state" VALUE 0x0002038C __UBYTE_S 0 b_true 0 1 FORMAT "%1.0" /end CHARACTERISTIC
/begin CHARACTERISTIC HW_V_PS_SNSR_CFG "power steer sensor config" VALUE 0x0002038C __UBYTE_S 0 u_ps_snsr_cfg 0 4 FORMAT "%1.0" /end CHARACTERISTIC
/begin CHARACTERISTIC HW_V_PS_CAN_SWTCH "power steer switch from can" VALUE 0x0002038C __UBYTE_S 0 b_true 0 1 FORMAT "%1.0" BIT_MASK 0x04 /end CHARACTERISTIC
/begin CHARACTERISTIC HW_V_HD_LGHT_CFG "head light config" VALUE 0x0002038C __UBYTE_S 0 u_hd_lt_cfg 0 2 FORMAT "%1.0" /end CHARACTERISTIC
/begin CHARACTERISTIC HW_V_IAT_USE_BOOST_T "use boost temp for iat" VALUE 0x0002038C __UBYTE_S 0 b_true 0 1 FORMAT "%1.0" /end CHARACTERISTIC
/begin CHARACTERISTIC HW_V_WGV_FREQ "waste gate valve pwm freqency" VALUE 0x0002038C __UWORD_S 0 u_freq 0 16383.75 FORMAT "%7.2" /end CHARACTERISTIC
/begin CHARACTERISTIC HW_V_AC_HI_LO_SWCH_INST "ac press high low switch install" VALUE 0x0002038C __UBYTE_S 0 b_true 0 1 FORMAT "%1.0" /end CHARACTERISTIC
/begin CHARACTERISTIC HW_V_ALT_PWM_CFG "alter pwm input polarity" VALUE 0x0002038C __UBYTE_S 0 b_true 0 1 FORMAT "%1.0" /end CHARACTERISTIC
/begin CHARACTERISTIC HW_V_ALT_DTY_CFG "alter duty input config" VALUE 0x0002038C __UBYTE_S 0 u_alt_dty_cfg 0 2 FORMAT "%1.0" /end CHARACTERISTIC
/begin CHARACTERISTIC HW_V_TRANS_TYP "transmission type" VALUE 0x0002038C __UBYTE_S 0 u_trans_typ 0 5 FORMAT "%1.0" /end CHARACTERISTIC
/begin CHARACTERISTIC HW_V_NG_SWTCH_CFG "neutral gear switch config" VALUE 0x0002038C __UBYTE_S 0 u_ng_sw_cfg 0 4 FORMAT "%1.0" /end CHARACTERISTIC
/begin CHARACTERISTIC HW_V_NG_SWTCH_HI "neutral gear switch hi active" VALUE 0x0002038C __UBYTE_S 0 b_true 0 1 FORMAT "%1.0" /end CHARACTERISTIC
/begin CHARACTERISTIC HW_V_RVRS_SWTCH_CFG "reverse gear switch config" VALUE 0x0002038C __UBYTE_S 0 u_r_sw_cfg 0 4 FORMAT "%1.0" /end CHARACTERISTIC
/begin CHARACTERISTIC HW_V_RVRS_SWTCH_HI "neutral gear switch hi active" VALUE 0x0002038C __UBYTE_S 0 b_true 0 1 FORMAT "%1.0" /end CHARACTERISTIC
/begin CHARACTERISTIC HW_V_BTM_CLTCH_SWTCH_CFG "bottom clutch switch config" VALUE 0x0002038C __UBYTE_S 0 u_b_cltch_cfg 0 4 FORMAT "%1.0" /end CHARACTERISTIC
/begin CHARACTERISTIC HW_V_BTM_CLTCH_SWTCH_HI "bottom clutch switch switch hi active" VALUE 0x0002038C __UBYTE_S 0 b_true 0 1 FORMAT "%1.0" /end CHARACTERISTIC
/begin CHARACTERISTIC HW_V_TOP_CLTCH_SWTCH_CFG "top clutch switch config" VALUE 0x0002038C __UBYTE_S 0 u_b_cltch_cfg 0 4 FORMAT "%1.0" /end CHARACTERISTIC
/begin CHARACTERISTIC HW_V_TOP_CLTCH_SWTCH_HI "top clutch switch switch hi active" VALUE 0x0002038C __UBYTE_S 0 b_true 0 1 FORMAT "%1.0" /end CHARACTERISTIC
/begin CHARACTERISTIC HW_V_MT_GR_NUM "MT gear numbers" VALUE 0x0002038C __UBYTE_S 0 u_cnts 0 6 FORMAT "%1.0" /end CHARACTERISTIC
/begin CHARACTERISTIC HW_V_DRV_TRN_SW_INST "drive train switch install" VALUE 0x0002038C __UBYTE_S 0 b_true 0 1 FORMAT "%1.0" /end CHARACTERISTIC
/begin CHARACTERISTIC HW_V_DRV_TRN_SW_HI "drive train switch hi active" VALUE 0x0002038C __UBYTE_S 0 b_true 0 1 FORMAT "%1.0" /end CHARACTERISTIC
/begin CHARACTERISTIC HW_V_PPS2_VREF_CFG "PPS2 supply voltage config" VALUE 0x0002038C __UBYTE_S 0 u_vref_src 0 1 FORMAT "%1.0" /end CHARACTERISTIC
/begin CHARACTERISTIC HW_V_PPS2_VREF_CFG_R "PPS2 supply voltage config(runduant)" VALUE 0x0002038C __UBYTE_S 0 u_vref_src_r 0 1 FORMAT "%1.0" /end CHARACTERISTIC
/begin CHARACTERISTIC HW_V_TPS1_VREF_CFG "TPS1 supply voltage config" VALUE 0x0002038C __UBYTE_S 0 u_vref_src 0 1 FORMAT "%1.0" /end CHARACTERISTIC
/begin CHARACTERISTIC HW_V_TPS2_VREF_CFG "TPS2 supply voltage config" VALUE 0x0002038C __UBYTE_S 0 u_vref_src 0 1 FORMAT "%1.0" /end CHARACTERISTIC
/begin CHARACTERISTIC HW_C_DIN_ACTV_CFG "DIN active hi/lo config" CURVE 0x000200B0 __UBYTE_S 0 b_actv_cfg 0.0 1.0 FORMAT "%1.0"
 /begin AXIS_DESCR FIX_AXIS NO_INPUT_QUANTITY u_din_chn 7 0 6 /begin FIX_AXIS_PAR_LIST 0 1 2 3 4 5 6 /end FIX_AXIS_PAR_LIST /end AXIS_DESCR
/end CHARACTERISTIC
/begin CHARACTERISTIC HW_V_DIN_KE1_CFG "DIN1 config" VALUE 0x0002038C __UBYTE_S 0 u_din_cfg 0 255 FORMAT "%5.0" /end CHARACTERISTIC
/begin CHARACTERISTIC HW_V_DIN_KG5_CFG "DIN2 config" VALUE 0x0002038C __UBYTE_S 0 u_din_cfg 0 255 FORMAT "%5.0" /end CHARACTERISTIC
/begin CHARACTERISTIC HW_V_DIN_KG4_CFG "DIN3 config" VALUE 0x0002038C __UBYTE_S 0 u_din_cfg 0 255 FORMAT "%5.0" /end CHARACTERISTIC
/begin CHARACTERISTIC HW_V_DIN_KD4_CFG "DIN4 config" VALUE 0x0002038C __UBYTE_S 0 u_din_cfg 0 255 FORMAT "%5.0" /end CHARACTERISTIC
/begin CHARACTERISTIC HW_V_DIN_KE5_CFG "DIN5 config" VALUE 0x0002038C __UBYTE_S 0 u_din_cfg 0 255 FORMAT "%5.0" /end CHARACTERISTIC
/begin CHARACTERISTIC HW_V_DIN_KE3_CFG "DIN6 config" VALUE 0x0002038C __UBYTE_S 0 u_din_cfg 0 255 FORMAT "%5.0" /end CHARACTERISTIC
/begin CHARACTERISTIC HW_V_DIN_KD3_CFG "DIN7 config" VALUE 0x0002038C __UBYTE_S 0 u_din_cfg 0 255 FORMAT "%5.0" /end CHARACTERISTIC
/begin CHARACTERISTIC HW_V_FC_PWM_PERIOD "fuel consumption pwm period" VALUE 0x0002038C __UWORD_S 0 u_millisec 0 1023.984375 /end CHARACTERISTIC
/begin CHARACTERISTIC HW_V_FC_PWM_DTY "fuel consumption pwm duty cycle" VALUE 0x0002038C __UWORD_S 0 u_pct 0 199.99694824219 /end CHARACTERISTIC
/begin CHARACTERISTIC HW_V_FC_HW_PULS_NUM_MAX "hardware fuel consumption pulse number max" VALUE 0x0002038C __UWORD_S 0 u_cnts 0 65535 FORMAT "%5.0" /end CHARACTERISTIC
/begin CHARACTERISTIC HW_V_FC_CAN_PULS_NUM_MAX "can fuel consumption pulse number max" VALUE 0x0002038C __UWORD_S 0 u_cnts 0 65535 FORMAT "%5.0" /end CHARACTERISTIC
/begin CHARACTERISTIC HW_V_FC_PULS_USE_HW "fuel consumption pulse output use hardware" VALUE 0x0002038C __UBYTE_S 0 b_true 0 1 FORMAT "%1.0" /end CHARACTERISTIC
/begin CHARACTERISTIC HW_V_FC_PULS_PRECSN "fuel consumption pulse precision" VALUE 0x0002038C __UWORD_S 0 u_ul 0 2047.96875 FORMAT "%6.2" /end CHARACTERISTIC
/begin CHARACTERISTIC HW_V_CYL_NUM "cylinder number" VALUE 0x0002038C __UBYTE_S 0 u_cnts 3 6 FORMAT "%1.0" /end CHARACTERISTIC
/begin CHARACTERISTIC HW_C_CRK_TH_PER_CAM "crank teeth number per cam pulse" VAL_BLK 0x0002038C __UBYTE_S 0 u_cnts 0 255 NUMBER 4 /end CHARACTERISTIC
/begin CHARACTERISTIC HW_C_CAM_DTY_MIN "cam pulse duty min" VAL_BLK 0x0002038C __UBYTE_S 0 u_pct_1_b 0 99.609375 NUMBER 4 FORMAT "%3.1" /end CHARACTERISTIC
/begin CHARACTERISTIC HW_C_CAM_DTY_MAX "cam pulse duty max" VAL_BLK 0x0002038C __UBYTE_S 0 u_pct_1_b 0 99.609375 NUMBER 4 FORMAT "%3.1" /end CHARACTERISTIC
/begin CHARACTERISTIC HW_V_1ST_TH_ANG "first tooth angle" VALUE 0x0002038C __UWORD_S 0 u_crk_ang 0 1023.984375 /end CHARACTERISTIC
/begin CHARACTERISTIC HW_C_CAM_FALL_ANG "cam fall pulse tooth angle" VAL_BLK 0x0002038C __UWORD_S 0 u_crk_ang 0 1023.984375 NUMBER 4 /end CHARACTERISTIC
/begin CHARACTERISTIC HW_V_CAM_NUM_BEFR_GAP "cam pulse number before gap" VALUE 0x0002038C __UBYTE_S 0 u_cnts 0 255 /end CHARACTERISTIC
/begin CHARACTERISTIC HW_V_FLV_AVAL "fuel level input availble" VALUE 0x0002038C __UBYTE_S 0 b_true 0 1 FORMAT "%1.0" /end CHARACTERISTIC
/begin CHARACTERISTIC HW_V_E_THST_AVAL "Electrical coolant thermostat availble" VALUE 0x0002038C __UBYTE_S 0 b_true 0 1 FORMAT "%1.0" /end CHARACTERISTIC
/begin CHARACTERISTIC HW_V_E_THST_FREQ "Electrical coolant thermostat pwm freqency" VALUE 0x0002038C __UWORD_S 0 u_freq 0 16383.75 FORMAT "%7.2" /end CHARACTERISTIC
/begin CHARACTERISTIC HW_V_RGLTR_FREQ "regulator freq" VALUE 0x0002038C __UWORD_S 0 u_freq 0 16383.75 FORMAT "%7.2" /end CHARACTERISTIC
/begin CHARACTERISTIC HW_V_IAT_INST "IAT sensor install" VALUE 0x0002038C __UBYTE_S 0 b_true 0 1 FORMAT "%1.0" /end CHARACTERISTIC
/begin CHARACTERISTIC HW_V_LINEAR_WSS_INST "linear wheel speed sensor install" VALUE 0x0002038C __UBYTE_S 0 b_true 0 1 FORMAT "%1.0" /end CHARACTERISTIC
/begin CHARACTERISTIC HW_V_RR_SRC "rough road source" VALUE 0x0002038C __UBYTE_S 0 u_rr_src 0 5 FORMAT "%1.0" /end CHARACTERISTIC
/begin CHARACTERISTIC HW_V_EGR_VLV_FREQ "regulator freq" VALUE 0x0002038C __UWORD_S 0 u_freq 0 16383.75 FORMAT "%7.2" /end CHARACTERISTIC
/begin CHARACTERISTIC HW_V_BRK_SW_INST "break switch install" VALUE 0x0002038C __UBYTE_S 0 b_true 0 1 FORMAT "%1.0" /end CHARACTERISTIC
/begin CHARACTERISTIC HW_V_AMB_T_CFG "ambient temp config" VALUE 0x0002038C __UBYTE_S 0 u_amb_t_cfg 0 2 FORMAT "%1.0" /end CHARACTERISTIC
/begin CHARACTERISTIC HW_V_ENS_CFG "ENS config" VALUE 0x0002038C __UBYTE_S 0 u_ens_cfg 0 3 FORMAT "%1.0" /end CHARACTERISTIC
/begin CHARACTERISTIC HW_V_CLMB_AUX_SW_CFG "climbing auxiliary switch config" VALUE 0x0002038C __UBYTE_S 0 u_clmb_sw_cfg 0 1 FORMAT "%1.0" /end CHARACTERISTIC
/begin CHARACTERISTIC HW_V_VEH_PLANT_POW_ON_TMS "vehicle in plant enable power on times" VALUE 0x0002038C __UBYTE_S 0 u_cnts 0 255 /end CHARACTERISTIC
/begin CHARACTERISTIC HW_V_DIN_LA_KE2_CFG "discrete input low active config" VALUE 0x0002038C __UBYTE_S 0 u_din_cfg 0 255 FORMAT "%5.0" /end CHARACTERISTIC
/begin CHARACTERISTIC HW_V_DIN_LA_KF3_CFG "discrete input low active config" VALUE 0x0002038C __UBYTE_S 0 u_din_cfg 0 255 FORMAT "%5.0" /end CHARACTERISTIC
/begin CHARACTERISTIC HW_V_DIN_LA_KF4_CFG "discrete input low active config" VALUE 0x0002038C __UBYTE_S 0 u_din_cfg 0 255 FORMAT "%5.0" /end CHARACTERISTIC
/begin CHARACTERISTIC HW_V_DIN_LA_KG3_CFG "discrete input low active config" VALUE 0x0002038C __UBYTE_S 0 u_din_cfg 0 255 FORMAT "%5.0" /end CHARACTERISTIC
/begin CHARACTERISTIC HW_V_DIN_LA_KD5_CFG "discrete input low active config" VALUE 0x0002038C __UBYTE_S 0 u_din_cfg 0 255 FORMAT "%5.0" /end CHARACTERISTIC
/begin CHARACTERISTIC HW_V_DIN_LA_KD2_CFG "discrete input low active config" VALUE 0x0002038C __UBYTE_S 0 u_din_cfg 0 255 FORMAT "%5.0" /end CHARACTERISTIC
/begin CHARACTERISTIC HW_V_DIN_LA_KD1_CFG "discrete input low active config" VALUE 0x0002038C __UBYTE_S 0 u_din_cfg 0 255 FORMAT "%5.0" /end CHARACTERISTIC
/begin CHARACTERISTIC HW_V_DIN_HA_KE4_CFG "discrete input high active config" VALUE 0x0002038C __UBYTE_S 0 u_din_cfg 0 255 FORMAT "%5.0" /end CHARACTERISTIC
/begin CHARACTERISTIC HW_V_DIN_HA_KF5_CFG "discrete input high active config" VALUE 0x0002038C __UBYTE_S 0 u_din_cfg 0 255 FORMAT "%5.0" /end CHARACTERISTIC
/begin CHARACTERISTIC HW_V_DOUT_KC5_CFG "discrete output low active config" VALUE 0x0002038C __UBYTE_S 0 u_do_lamp2_cfg 0 255 FORMAT "%5.0" /end CHARACTERISTIC
/begin CHARACTERISTIC HW_V_DOUT_PULS_KC2_CFG "pulse output low active config" VALUE 0x0002038C __UBYTE_S 0 u_do_pulse1_cfg 0 255 FORMAT "%5.0" /end CHARACTERISTIC
/begin CHARACTERISTIC HW_V_DOUT_PULS_KM1_CFG "pulse output low active config" VALUE 0x0002038C __UBYTE_S 0 u_do_pulse2_cfg 0 255 FORMAT "%5.0" /end CHARACTERISTIC
/begin CHARACTERISTIC HW_V_DOUT_PWM_AA4_CFG "pwm output low active config" VALUE 0x0002038C __UBYTE_S 0 u_do_pwm_cfg 0 255 FORMAT "%5.0" /end CHARACTERISTIC
/begin CHARACTERISTIC HW_V_DOUT_PWM_AB4_CFG "pwm output low active config" VALUE 0x0002038C __UBYTE_S 0 u_do_pwm_cfg 0 255 FORMAT "%5.0" /end CHARACTERISTIC
/begin CHARACTERISTIC HW_V_DOUT_PWM_AB5_CFG "pwm output low active config" VALUE 0x0002038C __UBYTE_S 0 u_do_pwm1_cfg 0 255 FORMAT "%5.0" /end CHARACTERISTIC
/begin CHARACTERISTIC HW_V_DOUT_PULS_POL_KC2_CFG "pulse output polarity config" VALUE 0x0002038C __UBYTE_S 0 u_cnts 0 1 FORMAT "%1.0" SYMBOL_LINK "HW_C_DOUT_PULS_POL" 0 /end CHARACTERISTIC
/begin CHARACTERISTIC HW_V_DOUT_PULS_POL_KM1_CFG "pulse output polarity config" VALUE 0x0002038C __UBYTE_S 0 u_cnts 0 1 FORMAT "%1.0" SYMBOL_LINK "HW_C_DOUT_PULS_POL" 1 /end CHARACTERISTIC
/begin CHARACTERISTIC HW_V_VGIS1_CFG "VGIS1 install config" VALUE 0x2053C __UBYTE_S 0 u_vgis_cfg 0 2 FORMAT "%5.2" /end CHARACTERISTIC
/begin CHARACTERISTIC HW_V_VGIS2_CFG "VGIS2 install config" VALUE 0x2053C __UBYTE_S 0 u_vgis_cfg 0 2 FORMAT "%5.2" /end CHARACTERISTIC
/begin CHARACTERISTIC HW_V_CRU_ONOFF_TYP "cruise onoff switch active type" VALUE 0x0002038C __UBYTE_S 0 u_cru_actv_typ 0 3 FORMAT "%1.0" /end CHARACTERISTIC
/begin CHARACTERISTIC HW_V_COM_HD_OPN "hood open from comm" VALUE 0x0002038C __UBYTE_S 0 b_true 0 1 FORMAT "%1.0" /end CHARACTERISTIC
/begin CHARACTERISTIC HW_V_COM_DR_OPN "door open from comm" VALUE 0x0002038C __UBYTE_S 0 b_true 0 1 FORMAT "%1.0" /end CHARACTERISTIC
/begin CHARACTERISTIC HW_V_COM_BLT_OPN "seat belt open from comm" VALUE 0x0002038C __UBYTE_S 0 b_true 0 1 FORMAT "%1.0" /end CHARACTERISTIC
/begin CHARACTERISTIC HW_V_COM_R_DEFOG "rear defog from comm" VALUE 0x0002038C __UBYTE_S 0 b_true 0 1 FORMAT "%1.0" /end CHARACTERISTIC
/begin CHARACTERISTIC HW_V_COM_ISG "isg from comm" VALUE 0x0002038C __UBYTE_S 0 b_true 0 1 FORMAT "%1.0" /end CHARACTERISTIC
/begin CHARACTERISTIC HW_V_ISG_INIT_ST "isg initial state" VALUE 0x0002038C __UBYTE_S 0 u_isg_init 0 3 FORMAT "%5.0" /end CHARACTERISTIC
/begin CHARACTERISTIC HW_V_ISG_SW_TYP "isg switch type" VALUE 0x0002038C __UBYTE_S 0 u_can_lmt_sw_typ 0 1 FORMAT "%1.0" /end CHARACTERISTIC
/begin CHARACTERISTIC HW_V_POW_ON_DLY "power on delay counts" VALUE 0x0002038C __UWORD_S 0 u_cnts 0 65535 FORMAT "%5.0" /end CHARACTERISTIC
/begin CHARACTERISTIC HW_V_KEY_ON_DLY "key on delay counts" VALUE 0x0002038C __UWORD_S 0 u_cnts 0 65535 FORMAT "%5.0" /end CHARACTERISTIC
/begin CHARACTERISTIC SYS_M_MAP_FIL "map filter" MAP 0x00020320 __UWORD_S 0 u_filter 0 0.9999847412109375 FORMAT "%10.9" SYMBOL_LINK "SYS_M_MAP_FIL" 4
 /begin AXIS_DESCR COM_AXIS sys_eng_spd u_espd 6 0.000000 8191.875000 FORMAT "%6.2" AXIS_PTS_REF SYS_X_ESPD_B /end AXIS_DESCR
 /begin AXIS_DESCR COM_AXIS sys_tps_pct u_pct 4 0.000000 199.996948242187 FORMAT "%4.1" AXIS_PTS_REF SYS_X_THRO_POS /end AXIS_DESCR
/end CHARACTERISTIC
/begin AXIS_PTS SYS_X_ESPD_B "engine speed breakpoint" 0x0002006C sys_eng_spd SSV__UWORD_S 0 u_espd 6 0.000000 8191.875000 FORMAT "%4.1" DEPOSIT ABSOLUTE SYMBOL_LINK "SYS_X_ESPD_B" 2 /end AXIS_PTS
/begin AXIS_PTS SYS_X_THRO_POS "throttle position breakpoint" 0x0002006C sys_tps_pct SSV__UWORD_S 0 u_pct 4 0.000000 199.996948242187 FORMAT "%4.1" DEPOSIT ABSOLUTE SYMBOL_LINK "SYS_X_THRO_POS" 2 /end AXIS_PTS
/begin CHARACTERISTIC SYS_C_ECT "ECT temp hi table" CURVE 0x000200B0 __SWORD_S 0 u_deg_C -256.0 255.9921875 SYMBOL_LINK "SYS_C_ECT" 2
 /begin AXIS_DESCR COM_AXIS hw_ect_vlt u_ad_volt 27 0 4.9999237060546875 AXIS_PTS_REF SYS_X_ECT_VLT /end AXIS_DESCR
/end CHARACTERISTIC
/begin CHARACTERISTIC SYS_M_ECT_DFLT "ECT default value" MAP 0x00020320 __SBYTE_S 0 u_deg_C_a -128.0 127.0 SYMBOL_LINK "SYS_M_ECT_DFLT" 3
 /begin AXIS_DESCR FIX_AXIS sys_eng_rtm_nv u_1s_tmr 5 0 512 FORMAT "%3.0" /begin FIX_AXIS_PAR_LIST 0 128 256 384 512 /end FIX_AXIS_PAR_LIST /end AXIS_DESCR
 /begin AXIS_DESCR FIX_AXIS sys_iat u_deg_C 6 -16 44 FORMAT "%2.0" /begin FIX_AXIS_PAR_LIST -2048 -512 1024 2560 4096 5632 /end FIX_AXIS_PAR_LIST /end AXIS_DESCR
/end CHARACTERISTIC
/begin CHARACTERISTIC SYS_V_ECT_FIL "ECT filter" VALUE 0x0002038C __UWORD_S 0 u_filter 0 0.9999847412109375 FORMAT "%10.9" /end CHARACTERISTIC
/begin CHARACTERISTIC SYS_C_AC_TEMP "ac evap temp" CURVE 0x000200B0 __SWORD_S 0 u_deg_C -256.0 255.9921875 SYMBOL_LINK "SYS_C_AC_TEMP" 2
 /begin AXIS_DESCR FIX_AXIS hw_ac_temp_vlt u_ad_volt 17 0 5
  /begin FIX_AXIS_PAR_LIST 0 4096 8192 12288 16384 20480 24576 28672 32768 36864 40960 45056 49152 53248 57344 61440 65535 /end FIX_AXIS_PAR_LIST
 /end AXIS_DESCR
/end CHARACTERISTIC
/begin CHARACTERISTIC SYS_C_IAT_HI "IAT temp hi table" CURVE 0x000200B0 __SWORD_S 0 u_deg_C -256.0 255.9921875 SYMBOL_LINK "SYS_C_IAT_HI" 2
 /begin AXIS_DESCR FIX_AXIS hw_iat_vlt u_ad_volt 21 4 5
  /begin FIX_AXIS_PAR_LIST 52428 53084 53739 54394 55050 55705 56360 57016 57671 58327 58982 59637 60293 60948 61603 62259 62914 63569 64225 64880 65536 /end FIX_AXIS_PAR_LIST
 /end AXIS_DESCR
/end CHARACTERISTIC
/begin CHARACTERISTIC SYS_C_IAT_LO "IAT temp lo table" CURVE 0x000200B0 __SWORD_S 0 u_deg_C -256.0 255.9921875 SYMBOL_LINK "SYS_C_IAT_LO" 2
 /begin AXIS_DESCR FIX_AXIS hw_iat_vlt u_ad_volt 17 0 4
  /begin FIX_AXIS_PAR_LIST 0 3276 6553 9830 13107 16384 19660 22937 26214 29491 32768 36044 39321 42598 45875 49152 52428 /end FIX_AXIS_PAR_LIST
 /end AXIS_DESCR
/end CHARACTERISTIC
/begin CHARACTERISTIC SYS_V_IAT_DFLT "IAT default value" VALUE 0x0002038C __SWORD_S 0 u_deg_C -256 255.9921875 FORMAT "%4.2" /end CHARACTERISTIC
/begin CHARACTERISTIC SYS_V_AC_TEMP_DFLT "evap temp default value" VALUE 0x0002038C __SWORD_S 0 u_deg_C -256 255.9921875 FORMAT "%4.2" /end CHARACTERISTIC
/begin CHARACTERISTIC SYS_V_IAT_FIL "IAT filter" VALUE 0x0002038C __UWORD_S 0 u_filter 0 0.9999847412109375 FORMAT "%10.9" /end CHARACTERISTIC
/begin CHARACTERISTIC SYS_V_KEY_ON_VLT_HI "key voltage to determine key on" VALUE 0x0002038C __UWORD_S 0 u_volt_32 0 31.99951171875 FORMAT "%4.2" /end CHARACTERISTIC
/begin CHARACTERISTIC SYS_V_KEY_OFF_VLT_LO "key voltage to determine key on" VALUE 0x0002038C __UWORD_S 0 u_volt_32 0 31.99951171875 FORMAT "%4.2" /end CHARACTERISTIC
/begin CHARACTERISTIC SYS_V_MAP_SNSR_K "map sensor conversion K,base on MAP=K*(sensor volt/5v)+B" VALUE 0x0002038C __UWORD_S 0 u_kPa_0_512 0 511.9921875 /end CHARACTERISTIC
/begin CHARACTERISTIC SYS_V_MAP_SNSR_B "map sensor conversion B,base on MAP=K*(sensor volt/5v)+B" VALUE 0x0002038C __SWORD_S 0 u_kPa_128n_128p -128 127.99609375 SYMBOL_LINK "SYS_V_MAP_SNSR_B" 2 /end CHARACTERISTIC
/begin CHARACTERISTIC SYS_V_AC_P_SNSR_K "ac press sensor conversion K,base on P=K*(sensor volt/5v)+B" VALUE 0x0002038C __SWORD_S 0 u_kPa_4096n_4096p -4096 4095.875 /end CHARACTERISTIC
/begin CHARACTERISTIC SYS_V_AC_P_SNSR_B "ac press sensor conversion B,base on P=K*(sensor volt/5v)+B" VALUE 0x0002038C __SWORD_S 0 u_kPa_4096n_4096p -4096 4095.875 SYMBOL_LINK "SYS_V_AC_P_SNSR_B" 2 /end CHARACTERISTIC
/begin CHARACTERISTIC SYS_V_TANK_P_SNSR_K "tank press sensor conversion K,base on P=K*(sensor volt/5v)+B" VALUE 0x0002038C __SWORD_S 0 u_kPa_8n_8p -8 7.999755859375 FORMAT "%4.3" /end CHARACTERISTIC
/begin CHARACTERISTIC SYS_V_TANK_P_SNSR_B "tank press sensor conversion B,base on P=K*(sensor volt/5v)+B" VALUE 0x0002038C __SWORD_S 0 u_kPa_8n_8p -8 7.999755859375 FORMAT "%4.3" /end CHARACTERISTIC
/begin CHARACTERISTIC SYS_V_BST_P_SNSR_K "boost p sensor conversion K,base on MAP=K*(sensor volt/5v)+B" VALUE 0x0002038C __UWORD_S 0 u_kPa_0_512 0 511.9921875 SYMBOL_LINK "SYS_V_BST_P_SNSR" 0 /end CHARACTERISTIC
/begin CHARACTERISTIC SYS_V_BST_P_SNSR_B "boost p sensor conversion B,base on MAP=K*(sensor volt/5v)+B" VALUE 0x0002038C __SWORD_S 0 u_kPa_128n_128p -128 127.99609375 SYMBOL_LINK "SYS_V_BST_P_SNSR" 2 /end CHARACTERISTIC
/begin CHARACTERISTIC SYS_V_BST_P_MIN "boost press min" VALUE 0x0002038C __UWORD_S 0 u_kPa_0_256 0 255.99609375 /end CHARACTERISTIC
/begin CHARACTERISTIC SYS_C_BST_P_DFLT "boost p default" CURVE 0x000200B0 __UWORD_S 0 u_kPa_0_256 0 255.99609375 SYMBOL_LINK "SYS_C_BST_P_DFLT" 2
 /begin AXIS_DESCR COM_AXIS sys_amp u_kPa_0_256 6 0 255.99609375 AXIS_PTS_REF SYS_X_AMP_A /end AXIS_DESCR
/end CHARACTERISTIC
/begin AXIS_PTS SYS_X_AMP_A "amp breakpoint" 0x0002006C sys_amp SSV__UWORD_S 0 u_kPa_0_256 6 0 255.99609375 DEPOSIT ABSOLUTE SYMBOL_LINK "SYS_X_AMP_A" 2 /end AXIS_PTS
/begin CHARACTERISTIC SYS_V_BST_P_FIL "boost p filter" VALUE 0x0002038C __UWORD_S 0 u_filter 0 0.9999847412109375 FORMAT "%10.9" /end CHARACTERISTIC
/begin CHARACTERISTIC SYS_V_MAP_DFLT "default map when engine stall" VALUE 0x0002038C __UWORD_S 0 u_kPa_0_256 0 255.99609375 /end CHARACTERISTIC
/begin CHARACTERISTIC SYS_C_AMP_MAP_FAC "normalized map factor" CURVE 0x000200B0 __UWORD_S 0 u_fac_4 0 3.99993896484375 FORMAT "%4.3" SYMBOL_LINK "SYS_C_AMP_MAP_FAC" 2
 /begin AXIS_DESCR FIX_AXIS sys_amp u_kPa_0_256 12 50 105
  /begin FIX_AXIS_PAR_LIST 12800 14080 15360 16640 17920 19200 20480 21760 23040 24320 25600 26880 /end FIX_AXIS_PAR_LIST
 /end AXIS_DESCR
/end CHARACTERISTIC
/begin CHARACTERISTIC SYS_V_AMP_MAP_BIAS "normalized map bias" VALUE 0x0002038C __SWORD_S 0 u_kPa_256n_256p -256 255.9921875 /end CHARACTERISTIC
/begin CHARACTERISTIC SYS_V_AMP_SNSR_K "amp sensor conversion K,base on AMP=K*(sensor volt/5v)+B" VALUE 0x0002038C __UWORD_S 0 u_kPa_0_512 0 511.9921875 SYMBOL_LINK "SYS_V_AMP_SNSR" 0 /end CHARACTERISTIC
/begin CHARACTERISTIC SYS_V_AMP_SNSR_B "amp sensor conversion B,base on AMP=K*(sensor volt/5v)+B" VALUE 0x0002038C __SWORD_S 0 u_kPa_128n_128p -128 127.99609375 SYMBOL_LINK "SYS_V_AMP_SNSR" 2 /end CHARACTERISTIC
/begin CHARACTERISTIC SYS_V_AMP_MAX "amp max" VALUE 0x0002038C __UWORD_S 0 u_kPa_0_256 0 255.99609375 /end CHARACTERISTIC
/begin CHARACTERISTIC SYS_V_AMP_MIN "amp min" VALUE 0x0002038C __UWORD_S 0 u_kPa_0_256 0 255.99609375 /end CHARACTERISTIC
/begin CHARACTERISTIC SYS_V_AMP_FIL "AMP filter" VALUE 0x0002038C __UWORD_S 0 u_filter 0 0.9999847412109375 FORMAT "%10.9" /end CHARACTERISTIC
/begin CHARACTERISTIC SYS_V_ESPD_SUM_CNTS "engine speed accumulated counts for averaged speed " VALUE 0x0002038C __UBYTE_S 0 u_cnts 1 4 FORMAT "%5.2" /end CHARACTERISTIC
/begin CHARACTERISTIC SYS_C_ST_RUN_ESPD "engine speed threshhold start to run" CURVE 0x000200B0 __UWORD_S 0 u_espd 0.0 8191.875 SYMBOL_LINK "SYS_C_ST_RUN_ESPD" 2
 /begin AXIS_DESCR COM_AXIS sys_keyon_ect u_deg_C 7 -256 255.9921875 AXIS_PTS_REF SYS_X_KEYON_ECT /end AXIS_DESCR
/end CHARACTERISTIC
/begin CHARACTERISTIC SYS_C_AST_ST_RUN_ESPD "auto start engine speed threshhold start to run" CURVE 0x000200B0 __UWORD_S 0 u_espd 0.0 8191.875 SYMBOL_LINK "SYS_C_AST_ST_RUN_ESPD" 2
 /begin AXIS_DESCR COM_AXIS sys_keyon_ect u_deg_C 7 -256 255.9921875 AXIS_PTS_REF SYS_X_KEYON_ECT /end AXIS_DESCR
/end CHARACTERISTIC
/begin CHARACTERISTIC SYS_V_RUN_AST_DLY_CLD_THR "engine run segment delay cold engine ECT thr when auto start" VALUE 0x0002038C __SWORD_S 0 u_deg_C -256 255.9921875 FORMAT "%4.2" /end CHARACTERISTIC
/begin CHARACTERISTIC SYS_V_RUN_AST_DLY_HOT_THR "engine run segment delay hot engine ECT thr when auto start" VALUE 0x0002038C __SWORD_S 0 u_deg_C -256 255.9921875 FORMAT "%4.2" /end CHARACTERISTIC
/begin CHARACTERISTIC SYS_V_RUN_DLY_CLD_THR "engine run segment delay cold engine ECT thr" VALUE 0x0002038C __SWORD_S 0 u_deg_C -256 255.9921875 FORMAT "%4.2" /end CHARACTERISTIC
/begin CHARACTERISTIC SYS_V_RUN_DLY_HOT_THR "engine run segment delay hot engine ECT thr" VALUE 0x0002038C __SWORD_S 0 u_deg_C -256 255.9921875 FORMAT "%4.2" /end CHARACTERISTIC
/begin CHARACTERISTIC SYS_V_RUN_AST_CLD_SEG_DLY "engine run cold engine segment delay when auto start" VALUE 0x0002038C __UBYTE_S 0 u_cnts 0 255 SYMBOL_LINK "SYS_V_RUN_CLD_SEG_DLY" 0 /end CHARACTERISTIC
/begin CHARACTERISTIC SYS_V_RUN_WRM_SEG_DLY "engine run warm engine segment delay" VALUE 0x0002038C __UBYTE_S 0 u_cnts 0 255 /end CHARACTERISTIC
/begin CHARACTERISTIC SYS_V_RUN_AST_WRM_SEG_DLY "engine run warm engine segment delay when auto start" VALUE 0x0002038C __UBYTE_S 0 u_cnts 0 255 /end CHARACTERISTIC
/begin CHARACTERISTIC SYS_V_RUN_CLD_SEG_DLY "engine run cold engine segment delay" VALUE 0x0002038C __UBYTE_S 0 u_cnts 0 255 /end CHARACTERISTIC
/begin CHARACTERISTIC SYS_V_RUN_HOT_SEG_DLY "engine run hot engine segment delay" VALUE 0x0002038C __UBYTE_S 0 u_cnts 0 255 /end CHARACTERISTIC
/begin CHARACTERISTIC SYS_V_RUN_ST_ESPD "engine speed threshhold run to start" VALUE 0x0002038C __UWORD_S 0 u_espd 0.0 8191.875 FORMAT "%6.2" /end CHARACTERISTIC
/begin CHARACTERISTIC SYS_V_SHUT_DWN_DLY "engine shut down delay" VALUE 0x0002038C __UWORD_S 0 u_1x_tmr 0.0 511.9921875 FORMAT "%5.2" /end CHARACTERISTIC
/begin CHARACTERISTIC SYS_V_PPS2_K "factor of pps2,sys_pps2_pct_raw=SYS_V_PPS2_K*(hw_pps2_vlt/5v-SYS_V_PPS2_BIAS)" VALUE 0x0002038C __UWORD_S 0 u_fac_4 0 3.99993896484375 FORMAT "%3.2" /end CHARACTERISTIC
/begin CHARACTERISTIC SYS_V_PPS2_K_R "factor of pps2,sys_pps2_pct_raw=SYS_V_PPS2_K*(hw_pps2_vlt/5v-SYS_V_PPS2_BIAS)(runduant)" VALUE 0x0002038C __UWORD_S 0 u_fac_8 0 7.9998779296875 FORMAT "%3.2" /end CHARACTERISTIC
/begin CHARACTERISTIC SYS_V_PPS2_BIAS "factor of pps2,sys_pps2_pct_raw=SYS_V_PPS2_K*(hw_pps2_vlt/5v-SYS_V_PPS2_BIAS)" VALUE 0x0002038C __UWORD_S 0 u_pct 0 199.996948242187 /end CHARACTERISTIC
/begin CHARACTERISTIC SYS_V_PPS2_BIAS_R "factor of pps2,sys_pps2_pct_raw=SYS_V_PPS2_K*(hw_pps2_vlt/5v-SYS_V_PPS2_BIAS)(runduant)" VALUE 0x0002038C __UWORD_S 0 u_pct_s -200 199.993896484375 /end CHARACTERISTIC
/begin CHARACTERISTIC SYS_V_BRK_ON_PPS_MAX "pedal position max when break on and etc in limit performance mode" VALUE 0x0002038C __UWORD_S 0 u_pct 0 199.996948242187 /end CHARACTERISTIC
/begin CHARACTERISTIC SYS_V_PPS_DEAD_BAND "pedal position deadband" VALUE 0x0002038C __UWORD_S 0 u_pct 0 199.996948242187 /end CHARACTERISTIC
/begin CHARACTERISTIC SYS_V_PPS_DEAD_BAND_R "pedal position deadband(runduant)" VALUE 0x0002038C __SWORD_S 0 u_pct_s -200 199.993896484375 /end CHARACTERISTIC
/begin CHARACTERISTIC SYS_C_PPS_HYS "force idle mode pedal position" CURVE 0x000200B0 __UWORD_S 0 u_pct 0.0 199.996948 SYMBOL_LINK "SYS_C_PPS_HYS" 2
 /begin AXIS_DESCR FIX_AXIS NO_INPUT_QUANTITY u_pct 17 0 100
  /begin FIX_AXIS_PAR_LIST 0 2048 4096 6144 8192 10240 12288 14336 16384 18432 20480 22528 24576 26624 28672 30720 32768 /end FIX_AXIS_PAR_LIST
 /end AXIS_DESCR
/end CHARACTERISTIC
/begin CHARACTERISTIC SYS_C_PPS_HYS_R "force idle mode pedal position" CURVE 0x000200B0 __SWORD_S 0 u_pct_s -200 199.993896484375 SYMBOL_LINK "SYS_C_PPS_HYS_R" 2
 /begin AXIS_DESCR FIX_AXIS NO_INPUT_QUANTITY u_pct_s 17 0 100
  /begin FIX_AXIS_PAR_LIST 0 1024 2048 3072 4096 5120 6144 7168 8192 9216 10240 11264 12288 13312 14336 15360 16384 /end FIX_AXIS_PAR_LIST
 /end AXIS_DESCR
/end CHARACTERISTIC
/begin CHARACTERISTIC SYS_M_PPS1_FAC "pps1 weighted factor" MAP 0x00020320 __UWORD_S 0 u_fac_2 0 1.999969482421875 FORMAT "%4.3" SYMBOL_LINK "SYS_M_PPS1_FAC" 4
 /begin AXIS_DESCR FIX_AXIS sys_pps_vlt_stat pps_vlt_stat 4 0 3 FORMAT "%3.0" /begin FIX_AXIS_PAR_LIST 0 1 2 3 /end FIX_AXIS_PAR_LIST /end AXIS_DESCR
 /begin AXIS_DESCR FIX_AXIS sys_pps_corr_stat pps_corr_stat 2 0 1 FORMAT "%3.0" /begin FIX_AXIS_PAR_LIST 0 1 /end FIX_AXIS_PAR_LIST /end AXIS_DESCR
/end CHARACTERISTIC
/begin CHARACTERISTIC SYS_M_PPS1_FAC_R "pps1 weighted factor(runduant)" MAP 0x00020320 __UWORD_S 0 u_fac_4 0 3.99993896484375 FORMAT "%4.3" SYMBOL_LINK "SYS_M_PPS1_FAC_R" 4
 /begin AXIS_DESCR FIX_AXIS sys_pps_vlt_stat pps_vlt_stat 4 0 3 FORMAT "%3.0" /begin FIX_AXIS_PAR_LIST 0 1 2 3 /end FIX_AXIS_PAR_LIST /end AXIS_DESCR
 /begin AXIS_DESCR FIX_AXIS sys_pps_corr_stat pps_corr_stat 2 0 1 FORMAT "%3.0" /begin FIX_AXIS_PAR_LIST 0 1 /end FIX_AXIS_PAR_LIST /end AXIS_DESCR
/end CHARACTERISTIC
/begin CHARACTERISTIC SYS_M_PPS2_FAC "pps2 weighted factor" MAP 0x00020320 __UWORD_S 0 u_fac_2 0 1.999969482421875 FORMAT "%4.3" SYMBOL_LINK "SYS_M_PPS2_FAC" 4
 /begin AXIS_DESCR FIX_AXIS sys_pps_vlt_stat pps_vlt_stat 4 0 3 FORMAT "%3.0" /begin FIX_AXIS_PAR_LIST 0 1 2 3 /end FIX_AXIS_PAR_LIST /end AXIS_DESCR
 /begin AXIS_DESCR FIX_AXIS sys_pps_corr_stat pps_corr_stat 2 0 1 FORMAT "%3.0" /begin FIX_AXIS_PAR_LIST 0 1 /end FIX_AXIS_PAR_LIST /end AXIS_DESCR
/end CHARACTERISTIC
/begin CHARACTERISTIC SYS_M_PPS2_FAC_R "pps2 weighted factor" MAP 0x00020320 __UWORD_S 0 u_fac_4 0 3.99993896484375 FORMAT "%4.3" SYMBOL_LINK "SYS_M_PPS2_FAC_R" 4
 /begin AXIS_DESCR FIX_AXIS sys_pps_vlt_stat pps_vlt_stat 4 0 3 FORMAT "%3.0" /begin FIX_AXIS_PAR_LIST 0 1 2 3 /end FIX_AXIS_PAR_LIST /end AXIS_DESCR
 /begin AXIS_DESCR FIX_AXIS sys_pps_corr_stat pps_corr_stat 2 0 1 FORMAT "%3.0" /begin FIX_AXIS_PAR_LIST 0 1 /end FIX_AXIS_PAR_LIST /end AXIS_DESCR
/end CHARACTERISTIC
/begin CHARACTERISTIC SYS_V_PPS_SCAL_FAC "factor of scaled pps" VALUE 0x0002038C __UWORD_S 0 u_fac_8 0 7.9998779296875 FORMAT "%3.2" /end CHARACTERISTIC
/begin CHARACTERISTIC SYS_V_PPS_SCAL_FAC_R "factor of scaled pps(runduant)" VALUE 0x0002038C __UWORD_S 0 u_fac_16 0 15.999756 FORMAT "%4.2" /end CHARACTERISTIC
/begin CHARACTERISTIC SYS_V_PPS_LRN_FIL "pps position learn down filter" VALUE 0x0002038C __UWORD_S 0 u_filter 0 0.9999847412109375 FORMAT "%10.9" /end CHARACTERISTIC
/begin CHARACTERISTIC SYS_V_PPS_LRN_FIL_R "pps position learn down filter(runduant)" VALUE 0x0002038C __UWORD_S 0 u_filter 0 0.9999847412109375 FORMAT "%10.9" /end CHARACTERISTIC
/begin CHARACTERISTIC SYS_V_PPS_LRN_DLY "pps learn enable delay after AD response test" VALUE 0x0002038C __UWORD_S 0 u_sec_16 0 15.999755859375 FORMAT "%4.2" /end CHARACTERISTIC
/begin CHARACTERISTIC SYS_V_PPS_LRN_DLY_R "pps learn enable delay after AD response test(runduant)" VALUE 0x0002038C __UWORD_S 0 u_sec_16 0 15.999755859375 FORMAT "%4.2" /end CHARACTERISTIC
/begin CHARACTERISTIC SYS_V_PPS_LRN_UP_EN_LO "pedal position learn up enable thr" VALUE 0x0002038C __UWORD_S 0 u_pct 0 199.996948242187 /end CHARACTERISTIC
/begin CHARACTERISTIC SYS_V_PPS_LRN_UP_EN_LO_R "pedal position learn up enable thr(runduant)" VALUE 0x0002038C __SWORD_S 0 u_pct_s -200 199.993896484375 /end CHARACTERISTIC
/begin CHARACTERISTIC SYS_V_PPS_LRN_UP_EN_HI "pedal position learn up enable thr" VALUE 0x0002038C __UWORD_S 0 u_pct 0 199.996948242187 /end CHARACTERISTIC
/begin CHARACTERISTIC SYS_V_PPS_LRN_UP_EN_HI_R "pedal position learn up enable thr" VALUE 0x0002038C __UWORD_S 0 u_pct_s -200 199.993896484375 /end CHARACTERISTIC
/begin CHARACTERISTIC SYS_V_PPS_LRN_DWN_STBL_DLT "delta between high and low PPS to confirm learn down stable condition" VALUE 0x0002038C __UWORD_S 0 u_pct 0 199.996948242187 /end CHARACTERISTIC
/begin CHARACTERISTIC SYS_V_PPS_LRN_DWN_STBL_DLT_R "delta between high and low PPS to confirm learn down stable condition(rundunt)" VALUE 0x0002038C __UWORD_S 0 u_pct_s -200 199.993896484375 /end CHARACTERISTIC
/begin CHARACTERISTIC SYS_V_PPS_ZERO_LRN_FIL "pps zero volt learn down filter" VALUE 0x0002038C __UWORD_S 0 u_filter 0 0.9999847412109375 FORMAT "%10.9" /end CHARACTERISTIC
/begin CHARACTERISTIC SYS_V_PPS_ZERO_LRN_FIL_R "pps zero volt learn down filter(runduant)" VALUE 0x0002038C __UWORD_S 0 u_filter 0 0.9999847412109375 FORMAT "%10.9" /end CHARACTERISTIC
/begin CHARACTERISTIC SYS_V_PPS_ZERO_VLT_MIN "pps zero volt min" VALUE 0x0002038C __UWORD_S 0 u_ad_volt_lo 0 9.999847412109375 FORMAT "%5.4" /end CHARACTERISTIC
/begin CHARACTERISTIC SYS_V_PPS_ZERO_VLT_MIN_R "pps zero volt min(runduant)" VALUE 0x0002038C __SWORD_S 0 u_ad_volt_lo_r 0 9.99969482421875 FORMAT "%5.4" /end CHARACTERISTIC
/begin CHARACTERISTIC SYS_V_PPS_ZERO_VLT_MAX "pps zero volt max" VALUE 0x0002038C __UWORD_S 0 u_ad_volt_lo 0 9.999847412109375 FORMAT "%5.4" /end CHARACTERISTIC
/begin CHARACTERISTIC SYS_V_PPS_ZERO_VLT_MAX_R "pps zero volt max(runduant)" VALUE 0x0002038C __SWORD_S 0 u_ad_volt_lo_r 0 9.99969482421875 FORMAT "%5.4" /end CHARACTERISTIC
/begin CHARACTERISTIC SYS_V_PPS_RNDT_DLT "ETC pps runduant postion delta max" VALUE 0x2886C __UWORD_S 0 u_pct 0 199.996948 /end CHARACTERISTIC
/begin CHARACTERISTIC SYS_V_PPS_RNDT_DLT_R "ETC pps runduant postion delta max(runduant)" VALUE 0x2886C __SWORD_S 0 u_pct_s -200 199.993896484375 /end CHARACTERISTIC
/begin CHARACTERISTIC SYS_V_O2_SUM_CNTS "upstream O2 volt sum counts" VALUE 0x0002038C __UBYTE_S 0 u_cnts 0 6 FORMAT "%1.0" /end CHARACTERISTIC
/begin AXIS_PTS SYS_X_ECT_VLT "ECT axis when temp hi" 0x0002006C hw_ect_vlt SSV__UWORD_S 0 u_ad_volt 27 0 4.9999237060546875 FORMAT "%4.2" DEPOSIT ABSOLUTE SYMBOL_LINK "SYS_X_ECT_VLT" 2 /end AXIS_PTS
/begin AXIS_PTS SYS_X_KEYON_ECT "key on engine ECT breakpoint" 0x0002006C sys_keyon_ect SSV__SWORD_S 0 u_deg_C 7 -256 255.9921875 DEPOSIT ABSOLUTE SYMBOL_LINK "SYS_X_KEYON_ECT" 2 /end AXIS_PTS
/begin CHARACTERISTIC SYS_V_TPS2_K "factor of tps2,sys_tps2_pct_raw=SYS_V_TPS2_K*(100%-hw_tps2_vlt/5v)" VALUE 0x0002038C __UWORD_S 0 u_fac_4 0 3.99993896484375 FORMAT "%3.2" /end CHARACTERISTIC
/begin CHARACTERISTIC SYS_V_TPS1_FAC "tps1 weighted factor" VALUE 0x0002038C __UWORD_S 0 u_fac_4 0 3.99993896484375 FORMAT "%3.2" /end CHARACTERISTIC
/begin AXIS_PTS SYS_X_ESPD_A "engine speed breakpoint" 0x0002006C sys_eng_spd SSV__UWORD_S 0 u_espd 9 0 8191.875 FORMAT "%6.2" DEPOSIT ABSOLUTE SYMBOL_LINK "SYS_X_ESPD_A" 2 /end AXIS_PTS
/begin AXIS_PTS SYS_X_ECT_A "ect breakpoint" 0x0002006C sys_ect SSV__SWORD_S 0 u_deg_C 15 -256 255.9921875 DEPOSIT ABSOLUTE SYMBOL_LINK "SYS_X_ECT_A" 2 /end AXIS_PTS
/begin CHARACTERISTIC SYS_V_OVRHT_EOIL_T_HI "engine overheat engine oil temp thr high" VALUE 0x0002038C __SWORD_S 0 u_deg_C -256 255.9921875 FORMAT "%4.2" /end CHARACTERISTIC
/begin CHARACTERISTIC SYS_V_OVRHT_ECT_T_HI "engine overheat engine ect thr high" VALUE 0x0002038C __SWORD_S 0 u_deg_C -256 255.9921875 FORMAT "%4.2" /end CHARACTERISTIC
/begin CHARACTERISTIC SYS_V_OVRHT_TOIL_T_HI "engine overheat transmision oil temp thr high" VALUE 0x0002038C __SWORD_S 0 u_deg_C -256 255.9921875 FORMAT "%4.2" /end CHARACTERISTIC
/begin CHARACTERISTIC SYS_V_OVRHT_EOIL_T_LO "engine overheat engine oil temp thr high" VALUE 0x0002038C __SWORD_S 0 u_deg_C -256 255.9921875 FORMAT "%4.2" /end CHARACTERISTIC
/begin CHARACTERISTIC SYS_V_OVRHT_ECT_T_LO "engine overheat engine ect thr high" VALUE 0x0002038C __SWORD_S 0 u_deg_C -256 255.9921875 FORMAT "%4.2" /end CHARACTERISTIC
/begin CHARACTERISTIC SYS_V_OVRHT_TOIL_T_LO "engine overheat transmision oil temp thr high" VALUE 0x0002038C __SWORD_S 0 u_deg_C -256 255.9921875 FORMAT "%4.2" /end CHARACTERISTIC
/begin CHARACTERISTIC SYS_V_OVRHT_MET_DLY "engine overheat delay" VALUE 0x0002038C __UWORD_S 0 u_2x_tmr 0 1023.984375 /end CHARACTERISTIC
/begin CHARACTERISTIC SYS_C_EGR_OUT_T "egr out temp" CURVE 0x000200B0 __SWORD_S 0 u_deg_C -256.0 255.9921875 SYMBOL_LINK "SYS_C_EGR_OUT_T" 2
 /begin AXIS_DESCR COM_AXIS hw_egr_out_t_vlt u_ad_volt 21 0 4.9999237060546875 AXIS_PTS_REF SYS_X_EGR_T_VLT /end AXIS_DESCR
/end CHARACTERISTIC
/begin AXIS_PTS SYS_X_EGR_T_VLT "egr volt breakpoint" 0x0002006C hw_egr_out_t_vlt SSV__UWORD_S 0 u_ad_volt 21 0 4.9999237060546875 FORMAT "%4.3" DEPOSIT ABSOLUTE SYMBOL_LINK "SYS_X_EGR_T_VLT" 2 /end AXIS_PTS
/begin CHARACTERISTIC SYS_V_EGR_OUT_T_DFLT "egr out temp default" VALUE 0x0002038C __SWORD_S 0 u_deg_C -256 255.9921875 FORMAT "%4.2" /end CHARACTERISTIC
/begin CHARACTERISTIC SYS_V_EGR_OUT_T_FIL "egr out temp filter" VALUE 0x0002038C __UWORD_S 0 u_filter 0 0.9999847412109375 FORMAT "%4.3" /end CHARACTERISTIC
/begin CHARACTERISTIC SYS_V_FLV_UPDT_EN_VLT_DLT "fuel level update enable voltage delta max" VALUE 0x0002038C __UWORD_S 0 u_volt_32 0 31.99951171875 FORMAT "%4.2" /end CHARACTERISTIC
/begin CHARACTERISTIC SYS_V_FLV_VLT_COR_EN "fuel level battery voltage correction enable" VALUE 0x0002038C __UBYTE_S 0 b_true 0 1 FORMAT "%1.0" /end CHARACTERISTIC
/begin CHARACTERISTIC SYS_C_FLV_VLT_COR "fuel level battery voltage correction" CURVE 0x000200B0 __UWORD_S 0 u_fac_2 0 1.999969482421875 FORMAT "%4.3" SYMBOL_LINK "SYS_C_FLV_VLT_COR" 2
 /begin AXIS_DESCR FIX_AXIS hw_bat_vlt u_volt_32 11 0 31.99951171875
  /begin FIX_AXIS_PAR_LIST 16384 18022 19660 21299 22937 24576 26214 27852 29491 31129 32768 /end FIX_AXIS_PAR_LIST
 /end AXIS_DESCR
/end CHARACTERISTIC
/begin CHARACTERISTIC SYS_C_FLV_PCT "fuel level percent" CURVE 0x000200B0 __UWORD_S 0 u_pct_1 0 99.9984741210937 FORMAT "%4.1" SYMBOL_LINK "SYS_C_FLV_PCT" 2
 /begin AXIS_DESCR COM_AXIS sys_flv_pct_raw u_pct_1 33 0 99.9984741210937 AXIS_PTS_REF SYS_X_FLV_PCT_RAW /end AXIS_DESCR
/end CHARACTERISTIC
/begin AXIS_PTS SYS_X_FLV_PCT_RAW "fuel level breakpoint" 0x0002006C sys_flv_pct_raw SSV__UWORD_S 0 u_pct_1 33 0 99.9984741210937 FORMAT "%4.2" DEPOSIT ABSOLUTE SYMBOL_LINK "SYS_X_FLV_PCT_RAW" 2 /end AXIS_PTS
/begin CHARACTERISTIC SYS_V_FLV_PCT_DFLT "fuel level percent default" VALUE 0x0002038C __UWORD_S 0 u_pct_1 0 99.9984741210937 FORMAT "%4.2" /end CHARACTERISTIC
/begin CHARACTERISTIC SYS_C_ESS_INC_FLT "engine speed signal increase filter" CURVE 0x000200B0 __UBYTE_S 0 u_filter_b 0 0.99609375 FORMAT "%4.3" SYMBOL_LINK "SYS_C_ESS_INC_FLT" 2
 /begin AXIS_DESCR FIX_AXIS sys_eng_spd u_espd 7 0 8191.875 /begin FIX_AXIS_PAR_LIST 0 3200 6400 9600 12800 19200 25600 /end FIX_AXIS_PAR_LIST /end AXIS_DESCR
/end CHARACTERISTIC
/begin CHARACTERISTIC SYS_C_ESS_DEC_FLT "engine speed signal decrease filter" CURVE 0x000200B0 __UBYTE_S 0 u_filter_b 0 0.99609375 FORMAT "%4.3" SYMBOL_LINK "SYS_C_ESS_DEC_FLT" 2
 /begin AXIS_DESCR FIX_AXIS sys_eng_spd u_espd 7 0 8191.875 /begin FIX_AXIS_PAR_LIST 0 3200 6400 9600 12800 19200 25600 /end FIX_AXIS_PAR_LIST /end AXIS_DESCR
/end CHARACTERISTIC
/begin CHARACTERISTIC SYS_V_ESS_TYP "engine speed signal type" VALUE 0x0002038C __UBYTE_S 0 u_ess_typ 0 2 FORMAT "%1.0" /end CHARACTERISTIC
/begin CHARACTERISTIC SYS_V_ESS_FREQ_FAC "engine speed signal frequency factor" VALUE 0x0002038C __UWORD_S 0 u_fac_2 0 1.999969482421875 FORMAT "%4.3" /end CHARACTERISTIC
/begin CHARACTERISTIC SYS_C_ECT_OUT_PWM "ect output pwm" CURVE 0x000200B0 __UWORD_S 0 u_pct 0 199.996948242187 SYMBOL_LINK "SYS_C_ECT_OUT_PWM" 2
 /begin AXIS_DESCR COM_AXIS sys_ect u_deg_C 17 -256 255.9921875 AXIS_PTS_REF SYS_X_ECT_B /end AXIS_DESCR
/end CHARACTERISTIC
/begin AXIS_PTS SYS_X_ECT_B "ect breakpoint" 0x0002006C sys_ect SSV__SWORD_S 0 u_deg_C 17 -256 255.9921875 FORMAT "%4.1" DEPOSIT ABSOLUTE SYMBOL_LINK "SYS_X_ECT_B" 2 /end AXIS_PTS
/begin CHARACTERISTIC SYS_V_ECT_OUT_FREQ "ect out signal frequency" VALUE 0x0002038C __UWORD_S 0 u_freq 0 16383.75 /end CHARACTERISTIC
/begin CHARACTERISTIC SYS_C_VSPD_FIL "vehicle speed filter" CURVE 0x000200B0 __UWORD_S 0 u_filter 0 0.9999847412109375 FORMAT "%4.3" SYMBOL_LINK "SYS_C_VSPD_FIL" 2
 /begin AXIS_DESCR FIX_AXIS sys_vspd_raw u_vspd 9 0 256 /begin FIX_AXIS_PAR_LIST 0 4096 8192 12288 16384 20480 24576 28672 32768 /end FIX_AXIS_PAR_LIST /end AXIS_DESCR
/end CHARACTERISTIC
/begin CHARACTERISTIC SYS_V_VSPD_K_A "vehicle speed calculate constant" VALUE 0x0002038C __UWORD_S 0 u_cnts 0 65535 FORMAT "%5.0" /end CHARACTERISTIC
/begin CHARACTERISTIC SYS_V_VSPD_K_B "vehicle speed calculate constant" VALUE 0x0002038C __UWORD_S 0 u_cnts 0 65535 FORMAT "%5.0" /end CHARACTERISTIC
/begin CHARACTERISTIC SYS_V_VSPD_K_C "vehicle speed calculate constant" VALUE 0x0002038C __UWORD_S 0 u_cnts 0 65535 FORMAT "%5.0" /end CHARACTERISTIC
/begin CHARACTERISTIC SYS_V_VSPD_K_D "vehicle speed calculate constant" VALUE 0x0002038C __UWORD_S 0 u_cnts 0 65535 FORMAT "%5.0" /end CHARACTERISTIC
/begin CHARACTERISTIC SYS_V_VSPD_K_E "vehicle speed calculate constant" VALUE 0x0002038C __UWORD_S 0 u_cnts 0 65535 FORMAT "%5.0" /end CHARACTERISTIC
/begin CHARACTERISTIC SYS_V_VSPD_DFLT "vehicle speed default" VALUE 0x0002038C __UWORD_S 0 u_vspd 0 511.992188 FORMAT "%4.1" /end CHARACTERISTIC
/begin CHARACTERISTIC SYS_V_BAT_VLT_FIL "battery voltage filter" VALUE 0x0002038C __UWORD_S 0 u_filter 0 0.9999847412109375 FORMAT "%4.3" /end CHARACTERISTIC
/begin CHARACTERISTIC SYS_V_MPR_VLT_FIL "main power relay voltage filter" VALUE 0x0002038C __UWORD_S 0 u_filter 0 0.9999847412109375 FORMAT "%4.3" /end CHARACTERISTIC
/begin CHARACTERISTIC SYS_V_TANK_P_FIL "tank press filter" VALUE 0x0002038C __UWORD_S 0 u_filter 0 0.9999847412109375 FORMAT "%4.3" /end CHARACTERISTIC
/begin CHARACTERISTIC SYS_V_ECO_DET_DUR "eco mode detect duration" VALUE 0x0002038C __UWORD_S 0 u_2x_tmr 0 1023.984375 /end CHARACTERISTIC
/begin CHARACTERISTIC SYS_V_ECO_REQ_INIT "eco request initial" VALUE 0x0002038C __UBYTE_S 0 b_true 0 1 FORMAT "%1.0" /end CHARACTERISTIC
/begin CHARACTERISTIC SYS_C_FLV_OUT "engine speed signal increase filter" CURVE 0x000200B0 __UWORD_S 0 u_pct 0 199.996948242187 FORMAT "%5.3" SYMBOL_LINK "SYS_C_FLV_OUT" 2
 /begin AXIS_DESCR FIX_AXIS sys_flv_pct_mmv u_pct_1 17 0 99.9984741210937
  /begin FIX_AXIS_PAR_LIST 0 4096 8192 12288 16384 20480 24576 28672 32768 36864 40960 45056 49152 53248 57344 61440 65535 /end FIX_AXIS_PAR_LIST
 /end AXIS_DESCR
/end CHARACTERISTIC
/begin CHARACTERISTIC SYS_V_AC_P_FIL "ac press filter" VALUE 0x0002038C __UWORD_S 0 u_filter 0 0.9999847412109375 FORMAT "%4.3" /end CHARACTERISTIC
/begin CHARACTERISTIC SYS_V_CLS_THRO_HI "close throttle thr hi" VALUE 0x0002038C __UWORD_S 0 u_pct 0 199.996948242187 FORMAT "%4.1" /end CHARACTERISTIC
/begin CHARACTERISTIC SYS_V_CLS_THRO_LO "close throttle thr lo" VALUE 0x0002038C __UWORD_S 0 u_pct 0 199.996948242187 FORMAT "%4.1" /end CHARACTERISTIC
/begin CHARACTERISTIC SYS_V_PS_ACTV_DLY "power steer active delay after power steer deactive" VALUE 0x0002038C __UWORD_S 0 u_2x_tmr 0 1023.984375 /end CHARACTERISTIC
/begin CHARACTERISTIC SYS_V_PS_ACTV_ESPD_HI "power steer active engine speed high" VALUE 0x0002038C __UWORD_S 0 u_espd 0 8191.875 FORMAT "%5.1" /end CHARACTERISTIC
/begin CHARACTERISTIC SYS_V_PS_ACTV_ESPD_LO "power steer active engine speed low" VALUE 0x0002038C __UWORD_S 0 u_espd 0 8191.875 FORMAT "%5.1" /end CHARACTERISTIC
/begin CHARACTERISTIC SYS_V_PS_ACTV_VSPD_HI "power steer active vehicle speed high" VALUE 0x0002038C __UWORD_S 0 u_vspd 0 511.992188 FORMAT "%5.1" /end CHARACTERISTIC
/begin CHARACTERISTIC SYS_V_PS_ACTV_VSPD_LO "power steer active vehicle speed low" VALUE 0x0002038C __UWORD_S 0 u_vspd 0 511.992188 FORMAT "%5.1" /end CHARACTERISTIC
/begin CHARACTERISTIC SYS_C_PS_ACTV_ECT "power steer active ect thr" CURVE 0x000200B0 __SWORD_S 0 u_deg_C -256 255.9921875 FORMAT "%4.1" SYMBOL_LINK "SYS_C_PS_ACTV_ECT" 2
 /begin AXIS_DESCR FIX_AXIS sys_keyon_ect u_deg_C 17 -40 120
  /begin FIX_AXIS_PAR_LIST -5120 -3840 -2560 -1280 0 1280 2560 3840 5120 6400 7680 8960 10240 11520 12800 14080 15360 /end FIX_AXIS_PAR_LIST
 /end AXIS_DESCR
/end CHARACTERISTIC
/begin CHARACTERISTIC SYS_C_PS_ACTV_RUN_MIN "power steer active runtime min" CURVE 0x000200B0 __UWORD_S 0 u_1s_tmr 0 65535 SYMBOL_LINK "SYS_C_PS_ACTV_RUN_MIN" 2
 /begin AXIS_DESCR FIX_AXIS sys_keyon_ect u_deg_C 17 -40 120
  /begin FIX_AXIS_PAR_LIST -5120 -3840 -2560 -1280 0 1280 2560 3840 5120 6400 7680 8960 10240 11520 12800 14080 15360 /end FIX_AXIS_PAR_LIST
 /end AXIS_DESCR
/end CHARACTERISTIC
/begin CHARACTERISTIC SYS_C_BST_T_HI "boost temp hi table" CURVE 0x000200B0 __SWORD_S 0 u_deg_C -256.0 255.9921875 SYMBOL_LINK "SYS_C_BST_T_HI" 2
 /begin AXIS_DESCR FIX_AXIS hw_bst_t_vlt u_ad_volt 21 4 5
  /begin FIX_AXIS_PAR_LIST 52428 53084 53739 54394 55050 55705 56360 57016 57671 58327 58982 59637 60293 60948 61603 62259 62914 63569 64225 64880 65536 /end FIX_AXIS_PAR_LIST
 /end AXIS_DESCR
/end CHARACTERISTIC
/begin CHARACTERISTIC SYS_C_BST_T_LO "IAT temp lo table" CURVE 0x000200B0 __SWORD_S 0 u_deg_C -256.0 255.9921875 SYMBOL_LINK "SYS_C_BST_T_LO" 2
 /begin AXIS_DESCR FIX_AXIS hw_bst_t_vlt u_ad_volt 17 0 4
  /begin FIX_AXIS_PAR_LIST 0 3276 6553 9830 13107 16384 19660 22937 26214 29491 32768 36044 39321 42598 45875 49152 52428 /end FIX_AXIS_PAR_LIST
 /end AXIS_DESCR
/end CHARACTERISTIC
/begin CHARACTERISTIC SYS_C_BST_MNFD_T_HI "boost temp hi table" CURVE 0x000200B0 __SWORD_S 0 u_deg_C -256.0 255.9921875 SYMBOL_LINK "SYS_C_BST_MNFD_T_HI" 2
 /begin AXIS_DESCR FIX_AXIS hw_bst_t_vlt u_ad_volt 21 4 5
  /begin FIX_AXIS_PAR_LIST 52428 53084 53739 54394 55050 55705 56360 57016 57671 58327 58982 59637 60293 60948 61603 62259 62914 63569 64225 64880 65536 /end FIX_AXIS_PAR_LIST
 /end AXIS_DESCR
/end CHARACTERISTIC
/begin CHARACTERISTIC SYS_C_BST_MNFD_T_LO "IAT temp lo table" CURVE 0x000200B0 __SWORD_S 0 u_deg_C -256.0 255.9921875 SYMBOL_LINK "SYS_C_BST_MNFD_T_LO" 2
 /begin AXIS_DESCR FIX_AXIS hw_bst_t_vlt u_ad_volt 17 0 4
  /begin FIX_AXIS_PAR_LIST 0 3276 6553 9830 13107 16384 19660 22937 26214 29491 32768 36044 39321 42598 45875 49152 52428 /end FIX_AXIS_PAR_LIST
 /end AXIS_DESCR
/end CHARACTERISTIC
/begin CHARACTERISTIC SYS_V_IAT_USE_BST_EN_RT "iat use boost temp enable ratio max" VALUE 0x0002038C __UWORD_S 0 u_fac_8 0 7.9998779296875 FORMAT "%4.3" /end CHARACTERISTIC
/begin CHARACTERISTIC SYS_V_IAT_USE_BST_EN_DLY "iat use boost temp enable delay" VALUE 0x0002038C __UWORD_S 0 u_2x_tmr 0 1023.984375 /end CHARACTERISTIC
/begin CHARACTERISTIC SYS_V_IAT_USE_BST_FIL "IAT filter" VALUE 0x0002038C __UWORD_S 0 u_filter 0 0.9999847412109375 FORMAT "%10.9" /end CHARACTERISTIC
/begin CHARACTERISTIC SYS_V_BST_T_FIL "boost temp filter" VALUE 0x0002038C __UWORD_S 0 u_filter 0 0.9999847412109375 FORMAT "%10.9" /end CHARACTERISTIC
/begin CHARACTERISTIC SYS_C_PS_ACTV_P_HI "power steer active press high" CURVE 0x000200B0 __UWORD_S 0 u_kPa_0_32768 0 32767.5 SYMBOL_LINK "SYS_C_PS_ACTV_P_HI" 2
 /begin AXIS_DESCR FIX_AXIS sys_ect u_deg_C 17 -40 120
  /begin FIX_AXIS_PAR_LIST -5120 -3840 -2560 -1280 0 1280 2560 3840 5120 6400 7680 8960 10240 11520 12800 14080 15360 /end FIX_AXIS_PAR_LIST
 /end AXIS_DESCR
/end CHARACTERISTIC
/begin CHARACTERISTIC SYS_C_PS_ACTV_P_LO "power steer active press low" CURVE 0x000200B0 __UWORD_S 0 u_kPa_0_32768 0 32767.5 SYMBOL_LINK "SYS_C_PS_ACTV_P_LO" 2
 /begin AXIS_DESCR FIX_AXIS sys_ect u_deg_C 17 -40 120
  /begin FIX_AXIS_PAR_LIST -5120 -3840 -2560 -1280 0 1280 2560 3840 5120 6400 7680 8960 10240 11520 12800 14080 15360 /end FIX_AXIS_PAR_LIST
 /end AXIS_DESCR
/end CHARACTERISTIC
/begin CHARACTERISTIC SYS_V_PS_ACTV_I_HI "power steer active current high" VALUE 0x0002038C __UWORD_S 0 u_amp 0 127.998046875 /end CHARACTERISTIC
/begin CHARACTERISTIC SYS_V_PS_ACTV_I_LO "power steer active current high" VALUE 0x0002038C __UWORD_S 0 u_amp 0 127.998046875 /end CHARACTERISTIC
/begin CHARACTERISTIC SYS_V_PS_P_SNSR_K "power steer press sensor conversion K,base on P=K*(sensor volt/5v)+B" VALUE 0x0002038C __UWORD_S 0 u_kPa_0_32768 0 32767.5 FORMAT "%5.1" /end CHARACTERISTIC
/begin CHARACTERISTIC SYS_V_PS_P_SNSR_B "power steer press sensor conversion B,base on P=K*(sensor volt/5v)+B" VALUE 0x0002038C __UWORD_S 0 u_kPa_4096n_4096p 0 32767.5 SYMBOL_LINK "SYS_V_PS_P_SNSR_B" 2 /end CHARACTERISTIC
/begin CHARACTERISTIC SYS_V_PS_P_FIL "power steer press filter" VALUE 0x0002038C __UWORD_S 0 u_filter 0 0.9999847412109375 FORMAT "%10.9" /end CHARACTERISTIC
/begin CHARACTERISTIC SYS_V_PS_P_DLT_FIL "power steer press delta filter" VALUE 0x0002038C __UWORD_S 0 u_filter 0 0.9999847412109375 FORMAT "%10.9" /end CHARACTERISTIC
/begin CHARACTERISTIC SYS_V_PS_ON_TRS_DUR "power steer active transient duration" VALUE 0x0002038C __UWORD_S 0 u_2x_tmr 0 1023.984375 /end CHARACTERISTIC
/begin CHARACTERISTIC SYS_V_PS_OFF_TRS_DUR "power steer deactive transient duration" VALUE 0x0002038C __UWORD_S 0 u_2x_tmr 0 1023.984375 /end CHARACTERISTIC
/begin CHARACTERISTIC SYS_V_BRK_P_SNSR_K "break p sensor conversion K,base on P=K*(sensor volt/5v)+B" VALUE 0x0002038C __SWORD_S 0 u_kPa_512n_512p -512 511.984375 /end CHARACTERISTIC
/begin CHARACTERISTIC SYS_V_BRK_P_SNSR_B "break p sensor conversion B,base on P=K*(sensor volt/5v)+B" VALUE 0x0002038C __SWORD_S 0 u_kPa_128n_128p -128 127.99609375 SYMBOL_LINK "SYS_V_BRK_P_SNSR_B" 2 /end CHARACTERISTIC
/begin CHARACTERISTIC SYS_V_CAN_BRK_P "break press from can" VALUE 0x0002038C __UBYTE_S 0 b_true 0 1 FORMAT "%1.0" /end CHARACTERISTIC
/begin CHARACTERISTIC SYS_V_BRK_P_DFLT "break press default" VALUE 0x0002038C __UWORD_S 0 u_kPa_0_256 0 255.99609375 FORMAT "%10.9" /end CHARACTERISTIC
/begin CHARACTERISTIC SYS_V_BRK_P_TYP "break press type" VALUE 0x0002038C __UBYTE_S 0 u_brk_p_typ 0 2 FORMAT "%1.0" /end CHARACTERISTIC
/begin CHARACTERISTIC SYS_V_ST_RLY_STAT_CFG "starter relay state config" VALUE 0x0002038C __UBYTE_S 0 u_st_rly_cfg 0 2 FORMAT "%1.0" /end CHARACTERISTIC
/begin CHARACTERISTIC SYS_M_BLWR_ST_THR "analog blower state thr" MAP 0x00020320 __UWORD_S 0 u_pct_1 0 99.9984741210937 FORMAT "%4.2"
 /begin AXIS_DESCR FIX_AXIS NO_INPUT_QUANTITY u_cnts 5 0 4 /begin FIX_AXIS_PAR_LIST 0 1 2 3 4 /end FIX_AXIS_PAR_LIST /end AXIS_DESCR
 /begin AXIS_DESCR FIX_AXIS NO_INPUT_QUANTITY u_cnts 2 0 1 /begin FIX_AXIS_PAR_LIST 0 1 /end FIX_AXIS_PAR_LIST /end AXIS_DESCR
/end CHARACTERISTIC
/begin CHARACTERISTIC SYS_V_BLWR_CHG_DLY "blower state change delay" VALUE 0x0002038C __UBYTE_S 0 u_2x_tmr 0 3.984375 FORMAT "%4.3" /end CHARACTERISTIC
/begin CHARACTERISTIC SYS_V_ESPD_ACC_DLT_T "engine speed acceleraion calculation delta time,must mult by 15.6ms" VALUE 0x0002038C __UWORD_S 0 u_2x_tmr 0 1023.984375 /end CHARACTERISTIC
/begin CHARACTERISTIC SYS_V_EST_CLTCH_EN "use declutch calculate" VALUE 0x0002038C __UBYTE_S 0 b_true 0 1 FORMAT "%1.0" /end CHARACTERISTIC
/begin CHARACTERISTIC SYS_V_CLTCH_ON_SPD_INC_MIN "declutch active engine speed increase min" VALUE 0x0002038C __UWORD_S 0 u_espd 0 8191.875 FORMAT "%5.1" /end CHARACTERISTIC
/begin CHARACTERISTIC SYS_V_CLTCH_ON_SPD_ACC_MIN "declutch active engine speed accelaration min" VALUE 0x0002038C __UWORD_S 0 u_espd_acc 0 32767.5 /end CHARACTERISTIC
/begin CHARACTERISTIC SYS_V_CLTCH_ON_ECT_MIN "declutch active engine speed ect min" VALUE 0x0002038C __SWORD_S 0 u_deg_C -256.000000 255.9921875 FORMAT "%4.1" /end CHARACTERISTIC
/begin CHARACTERISTIC SYS_V_CLTCH_EST_DUR_MAX "max duration for declutch detection after close throttle" VALUE 0x0002038C __UWORD_S 0 u_2x_tmr 0 1023.984375 /end CHARACTERISTIC
/begin CHARACTERISTIC SYS_V_CLTCH_ON_DLY "declutch active delay after condtions met" VALUE 0x0002038C __UWORD_S 0 u_2x_tmr 0 1023.984375 /end CHARACTERISTIC
/begin CHARACTERISTIC SYS_V_CLTCH_ON_DUR "declutch active duration" VALUE 0x0002038C __UWORD_S 0 u_2x_tmr 0 1023.984375 /end CHARACTERISTIC
/begin CHARACTERISTIC SYS_V_ACC_VLT_FIL "acc voltage filter" VALUE 0x0002038C __UWORD_S 0 u_filter 0 0.9999847412109375 FORMAT "%10.9" /end CHARACTERISTIC
/begin CHARACTERISTIC SYS_V_ACC_OFF_DLY "acc off delay" VALUE 0x0002038C __UWORD_S 0 u_1x_tmr 0 511.9921875 FORMAT "%5.2" /end CHARACTERISTIC
/begin CHARACTERISTIC SYS_V_WSPD_TYP "break press type" VALUE 0x0002038C __UBYTE_S 0 u_wspd_typ 0 3 FORMAT "%1.0" /end CHARACTERISTIC
/begin CHARACTERISTIC SYS_V_ALT_DTY_INC_FIL "alter duty increase filter" VALUE 0x0002038C __UWORD_S 0 u_filter 0 0.9999847412109375 FORMAT "%10.9" /end CHARACTERISTIC
/begin CHARACTERISTIC SYS_V_ALT_DTY_DEC_FIL "alter duty decrease filter" VALUE 0x0002038C __UWORD_S 0 u_filter 0 0.9999847412109375 FORMAT "%10.9" /end CHARACTERISTIC
/begin CHARACTERISTIC SYS_V_KEY_OFF_DLY "key off delay" VALUE 0x0002038C __UWORD_S 0 u_1x_tmr 0 511.9921875 FORMAT "%5.2" /end CHARACTERISTIC
/begin CHARACTERISTIC SYS_V_TRS_OIL_T_DFLT "trans oil temp default" VALUE 0x0002038C __SWORD_S 0 u_deg_C -256 255.9921875 FORMAT "%4.2" /end CHARACTERISTIC
/begin CHARACTERISTIC SYS_V_TRS_CLD_THR_LO "trans cold oil temp thr low" VALUE 0x0002038C __SWORD_S 0 u_deg_C -256 255.9921875 FORMAT "%4.2" /end CHARACTERISTIC
/begin CHARACTERISTIC SYS_V_TRS_CLD_THR_HI "trans cold oil temp thr high" VALUE 0x0002038C __SWORD_S 0 u_deg_C -256 255.9921875 FORMAT "%4.2" /end CHARACTERISTIC
/begin CHARACTERISTIC SYS_C_F_IDL_PPS "force idle mode pedal position" CURVE 0x000200B0 __UWORD_S 0 u_pct 0.0 199.996948 SYMBOL_LINK "SYS_C_F_IDL_PPS" 2
 /begin AXIS_DESCR FIX_AXIS sys_veh_spd u_vspd 17 0 80
  /begin FIX_AXIS_PAR_LIST 0 640 1280 1920 2560 3200 3840 4480 5120 5760 6400 7040 7680 8320 8960 9600 10240 /end FIX_AXIS_PAR_LIST
 /end AXIS_DESCR
/end CHARACTERISTIC
/begin CHARACTERISTIC SYS_C_F_IDL_PPS_R "force idle mode pedal position" CURVE 0x000200B0 __SWORD_S 0 u_pct_s -200 199.993896484375 SYMBOL_LINK "SYS_C_F_IDL_PPS_R" 2
 /begin AXIS_DESCR FIX_AXIS sys_veh_spd u_vspd 17 0 80
  /begin FIX_AXIS_PAR_LIST 0 640 1280 1920 2560 3200 3840 4480 5120 5760 6400 7040 7680 8320 8960 9600 10240 /end FIX_AXIS_PAR_LIST
 /end AXIS_DESCR
/end CHARACTERISTIC
/begin CHARACTERISTIC SYS_V_TPS_SCAL_FAC "factor of scaled tps" VALUE 0x0002038C __UWORD_S 0 u_fac_2p56 0 2.5599609375 FORMAT "%3.2" /end CHARACTERISTIC
/begin CHARACTERISTIC SYS_V_TPS_MIN_DFLT "TPS min default" VALUE 0x0002038C __UWORD_S 0 u_pct 0 199.996948242187 FORMAT "%4.1" /end CHARACTERISTIC
/begin CHARACTERISTIC SYS_V_TPS1_ZERO_MAX "TPS1 zero position max" VALUE 0x0002038C __UWORD_S 0 u_pct 0 199.996948242187 FORMAT "%4.1" SYMBOL_LINK "SYS_M_TPS_ZERO_LMT" 0 /end CHARACTERISTIC
/begin CHARACTERISTIC SYS_V_TPS1_ZERO_MIN "TPS1 zero position min" VALUE 0x0002038C __UWORD_S 0 u_pct 0 199.996948242187 FORMAT "%4.1" SYMBOL_LINK "SYS_M_TPS_ZERO_LMT" 2 /end CHARACTERISTIC
/begin CHARACTERISTIC SYS_V_TPS2_ZERO_MAX "TPS2 zero position max" VALUE 0x0002038C __UWORD_S 0 u_pct 0 199.996948242187 FORMAT "%4.1" SYMBOL_LINK "SYS_M_TPS_ZERO_LMT" 4 /end CHARACTERISTIC
/begin CHARACTERISTIC SYS_V_TPS2_ZERO_MIN "TPS2 zero position min" VALUE 0x0002038C __UWORD_S 0 u_pct 0 199.996948242187 FORMAT "%4.1" SYMBOL_LINK "SYS_M_TPS_ZERO_LMT" 6 /end CHARACTERISTIC
/begin CHARACTERISTIC SYS_V_TPS_ZERO_BIAS "TPS zero initial bias" VALUE 0x0002038C __UWORD_S 0 u_ad_volt_lo 0 9.999847412109375 FORMAT "%4.3" /end CHARACTERISTIC
/begin CHARACTERISTIC SYS_V_TPS_DFLT "TPS1 zero position max" VALUE 0x0002038C __UWORD_S 0 u_pct 0 199.996948242187 FORMAT "%4.1" /end CHARACTERISTIC
/begin CHARACTERISTIC SYS_V_TPS_LRN_FIL "tps position learn down filter" VALUE 0x0002038C __UWORD_S 0 u_filter 0 0.9999847412109375 FORMAT "%10.9" /end CHARACTERISTIC
/begin CHARACTERISTIC SYS_V_TPS_LRN_DUR_MAX "tps learn duration max" VALUE 0x0002038C __UWORD_S 0 u_2x_tmr 0 1023.984375 /end CHARACTERISTIC
/begin CHARACTERISTIC SYS_V_THRO_MOT_VLT_DCY "throttle motor voltage decay step for tps noise thr cal" VALUE 0x0002038C __UWORD_S 0 u_volt_32 0 31.99951171875 FORMAT "%4.2" /end CHARACTERISTIC
/begin CHARACTERISTIC SYS_C_TPS_NOIS_THR "tps noise detect thr" CURVE 0x000200B0 __UWORD_S 0 u_tps_d_abs 0 4095.9375 SYMBOL_LINK "SYS_C_TPS_NOIS_THR" 2
 /begin AXIS_DESCR FIX_AXIS sys_tps_nois_mot_vlt u_volt_32 6 0 15 /begin FIX_AXIS_PAR_LIST 0 6144 12288 18432 24576 30720 /end FIX_AXIS_PAR_LIST /end AXIS_DESCR
/end CHARACTERISTIC
/begin CHARACTERISTIC SYS_V_TPS_SS_THR "tps steady thr" VALUE 0x0002038C __UWORD_S 0 u_tps_d_abs 0 4095.9375 /end CHARACTERISTIC
/begin CHARACTERISTIC SYS_V_TPS_SS_DUR "tps steady duration min" VALUE 0x0002038C __UWORD_S 0 u_2x_tmr 0 1023.984375 /end CHARACTERISTIC
/begin CHARACTERISTIC SYS_V_TPS_LRN_ESPD_MIN "tps zero learn enable engine speed min" VALUE 0x0002038C __UWORD_S 0 u_espd 0 8191.875 FORMAT "%5.1" /end CHARACTERISTIC
/begin CHARACTERISTIC SYS_V_TPS_LRN_DB "TPS zero position learn deadband" VALUE 0x0002038C __UWORD_S 0 u_pct_1 0 99.9984741210937 FORMAT "%4.2" /end CHARACTERISTIC
/begin CHARACTERISTIC SYS_V_FUEL_DENSTY "gasoline density" VALUE 0x0002038C __UWORD_S 0 u_fuel_density 0 0.9999847412109375 FORMAT "%5.4" /end CHARACTERISTIC
/begin CHARACTERISTIC SYS_M_MDL_OIL_P "model oil press" MAP 0x36504 __UWORD_S 0 u_kPa_0_1024 0 1023.984375 FORMAT "%5.1" SYMBOL_LINK "SYS_M_MDL_OIL_P" 4
 /begin AXIS_DESCR COM_AXIS sys_eng_spd u_espd 7 0.000000 8191.875000 AXIS_PTS_REF SYS_X_ESPD_C /end AXIS_DESCR
 /begin AXIS_DESCR COM_AXIS sys_oil_t u_deg_C 5 -256.000000 255.9921875 AXIS_PTS_REF SYS_X_OIL_T_A /end AXIS_DESCR
/end CHARACTERISTIC
/begin AXIS_PTS SYS_X_ESPD_C "engine speed breakpoint" 0x0002006C sys_eng_spd SSV__UWORD_S 0 u_espd 7 0.000000 8191.875000 FORMAT "%5.1" DEPOSIT ABSOLUTE SYMBOL_LINK "SYS_X_ESPD_C" 2 /end AXIS_PTS
/begin AXIS_PTS SYS_X_OIL_T_A "oil temperature breakpoint" 0x0002006C sys_oil_t SSV__SWORD_S 0 u_deg_C 5 -256.000000 255.9921875 FORMAT "%4.1" DEPOSIT ABSOLUTE SYMBOL_LINK "SYS_X_OIL_T_A" 2 /end AXIS_PTS
/begin CHARACTERISTIC SYS_V_VVT_OIL_DRP_FAC "oil press drop factor because vvt move" VALUE 0x0002038C __UWORD_S 0 u_fac_2 0 1.999969482421875 FORMAT "%5.4" /end CHARACTERISTIC
/begin CHARACTERISTIC SYS_V_OIL_HP_SW_HI "oil high press switch high active" VALUE 0x0002038C __UBYTE_S 0 b_true 0 1 FORMAT "%1.0" /end CHARACTERISTIC
/begin CHARACTERISTIC SYS_V_FLV_DFLT "fuel level default" VALUE 0x0002038C __UWORD_S 0 u_pct_1 0 99.9984741210937 FORMAT "%4.2" /end CHARACTERISTIC
/begin CHARACTERISTIC SYS_V_FLV_RUN_FIL "engine run state fuel level filter" VALUE 0x0002038C __UWORD_S 0 u_filter 0 0.9999847412109375 FORMAT "%5.4" /end CHARACTERISTIC
/begin CHARACTERISTIC SYS_V_FLV_STOP_FIL "engine stop state fuel level filter" VALUE 0x0002038C __UWORD_S 0 u_filter 0 0.9999847412109375 FORMAT "%5.4" /end CHARACTERISTIC
/begin CHARACTERISTIC SYS_V_FLV_REFUEL_FAC "refuel detect fuel level delta" VALUE 0x0002038C __UWORD_S 0 u_pct_1 0 99.9984741210937 FORMAT "%4.2" /end CHARACTERISTIC
/begin CHARACTERISTIC SYS_V_REFL_RUN_CHK_DLY "refuel check delay" VALUE 0x0002038C __UWORD_S 0 u_16x_tmr 0 8191.875 /end CHARACTERISTIC
/begin CHARACTERISTIC SYS_V_REFUEL_STRT_DLY "refuel start confirm delay" VALUE 0x0002038C __UWORD_S 0 u_16x_tmr 0 8191.875 /end CHARACTERISTIC
/begin CHARACTERISTIC SYS_V_REFUEL_VSPD_MAX "refuel start confirm vehicle speed max" VALUE 0x0002038C __UWORD_S 0 u_vspd 0 511.992188 FORMAT "%4.1" /end CHARACTERISTIC
/begin CHARACTERISTIC SYS_V_REFUEL_TANK_VAC_MAX "refuel start confirm tank vacuum max" VALUE 0x0002038C __SWORD_S 0 u_kPa_8n_8p -8 7.999755859375 FORMAT "%4.3" /end CHARACTERISTIC
/begin CHARACTERISTIC SYS_V_REFL_KEYON_CHK_DLY "refuel keyon check delay" VALUE 0x0002038C __UWORD_S 0 u_16x_tmr 0 8191.875 /end CHARACTERISTIC
/begin CHARACTERISTIC SYS_V_FLV_STBL_DLY "fuel level stable delay" VALUE 0x0002038C __UWORD_S 0 u_16x_tmr 0 8191.875 /end CHARACTERISTIC
/begin CHARACTERISTIC SYS_V_REFUEL_FLV_FIL "refuel check fuel level filter" VALUE 0x0002038C __UWORD_S 0 u_filter 0 0.9999847412109375 FORMAT "%5.4" /end CHARACTERISTIC
/begin CHARACTERISTIC SYS_V_CRU_VSPD_CFG "cruise vehicle speed input config" VALUE 0x0002038C __UBYTE_S 0 u_cru_vss_cfg 0 3 FORMAT "%1.0" /end CHARACTERISTIC
/begin CHARACTERISTIC SYS_V_CRU_VSPD_K "cruise vehicle speed gain" VALUE 0x0002038C __UWORD_S 0 u_pct 0 199.996948 /end CHARACTERISTIC
/begin CHARACTERISTIC SYS_V_CRU_VSPD_BIAS "cruise vehicle speed bias" VALUE 0x0002038C __UWORD_S 0 u_vspd 0 511.992188 /end CHARACTERISTIC
/begin CHARACTERISTIC SYS_C_CRU_VSPD_FIL "cruise vehicle speed filter" CURVE 0x000200B0 __UWORD_S 0 u_filter 0 0.9999847412109375 FORMAT "%5.4" SYMBOL_LINK "SYS_C_CRU_VSPD_FIL" 2
 /begin AXIS_DESCR COM_AXIS sys_cru_vspd u_vspd 9 0 511.992188 AXIS_PTS_REF SYS_X_CRU_VSPD_A /end AXIS_DESCR
/end CHARACTERISTIC
/begin CHARACTERISTIC SYS_C_CRU_VSPD_ACC_MAX "cruise vehicle speed acceleration max" CURVE 0x000200B0 __UBYTE_S 0 u_acc_b 0 63.75 SYMBOL_LINK "SYS_C_CRU_VSPD_ACC_MAX" 2
 /begin AXIS_DESCR COM_AXIS sys_cru_vspd u_vspd 9 0 511.992188 AXIS_PTS_REF SYS_X_CRU_VSPD_A /end AXIS_DESCR
/end CHARACTERISTIC
/begin CHARACTERISTIC SYS_C_CRU_VSPD_DCL_MAX "cruise vehicle speed deceleration max" CURVE 0x000200B0 __UBYTE_S 0 u_acc_b 0 63.75 SYMBOL_LINK "SYS_C_CRU_VSPD_DCL_MAX" 2
 /begin AXIS_DESCR COM_AXIS sys_cru_vspd u_vspd 9 0 511.992188 AXIS_PTS_REF SYS_X_CRU_VSPD_A /end AXIS_DESCR
/end CHARACTERISTIC
/begin AXIS_PTS SYS_X_CRU_VSPD_A "cruise vehicle speed breakpoint" 0x0002006C sys_cru_vspd SSV__UWORD_S 0 u_vspd 9 0 511.992188 FORMAT "%4.1" DEPOSIT ABSOLUTE SYMBOL_LINK "SYS_X_CRU_VSPD_A" 2 /end AXIS_PTS
/begin CHARACTERISTIC SYS_V_CRU_VSPD_ACC_FIL "cruise vehicle speed acceleration filter" VALUE 0x0002038C __UWORD_S 0 u_filter 0 0.9999847412109375 FORMAT "%5.4" /end CHARACTERISTIC
/begin CHARACTERISTIC SYS_V_CRU_CNCL_VLT_MIN "cruise cancel switch voltage min" VALUE 0x0002038C __UWORD_S 0 u_volt_32 0 31.99951171875 FORMAT "%4.2" /end CHARACTERISTIC
/begin CHARACTERISTIC SYS_V_CRU_CNCL_VLT_MAX "cruise cancel switch voltage max" VALUE 0x0002038C __UWORD_S 0 u_volt_32 0 31.99951171875 FORMAT "%4.2" /end CHARACTERISTIC
/begin CHARACTERISTIC SYS_V_CRU_RES_VLT_MIN "cruise resume switch voltage min" VALUE 0x0002038C __UWORD_S 0 u_volt_32 0 31.99951171875 FORMAT "%4.2" /end CHARACTERISTIC
/begin CHARACTERISTIC SYS_V_RES_CNCL_VLT_MAX "cruise resume switch voltage max" VALUE 0x0002038C __UWORD_S 0 u_volt_32 0 31.99951171875 FORMAT "%4.2" /end CHARACTERISTIC
/begin CHARACTERISTIC SYS_V_CRU_SET_VLT_MIN "cruise set switch voltage min" VALUE 0x0002038C __UWORD_S 0 u_volt_32 0 31.99951171875 FORMAT "%4.2" /end CHARACTERISTIC
/begin CHARACTERISTIC SYS_V_CRU_SET_VLT_MAX "cruise set switch voltage max" VALUE 0x0002038C __UWORD_S 0 u_volt_32 0 31.99951171875 FORMAT "%4.2" /end CHARACTERISTIC
/begin CHARACTERISTIC SYS_V_CRU_OFF_VLT_MIN "cruise off voltage min" VALUE 0x0002038C __UWORD_S 0 u_volt_32 0 31.99951171875 FORMAT "%4.2" /end CHARACTERISTIC
/begin CHARACTERISTIC SYS_V_CRU_OFF_VLT_MAX "cruise off switch voltage max" VALUE 0x0002038C __UWORD_S 0 u_volt_32 0 31.99951171875 FORMAT "%4.2" /end CHARACTERISTIC
/begin CHARACTERISTIC SYS_V_CRU_UNUSE_VLT_MIN "cruise unuse switch voltage min" VALUE 0x0002038C __UWORD_S 0 u_volt_32 0 31.99951171875 FORMAT "%4.2" /end CHARACTERISTIC
/begin CHARACTERISTIC SYS_V_CRU_UNUSE_VLT_MAX "cruise unuse switch voltage max" VALUE 0x0002038C __UWORD_S 0 u_volt_32 0 31.99951171875 FORMAT "%4.2" /end CHARACTERISTIC
/begin CHARACTERISTIC SYS_V_CRU_DIST_VLT_MIN "cruise distance switch voltage min" VALUE 0x0002038C __UWORD_S 0 u_volt_32 0 31.99951171875 FORMAT "%4.2" /end CHARACTERISTIC
/begin CHARACTERISTIC SYS_V_CRU_DIST_VLT_MAX "cruise distance switch voltage max" VALUE 0x0002038C __UWORD_S 0 u_volt_32 0 31.99951171875 FORMAT "%4.2" /end CHARACTERISTIC
/begin CHARACTERISTIC SYS_V_CRU_MAIN_VLT_MIN "cruise main switch voltage min" VALUE 0x0002038C __UWORD_S 0 u_volt_32 0 31.99951171875 FORMAT "%4.2" /end CHARACTERISTIC
/begin CHARACTERISTIC SYS_V_CRU_MAIN_VLT_MAX "cruise main switch voltage max" VALUE 0x0002038C __UWORD_S 0 u_volt_32 0 31.99951171875 FORMAT "%4.2" /end CHARACTERISTIC
/begin CHARACTERISTIC SYS_V_VSPD_LMT_VLT_MIN "vehicle speed limit switch voltage min" VALUE 0x0002038C __UWORD_S 0 u_volt_32 0 31.99951171875 FORMAT "%4.2" /end CHARACTERISTIC
/begin CHARACTERISTIC SYS_V_VSPD_LMT_VLT_MAX "vehicle speed limit switch voltage max" VALUE 0x0002038C __UWORD_S 0 u_volt_32 0 31.99951171875 FORMAT "%4.2" /end CHARACTERISTIC
/begin CHARACTERISTIC SYS_V_CRU_FLT_DIS_SW "cruise fault disable cruise switch" VALUE 0x0002038C __UBYTE_S 0 b_true 0 1 FORMAT "%1.0" /end CHARACTERISTIC
/begin CHARACTERISTIC SYS_V_CRU_BY_CAN "cruise switch use can" VALUE 0x0002038C __UBYTE_S 0 b_true 0 1 FORMAT "%1.0" /end CHARACTERISTIC
/begin CHARACTERISTIC SYS_V_CAN_VSPD_LMT_TYP "can vehicle speed limit switch type" VALUE 0x0002038C __UBYTE_S 0 u_can_lmt_sw_typ 0 1 FORMAT "%1.0" /end CHARACTERISTIC
/begin CHARACTERISTIC SYS_V_CRU_ON_DLY "cruise on switch on off delay" VALUE 0x0002038C __UBYTE_S 0 u_cnts 0 255 /end CHARACTERISTIC
/begin CHARACTERISTIC SYS_V_VLMT_ON_DLY "speed limit switch on off delay" VALUE 0x0002038C __UBYTE_S 0 u_cnts 0 255 /end CHARACTERISTIC
/begin CHARACTERISTIC SYS_V_CRU_SET_ON_DLY "cruise set switch on off delay" VALUE 0x0002038C __UBYTE_S 0 u_cnts 0 255 /end CHARACTERISTIC
/begin CHARACTERISTIC SYS_V_CRU_RES_ON_DLY "cruise resume switch on off delay" VALUE 0x0002038C __UBYTE_S 0 u_cnts 0 255 /end CHARACTERISTIC
/begin CHARACTERISTIC SYS_V_CRU_CNCL_ON_DLY "cruise cancel switch on off delay" VALUE 0x0002038C __UBYTE_S 0 u_cnts 0 255 /end CHARACTERISTIC
/begin CHARACTERISTIC SYS_V_CRU_DIST_ON_DLY "cruise distance switch on off delay" VALUE 0x0002038C __UBYTE_S 0 u_cnts 0 255 /end CHARACTERISTIC
/begin CHARACTERISTIC SYS_V_CRU_SW_EN_MIN "cruise switch active enable voltage min" VALUE 0x0002038C __UWORD_S 0 u_volt_32 0 31.99951171875 FORMAT "%4.2" /end CHARACTERISTIC
/begin CHARACTERISTIC SYS_V_CRU_SW_EN_MAX "cruise switch active enable voltage max" VALUE 0x0002038C __UWORD_S 0 u_volt_32 0 31.99951171875 FORMAT "%4.2" /end CHARACTERISTIC
/begin CHARACTERISTIC SYS_M_RR_G_SNSR_THR "G sensor rough road detect thr" MAP 0x00020320 __UWORD_S 0 u_fac_2 0 1.999969482421875 FORMAT "%5.4" SYMBOL_LINK "SYS_M_RR_G_SNSR_THR" 4
 /begin AXIS_DESCR FIX_AXIS sys_rr_avg_espd u_espd 8 0 3500 /begin FIX_AXIS_PAR_LIST 0 4000 8000 12000 16000 20000 24000 28000 /end FIX_AXIS_PAR_LIST /end AXIS_DESCR
 /begin AXIS_DESCR FIX_AXIS sys_rr_avg_load u_pct_1 9 0 100 /begin FIX_AXIS_PAR_LIST 0 8192 16384 24576 32768 40960 49152 57344 65535 /end FIX_AXIS_PAR_LIST /end AXIS_DESCR
/end CHARACTERISTIC
/begin CHARACTERISTIC SYS_V_RR_DET_DLY "rough road detect delay" VALUE 0x0002038C __UWORD_S 0 u_1s_tmr 0 65535 /end CHARACTERISTIC
/begin CHARACTERISTIC SYS_V_RR_SNSR_G_DLT_MAX "rough road G sensor accelerometer delta max" VALUE 0x0002038C __SWORD_S 0 u_grav -8 7.999755859375 /end CHARACTERISTIC
/begin CHARACTERISTIC SYS_V_RR_SNSR_G_FIL "rough road sensor G filter" VALUE 0x0002038C __UWORD_S 0 u_filter 0 0.9999847412109375 FORMAT "%5.4" /end CHARACTERISTIC
/begin CHARACTERISTIC SYS_M_RR_WSS_THR "wheel speed sensor rough road detect thr" MAP 0x00020320 __UWORD_S 0 u_fac_2 0 1.999969482421875 FORMAT "%5.4" SYMBOL_LINK "SYS_M_RR_WSS_THR" 4
 /begin AXIS_DESCR FIX_AXIS sys_veh_spd u_vspd 9 0 256 /begin FIX_AXIS_PAR_LIST 0 4096 8192 12288 16384 20480 24576 28672 32768 /end FIX_AXIS_PAR_LIST /end AXIS_DESCR
 /begin AXIS_DESCR FIX_AXIS mf_eng_load u_pct_1 9 0 100 /begin FIX_AXIS_PAR_LIST 0 8192 16384 24576 32768 40960 49152 57344 65535 /end FIX_AXIS_PAR_LIST /end AXIS_DESCR
/end CHARACTERISTIC
/begin CHARACTERISTIC SYS_V_RR_WSS_LOG_CNTS "wheel speed sensor rough road detect log counts" VALUE 0x0002038C __UWORD_S 0 u_cnts 0 65535 FORMAT "%5.0" /end CHARACTERISTIC
/begin CHARACTERISTIC SYS_C_RR_WSS_G_DLT_MIN "wheel speed sensor rough road G delta min" CURVE 0x000200B0 __UWORD_S 0 u_grav_0_64 0 63.9990234375 FORMAT "%4.2" SYMBOL_LINK "SYS_C_RR_WSS_G_DLT_MIN" 2
 /begin AXIS_DESCR FIX_AXIS sys_vspd_pred u_vspd 9 0 256 /begin FIX_AXIS_PAR_LIST 0 4096 8192 12288 16384 20480 24576 28672 32768 /end FIX_AXIS_PAR_LIST /end AXIS_DESCR
/end CHARACTERISTIC
/begin CHARACTERISTIC SYS_V_RR_ABS_EN_LD_MIN "rough road detect use ABS enable load min" VALUE 0x0002038C __UWORD_S 0 u_pct_1 0 99.9984741210937 FORMAT "%4.2" /end CHARACTERISTIC
/begin CHARACTERISTIC SYS_V_RR_ABS_EN_ESPD_MIN "rough road detect use ABS enable engine speed min" VALUE 0x0002038C __UWORD_S 0 u_espd 0 8191.875 FORMAT "%5.1" /end CHARACTERISTIC
/begin CHARACTERISTIC SYS_C_RR_ABS_THR "ABS rough road detect thr" CURVE 0x000200B0 __UWORD_S 0 u_fac_2 0 1.999969482421875 FORMAT "%5.4" SYMBOL_LINK "SYS_C_RR_ABS_THR" 2
 /begin AXIS_DESCR FIX_AXIS sys_veh_spd u_vspd 17 0 256
  /begin FIX_AXIS_PAR_LIST 0 1024 2048 3072 4096 5120 6144 7168 8192 9216 10240 11264 12288 13312 14336 15360 16384 /end FIX_AXIS_PAR_LIST
 /end AXIS_DESCR
/end CHARACTERISTIC
/begin CHARACTERISTIC SYS_V_RR_ABS_ACTV_DTY_LO "ABS break active pwm duty low,when ABS pwm used for RR detect" VALUE 0x0002038C __UWORD_S 0 u_pct_r 0 127.998046875 /end CHARACTERISTIC
/begin CHARACTERISTIC SYS_V_RR_ABS_ACTV_DTY_HI "ABS break active pwm duty high,when ABS pwm used for RR detect" VALUE 0x0002038C __UWORD_S 0 u_pct_r 0 127.998046875 /end CHARACTERISTIC
/begin CHARACTERISTIC SYS_V_RR_ABS_WS_FL_DTY_LO "ABS wheel speed sensor fail duty low,when ABS pwm used for RR detect" VALUE 0x0002038C __UWORD_S 0 u_pct_r 0 127.998046875 /end CHARACTERISTIC
/begin CHARACTERISTIC SYS_V_EGR_LRN_DWN_FIL "EGR zero learn down filter" VALUE 0x0002038C __UWORD_S 0 u_filter 0 0.9999847412109375 FORMAT "%5.4" /end CHARACTERISTIC
/begin CHARACTERISTIC SYS_V_EGR_LRN_UP_DLY "EGR zero learn up delay" VALUE 0x0002038C __UWORD_S 0 u_1x_tmr 0 511.9921875 FORMAT "%4.1" /end CHARACTERISTIC
/begin CHARACTERISTIC SYS_V_EGR_LRN_UP_MAP "EGR zero learn up enable MAP max" VALUE 0x0002038C __UWORD_S 0 u_kPa_0_256 0 255.99609375 FORMAT "%4.1" /end CHARACTERISTIC
/begin CHARACTERISTIC SYS_V_EGR_CLS_MAX "EGR close pos max" VALUE 0x0002038C __UWORD_S 0 u_pct 0 199.996948 FORMAT "%4.1" /end CHARACTERISTIC
/begin CHARACTERISTIC SYS_V_EGR_LRN_UP_MAX "EGR learn up max" VALUE 0x0002038C __UWORD_S 0 u_pct 0 199.996948 FORMAT "%4.1" /end CHARACTERISTIC
/begin CHARACTERISTIC SYS_V_EGR_POS_FAC "EGR position factor" VALUE 0x0002038C __UWORD_S 0 u_fac_4 0 3.99993896484375 FORMAT "%4.3" /end CHARACTERISTIC
/begin CHARACTERISTIC SYS_V_EGR_POS_FIL "EGR position filter" VALUE 0x0002038C __UWORD_S 0 u_filter 0 0.9999847412109375 FORMAT "%5.4" /end CHARACTERISTIC
/begin CHARACTERISTIC SYS_C_DECLTCH_REF_DLT "declutch detect ref delta thr" CURVE 0x000200B0 __UWORD_S 0 u_millisec 0 1023.984375 SYMBOL_LINK "SYS_C_DECLTCH_REF_DLT" 2
 /begin AXIS_DESCR FIX_AXIS sys_eng_spd u_espd 17 0 3200
  /begin FIX_AXIS_PAR_LIST 0 1600 3200 4800 6400 8000 9600 11200 12800 14400 16000 17600 19200 20800 22400 24000 25600 /end FIX_AXIS_PAR_LIST
 /end AXIS_DESCR
/end CHARACTERISTIC
/begin CHARACTERISTIC SYS_V_CLMB_AUX_EN_VSPD "climbing auxiliary enable vehicle speed min" VALUE 0x0002038C __UWORD_S 0 u_vspd 0 511.9921875 FORMAT "%4.1" /end CHARACTERISTIC
/begin CHARACTERISTIC SYS_V_SPRT_SW_ON_DUR "sports switch on duration min" VALUE 0x0002038C __UWORD_S 0 u_2x_tmr 0 1023.984375 /end CHARACTERISTIC
/begin CHARACTERISTIC SYS_V_BLW_SW_LRN_ACTV_CNTS "blower switch learn switch active counts" VALUE 0x0002038C __UBYTE_S 0 u_cnts 0 255 /end CHARACTERISTIC
/begin CHARACTERISTIC SYS_C_VGIS1_THRO_BND "VGIS1 area throttle boundary" CURVE 0x350F6 __UWORD_S 0 u_pct 0 199 SYMBOL_LINK "SYS_C_VGIS1_THRO_BND" 2
 /begin AXIS_DESCR COM_AXIS sys_eng_spd u_espd 8 0.000000 8191.875000 AXIS_PTS_REF SYS_X_ESPD_D /end AXIS_DESCR
/end CHARACTERISTIC
/begin CHARACTERISTIC SYS_C_VGIS2_THRO_BND "VGIS2 area throttle boundary" CURVE 0x350F6 __UWORD_S 0 u_pct 0 199 SYMBOL_LINK "SYS_C_VGIS2_THRO_BND" 2
 /begin AXIS_DESCR COM_AXIS sys_eng_spd u_espd 8 0.000000 8191.875000 AXIS_PTS_REF SYS_X_ESPD_D /end AXIS_DESCR
/end CHARACTERISTIC
/begin CHARACTERISTIC SYS_V_VGIS1_SPD_BND_LO "VGIS1 low speed boundary" VALUE 0x2336C __UWORD_S 0 u_espd 0 8191.875000 FORMAT "%6.2" /end CHARACTERISTIC
/begin CHARACTERISTIC SYS_V_VGIS2_SPD_BND_LO "VGIS2 low speed boundary" VALUE 0x2336C __UWORD_S 0 u_espd 0 8191.875000 FORMAT "%6.2" /end CHARACTERISTIC
/begin CHARACTERISTIC SYS_V_VGIS2_SPD_BND_HI "VGIS2 high speed boundary" VALUE 0x2336C __UWORD_S 0 u_espd 0 8191.875000 FORMAT "%6.2" /end CHARACTERISTIC
/begin CHARACTERISTIC SYS_V_VGIS1_SPD_BND_HI "VGIS1 high speed boundary" VALUE 0x2336C __UWORD_S 0 u_espd 0 8191.875000 FORMAT "%6.2" /end CHARACTERISTIC
/begin CHARACTERISTIC SYS_V_VGIS_SPD_BND_HYS "VGIS speed boundary hysteresis" VALUE 0x2336C __UWORD_S 0 u_espd 0 8191.875000 FORMAT "%6.2" /end CHARACTERISTIC
/begin CHARACTERISTIC SYS_V_VGIS_THRO_BND_HYS "VGIS throttle boundary hysteresis" VALUE 0x2336E __UWORD_S 0 u_pct 0 199.996948 /end CHARACTERISTIC
/begin CHARACTERISTIC SYS_V_VGIS1_VAC_THR "VGIS1 manifold vacuum threshhold" VALUE 0x2336E __UWORD_S 0 u_kPa_128n_128p -128 127.99609375 /end CHARACTERISTIC
/begin CHARACTERISTIC SYS_V_VGIS2_VAC_THR "VGIS2 manifold vacuum threshhold" VALUE 0x2336E __UWORD_S 0 u_kPa_128n_128p -128 127.99609375 /end CHARACTERISTIC
/begin CHARACTERISTIC SYS_C_VGIS1_EN_AREA_CFG "VGIS1 enable cell config" CURVE 0x652D0 __UBYTE_S 0 b_enable 0 1 FORMAT "%5.2"
 /begin AXIS_DESCR FIX_AXIS sys_vgis1_area u_vgis_area 6 0 5 /begin FIX_AXIS_PAR_LIST 0 1 2 3 4 5 /end FIX_AXIS_PAR_LIST /end AXIS_DESCR
/end CHARACTERISTIC
/begin CHARACTERISTIC SYS_C_VGIS2_EN_AREA_CFG "VGIS2 enable cell config" CURVE 0x652D0 __UBYTE_S 0 b_enable 0 1 FORMAT "%5.2"
 /begin AXIS_DESCR FIX_AXIS sys_vgis1_area u_vgis_area 6 0 5 /begin FIX_AXIS_PAR_LIST 0 1 2 3 4 5 /end FIX_AXIS_PAR_LIST /end AXIS_DESCR
/end CHARACTERISTIC
/begin CHARACTERISTIC SYS_V_VGIS_HOLD_CNTS_LMT "If sys_vgis1/2_hold_cnts greater than this cal,enable VGIS cleaning logic" VALUE 0x29516 __UBYTE_S 0 u_cnts 0 255 FORMAT "%5.2" /end CHARACTERISTIC
/begin AXIS_PTS SYS_X_ESPD_D "espd breakpoint" 0x350E0 sys_eng_spd SSV__UWORD_S 0 u_espd 8 0.000000 8191.875000 FORMAT "%6.2" DEPOSIT ABSOLUTE SYMBOL_LINK "SYS_X_ESPD_D" 2 /end AXIS_PTS
/begin CHARACTERISTIC SYS_V_F_REFUEL "force refuel active" VALUE 0x0002038C __UBYTE_S 0 b_true 0 1 FORMAT "%1.0" /end CHARACTERISTIC
/begin CHARACTERISTIC SYS_V_ENG_TRN_RST_DLY "engine turn reset delay" VALUE 0x32A1E __UWORD_S 0 u_1x_tmr 0 511.9921875 FORMAT "%4.1" /end CHARACTERISTIC
/*--------------GPF IO-------------------------*/
/begin COMPU_METHOD u_ad_volt "ad voltage" RAT_FUNC "%6.4" "V" COEFFS 0.0 1.0 0.000000 0.0 0.0 0.0000762939453125 /end COMPU_METHOD
/begin COMPU_METHOD u_ad_volt_lo "voltage" RAT_FUNC "%6.4" "V" COEFFS 0.0 1.0 0.000000 0.0 0.0 0.000152587890625 /end COMPU_METHOD
/begin COMPU_METHOD u_ad_volt_lo_r "voltage" RAT_FUNC "%6.4" "V" COEFFS 0.0 1.0 0.000000 0.0 0.0 0.00030517578125 /end COMPU_METHOD
/begin COMPU_METHOD u_volt_32 "voltage" RAT_FUNC "%6.4" "V" COEFFS 0.0 1.0 0.000000 0.0 0.0 0.00048828125 /end COMPU_METHOD
/begin COMPU_METHOD u_kPa_0_256 "press" RAT_FUNC "%5.2" "kPa" COEFFS 0.0 1.0 0.000000 0.0 0.0 0.00390625 /end COMPU_METHOD
/begin COMPU_METHOD u_kPa_0_512 "press" RAT_FUNC "%5.2" "kPa" COEFFS 0.0 1.0 0.000000 0.0 0.0 0.0078125 /end COMPU_METHOD
/begin COMPU_METHOD u_kPa_0_1024 "press" RAT_FUNC "%5.2" "kPa" COEFFS 0.0 1.0 0.000000 0.0 0.0 0.015625 /end COMPU_METHOD
/begin COMPU_METHOD u_kPa_0_32768 "press" RAT_FUNC "%6.1" "kPa" COEFFS 0.0 1.0 0.000000 0.0 0.0 0.5 /end COMPU_METHOD
/begin COMPU_METHOD u_kPa_8n_8p "press" RAT_FUNC "%6.5" "kPa" COEFFS 0.0 1.0 0.000000 0.0 0.0 0.000244140625 /end COMPU_METHOD
/begin COMPU_METHOD u_kPa_128n_128p "press" RAT_FUNC "%5.2" "kPa" COEFFS 0.0 1.0 0.000000 0.0 0.0 0.00390625 /end COMPU_METHOD
/begin COMPU_METHOD u_kPa_256n_256p "press" RAT_FUNC "%5.2" "kPa" COEFFS 0.0 1.0 0.000000 0.0 0.0 0.0078125 /end COMPU_METHOD
/begin COMPU_METHOD u_kPa_512n_512p "press" RAT_FUNC "%5.2" "kPa" COEFFS 0.0 1.0 0.000000 0.0 0.0 0.015625 /end COMPU_METHOD
/begin COMPU_METHOD u_kPa_1024n_1024p "press" RAT_FUNC "%5.2" "kPa" COEFFS 0.0 1.0 0.000000 0.0 0.0 0.03125 /end COMPU_METHOD
/begin COMPU_METHOD u_kPa_4096n_4096p "press" RAT_FUNC "%5.1" "kPa" COEFFS 0.0 1.0 0.000000 0.0 0.0 0.125 /end COMPU_METHOD
/begin COMPU_METHOD u_fac_128 "factor" RAT_FUNC "%5.2" "fac" COEFFS 0.0 1.0 0.000000 0.0 0.0 0.001953125 /end COMPU_METHOD
/begin COMPU_METHOD u_fac_16 "factor" RAT_FUNC "%5.3" "fac" COEFFS 0.0 1.0 0.000000 0.0 0.0 0.000244140625 /end COMPU_METHOD
/begin COMPU_METHOD u_fac_8 "factor" RAT_FUNC "%8.7" "fac" COEFFS 0.0 1.0 0.000000 0.0 0.0 0.0001220703125 /end COMPU_METHOD
/begin COMPU_METHOD u_fac_4 "factor" RAT_FUNC "%5.4" "fac" COEFFS 0.0 1.0 0.000000 0.0 0.0 0.00006103515625 /end COMPU_METHOD
/begin COMPU_METHOD u_fac_2 "factor" RAT_FUNC "%3.2" "fac" COEFFS 0.0 1.0 0.000000 0.0 0.0 0.000030517578125 /end COMPU_METHOD
/begin COMPU_METHOD u_km "kilometers" RAT_FUNC "%5.0" "km" COEFFS 0.0 1.0 0.000000 0.0 0.0 1.0 /end COMPU_METHOD
/begin COMPU_METHOD u_amp "current" RAT_FUNC "%5.2" "A" COEFFS 0.0 1.0 0.000000 0.0 0.0 0.001953125 /end COMPU_METHOD
/begin COMPU_METHOD u_fac_2p56 "factor" RAT_FUNC "%4.2" "fac" COEFFS 0.0 1.0 0.000000 0.0 0.0 0.0000390625 /end COMPU_METHOD
/begin COMPU_METHOD u_ul "microliter" RAT_FUNC "%7.3" "ul" COEFFS 0.0 1.0 0.000000 0.0 0.0 0.03125 /end COMPU_METHOD
/begin COMPU_METHOD u_deg_C "degC" RAT_FUNC "%5.2" "¡æ" COEFFS 0.0 1.0 0.0 0.0 0.0 0.0078125 /end COMPU_METHOD
/begin COMPU_METHOD u_deg_C_a "degC" RAT_FUNC "%3.0" "¡æ" COEFFS 0.0 1.0 0.0 0.0 0.0 1.0 /end COMPU_METHOD
/begin COMPU_METHOD u_filter "filter" RAT_FUNC "%11.10" "coef" COEFFS 0.0 1.0 0.0 0.0 0.0 0.0000152587890625 /end COMPU_METHOD
/begin COMPU_METHOD u_filter_b "filter" RAT_FUNC "%11.10" "coef" COEFFS 0.0 1.0 0.0 0.0 0.0 0.00390625 /end COMPU_METHOD
/begin COMPU_METHOD u_cnts "counts" RAT_FUNC "%3.0" "cnts" COEFFS 0.0 1.0 0.0 0.0 0.0 1.0 /end COMPU_METHOD
/begin COMPU_METHOD u_1x_tmr "7.81 timer" RAT_FUNC "%4.3" "s" COEFFS 0.0 1.0 0.0 0.0 0.0 0.0078125 /end COMPU_METHOD
/begin COMPU_METHOD u_2x_tmr "15.6 timer" RAT_FUNC "%6.2" "s" COEFFS 0.0 1.0 0.0 0.0 0.0 0.015625 /end COMPU_METHOD
/begin COMPU_METHOD u_16x_tmr "125 timer" RAT_FUNC "%5.1" "s" COEFFS 0.0 1.0 0.0 0.0 0.0 0.125 /end COMPU_METHOD
/begin COMPU_METHOD u_1s_tmr "1 sec timer" RAT_FUNC "%5.0" "s" COEFFS 0.0 1.0 0.0 0.0 0.0 1.0 /end COMPU_METHOD
/begin COMPU_METHOD u_millisec "millisec" RAT_FUNC "%6.2" "ms" COEFFS 0.0 1.0 0.0 0.0 0.0 0.015625 /end COMPU_METHOD
/begin COMPU_METHOD u_millisec_2048 "millisec" RAT_FUNC "%6.2" "ms" COEFFS 0.0 1.0 0.0 0.0 0.0 0.03125 /end COMPU_METHOD
/begin COMPU_METHOD u_pw "millisec" RAT_FUNC "%6.2" "ms" COEFFS 0.0 1.0 0.0 0.0 0.0 0.00390625 /end COMPU_METHOD
/begin COMPU_METHOD u_sec_16 "sec" RAT_FUNC "%5.3" "s" COEFFS 0.0 1.0 0.0 0.0 0.0 0.000244140625 /end COMPU_METHOD
/begin COMPU_METHOD b_true "" TAB_VERB "%6.3" "" COMPU_TAB_REF b_true /end COMPU_METHOD
/begin COMPU_VTAB b_true "" TAB_VERB 2 0 "FALSE" 1 "TRUE" /end COMPU_VTAB
/begin COMPU_METHOD b_avail "" TAB_VERB "%6.3" "" COMPU_TAB_REF b_avail /end COMPU_METHOD
/begin COMPU_VTAB b_avail "" TAB_VERB 2 0 "UNAVAIL" 1 "AVAIL" /end COMPU_VTAB
/begin COMPU_METHOD b_enable "" TAB_VERB "%6.3" "" COMPU_TAB_REF b_enable /end COMPU_METHOD
/begin COMPU_VTAB b_enable "" TAB_VERB 2 0 "DISABLE" 1 "ENABLE" /end COMPU_VTAB
/begin COMPU_METHOD b_actv_cfg "" TAB_VERB "%6.3" "" COMPU_TAB_REF b_actv_cfg /end COMPU_METHOD
/begin COMPU_VTAB b_actv_cfg "" TAB_VERB 2 0 "HIGH" 1 "LOW" /end COMPU_VTAB
/begin COMPU_METHOD b_rising "" TAB_VERB "%6.3" "" COMPU_TAB_REF b_rising /end COMPU_METHOD
/begin COMPU_VTAB b_rising "" TAB_VERB 2 0 "FALLING" 1 "RISING" /end COMPU_VTAB
/begin COMPU_METHOD b_pps "" TAB_VERB "%6.3" "" COMPU_TAB_REF b_pps /end COMPU_METHOD
/begin COMPU_VTAB b_pps "" TAB_VERB 2 0 "SENSOR" 1 "CAN" /end COMPU_VTAB
/begin COMPU_METHOD u_ht_cfg "" TAB_VERB "%6.3" "" COMPU_TAB_REF u_ht_cfg /end COMPU_METHOD
/begin COMPU_VTAB u_ht_cfg "" TAB_VERB 5 0 "CONST_PWM" 1 "ONE_UP_HT" 2 "TWO_UP_HT" 3 "ONE_UP_DWN_HT" 4 "TWO_UP_DWN_HT" /end COMPU_VTAB
/begin COMPU_METHOD b_egr_inst_cfg "" TAB_VERB "%6.3" "" COMPU_TAB_REF b_egr_inst_cfg /end COMPU_METHOD
/begin COMPU_VTAB b_egr_inst_cfg "" TAB_VERB 4 0 "PRE_CAT" 1 "POST_CAT" 2 "COOLER_PRECAT" 3 "COOLER_POSTCAT" /end COMPU_VTAB
/begin COMPU_METHOD b_egr_cfg "" TAB_VERB "%6.3" "" COMPU_TAB_REF b_egr_cfg /end COMPU_METHOD
/begin COMPU_VTAB b_egr_cfg "" TAB_VERB 3 0 "Disable" 1 "Solenoid" 2 "DC_Motor" /end COMPU_VTAB
/begin COMPU_METHOD b_f_rail "" TAB_VERB "%6.3" "" COMPU_TAB_REF b_f_rail /end COMPU_METHOD
/begin COMPU_VTAB b_f_rail "" TAB_VERB 2 0 "RECIRCU" 1 "RTNLESS" /end COMPU_VTAB
/begin COMPU_METHOD b_inj_bias "" TAB_VERB "%6.3" "" COMPU_TAB_REF b_inj_bias /end COMPU_METHOD
/begin COMPU_VTAB b_inj_bias "" TAB_VERB 2 0 "LKUP_VAC" 1 "LKUP_INJTMP" /end COMPU_VTAB
/begin COMPU_METHOD b_eco_cfg "" TAB_VERB "%6.3" "" COMPU_TAB_REF b_eco_cfg /end COMPU_METHOD
/begin COMPU_VTAB b_eco_cfg "" TAB_VERB 4 0 "OFF" 1 "CAN" 2 "SW_PULSE" 3 "SW_ONOFF" /end COMPU_VTAB
/begin COMPU_METHOD u_obd_typ "" TAB_VERB "%6.3" "" COMPU_TAB_REF u_obd_typ /end COMPU_METHOD
/begin COMPU_VTAB u_obd_typ "" TAB_VERB 4 1 "CARB" 5 "NO_OBD" 6 "CHN_G5" 29 "CHN_G6" /end COMPU_VTAB
/begin COMPU_METHOD u_lin_typ "" TAB_VERB "%6.3" "" COMPU_TAB_REF u_lin_typ /end COMPU_METHOD
/begin COMPU_VTAB u_lin_typ "" TAB_VERB 4 0 "UNUSE" 1 "BOSCH" 2 "HELLA" 3 "FEIC" /end COMPU_VTAB
/begin COMPU_METHOD u_state_eng "" TAB_VERB "%6.3" "" COMPU_TAB_REF u_state_eng /end COMPU_METHOD
/begin COMPU_VTAB u_state_eng "" TAB_VERB 7 0 "INIT" 1 "KEYON" 2 "START" 3 "RUN" 4 "STOP" 5 "POWOFF" 6 "SHUTDWN" /end COMPU_VTAB
/begin COMPU_METHOD u_state_veh "" TAB_VERB "%10.4" "" COMPU_TAB_REF u_state_veh /end COMPU_METHOD
/begin COMPU_VTAB u_state_veh "" TAB_VERB 8 0 "VEH_OFF" 1 "SUTTING_DOWN" 2 "POW_OFF_DLY" 3 "STALL" 4 "CRK" 5 "RUN" 6 "HYB_STOP" 7 "ACC_ON" /end COMPU_VTAB
/begin COMPU_METHOD pps_corr_stat "" TAB_VERB "%4.0" "" COMPU_TAB_REF pps_corr_stat /end COMPU_METHOD
/begin COMPU_VTAB pps_corr_stat "" TAB_VERB 2 0 "CORR_PASS" 1 "CORR_FAIL" /end COMPU_VTAB
/begin COMPU_METHOD pps_vlt_stat "" TAB_VERB "%4.0" "" COMPU_TAB_REF pps_vlt_stat /end COMPU_METHOD
/begin COMPU_VTAB pps_vlt_stat "" TAB_VERB 4 0 "ALL_PASS" 1 "PPS1_FAIL" 2 "PPS2_FAIL" 3 "ALL_FAIL" /end COMPU_VTAB
/begin COMPU_METHOD b_ac_p_typ "" TAB_VERB "%4.0" "" COMPU_TAB_REF b_ac_p_typ /end COMPU_METHOD
/begin COMPU_VTAB b_ac_p_typ "" TAB_VERB 2 0 "SWITCH" 1 "SENSOR" /end COMPU_VTAB
/begin COMPU_METHOD u_flv_cfg "" TAB_VERB "%4.0" "" COMPU_TAB_REF u_flv_cfg /end COMPU_METHOD
/begin COMPU_VTAB u_flv_cfg "" TAB_VERB 3 0 "ANALOG" 1 "CAN" 2 "UNAVAIL" /end COMPU_VTAB
/begin COMPU_METHOD u_ess_typ "" TAB_VERB "%4.0" "" COMPU_TAB_REF u_ess_typ /end COMPU_METHOD
/begin COMPU_VTAB u_ess_typ "" TAB_VERB 3 0 "FIX_PWM" 1 "FIX_ON_T" 2 "FIX_OFF_T" /end COMPU_VTAB
/begin COMPU_METHOD u_blwr_cfg "" TAB_VERB "%4.0" "" COMPU_TAB_REF u_blwr_cfg /end COMPU_METHOD
/begin COMPU_VTAB u_blwr_cfg "" TAB_VERB 4 0 "ANALOG" 1 "CAN" 2 "LEARN" 3 "SWITCH" /end COMPU_VTAB
/begin COMPU_METHOD u_amb_t_cfg "" TAB_VERB "%4.0" "" COMPU_TAB_REF u_amb_t_cfg /end COMPU_METHOD
/begin COMPU_VTAB u_amb_t_cfg "" TAB_VERB 3 0 "UNUSE" 1 "CAN" 2 "MODLE" /end COMPU_VTAB
/begin COMPU_METHOD u_vspd_cfg "" TAB_VERB "%4.0" "" COMPU_TAB_REF u_vspd_cfg /end COMPU_METHOD
/begin COMPU_VTAB u_vspd_cfg "" TAB_VERB 4 0 "HALL" 1 "CAN" 2 "VR" 3 "AUTO_VR_HALL" /end COMPU_VTAB
/begin COMPU_METHOD u_wspd_cfg "" TAB_VERB "%4.0" "" COMPU_TAB_REF u_wspd_cfg /end COMPU_METHOD
/begin COMPU_VTAB u_wspd_cfg "" TAB_VERB 5 0 "AUTO_CAN_VR" 1 "CAN" 2 "VR" 3 "HALL" 4 "AUTO_HALL_VR" /end COMPU_VTAB
/begin COMPU_METHOD u_wspd_can_cfg "" TAB_VERB "%4.0" "" COMPU_TAB_REF u_wspd_can_cfg /end COMPU_METHOD
/begin COMPU_VTAB u_wspd_can_cfg "" TAB_VERB 5 0 "OFF" 1 "DRV_LEFT" 2 "NON_LEFT" 3 "DRV_RIGHT" 4 "NON_RIGHT" /end COMPU_VTAB
/begin COMPU_METHOD u_ps_snsr_cfg "" TAB_VERB "%4.0" "" COMPU_TAB_REF u_ps_snsr_cfg /end COMPU_METHOD
/begin COMPU_VTAB u_ps_snsr_cfg "" TAB_VERB 5 0 "UNINSTL" 1 "SWITCH" 2 "SENSOR" 3 "LEARN" 4 "EPS_CAN" /end COMPU_VTAB
/begin COMPU_METHOD u_sprt_cfg "" TAB_VERB "%4.0" "" COMPU_TAB_REF u_sprt_cfg /end COMPU_METHOD
/begin COMPU_VTAB u_sprt_cfg "" TAB_VERB 3 0 "CAN" 1 "SWITCH" 2 "UNAVAL" /end COMPU_VTAB
/begin COMPU_METHOD u_vspd_src "" TAB_VERB "%4.0" "" COMPU_TAB_REF u_vspd_src /end COMPU_METHOD
/begin COMPU_VTAB u_vspd_src "" TAB_VERB 8 0 "LEARN" 1 "VSS_4X_HALL" 2 "ABS_HALL" 3 "WSS_VR" 4 "TCM_CAN" 5 "WSS_DRV" 6 "VSS_HALL" 7 "VSS_LINEAR" /end COMPU_VTAB
/begin COMPU_METHOD u_sprt_sw_typ "" TAB_VERB "%4.0" "" COMPU_TAB_REF u_sprt_sw_typ /end COMPU_METHOD
/begin COMPU_VTAB u_sprt_sw_typ "" TAB_VERB 2 0 "PULSE" 1 "ONOFF" /end COMPU_VTAB
/begin COMPU_METHOD u_ps_lrn_typ "" TAB_VERB "%4.0" "" COMPU_TAB_REF u_ps_lrn_typ /end COMPU_METHOD
/begin COMPU_VTAB u_ps_lrn_typ "" TAB_VERB 4 0 "LEARN" 1 "SENSOR" 2 "SWITCH" 3 "FAULT" /end COMPU_VTAB
/begin COMPU_METHOD u_din_cfg "" TAB_VERB "%10.4" "" COMPU_TAB_REF u_din_cfg /end COMPU_METHOD
/begin COMPU_VTAB u_din_cfg "" TAB_VERB 26 0 "UNUSE" 2 "PSPS" 3 "AC_MID" 4 "ELOAD1" 5 "ELOAD2" 6 "BRK_LAMP" 7 "BRK_SW" 8 "CRK_REQ" 9 "SS_SW" 10 "START_ST" 11 "PN_SW" 12 "CLUTCH_TOP_SW" 13 "CLUTCH_BOT_SW" 14 "DRV_TRAIN" 15 "DRV_DOOR" 16 "HOOD_OPN" 17 "HEAD_LIGHT" 18 "AC_REQ" 21 "AC_P_HI_LO_SW" 22 "PARK_BRAKE" 23 "REVERSE_SW" 24 "SPORT_SW" 25 "OIL_PRESS_SW" 26 "ECO_SW" 27 "EXH_BRK_SW" 30 "BLOWER_ST" /end COMPU_VTAB
/begin COMPU_METHOD u_espd "engine speed" RAT_FUNC "%5.2" "rpm" COEFFS 0.0 1.0 0.000000 0.0 0.0 0.125 /end COMPU_METHOD
/begin COMPU_METHOD u_espd_acc "engine speed acc" RAT_FUNC "%6.1" "rpm/s" COEFFS 0.0 1.0 0.000000 0.0 0.0 0.5 /end COMPU_METHOD
/begin COMPU_METHOD u_vspd "vehicle speed" RAT_FUNC "%5.2" "kph" COEFFS 0.0 1.0 0.000000 0.0 0.0 0.0078125 /end COMPU_METHOD
/begin COMPU_METHOD u_vspd_per_sec "vehicle speed acc" RAT_FUNC "%5.3" "kph/s" COEFFS 0.0 1.0 0.000000 0.0 0.0 0.001953125 /end COMPU_METHOD
/begin COMPU_METHOD u_vspd_j "vehicle speed jerk" RAT_FUNC "%5.3" "kph/s2" COEFFS 0.0 1.0 0.000000 0.0 0.0 0.0009765625 /end COMPU_METHOD
/begin COMPU_METHOD u_pct "percentage" RAT_FUNC "%5.2" "%" COEFFS 0.0 1.0 0.000000 0.0 0.0 0.0030517578125 /end COMPU_METHOD
/begin COMPU_METHOD u_pct_1 "percentage" RAT_FUNC "%5.2" "%" COEFFS 0.0 1.0 0.000000 0.0 0.0 0.00152587890625 /end COMPU_METHOD
/begin COMPU_METHOD u_pct_1_b "percentage" RAT_FUNC "%5.2" "%" COEFFS 0.0 1.0 0.000000 0.0 0.0 0.390625 /end COMPU_METHOD
/begin COMPU_METHOD u_pct_s "percentage" RAT_FUNC "%5.2" "%" COEFFS 0.0 1.0 0.000000 0.0 0.0 0.006103515625 /end COMPU_METHOD
/begin COMPU_METHOD u_pct_r "real pct" RAT_FUNC "%5.2" "%" COEFFS 0.0 1.0 0.000000 0.0 0.0 0.001953125 /end COMPU_METHOD
/begin COMPU_METHOD u_g_per_sec_64 "g per second" RAT_FUNC "%5.2" "g/s" COEFFS 0.0 1.0 0.000000 0.0 0.0 0.0009765625 /end COMPU_METHOD
/begin COMPU_METHOD u_afr "airfuel" RAT_FUNC "%3.1" "Ratio" COEFFS 0.0 1.0 0.000000 0.0 0.0 0.00048828125 /end COMPU_METHOD
/begin COMPU_METHOD u_kPa_0_4096 "IMEP" RAT_FUNC "%6.2" "kPa" COEFFS 0.0 1.0 0.000000 0.0 0.0 0.0625 /end COMPU_METHOD
/begin COMPU_METHOD u_iga "ignition angle" RAT_FUNC "%3.1" "Deg" COEFFS 0.0 1.0 0.000000 0.0 0.0 0.0078125 /end COMPU_METHOD
/begin COMPU_METHOD u_crk_ang "crankshaft angle" RAT_FUNC "%5.1" "Deg" COEFFS 0.0 1.0 0.000000 0.0 0.0 0.015625 /end COMPU_METHOD
/begin COMPU_METHOD u_fuel_density "density" RAT_FUNC "%8.3" "kg/L" COEFFS 0.0 1.0 0.000000 0.0 0.0 0.0000152587890625 /end COMPU_METHOD
/begin COMPU_METHOD u_tps_d "tps deriv" RAT_FUNC "%7.3" "%/s" COEFFS 0.0 1.0 0.000000 0.0 0.0 0.125 /end COMPU_METHOD
/begin COMPU_METHOD u_tps_d_abs "tps deriv" RAT_FUNC "%7.3" "%/s" COEFFS 0.0 1.0 0.000000 0.0 0.0 0.0625 /end COMPU_METHOD
/begin COMPU_METHOD u_freq "freq" RAT_FUNC "%6.1" "Hz" COEFFS 0.0 1.0 0.000000 0.0 0.0 0.25 /end COMPU_METHOD
/begin COMPU_METHOD u_freq_2048 "freq" RAT_FUNC "%6.2" "Hz" COEFFS 0.0 1.0 0.000000 0.0 0.0 0.03125 /end COMPU_METHOD
/begin COMPU_METHOD u_pct_dc "duty cycle pct" RAT_FUNC "%5.2" "%" COEFFS 0.0 1.0 0.000000 0.0 0.0 0.0244140625 /end COMPU_METHOD
/begin COMPU_METHOD u_brk_p_typ "" TAB_VERB "%5.0" "" COMPU_TAB_REF u_brk_p_typ /end COMPU_METHOD
/begin COMPU_VTAB u_brk_p_typ "" TAB_VERB 3 0 "UNAVAL" 1 "ABS_PRESS" 2 "REL_PRESS" /end COMPU_VTAB
/begin COMPU_METHOD u_st_rly_cfg "" TAB_VERB "%5.0" "" COMPU_TAB_REF u_st_rly_cfg /end COMPU_METHOD
/begin COMPU_VTAB u_st_rly_cfg "" TAB_VERB 3 0 "UNAVAL" 1 "SWITCH" 2 "CAN" /end COMPU_VTAB
/begin COMPU_METHOD u_hd_lt_cfg "" TAB_VERB "%5.0" "" COMPU_TAB_REF u_hd_lt_cfg /end COMPU_METHOD
/begin COMPU_VTAB u_hd_lt_cfg "" TAB_VERB 3 0 "SWITCH" 1 "CAN" 2 "LEARN" /end COMPU_VTAB
/begin COMPU_METHOD u_blwr_st "" TAB_VERB "%5.0" "" COMPU_TAB_REF u_blwr_st /end COMPU_METHOD
/begin COMPU_VTAB u_blwr_st "" TAB_VERB 5 0 "OFF" 1 "LOW" 2 "MID" 3 "MID_HI" 4 "HIGH" /end COMPU_VTAB
/begin COMPU_METHOD u_wspd_typ "" TAB_VERB "%5.0" "" COMPU_TAB_REF u_wspd_typ /end COMPU_METHOD
/begin COMPU_VTAB u_wspd_typ "" TAB_VERB 4 0 "UNAVAL" 1 "DRV" 2 "NON_DRV" 3 "DRV_NONDRV" /end COMPU_VTAB
/begin COMPU_METHOD u_alt_dty_cfg "" TAB_VERB "%5.0" "" COMPU_TAB_REF u_alt_dty_cfg /end COMPU_METHOD
/begin COMPU_VTAB u_alt_dty_cfg "" TAB_VERB 3 0 "UNAVAL" 1 "PWM" 2 "LIN" /end COMPU_VTAB
/begin COMPU_METHOD u_trans_typ "" TAB_VERB "%5.0" "" COMPU_TAB_REF u_trans_typ /end COMPU_METHOD
/begin COMPU_VTAB u_trans_typ "" TAB_VERB 6 0 "MT" 1 "AT_TCM" 2 "AT_PCM" 3 "AMT" 4 "CVT" 5 "DCT" /end COMPU_VTAB
/begin COMPU_METHOD u_ng_sw_cfg "" TAB_VERB "%5.0" "" COMPU_TAB_REF u_ng_sw_cfg /end COMPU_METHOD
/begin COMPU_VTAB u_ng_sw_cfg "" TAB_VERB 3 0 "UNAVAL" 1 "SWITCH" 4 "CAN" /end COMPU_VTAB
/begin COMPU_METHOD u_r_sw_cfg "" TAB_VERB "%5.0" "" COMPU_TAB_REF u_r_sw_cfg /end COMPU_METHOD
/begin COMPU_VTAB u_r_sw_cfg "" TAB_VERB 3 0 "UNAVAL" 1 "SWITCH" 4 "CAN" /end COMPU_VTAB
/begin COMPU_METHOD u_b_cltch_cfg "" TAB_VERB "%5.0" "" COMPU_TAB_REF u_b_cltch_cfg /end COMPU_METHOD
/begin COMPU_VTAB u_b_cltch_cfg "" TAB_VERB 3 0 "UNAVAL" 1 "SWITCH" 4 "CAN" /end COMPU_VTAB
/begin COMPU_METHOD u_vref_src "" TAB_VERB "%5.0" "" COMPU_TAB_REF u_vref_src /end COMPU_METHOD
/begin COMPU_VTAB u_vref_src "" TAB_VERB 2 0 "REF_A" 1 "REF_B" /end COMPU_VTAB
/begin COMPU_METHOD u_vref_src_r "" TAB_VERB "%5.0" "" COMPU_TAB_REF u_vref_src_r /end COMPU_METHOD
/begin COMPU_VTAB u_vref_src_r "" TAB_VERB 2 0 "REF_B" 1 "REF_A" /end COMPU_VTAB
/begin COMPU_METHOD b_tb_st "" TAB_VERB "%6.3" "" COMPU_TAB_REF b_tb_st /end COMPU_METHOD
/begin COMPU_VTAB b_tb_st "" TAB_VERB 4 0 "Inactive" 1 "Absolute" 2 "Modify" 3 "Error" /end COMPU_VTAB
/begin COMPU_METHOD u_isg_init "" TAB_VERB "%6.3" "" COMPU_TAB_REF u_isg_init /end COMPU_METHOD
/begin COMPU_VTAB u_isg_init "" TAB_VERB 4 0 "MEM" 1 "ENABLE" 2 "DISABLE" 3 "SERVICE" /end COMPU_VTAB
/begin COMPU_METHOD u_cru_vss_cfg "" TAB_VERB "%6.3" "" COMPU_TAB_REF u_cru_vss_cfg /end COMPU_METHOD
/begin COMPU_VTAB u_cru_vss_cfg "" TAB_VERB 3 0 "ECU" 1 "DISP" 3 "AVG_4LOOP" /end COMPU_VTAB
/begin COMPU_METHOD u_acc_b "accelaration" RAT_FUNC "%4.2" "kph/s" COEFFS 0.0 1.0 0.000000 0.0 0.0 0.25 /end COMPU_METHOD
/begin COMPU_METHOD u_can_lmt_sw_typ "" TAB_VERB "%6.3" "" COMPU_TAB_REF u_can_lmt_sw_typ /end COMPU_METHOD
/begin COMPU_VTAB u_can_lmt_sw_typ "" TAB_VERB 2 0 "MOMENTARY" 1 "LATCH" /end COMPU_VTAB
/begin COMPU_METHOD u_rr_src "" TAB_VERB "%6.3" "" COMPU_TAB_REF u_rr_src /end COMPU_METHOD
/begin COMPU_VTAB u_rr_src "" TAB_VERB 6 0 "LEARN" 1 "ABS_CAN" 2 "ABS_PWM" 3 "G_SENSOR" 4 "WSS" 5 "UNUSE" /end COMPU_VTAB
/begin COMPU_METHOD u_grav "gravity" RAT_FUNC "%4.3" "g" COEFFS 0.0 1.0 0.0 0.0 0.0 0.000244140625 /end COMPU_METHOD
/begin COMPU_METHOD u_grav_0_64 "gravity" RAT_FUNC "%4.3" "g" COEFFS 0.0 1.0 0.0 0.0 0.0 0.0009765625 /end COMPU_METHOD
/begin COMPU_METHOD u_amb_t_cfg "" TAB_VERB "%6.3" "" COMPU_TAB_REF u_amb_t_cfg /end COMPU_METHOD
/begin COMPU_VTAB u_amb_t_cfg "" TAB_VERB 3 0 "MODEL" 1 "SENSOR" 2 "CAN" /end COMPU_VTAB
/begin COMPU_METHOD u_ens_cfg "" TAB_VERB "%6.3" "" COMPU_TAB_REF u_ens_cfg /end COMPU_METHOD
/begin COMPU_VTAB u_ens_cfg "" TAB_VERB 3 0 "UNUSE" 1 "COMMON" 3 "BAIC" /end COMPU_VTAB
/begin COMPU_METHOD u_clmb_sw_cfg "" TAB_VERB "%6.3" "" COMPU_TAB_REF u_clmb_sw_cfg /end COMPU_METHOD
/begin COMPU_VTAB u_clmb_sw_cfg "" TAB_VERB 2 0 "NORMAL_OPEN" 1 "NORMAL_CLOSE" /end COMPU_VTAB
/begin COMPU_METHOD u_do_lamp2_cfg "" TAB_VERB "%10.4" "" COMPU_TAB_REF u_do_lamp2_cfg /end COMPU_METHOD
/begin COMPU_VTAB u_do_lamp2_cfg "" TAB_VERB 4 0 "UNUSE" 3 "SVS" 7 "SS_LAMP" 13 "CRUISE_LAMP" /end COMPU_VTAB
/begin COMPU_METHOD u_do_pulse1_cfg "" TAB_VERB "%10.4" "" COMPU_TAB_REF u_do_pulse1_cfg /end COMPU_METHOD
/begin COMPU_VTAB u_do_pulse1_cfg "" TAB_VERB 4 0 "UNUSE" 7 "ECT_OUT" 8 "FLV_OUT" 11 "FC_OUT" /end COMPU_VTAB
/begin COMPU_METHOD u_do_pulse2_cfg "" TAB_VERB "%10.4" "" COMPU_TAB_REF u_do_pulse2_cfg /end COMPU_METHOD
/begin COMPU_VTAB u_do_pulse2_cfg "" TAB_VERB 5 0 "UNUSE" 7 "ECT_OUT" 8 "FLV_OUT" 9 "START_RLY" 11 "FC_OUT" /end COMPU_VTAB
/begin COMPU_METHOD u_do_pwm_cfg "" TAB_VERB "%10.4" "" COMPU_TAB_REF u_do_pwm_cfg /end COMPU_METHOD
/begin COMPU_VTAB u_do_pwm_cfg "" TAB_VERB 7 0 "UNUSE" 1 "WASTE_GATE_VLV" 2 "WATER_PUMP" 3 "EGR_VLV" 5 "E_THERMAL" 6 "TURBO_RELIEF" 10 "CNG_VLV" /end COMPU_VTAB
/begin COMPU_METHOD u_do_pwm1_cfg "" TAB_VERB "%10.4" "" COMPU_TAB_REF u_do_pwm1_cfg /end COMPU_METHOD
/begin COMPU_VTAB u_do_pwm1_cfg "" TAB_VERB 6 0 "UNUSE" 1 "WASTE_GATE_VLV" 2 "WATER_PUMP" 3 "EGR_VLV" 5 "E_THERMAL" 6 "TURBO_RELIEF" /end COMPU_VTAB
/begin COMPU_METHOD u_din_chn "" TAB_VERB "%10.4" "" COMPU_TAB_REF u_din_chn /end COMPU_METHOD
/begin COMPU_VTAB u_din_chn "" TAB_VERB 7 0 "PIN_KE1" 1 "PIN_KG5" 2 "PIN_KG4" 3 "PIN_KD4" 4 "PIN_KE5" 5 "PIN_KE3" 6 "PIN_KD3" /end COMPU_VTAB
/begin COMPU_METHOD u_amp_8 "current" RAT_FUNC "%5.2" "A" COEFFS 0.0 1.0 0.000000 0.0 0.0 0.0001220703125 /end COMPU_METHOD
/begin COMPU_METHOD u_refuel_typ "" TAB_VERB "%6.3" "" COMPU_TAB_REF u_refuel_typ /end COMPU_METHOD
/begin COMPU_VTAB u_refuel_typ "" TAB_VERB 5 0 "UNKNOWN" 1 "CAL" 2 "FAULT" 3 "KEYON_CHK" 4 "RUN_CHK" /end COMPU_VTAB
/begin COMPU_METHOD u_vgis_area "" TAB_VERB "%10.4" "" COMPU_TAB_REF u_vgis_area /end COMPU_METHOD
/begin COMPU_VTAB u_vgis_area "" TAB_VERB 7 0 "VGIS Area 1" 1 "VGIS Area 2" 2 "VGIS Area 3" 3 "VGIS Area 4" 4 "VGIS Area 5" 5 "VGIS Area 6" 6 "VGIS Area Num." /end COMPU_VTAB
/begin COMPU_METHOD u_vgis_cfg "" TAB_VERB "%4.0" "" COMPU_TAB_REF u_vgis_cfg /end COMPU_METHOD
/begin COMPU_VTAB u_vgis_cfg "" TAB_VERB 3 0 "NOT INSTALLED" 1 "USUALLY OPEN" 2 "USUALLY CLOSED" /end COMPU_VTAB
/begin COMPU_METHOD u_cru_actv_typ "" TAB_VERB "%4.0" "" COMPU_TAB_REF u_cru_actv_typ /end COMPU_METHOD
/begin COMPU_VTAB u_cru_actv_typ "" TAB_VERB 3 0 "NONE" 1 "MOMENTARY" 2 "LATCHING" /end COMPU_VTAB
/begin COMPU_METHOD u_fc "fuel consumption" RAT_FUNC "%9.1" "uL" COEFFS 0.0 1.0 0.000000 0.0 0.0 0.015625000000000 /end COMPU_METHOD
/begin FUNCTION force_ctrl ""
 /begin DEF_CHARACTERISTIC F_V_FMSP_EN F_V_AF_EN F_V_AF F_V_IG_EN F_V_IG_TD_EN F_V_IG_TD F_V_IGA_EN F_V_IGA F_V_VE_EN F_C_IGA_CYL_EN F_V_IGA_CYL F_V_VE_ACTV F_V_VE F_V_VVT_INTK_EN F_V_VVT_INTK F_V_INTK_VVT_DC_EN F_V_INTK_VVT_DC F_V_VVT_EXH_EN F_V_VVT_EXH F_V_INTK_EXH_DC_EN F_V_INTK_EXH_DC F_V_CLR_NV F_V_TEL_EOL F_V_TEL_RST F_V_CP_EN F_V_CP_DIAG_ACTV F_V_CP_DIAG_OFF F_V_CP_PWM_ACTV F_V_CP_PWM F_V_CP_FUEL_ACTV F_V_CP_FUEL F_V_EGR_EN F_V_EGR_ACTV F_V_EGR_POS F_V_TB_ACTV F_V_TB_ST F_V_TB_AB_SP F_V_TB_MOD_SP /end DEF_CHARACTERISTIC
 /begin OUT_MEASUREMENT /end OUT_MEASUREMENT
/end FUNCTION
/begin FUNCTION info "engine info" /begin DEF_CHARACTERISTIC INFO_C_CAL_ID INFO_V_CAL_RR_ID INFO_V_HW_VER /end DEF_CHARACTERISTIC /begin OUT_MEASUREMENT /end OUT_MEASUREMENT /end FUNCTION
/begin FUNCTION hwio ""
 /begin DEF_CHARACTERISTIC HW_V_AMP_SNSR_CFG HW_V_O2_PMP_CFG HW_V_RO2_PMP_CFG HW_V_PPS_CFG HW_V_FUEL_RAIL_CFG HW_C_RTNLESS_INJ_FLW HW_X_IM_VAC_A HW_V_RECIRCU_INJ_FLW HW_C_RECIRCU_INJ_BIAS HW_M_RTNLESS_INJ_BIAS HW_X_IM_VAC_B HW_V_O2_HT_CFG HW_M_EOI_RUN_MN HW_M_EOI_RUN_MN_VVT HW_V_UO2_HT_CURNT_FAC HW_V_DO2_HT_CURNT_FAC HW_V_INJ_SCH_ANGL HW_C_EOI_ST_PRE HW_C_EOI_ST_MN HW_C_EOI_RUN_PRE_ECT HW_C_EOI_RUN_MN_ECT HW_C_EOI_POST HW_M_EOI_RUN_PRE HW_M_EOI_RUN_PRE_VVT HW_X_ESPD_A HW_X_IMEP_A HW_V_CAM_EDGE_CFG HW_V_CAM_PULS_CNTS HW_V_SEG_ANG_TO_TDC HW_V_SEG_TOOTH HW_V_CAM_EVENT_ANG HW_V_1ST_CYL_CAM1_CFG HW_V_1ST_CYL_CAM2_CFG HW_V_VVT_CFG HW_V_EOI_VVT_FAC HW_V_ECO_REQ_CFG HW_V_TANK_P_SNSR_CFG HW_V_OBD_TYP HW_V_LIN_TYP HW_C_EOI_POW_HI_SPD_BIAS HW_C_EOI_POW_LO_SPD_BIAS HW_V_EOI_POW_ESPD_HI HW_V_EOI_POW_ESPD_LO HW_V_FAN_PWM_FREQ HW_V_EGR_SYS_CFG HW_V_FAN_PWM_POL HW_V_AC_P_SNSR_TYP HW_V_AC_INST HW_V_ACREQ_CAN HW_V_AC_P_CAN HW_V_AC_CLTCH_CAN HW_V_AC_T_CAN HW_V_AC_T_SNSR HW_V_EGR_T_INST HW_V_CAN_ENG_RVS_EN HW_V_FLV_CFG HW_V_ECT_OUT_EN HW_V_BLWR_CFG HW_V_AMB_T_CFG HW_V_VSPD_CFG HW_V_WSPD_CFG HW_V_WSPD_CAN_CFG HW_V_SPRT_MODE_CFG HW_V_SPRT_SWTH_TYP HW_V_ECM_CAL_ST HW_V_PS_SNSR_CFG HW_V_PS_CAN_SWTCH HW_V_HD_LGHT_CFG HW_V_AC_HI_LO_SWCH_INST HW_V_ALT_PWM_CFG HW_V_ALT_DTY_CFG HW_V_TRANS_TYP HW_V_NG_SWTCH_CFG HW_V_NG_SWTCH_HI HW_V_RVRS_SWTCH_CFG HW_V_RVRS_SWTCH_HI HW_V_BTM_CLTCH_SWTCH_CFG HW_V_BTM_CLTCH_SWTCH_HI HW_V_TOP_CLTCH_SWTCH_CFG HW_V_TOP_CLTCH_SWTCH_HI HW_V_MT_GR_NUM HW_V_DRV_TRN_SW_INST HW_V_DRV_TRN_SW_HI HW_V_PPS2_VREF_CFG HW_C_DIN_ACTV_CFG HW_V_DIN_KE1_CFG HW_V_DIN_KG5_CFG HW_V_DIN_KG4_CFG HW_V_DIN_KD4_CFG HW_V_DIN_KE5_CFG HW_V_DIN_KE3_CFG HW_V_DIN_KD3_CFG HW_V_TPS1_VREF_CFG HW_V_TPS2_VREF_CFG HW_V_PPS2_VREF_CFG_R HW_V_FC_PWM_PERIOD HW_V_FC_PWM_DTY HW_V_FC_HW_PULS_NUM_MAX HW_V_FC_CAN_PULS_NUM_MAX HW_V_FC_PULS_USE_HW HW_V_FC_PULS_PRECSN HW_V_CYL_NUM HW_C_CRK_TH_PER_CAM HW_C_CAM_DTY_MIN HW_C_CAM_DTY_MAX HW_V_1ST_TH_ANG HW_C_CAM_FALL_ANG HW_V_CAM_NUM_BEFR_GAP HW_V_FLV_AVAL HW_V_E_THST_AVAL HW_V_E_THST_FREQ HW_V_RGLTR_FREQ HW_V_LINEAR_WSS_INST HW_V_RR_SRC HW_V_BRK_SW_INST HW_V_IAT_USE_BOOST_T HW_V_WGV_FREQ HW_V_IAT_INST HW_V_EGR_CFG HW_V_EGR_VLV_FREQ HW_V_VGIS1_CFG HW_V_VGIS2_CFG HW_V_AMB_T_CFG HW_V_CLMB_AUX_SW_CFG HW_V_VEH_PLANT_POW_ON_TMS HW_V_ENS_CFG HW_V_DIN_LA_KE2_CFG HW_V_DIN_LA_KF3_CFG HW_V_DIN_LA_KF4_CFG HW_V_DIN_LA_KG3_CFG HW_V_DIN_LA_KD5_CFG HW_V_DIN_LA_KD2_CFG HW_V_DIN_LA_KD1_CFG HW_V_DIN_HA_KE4_CFG HW_V_DIN_HA_KF5_CFG HW_V_DOUT_KC5_CFG HW_V_DOUT_PULS_KC2_CFG HW_V_DOUT_PULS_KM1_CFG HW_V_DOUT_PWM_AA4_CFG HW_V_DOUT_PWM_AB4_CFG HW_V_DOUT_PWM_AB5_CFG HW_V_DOUT_PULS_POL_KC2_CFG HW_V_DOUT_PULS_POL_KM1_CFG HW_V_POW_ON_DLY HW_V_KEY_ON_DLY HW_V_CRU_ONOFF_TYP HW_V_COM_HD_OPN HW_V_COM_DR_OPN HW_V_COM_BLT_OPN HW_V_COM_R_DEFOG HW_V_COM_ISG HW_V_ISG_SW_TYP HW_V_ISG_INIT_ST /end DEF_CHARACTERISTIC
 /begin OUT_MEASUREMENT hw_ect_vlt hw_iat_vlt hw_bat_vlt hw_bat_vlt_filt hw_map_vlt hw_amp_vlt hw_pps1_vlt hw_pps2_vlt hw_uo2_vlt hw_do2_vlt hw_mpr_vlt hw_mpr_vlt_raw hw_tps1_vlt hw_tps2_vlt hw_eoi_pre hw_eoi_main hw_eoi_post hw_b1_intk_vvt_dc hw_inj_flw hw_pow_eoi_bias hw_ac_temp_vlt hw_egr_out_t_vlt hw_brk_p_vlt hw_uo2_vlt_raw hw_do2_vlt_raw hw_uo2_ht_curr_vlt hw_do2_ht_curr_vlt hw_tnkp_vlt hw_bst_t_vlt hw_bst_p_vlt /end OUT_MEASUREMENT
/end FUNCTION
/begin FUNCTION sys_in_meas ""
 /begin DEF_CHARACTERISTIC SYS_C_ECT SYS_M_ECT_DFLT SYS_V_ECT_FIL SYS_X_ECT_A SYS_C_IAT_HI SYS_C_IAT_LO SYS_V_IAT_DFLT SYS_V_IAT_FIL SYS_V_KEY_ON_VLT_HI SYS_V_KEY_OFF_VLT_LO SYS_V_MAP_SNSR_K SYS_V_MAP_SNSR_B SYS_V_MAP_DFLT SYS_V_AMP_SNSR_K SYS_V_AMP_SNSR_B SYS_X_ESPD_A SYS_X_KEYON_ECT SYS_V_AMP_MAX SYS_V_AMP_MIN SYS_V_AMP_FIL SYS_V_ESPD_SUM_CNTS SYS_V_O2_SUM_CNTS SYS_V_PPS2_K_R SYS_V_PPS2_BIAS_R SYS_V_PPS_LRN_DWN_STBL_DLT SYS_V_PPS_LRN_DWN_STBL_DLT_R SYS_V_PPS2_K SYS_V_PPS2_BIAS SYS_V_BRK_ON_PPS_MAX SYS_C_PPS_HYS SYS_C_PPS_HYS_R SYS_V_PPS_DEAD_BAND SYS_M_PPS1_FAC SYS_M_PPS2_FAC SYS_V_PPS_SCAL_FAC SYS_V_PPS_LRN_FIL SYS_V_PPS_LRN_FIL_R SYS_V_PPS_LRN_DLY SYS_V_PPS_LRN_UP_EN_LO SYS_V_PPS_LRN_UP_EN_HI SYS_V_PPS_ZERO_LRN_FIL SYS_V_PPS_ZERO_VLT_MIN SYS_V_PPS_ZERO_VLT_MAX SYS_C_AC_TEMP SYS_V_PPS_LRN_UP_EN_LO_R SYS_V_TPS2_K SYS_V_TPS1_FAC SYS_M_MAP_FIL SYS_X_ESPD_B SYS_X_THRO_POS SYS_V_PPS_RNDT_DLT SYS_V_PPS_RNDT_DLT_R SYS_V_PPS_LRN_UP_EN_HI_R SYS_V_PPS_ZERO_LRN_FIL_R SYS_X_ECT_VLT SYS_V_AC_TEMP_DFLT SYS_C_EGR_OUT_T SYS_X_EGR_T_VLT SYS_V_EGR_OUT_T_DFLT SYS_V_PPS_ZERO_VLT_MIN_R SYS_V_PPS_ZERO_VLT_MAX_R SYS_V_PPS_LRN_DLY_R SYS_V_EGR_OUT_T_FIL SYS_V_FLV_UPDT_EN_VLT_DLT SYS_V_FLV_VLT_COR_EN SYS_C_FLV_VLT_COR SYS_M_PPS1_FAC_R SYS_M_PPS2_FAC_R SYS_V_PPS_SCAL_FAC_R SYS_X_FLV_PCT_RAW SYS_C_FLV_PCT SYS_V_FLV_PCT_DFLT SYS_C_VSPD_FIL SYS_V_VSPD_K_A SYS_V_VSPD_K_B SYS_V_VSPD_K_C SYS_V_VSPD_K_D SYS_V_PPS_DEAD_BAND_R SYS_C_F_IDL_PPS_R SYS_V_CRU_BY_CAN SYS_V_VSPD_K_E SYS_V_VSPD_DFLT SYS_V_BAT_VLT_FIL SYS_V_MPR_VLT_FIL SYS_V_ECO_DET_DUR SYS_V_ECO_REQ_INIT SYS_V_VSPD_LMT_VLT_MIN SYS_V_VSPD_LMT_VLT_MAX SYS_V_CRU_FLT_DIS_SW SYS_V_AC_P_SNSR_K SYS_V_AC_P_SNSR_B SYS_V_AC_P_FIL SYS_V_CLS_THRO_HI SYS_V_CLS_THRO_LO SYS_V_CRU_UNUSE_VLT_MIN SYS_V_CRU_UNUSE_VLT_MAX SYS_V_CRU_DIST_VLT_MIN SYS_V_CRU_DIST_VLT_MAX SYS_V_TANK_P_SNSR_K SYS_V_TANK_P_SNSR_B SYS_V_TANK_P_FIL SYS_V_PS_ACTV_DLY SYS_V_PS_ACTV_ESPD_HI SYS_V_CRU_SET_VLT_MIN SYS_V_CRU_SET_VLT_MAX SYS_V_CRU_MAIN_VLT_MIN SYS_V_CRU_MAIN_VLT_MAX SYS_V_PS_ACTV_ESPD_LO SYS_V_PS_ACTV_VSPD_HI SYS_V_PS_ACTV_VSPD_LO SYS_C_PS_ACTV_ECT SYS_C_PS_ACTV_RUN_MIN SYS_V_CRU_RES_VLT_MIN SYS_V_RES_CNCL_VLT_MAX SYS_V_CAN_VSPD_LMT_TYP SYS_C_PS_ACTV_P_LO SYS_C_PS_ACTV_P_HI SYS_V_PS_ACTV_I_HI SYS_V_PS_ACTV_I_LO SYS_V_PS_P_SNSR_K SYS_V_PS_P_SNSR_B SYS_V_CRU_CNCL_VLT_MIN SYS_V_CRU_CNCL_VLT_MAX SYS_V_PS_P_FIL SYS_V_PS_P_DLT_FIL SYS_V_PS_ON_TRS_DUR SYS_V_PS_OFF_TRS_DUR SYS_V_ST_RLY_STAT_CFG SYS_C_CRU_VSPD_DCL_MAX SYS_V_CRU_VSPD_ACC_FIL SYS_V_CRU_ON_DLY SYS_V_BRK_P_SNSR_K SYS_V_BRK_P_SNSR_B SYS_V_CAN_BRK_P SYS_V_BRK_P_DFLT SYS_V_BRK_P_TYP SYS_V_CRU_VSPD_CFG SYS_V_CRU_VSPD_K SYS_V_CRU_VSPD_BIAS SYS_C_CRU_VSPD_FIL SYS_M_BLWR_ST_THR SYS_V_BLWR_CHG_DLY SYS_V_ACC_VLT_FIL SYS_V_ACC_OFF_DLY SYS_V_WSPD_TYP SYS_V_FLV_STBL_DLY SYS_V_REFUEL_FLV_FIL SYS_C_CRU_VSPD_ACC_MAX SYS_X_CRU_VSPD_A SYS_V_ALT_DTY_INC_FIL SYS_V_ALT_DTY_DEC_FIL SYS_V_KEY_OFF_DLY SYS_V_TRS_OIL_T_DFLT SYS_V_TRS_CLD_THR_LO SYS_V_REFUEL_TANK_VAC_MAX SYS_V_REFL_KEYON_CHK_DLY SYS_V_TRS_CLD_THR_HI SYS_C_F_IDL_PPS SYS_V_TPS_SCAL_FAC SYS_V_TPS_MIN_DFLT SYS_C_TPS_NOIS_THR SYS_V_TPS_SS_THR SYS_V_TPS_SS_DUR SYS_V_REFUEL_VSPD_MAX SYS_V_TPS_DFLT SYS_V_TPS1_ZERO_MAX SYS_V_TPS1_ZERO_MIN SYS_V_TPS2_ZERO_MAX SYS_V_TPS2_ZERO_MIN SYS_V_TPS_ZERO_BIAS SYS_V_TPS_LRN_FIL SYS_V_TPS_LRN_DUR_MAX SYS_V_THRO_MOT_VLT_DCY SYS_V_TPS_LRN_ESPD_MIN SYS_V_TPS_LRN_DB SYS_V_FLV_DFLT SYS_V_FLV_RUN_FIL SYS_V_FLV_STOP_FIL SYS_V_FLV_REFUEL_FAC SYS_V_REFL_RUN_CHK_DLY SYS_V_REFUEL_STRT_DLY SYS_V_VLMT_ON_DLY SYS_V_CRU_SET_ON_DLY SYS_V_CRU_RES_ON_DLY SYS_V_CRU_CNCL_ON_DLY SYS_V_CRU_DIST_ON_DLY SYS_V_CRU_OFF_VLT_MIN SYS_V_CRU_OFF_VLT_MAX SYS_V_CRU_SW_EN_MIN SYS_V_CRU_SW_EN_MAX SYS_V_F_REFUEL SYS_V_ENG_TRN_RST_DLY SYS_V_EGR_LRN_DWN_FIL SYS_V_EGR_LRN_UP_DLY SYS_V_EGR_LRN_UP_MAP SYS_V_EGR_CLS_MAX SYS_V_EGR_LRN_UP_MAX SYS_V_EGR_POS_FAC SYS_V_EGR_POS_FIL SYS_V_IAT_USE_BST_EN_RT SYS_V_IAT_USE_BST_EN_DLY SYS_V_IAT_USE_BST_FIL SYS_C_BST_T_HI SYS_C_BST_T_LO SYS_C_BST_MNFD_T_HI SYS_C_BST_MNFD_T_LO SYS_V_BST_T_FIL SYS_V_BST_P_SNSR_K SYS_V_BST_P_SNSR_B SYS_V_BST_P_MIN SYS_C_BST_P_DFLT SYS_X_AMP_A SYS_V_BST_P_FIL /end DEF_CHARACTERISTIC
 /begin OUT_MEASUREMENT sys_ect sys_ect_raw sys_iat sys_iat_raw sys_keyon_ect sys_keyon_iat sys_keyoff_ect_nv sys_keyoff_iat_nv sys_trp_iat_min_nv sys_key_on sys_key_off sys_key_on_dur sys_key_off_dur sys_map sys_map_raw sys_map_seg sys_map_seg_raw sys_map_dflt sys_amp_snsr_raw sys_amp_snsr sys_amp sys_eng_spd sys_espd_avg sys_espd_delt sys_pps1_pct_raw sys_pps2_pct_raw sys_pps1_zero_nv sys_pps2_zero_nv sys_pps1_pct sys_pps2_pct sys_pps_corr_stat sys_pps_vlt_stat sys_pps_scaled sys_pps_scald_zero_nv sys_tps1_pct_raw sys_tps2_pct_raw sys_tps1_zero_nv sys_tps2_zero_nv sys_tps1_pct sys_tps2_pct sys_tps_scaled sys_tps_pct sys_uo2_vlt sys_do2_vlt sys_thro_cls sys_veh_spd sys_veh_mov sys_ac_temp sys_egr_out_t sys_eng_rvs_turn sys_flv_vlt sys_flv_pct_raw sys_flv_pct sys_vspd_raw sys_vspd_freq sys_vspd_period sys_vspd_pred sys_vspd_accel sys_vspd_jerk sys_vspd_src sys_eco_req sys_ac_p sys_tank_p sys_ps_p sys_ps_actv sys_ps_lrn_typ sys_ac_req sys_brk_p sys_strt_rly_st sys_hd_light_on sys_ac_p_hi_lo_actv sys_blwr_st sys_acc_swtch_on sys_acc_vlt sys_air_flap_pct sys_acc_vlt_raw sys_alt_dty_raw sys_alt_dty sys_brk1_actv sys_brk2_actv sys_real_af sys_tps_lrn_on_zero sys_tps_free sys_cru_vspd sys_tps_nois_mot_vlt sys_tps1_d sys_tps2_d sys_tps1_nois sys_tps2_nois sys_tps1_nois_ext_dly sys_tps2_nois_ext_dly sys_tps_ss sys_tps_zero_lrn_tms sys_tps_lrn_req sys_tps_lrn_en sys_tps_lrn_rst sys_tps_lrn_actv sys_tps1_zero_raw sys_tps2_zero_raw sys_tps_lrn_dur sys_tps_lrn_mov_dur sys_tps_lrn_fn sys_tps1_zero_lst sys_tps2_zero_lst sys_eng_turn sys_amp_vlt_pct sys_iat_vlt_pct sys_ac_temp_raw sys_ac_temp_raw sys_uo2_ht_cur sys_do2_ht_cur sys_decltch_stat sys_tps_1x_lst sys_tps_2x_lst sys_lock_odo sys_trip_refuel_tms sys_trip_refuel_typ sys_trip_fc_hi sys_veh_in_mfg sys_flv_pct_mmv sys_vspd_simp_accel sys_amp_raw sys_amp_updt_occr sys_pow_on_ect sys_pps1_vlt_pct sys_pps2_vlt_pct sys_tps1_vlt_pct sys_tps2_vlt_pct sys_seg_cnts sys_tps_flw_stbl sys_tps1_zero_tmp sys_tps2_zero_tmp sys_cyl_num sys_tcu_vspd sys_vspd_raw_mmv sys_brk_lamp_dprsd sys_brk_sw_dprsd sys_flv_mmv sys_flv_mmv_dly sys_refuel_flv_dlt sys_refuel_det_dly sys_flv_lst_trip sys_refuel_strt_dly sys_refuel_met sys_refuel_run_dly sys_refuel_min_flv sys_cru_an_invld sys_cru_onoff_raw sys_cru_cancl_raw sys_cru_res_raw sys_cru_set_raw sys_cru_dis_raw sys_cru_vsl_raw sys_cru_onoff_actv sys_cru_cancl_actv sys_cru_res_actv sys_cru_set_actv sys_cru_dis_actv sys_cru_vsl_actv sys_egr_pos_act sys_egr_vlt_pct_raw sys_bst_t_raw sys_bst_t sys_bst_p sys_bst_p_raw sys_bst_p_seg sys_bstp_vlt_pct sys_bst_t_vlt_pct /end OUT_MEASUREMENT
/end FUNCTION
/begin FUNCTION sys_in_calc ""
 /begin DEF_CHARACTERISTIC SYS_C_AMP_MAP_FAC SYS_V_AMP_MAP_BIAS SYS_C_ST_RUN_ESPD SYS_C_AST_ST_RUN_ESPD SYS_V_RUN_AST_DLY_CLD_THR SYS_V_RUN_AST_DLY_HOT_THR SYS_V_RUN_DLY_CLD_THR SYS_V_RUN_DLY_HOT_THR SYS_V_RUN_CLD_SEG_DLY SYS_V_RUN_HOT_SEG_DLY SYS_V_RUN_ST_ESPD SYS_V_SHUT_DWN_DLY SYS_V_RUN_AST_CLD_SEG_DLY SYS_V_RUN_WRM_SEG_DLY SYS_V_RUN_AST_WRM_SEG_DLY SYS_V_OVRHT_EOIL_T_HI SYS_V_OVRHT_ECT_T_HI SYS_V_OVRHT_TOIL_T_HI SYS_V_OVRHT_EOIL_T_LO SYS_V_OVRHT_ECT_T_LO SYS_V_OVRHT_TOIL_T_LO SYS_V_OVRHT_MET_DLY SYS_V_ESPD_ACC_DLT_T SYS_V_EST_CLTCH_EN SYS_V_CLTCH_ON_SPD_INC_MIN SYS_V_CLTCH_ON_SPD_ACC_MIN SYS_V_CLTCH_ON_ECT_MIN SYS_V_CLTCH_EST_DUR_MAX SYS_V_CLTCH_ON_DLY SYS_V_CLTCH_ON_DUR SYS_V_FUEL_DENSTY SYS_M_MDL_OIL_P SYS_X_ESPD_C SYS_X_OIL_T_A SYS_V_VVT_OIL_DRP_FAC SYS_V_OIL_HP_SW_HI SYS_M_RR_G_SNSR_THR SYS_V_RR_DET_DLY SYS_V_RR_SNSR_G_DLT_MAX SYS_V_RR_SNSR_G_FIL SYS_M_RR_WSS_THR SYS_V_RR_WSS_LOG_CNTS SYS_C_RR_WSS_G_DLT_MIN SYS_V_RR_ABS_EN_LD_MIN SYS_V_RR_ABS_EN_ESPD_MIN SYS_C_RR_ABS_THR SYS_V_RR_ABS_ACTV_DTY_LO SYS_V_RR_ABS_ACTV_DTY_HI SYS_V_RR_ABS_WS_FL_DTY_LO SYS_C_DECLTCH_REF_DLT SYS_V_CLMB_AUX_EN_VSPD SYS_V_SPRT_SW_ON_DUR SYS_V_BLW_SW_LRN_ACTV_CNTS /end DEF_CHARACTERISTIC
 /begin OUT_MEASUREMENT sys_map_amp sys_map_raw_amp sys_amp sys_eng_state sys_run_dly_thr sys_run_dly_seg_cnts sys_st_run_espd_thr sys_veh_st sys_shut_dwn_en sys_eng_rtm_nv sys_veh_rtm_nv sys_eng_trt_nv sys_pps_pct sys_im_vac sys_oil_t sys_alt_pwm sys_oil_p sys_eng_trt_lst_nv sys_eng_rtm_lst_nv sys_veh_rtm_lst_nv sys_eng_ovr_ht sys_cltch_espd_acc sys_cltch_on sys_cltch_in_espd sys_cltch_on_det_tm sys_cltch_on_tm sys_ac_inst_nv sys_trs_oil_t sys_trs_cld sys_amb_t sys_rr_avg_espd sys_rr_avg_load sys_trip_fc /end OUT_MEASUREMENT
/end FUNCTION
/begin FUNCTION sys_out ""
 /begin DEF_CHARACTERISTIC SYS_C_ESS_INC_FLT SYS_C_ESS_DEC_FLT SYS_V_ESS_TYP SYS_V_ESS_FREQ_FAC SYS_C_ECT_OUT_PWM SYS_X_ECT_B SYS_V_ECT_OUT_FREQ SYS_X_ESPD_D SYS_C_FLV_OUT SYS_C_VGIS1_THRO_BND SYS_C_VGIS2_THRO_BND SYS_V_VGIS1_SPD_BND_LO SYS_V_VGIS2_SPD_BND_LO SYS_V_VGIS1_SPD_BND_HI SYS_V_VGIS2_SPD_BND_HI SYS_V_VGIS_SPD_BND_HYS SYS_V_VGIS_THRO_BND_HYS SYS_V_VGIS1_VAC_THR SYS_V_VGIS2_VAC_THR SYS_C_VGIS1_EN_AREA_CFG SYS_C_VGIS2_EN_AREA_CFG SYS_V_VGIS_HOLD_CNTS_LMT /end DEF_CHARACTERISTIC
 /begin OUT_MEASUREMENT sys_mil_on sys_svs_on sys_mil_pwm sys_svs_pwm sys_ect_out_pwm sys_vgis_mode sys_vgis1_stat sys_vgis2_stat sys_vgis1_area sys_vgis2_area sys_vgis1_moved sys_vgis2_moved sys_vgis1_hold_cnts sys_vgis2_hold_cnts /end OUT_MEASUREMENT
/end FUNCTION
/begin FUNCTION system "" /begin SUB_FUNCTION sys_in_meas sys_in_calc sys_out /end SUB_FUNCTION /end FUNCTION
/begin RECORD_LAYOUT __UBYTE_S FNC_VALUES 1 UBYTE COLUMN_DIR DIRECT /end RECORD_LAYOUT
/begin RECORD_LAYOUT __UWORD_S FNC_VALUES 1 UWORD COLUMN_DIR DIRECT /end RECORD_LAYOUT
/begin RECORD_LAYOUT __SBYTE_S FNC_VALUES 1 SBYTE COLUMN_DIR DIRECT /end RECORD_LAYOUT
/begin RECORD_LAYOUT __SWORD_S FNC_VALUES 1 SWORD COLUMN_DIR DIRECT /end RECORD_LAYOUT
/begin RECORD_LAYOUT SSV__UWORD_S AXIS_PTS_X 1 UWORD INDEX_INCR DIRECT /end RECORD_LAYOUT
/begin RECORD_LAYOUT SSV__SWORD_S AXIS_PTS_X 1 SWORD INDEX_INCR DIRECT /end RECORD_LAYOUT
/end MODULE
/end PROJECT
