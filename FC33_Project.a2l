ASAP2_VERSION 1 60
/begin PROJECT FC33 ""
/begin HEADER "" VERSION "1.0" /end HEADER
/begin MODULE FC33 ""
/begin MOD_COMMON "" BYTE_ORDER MSB_FIRST ALIGNMENT_LONG 2 ALIGNMENT_WORD 1 /end MOD_COMMON
/begin MEASUREMENT errm_curr_dtc "current dtc code" UWORD u_cnts 0 0 0.00 65535.00 ECU_ADDRESS 0x4000440A FORMAT "%5.0" /end MEASUREMENT
/begin MEASUREMENT errm_hist_dtc "history dtc code" UWORD u_cnts 0 0 0.00 65535.00 ECU_ADDRESS 0x4000440A FORMAT "%5.0" /end MEASUREMENT
/begin MEASUREMENT errm_curr_dtc_typ "current dtc type" UWORD u_dtc_typ 0 0 0.00 65535.00 ECU_ADDRESS 0x4000440A /end MEASUREMENT
/begin MEASUREMENT errm_hist_dtc_typ "history dtc type" UWORD u_dtc_typ 0 0 0.00 65535.00 ECU_ADDRESS 0x4000440A /end MEASUREMENT
/begin MEASUREMENT errm_iupr_denom "iupr denominator" UWORD u_cnts 0 0 0.00 65535.00 ARRAY_SIZE 9 ECU_ADDRESS 0x4000440A FORMAT "%5.0" /end MEASUREMENT
/begin MEASUREMENT errm_iupr_numrtr "iupr numerator" UWORD u_cnts 0 0 0.00 65535.00 ARRAY_SIZE 9 ECU_ADDRESS 0x4000440A FORMAT "%5.0" /end MEASUREMENT
/begin MEASUREMENT errm_iupr_gen_denom "iupr generic denominator" UWORD u_cnts 0 0 0.00 65535.00 ECU_ADDRESS 0x4000440A FORMAT "%5.0" /end MEASUREMENT
/begin MEASUREMENT errm_iupr_ign_cnts "iupr ignition cycle counts" UWORD u_cnts 0 0 0.00 65535.00 ECU_ADDRESS 0x4000440A FORMAT "%5.0" /end MEASUREMENT
/begin MEASUREMENT errm_ign_cyc_tmr "ignition cycle timer" UWORD u_16x_tmr 0 0 0.00 8191.875 ECU_ADDRESS 0x4000440A FORMAT "%5.0" SYMBOL_LINK "errm_iupr_16x_tmr" 0 /end MEASUREMENT
/begin MEASUREMENT errm_den_runtm_tmr "denominator runtime timer" UWORD u_16x_tmr 0 0 0.00 8191.875 ECU_ADDRESS 0x4000440A FORMAT "%5.0" SYMBOL_LINK "errm_iupr_16x_tmr" 2 /end MEASUREMENT
/begin MEASUREMENT errm_den_cp_run_tmr "denominator purge runtime timer" UWORD u_16x_tmr 0 0 0.00 8191.875 ECU_ADDRESS 0x4000440A FORMAT "%5.0" SYMBOL_LINK "errm_iupr_16x_tmr" 4 /end MEASUREMENT
/begin MEASUREMENT errm_den_vspd_tmr "denominator vehicle speed timer" UWORD u_16x_tmr 0 0 0.00 8191.875 ECU_ADDRESS 0x4000440A FORMAT "%5.0" SYMBOL_LINK "errm_iupr_16x_tmr" 6 /end MEASUREMENT
/begin MEASUREMENT errm_den_idl_tmr "denominator idle timer" UWORD u_16x_tmr 0 0 0.00 8191.875 ECU_ADDRESS 0x4000440A FORMAT "%5.0" SYMBOL_LINK "errm_iupr_16x_tmr" 8 /end MEASUREMENT
/begin MEASUREMENT errm_b1_air_on_tmr "denominator idle timer" UWORD u_16x_tmr 0 0 0.00 8191.875 ECU_ADDRESS 0x4000440A FORMAT "%5.0" SYMBOL_LINK "errm_iupr_16x_tmr" 10 /end MEASUREMENT
/begin MEASUREMENT errm_b2_air_on_tmr "denominator idle timer" UWORD u_16x_tmr 0 0 0.00 8191.875 ECU_ADDRESS 0x4000440A FORMAT "%5.0" SYMBOL_LINK "errm_iupr_16x_tmr" 12 /end MEASUREMENT
/begin MEASUREMENT errm_iupr_fault_actv "iupr disable fault active" UBYTE b_true 0 0 0.00 1.00 BIT_MASK 0x1 ECU_ADDRESS 0x4000440A FORMAT "%1.0" /end MEASUREMENT
/begin MEASUREMENT errm_iupr_fault_actv_nv "iupr disable fault active" UBYTE b_true 0 0 0.00 1.00 BIT_MASK 0x1 ECU_ADDRESS 0x4000440A FORMAT "%1.0" /end MEASUREMENT
/begin MEASUREMENT errm_iupr_cmn_met "iupr common conditions met" UBYTE b_true 0 0 0.00 1.00 BIT_MASK 0x1 ECU_ADDRESS 0x4000440A FORMAT "%1.0" /end MEASUREMENT
/begin MEASUREMENT errm_iupr_amp_met "iupr amp condition met" UBYTE b_true 0 0 0.00 1.00 BIT_MASK 0x1 ECU_ADDRESS 0x4000440A FORMAT "%1.0" /end MEASUREMENT
/begin MEASUREMENT errm_iupr_amb_t_met "iupr ambient temp condition met" UBYTE b_true 0 0 0.00 1.00 BIT_MASK 0x1 ECU_ADDRESS 0x4000440A FORMAT "%1.0" /end MEASUREMENT
/begin MEASUREMENT errm_iupr_idl_met "iupr idle condition met" UBYTE b_true 0 0 0.00 1.00 BIT_MASK 0x1 ECU_ADDRESS 0x4000440A FORMAT "%1.0" /end MEASUREMENT
/begin MEASUREMENT errm_iupr_run_met "iupr run condition met" UBYTE b_true 0 0 0.00 1.00 BIT_MASK 0x1 ECU_ADDRESS 0x4000440A FORMAT "%1.0" /end MEASUREMENT
/begin MEASUREMENT errm_iupr_vspd_met "iupr vehicle speed condition met" UBYTE b_true 0 0 0.00 1.00 BIT_MASK 0x1 ECU_ADDRESS 0x4000440A FORMAT "%1.0" /end MEASUREMENT
/begin MEASUREMENT errm_iupr_ign_cnts_nv "iupr ignition cycle counts" UWORD u_cnts 0 0 0.00 65535.00 ECU_ADDRESS 0x4000440A FORMAT "%5.0" /end MEASUREMENT
/begin MEASUREMENT errm_iupr_gen_denom_nv "iupr generic denominator" UWORD u_cnts 0 0 0.00 65535.00 ECU_ADDRESS 0x4000440A FORMAT "%5.0" /end MEASUREMENT
/begin MEASUREMENT errm_iupr_evam_numrtr_nv "iupr evam numerator" UWORD u_cnts 0 0 0.00 65535.00 ECU_ADDRESS 0x4000440A FORMAT "%5.0" /end MEASUREMENT
/begin MEASUREMENT errm_iupr_evam_denom_nv "iupr evam denominator" UWORD u_cnts 0 0 0.00 65535.00 ECU_ADDRESS 0x4000440A FORMAT "%5.0" /end MEASUREMENT
/begin MEASUREMENT errm_iupr_egr_vvt_numrtr_nv "iupr egr vvt numerator" UWORD u_cnts 0 0 0.00 65535.00 ECU_ADDRESS 0x4000440A FORMAT "%5.0" /end MEASUREMENT
/begin MEASUREMENT errm_iupr_egr_vvt_denom_nv "iupr egr vvt denominator" UWORD u_cnts 0 0 0.00 65535.00 ECU_ADDRESS 0x4000440A FORMAT "%5.0" /end MEASUREMENT
/begin MEASUREMENT errm_iupr_air_denom_nv "iupr secondary air injection denominator" UWORD u_cnts 0 0 0.00 65535.00 ECU_ADDRESS 0x4000440A FORMAT "%5.0" /end MEASUREMENT
/begin MEASUREMENT errm_iupr_air_numrtr_nv "iupr secondary air injection numerator" UWORD u_cnts 0 0 0.00 65535.00 ECU_ADDRESS 0x4000440A FORMAT "%5.0" /end MEASUREMENT
/begin MEASUREMENT errm_iupr_b1_uo2_numrtr_nv "iupr bank1 uo2 numerator" UWORD u_cnts 0 0 0.00 65535.00 ECU_ADDRESS 0x4000440A FORMAT "%5.0" /end MEASUREMENT
/begin MEASUREMENT errm_iupr_b2_uo2_numrtr_nv "iupr bank2 uo2 numerator" UWORD u_cnts 0 0 0.00 65535.00 ECU_ADDRESS 0x4000440A FORMAT "%5.0" /end MEASUREMENT
/begin MEASUREMENT errm_iupr_b1_uo2_denom_nv "iupr bank1 uo2 denominator" UWORD u_cnts 0 0 0.00 65535.00 ECU_ADDRESS 0x4000440A FORMAT "%5.0" /end MEASUREMENT
/begin MEASUREMENT errm_iupr_b2_uo2_denom_nv "iupr bank2 uo2 denominator" UWORD u_cnts 0 0 0.00 65535.00 ECU_ADDRESS 0x4000440A FORMAT "%5.0" /end MEASUREMENT
/begin MEASUREMENT errm_iupr_b1_do2_numrtr_nv "iupr bank1 do2 numerator" UWORD u_cnts 0 0 0.00 65535.00 ECU_ADDRESS 0x4000440A FORMAT "%5.0" /end MEASUREMENT
/begin MEASUREMENT errm_iupr_b2_do2_numrtr_nv "iupr bank2 do2 numerator" UWORD u_cnts 0 0 0.00 65535.00 ECU_ADDRESS 0x4000440A FORMAT "%5.0" /end MEASUREMENT
/begin MEASUREMENT errm_iupr_b1_do2_denom_nv "iupr bank1 do2 denominator" UWORD u_cnts 0 0 0.00 65535.00 ECU_ADDRESS 0x4000440A FORMAT "%5.0" /end MEASUREMENT
/begin MEASUREMENT errm_iupr_b2_do2_denom_nv "iupr bank2 do2 denominator" UWORD u_cnts 0 0 0.00 65535.00 ECU_ADDRESS 0x4000440A FORMAT "%5.0" /end MEASUREMENT
/begin MEASUREMENT errm_iupr_b1_cfd_numrtr_nv "iupr bank1 catalyst numerator" UWORD u_cnts 0 0 0.00 65535.00 ECU_ADDRESS 0x4000440A FORMAT "%5.0" /end MEASUREMENT
/begin MEASUREMENT errm_iupr_b2_cfd_numrtr_nv "iupr bank2 catalyst numerator" UWORD u_cnts 0 0 0.00 65535.00 ECU_ADDRESS 0x4000440A FORMAT "%5.0" /end MEASUREMENT
/begin MEASUREMENT errm_iupr_b1_cfd_denom_nv "iupr bank1 catalyst denominator" UWORD u_cnts 0 0 0.00 65535.00 ECU_ADDRESS 0x4000440A FORMAT "%5.0" /end MEASUREMENT
/begin MEASUREMENT errm_iupr_b2_cfd_denom_nv "iupr bank2 catalyst denominator" UWORD u_cnts 0 0 0.00 65535.00 ECU_ADDRESS 0x4000440A FORMAT "%5.0" /end MEASUREMENT
/begin MEASUREMENT errm_iupr_denom_nv "iupr denominator array" UWORD u_cnts 0 0 0.00 65535.00 ARRAY_SIZE 35 ECU_ADDRESS 0x4000440A FORMAT "%5.0" /end MEASUREMENT
/begin MEASUREMENT errm_iupr_numrtr_nv "iupr numerator array" UWORD u_cnts 0 0 0.00 65535.00 ARRAY_SIZE 494 ECU_ADDRESS 0x4000440A FORMAT "%5.0" /end MEASUREMENT
/begin MEASUREMENT errm_warm_cnts "warmup counts for DTC" UBYTE u_cnts 0 0 0.00 255.00 ARRAY_SIZE 494 ECU_ADDRESS 0x4000440A FORMAT "%5.0" /end MEASUREMENT
/begin MEASUREMENT errm_map_fl_met "map short fail met" UBYTE b_true 0 0 0.00 1.00 BIT_MASK 0x1 ECU_ADDRESS 0x4000440A FORMAT "%1.0" /end MEASUREMENT
/begin MEASUREMENT errm_map_fl_actv "map short fail active" UBYTE b_true 0 0 0.00 1.00 BIT_MASK 0x1 ECU_ADDRESS 0x4000440A FORMAT "%1.0" /end MEASUREMENT
/begin MEASUREMENT errm_amp_shrt_actv "amp short fail active" UBYTE b_true 0 0 0.00 1.00 BIT_MASK 0x1 ECU_ADDRESS 0x4000440A FORMAT "%1.0" SYMBOL_LINK "errm_press_shrt_actv" 0 /end MEASUREMENT
/begin MEASUREMENT errm_ect_fl_actv "ect fail active" UBYTE b_true 0 0 0.00 1.00 BIT_MASK 0x1 ECU_ADDRESS 0x4000440A FORMAT "%1.0" /end MEASUREMENT
/begin MEASUREMENT errm_ect_shrt_met "ect short fail met" UBYTE b_true 0 0 0.00 1.00 BIT_MASK 0x1 ECU_ADDRESS 0x4000440A FORMAT "%1.0" /end MEASUREMENT
/begin MEASUREMENT errm_bstp_shrt_actv "boost press short fail active" UBYTE b_true 0 0 0.00 1.00 BIT_MASK 0x1 ECU_ADDRESS 0x4000440A FORMAT "%1.0" SYMBOL_LINK "errm_press_shrt_actv" 1 /end MEASUREMENT
/begin MEASUREMENT errm_map_shrt_actv "map short fail active" UBYTE b_true 0 0 0.00 1.00 BIT_MASK 0x1 ECU_ADDRESS 0x4000440A FORMAT "%1.0" SYMBOL_LINK "errm_press_shrt_actv" 2 /end MEASUREMENT
/begin MEASUREMENT errm_amp_shrt_trip "amp short fail this keyon" UBYTE b_true 0 0 0.00 1.00 BIT_MASK 0x1 ECU_ADDRESS 0x4000440A FORMAT "%1.0" SYMBOL_LINK "errm_press_shrt_trip" 0 /end MEASUREMENT
/begin MEASUREMENT errm_bstp_shrt_trip "boost short press fail this keyon" UBYTE b_true 0 0 0.00 1.00 BIT_MASK 0x1 ECU_ADDRESS 0x4000440A FORMAT "%1.0" SYMBOL_LINK "errm_press_shrt_trip" 1 /end MEASUREMENT
/begin MEASUREMENT errm_map_shrt_trip "map short fail this keyon" UBYTE b_true 0 0 0.00 1.00 BIT_MASK 0x1 ECU_ADDRESS 0x4000440A FORMAT "%1.0" SYMBOL_LINK "errm_press_shrt_trip" 2 /end MEASUREMENT
/begin MEASUREMENT errm_iat_shrt_actv "iat short fail active" UBYTE b_true 0 0 0.00 1.00 BIT_MASK 0x1 ECU_ADDRESS 0x4000440A FORMAT "%1.0" SYMBOL_LINK "errm_temp_shrt_actv" 0 /end MEASUREMENT
/begin MEASUREMENT errm_iat_shrt_met "iat short fail met" UBYTE b_true 0 0 0.00 1.00 BIT_MASK 0x1 ECU_ADDRESS 0x4000440A FORMAT "%1.0" SYMBOL_LINK "errm_temp_shrt_met" 0 /end MEASUREMENT
/begin MEASUREMENT errm_ac_t_shrt_actv "ac temp short fail active" UBYTE b_true 0 0 0.00 1.00 BIT_MASK 0x1 ECU_ADDRESS 0x4000440A FORMAT "%1.0" /end MEASUREMENT
/begin MEASUREMENT errm_iat_fl_actv "iat fail active" UBYTE b_true 0 0 0.00 1.00 ECU_ADDRESS 0x4000440A FORMAT "%1.0" /end MEASUREMENT
/begin MEASUREMENT errm_cpu_ad_fl "adc fail active" UBYTE b_true 0 0 0.00 1.00 ECU_ADDRESS 0x4000440A FORMAT "%1.0" /end MEASUREMENT
/begin MEASUREMENT errm_tps_fl_actv "tps fail active" UBYTE b_true 0 0 0.00 1.00 BIT_MASK 0x1 ECU_ADDRESS 0x4000440A FORMAT "%1.0" /end MEASUREMENT
/begin MEASUREMENT errm_tps_shrt_fl_met "tps short fail condotions met" UBYTE b_true 0 0 0.00 1.00 BIT_MASK 0x1 ECU_ADDRESS 0x4000440A FORMAT "%1.0" /end MEASUREMENT
/begin MEASUREMENT errm_mf_light_req "misfire light request" UBYTE b_true 0 0 0.00 1.00 BIT_MASK 0x1 ECU_ADDRESS 0x4000440A FORMAT "%1.0" /end MEASUREMENT
/begin MEASUREMENT errm_flv_fl "fuel level fail" UBYTE b_true 0 0 0.00 1.00 BIT_MASK 0x1 ECU_ADDRESS 0x4000440A FORMAT "%1.0" /end MEASUREMENT
/begin MEASUREMENT errm_inj_fl_actv "injector fail active" UBYTE b_true 0 0 0.00 1.00 BIT_MASK 0x1 ECU_ADDRESS 0x4000440A FORMAT "%1.0" /end MEASUREMENT
/begin MEASUREMENT errm_est_fl_trip "injector fail active" UBYTE b_true 0 0 0.00 1.00 BIT_MASK 0x1 ECU_ADDRESS 0x4000440A FORMAT "%1.0" /end MEASUREMENT
/begin MEASUREMENT cpd_drv_en "driver diag enable" UBYTE b_true 0 0 0.00 1.00 ARRAY_SIZE 143 ECU_ADDRESS 0x4000440A FORMAT "%1.0" /end MEASUREMENT
/begin MEASUREMENT cpd_drv_fl_met "driver diag fail met" UBYTE b_true 0 0 0.00 1.00 ARRAY_SIZE 143 ECU_ADDRESS 0x4000440A FORMAT "%1.0" /end MEASUREMENT
/begin MEASUREMENT cpd_drv_fl_cnt "driver diag fail counts" UBYTE u_cnts 0 0 0.00 255.00 ARRAY_SIZE 143 ECU_ADDRESS 0x4000440A /end MEASUREMENT
/begin MEASUREMENT cpd_drv_diag_cnt "driver diag counts" UBYTE u_cnts 0 0 0.00 255.00 ARRAY_SIZE 143 ECU_ADDRESS 0x4000440A /end MEASUREMENT
/begin MEASUREMENT cpd_drv_fn "driver diag finish" UBYTE b_true 0 0 0.00 1.00 BIT_MASK 0x80 ARRAY_SIZE 143 ECU_ADDRESS 0x40004EA0 FORMAT "%1.0" SYMBOL_LINK "cpd_drv_info" 0 /end MEASUREMENT
/begin MEASUREMENT cpd_drv_fl "driver diag finish" UBYTE b_true 0 0 0.00 1.00 BIT_MASK 0x40 ARRAY_SIZE 143 ECU_ADDRESS 0x40004EA0 FORMAT "%1.0" SYMBOL_LINK "cpd_drv_info" 0 /end MEASUREMENT
/begin MEASUREMENT cpd_drv_rpt_st "driver diag report state" UBYTE u_rpt_st 0 0 0.00 2.00 BIT_MASK 0x30 ECU_ADDRESS 0x40004EA0 SYMBOL_LINK "cpd_drv_info" 0 /end MEASUREMENT
/begin MEASUREMENT cpd_egr_vlv_met "egr valve conditions met" UBYTE b_true 0 0 0.00 1.00 ECU_ADDRESS 0x4000440A FORMAT "%1.0" /end MEASUREMENT
/begin MEASUREMENT cpd_egr_vlv_cls_dur "egr valve close duration" UBYTE u_16x_tmr 0 0 0.00 31.875 ECU_ADDRESS 0x400050DA FORMAT "%4.2" /end MEASUREMENT
/begin MEASUREMENT cpd_egr_err_en "egr position error diag enable" UBYTE b_true 0 0 0.00 1.00 ECU_ADDRESS 0x4000440A FORMAT "%1.0" /end MEASUREMENT
/begin MEASUREMENT cpd_egr_sp_unstbl "egr position setpoint unstable" UBYTE b_true 0 0 0.00 1.00 ECU_ADDRESS 0x4000440A FORMAT "%1.0" /end MEASUREMENT
/begin MEASUREMENT cpd_egr_err_fl_thr "egr position error fail thr" UWORD u_pct 0 0 0.0 199.996948242187 ECU_ADDRESS 0x4000DA4E /end MEASUREMENT
/begin MEASUREMENT cpd_egr_sp_max "egr position setpoint max" UWORD u_pct 0 0 0.0 199.996948242187 ECU_ADDRESS 0x4000DA4E /end MEASUREMENT
/begin MEASUREMENT cpd_egr_sp_min "egr position setpoint min" UWORD u_pct 0 0 0.0 199.996948242187 ECU_ADDRESS 0x4000DA4E /end MEASUREMENT
/begin MEASUREMENT cpd_egr_err_ar "egr position error diag area" UBYTE u_egr_area 0 0 0.00 2.00 ECU_ADDRESS 0x4000440A FORMAT "%1.0" /end MEASUREMENT
/begin MEASUREMENT cpd_egr_err_ar_stbl "egr position error diag area stable" UBYTE b_true 0 0 0.00 1.00 ECU_ADDRESS 0x4000440A FORMAT "%1.0" /end MEASUREMENT
/begin MEASUREMENT cpd_egr_err_st "egr position error diag state" UBYTE u_egr_err_st 0 0 0.00 2.00 ECU_ADDRESS 0x4000440A FORMAT "%1.0" /end MEASUREMENT
/begin MEASUREMENT cpd_egr_err_log_cnt "egr position error log counts" UBYTE u_cnts 0 0 0.00 255.00 ECU_ADDRESS 0x4000440A /end MEASUREMENT
/begin MEASUREMENT cpd_egr_err_fl_cnt "egr position error fail counts" UBYTE u_cnts 0 0 0.00 255.00 ECU_ADDRESS 0x4000440A /end MEASUREMENT
/begin MEASUREMENT cpd_egr_err_fl "egr position error fail" UBYTE b_true 0 0 0.00 1.00 ECU_ADDRESS 0x4000440A FORMAT "%1.0" /end MEASUREMENT
/begin MEASUREMENT cpd_egr_err_fn "egr position error finish" UBYTE b_true 0 0 0.00 1.00 ECU_ADDRESS 0x4000440A FORMAT "%1.0" /end MEASUREMENT
/begin MEASUREMENT ecsd_ect_cl_dlt "close loop ect to min ect delta" SWORD u_deg_C 0 0 -256 255.9921875 ECU_ADDRESS 0x40004EBC /end MEASUREMENT
/begin MEASUREMENT ecsd_trip_ect_min "min ect temperature this trip" SWORD u_deg_C 0 0 -256 255.9921875 ECU_ADDRESS 0x4000DA4E /end MEASUREMENT
/begin MEASUREMENT ecsd_ect_shrt_hi_fl_cnts "ect sensor short high fail counts" UWORD u_cnts 0 0 0 65535 ECU_ADDRESS 0x40004EA0 FORMAT "%5.0" SYMBOL_LINK "ecsd_ect_shrt_hi" 0 /end MEASUREMENT
/begin MEASUREMENT ecsd_ect_shrt_hi_diag_cnts "ect sensor short high diag counts" UWORD u_cnts 0 0 0 65535 ECU_ADDRESS 0x40004EA0 FORMAT "%5.0" SYMBOL_LINK "ecsd_ect_shrt_hi" 2 /end MEASUREMENT
/begin MEASUREMENT ecsd_ect_shrt_hi_en "ect sensor short high diag enable conditions met" UBYTE b_true 0 0 0.00 1.00 BIT_MASK 0x20 ECU_ADDRESS 0x40004EA0 FORMAT "%5.0" SYMBOL_LINK "ecsd_ect_shrt_hi" 4 /end MEASUREMENT
/begin MEASUREMENT ecsd_ect_shrt_hi_met "ect sensor short high diag fail conditions met" UBYTE b_true 0 0 0.00 1.00 BIT_MASK 0x10 ECU_ADDRESS 0x40004EA0 FORMAT "%5.0" SYMBOL_LINK "ecsd_ect_shrt_hi" 4 /end MEASUREMENT
/begin MEASUREMENT ecsd_ect_shrt_hi_fn "ect sensor short high diag finish" UBYTE b_true 0 0 0.00 1.00 BIT_MASK 0x08 ECU_ADDRESS 0x40004EA0 FORMAT "%5.0" SYMBOL_LINK "ecsd_ect_shrt_hi" 4 /end MEASUREMENT
/begin MEASUREMENT ecsd_ect_shrt_hi_fl "ect sensor short high diag fail" UBYTE b_true 0 0 0.00 1.00 BIT_MASK 0x04 ECU_ADDRESS 0x40004EA0 FORMAT "%5.0" SYMBOL_LINK "ecsd_ect_shrt_hi" 4 /end MEASUREMENT
/begin MEASUREMENT ecsd_ect_shrt_hi_rpt_st "ect sensor short high diag report state" UBYTE u_rpt_st 0 0 0.00 2.00 BIT_MASK 0x03 ECU_ADDRESS 0x40004EA0 SYMBOL_LINK "ecsd_ect_shrt_hi" 4 /end MEASUREMENT
/begin MEASUREMENT ecsd_ect_shrt_lo_fl_cnts "ect sensor short low fail counts" UWORD u_cnts 0 0 0 65535 ECU_ADDRESS 0x40004EA0 FORMAT "%5.0" SYMBOL_LINK "ecsd_ect_shrt_lo" 0 /end MEASUREMENT
/begin MEASUREMENT ecsd_ect_shrt_lo_diag_cnts "ect sensor short low diag counts" UWORD u_cnts 0 0 0 65535 ECU_ADDRESS 0x40004EA0 FORMAT "%5.0" SYMBOL_LINK "ecsd_ect_shrt_lo" 2 /end MEASUREMENT
/begin MEASUREMENT ecsd_ect_shrt_lo_en "ect sensor short low diag enable conditions met" UBYTE b_true 0 0 0.00 1.00 BIT_MASK 0x20 ECU_ADDRESS 0x40004EA0 FORMAT "%5.0" SYMBOL_LINK "ecsd_ect_shrt_lo" 4 /end MEASUREMENT
/begin MEASUREMENT ecsd_ect_shrt_lo_met "ect sensor short low diag fail conditions met" UBYTE b_true 0 0 0.00 1.00 BIT_MASK 0x10 ECU_ADDRESS 0x40004EA0 FORMAT "%5.0" SYMBOL_LINK "ecsd_ect_shrt_lo" 4 /end MEASUREMENT
/begin MEASUREMENT ecsd_ect_shrt_lo_fn "ect sensor short low diag finish" UBYTE b_true 0 0 0.00 1.00 BIT_MASK 0x08 ECU_ADDRESS 0x40004EA0 FORMAT "%5.0" SYMBOL_LINK "ecsd_ect_shrt_lo" 4 /end MEASUREMENT
/begin MEASUREMENT ecsd_ect_shrt_lo_fl "ect sensor short low diag fail" UBYTE b_true 0 0 0.00 1.00 BIT_MASK 0x04 ECU_ADDRESS 0x40004EA0 FORMAT "%5.0" SYMBOL_LINK "ecsd_ect_shrt_lo" 4 /end MEASUREMENT
/begin MEASUREMENT ecsd_ect_shrt_lo_rpt_st "ect sensor short low diag report state" UBYTE u_rpt_st 0 0 0.00 2.00 BIT_MASK 0x03 ECU_ADDRESS 0x40004EA0 SYMBOL_LINK "ecsd_ect_shrt_lo" 4 /end MEASUREMENT
/begin MEASUREMENT ecsd_cl_ect_thr "fuel close loop enable ect" SWORD u_deg_C 0 0 -256 255.9921875 ECU_ADDRESS 0x40004EBC /end MEASUREMENT
/begin MEASUREMENT ecsd_cl_pass_cnts "close loop diag pass counts" UWORD u_cnts 0 0 0 65535 ECU_ADDRESS 0x40004EA0 FORMAT "%5.0" /end MEASUREMENT
/begin MEASUREMENT ecsd_cl_fail_cnts "close loop diag fail counts" UWORD u_cnts 0 0 0 65535 ECU_ADDRESS 0x40004EA0 FORMAT "%5.0" /end MEASUREMENT
/begin MEASUREMENT ecsd_cl_diag_fn "close loop diag finish" UBYTE b_true 0 0 0.00 1.00 ECU_ADDRESS 0x40004EA0 FORMAT "%1.0" /end MEASUREMENT
/begin MEASUREMENT ecsd_cl_diag_fl "close loop diag fail" UBYTE b_true 0 0 0.00 1.00 ECU_ADDRESS 0x40004EA0 FORMAT "%1.0" /end MEASUREMENT
/begin MEASUREMENT ecsd_cl_warm_dur "close loop warm duration" UWORD u_500m_tmr 0 0 0 32767.5 ECU_ADDRESS 0x40004EA0 FORMAT "%6.1" /end MEASUREMENT
/begin MEASUREMENT ecsd_diag_flw_int "close loop diag air flow int" ULONG u_gram_l_16777216 0 0 0 16777215.99609375 ECU_ADDRESS 0x40004EA0 FORMAT "%10.2" /end MEASUREMENT
/begin MEASUREMENT ecsd_diag_idl_tmr "close loop warm duration" UWORD u_500m_tmr 0 0 0 32767.5 ECU_ADDRESS 0x40004EA0 FORMAT "%6.1" SYMBOL_LINK "ecsd_cl_tmr" 0 /end MEASUREMENT
/begin MEASUREMENT ecsd_iat_raw_max "iat raw max" SWORD u_deg_C 0 0 -256 255.9921875 ECU_ADDRESS 0x40004EBC /end MEASUREMENT
/begin MEASUREMENT ecsd_iat_min "iat min this key on" SWORD u_deg_C 0 0 -256 255.9921875 ECU_ADDRESS 0x40004EBC /end MEASUREMENT
/begin MEASUREMENT ecsd_eng_lo_fast_run "engine run fast from stall,not fully power down" UBYTE b_true 0 0 0.00 1.00 ECU_ADDRESS 0x40004EA0 FORMAT "%1.0" /end MEASUREMENT
/begin MEASUREMENT ecsd_ect_raw_out "ect raw out of high/low limit" UBYTE b_true 0 0 0.00 1.00 ECU_ADDRESS 0x40004EA0 FORMAT "%1.0" /end MEASUREMENT
/begin MEASUREMENT ecsd_ect_lo_air_flw_dur "ect low diag enable airflow condition met duration" UWORD u_500m_tmr 0 0 0 32767.5 ECU_ADDRESS 0x40004EA0 FORMAT "%6.1" /end MEASUREMENT
/begin MEASUREMENT ecsd_ect_lo_chg_dlt "ect low diag ect change delta" SWORD u_deg_C 0 0 -256 255.9921875 ECU_ADDRESS 0x40004EBC /end MEASUREMENT
/begin MEASUREMENT ecsd_key_on_ect "key on ect" SWORD u_deg_C 0 0 -256 255.9921875 ECU_ADDRESS 0x40004EBC /end MEASUREMENT
/begin MEASUREMENT ecsd_ect_lo_fl_cnts "ect low diag fail counts" UWORD u_cnts 0 0 0 65535 ECU_ADDRESS 0x40004EA0 FORMAT "%5.0" SYMBOL_LINK "ecsd_ect_lo_diag_data" 0 /end MEASUREMENT
/begin MEASUREMENT ecsd_ect_lo_diag_cnts "ect low diag counts" UWORD u_cnts 0 0 0 65535 ECU_ADDRESS 0x40004EA0 FORMAT "%5.0" SYMBOL_LINK "ecsd_ect_lo_diag_data" 2 /end MEASUREMENT
/begin MEASUREMENT ecsd_ect_lo_en_met "ect low diag enble met" UBYTE b_true 0 0 0 1 BIT_MASK 0x20 ECU_ADDRESS 0x40004EA0 FORMAT "%1.0" SYMBOL_LINK "ecsd_ect_lo_diag_data" 4 /end MEASUREMENT
/begin MEASUREMENT ecsd_ect_lo_fl_met "ect low diag enble met" UBYTE b_true 0 0 0 1 BIT_MASK 0x10 ECU_ADDRESS 0x40004EA0 FORMAT "%1.0" SYMBOL_LINK "ecsd_ect_lo_diag_data" 4 /end MEASUREMENT
/begin MEASUREMENT ecsd_ect_lo_diag_fn "ect low diag finish" UBYTE b_true 0 0 0 1 BIT_MASK 0x08 ECU_ADDRESS 0x40004EA0 FORMAT "%1.0" SYMBOL_LINK "ecsd_ect_lo_diag_data" 4 /end MEASUREMENT
/begin MEASUREMENT ecsd_ect_lo_diag_fl "ect low diag fail" UBYTE b_true 0 0 0 1 BIT_MASK 0x04 ECU_ADDRESS 0x40004EA0 FORMAT "%1.0" SYMBOL_LINK "ecsd_ect_lo_diag_data" 4 /end MEASUREMENT
/begin MEASUREMENT ecsd_ect_lo_rpt_st "ect low diag report state" UBYTE u_rpt_st 0 0 0 2 BIT_MASK 0x03 ECU_ADDRESS 0x40004EA0 FORMAT "%1.0" SYMBOL_LINK "ecsd_ect_lo_diag_data" 4 /end MEASUREMENT
/begin MEASUREMENT ecsd_eng_shi_fast_run "engine run fast from stall,not fully power down" UBYTE b_true 0 0 0.00 1.00 ECU_ADDRESS 0x40004EA0 FORMAT "%1.0" /end MEASUREMENT
/begin MEASUREMENT ecsd_ect_shi_fl_cnts "ect start high diag fail counts" UWORD u_cnts 0 0 0 65535 ECU_ADDRESS 0x40004EA0 FORMAT "%5.0" SYMBOL_LINK "ecsd_ect_shi_diag_data" 0 /end MEASUREMENT
/begin MEASUREMENT ecsd_ect_shi_diag_cnts "ect start high diag counts" UWORD u_cnts 0 0 0 65535 ECU_ADDRESS 0x40004EA0 FORMAT "%5.0" SYMBOL_LINK "ecsd_ect_shi_diag_data" 2 /end MEASUREMENT
/begin MEASUREMENT ecsd_ect_shi_en_met "ect start high diag enble met" UBYTE b_true 0 0 0 1 BIT_MASK 0x20 ECU_ADDRESS 0x40004EA0 FORMAT "%1.0" SYMBOL_LINK "ecsd_ect_shi_diag_data" 4 /end MEASUREMENT
/begin MEASUREMENT ecsd_ect_shi_fl_met "ect start high diag enble met" UBYTE b_true 0 0 0 1 BIT_MASK 0x10 ECU_ADDRESS 0x40004EA0 FORMAT "%1.0" SYMBOL_LINK "ecsd_ect_shi_diag_data" 4 /end MEASUREMENT
/begin MEASUREMENT ecsd_ect_shi_diag_fn "ect start high diag finish" UBYTE b_true 0 0 0 1 BIT_MASK 0x08 ECU_ADDRESS 0x40004EA0 FORMAT "%1.0" SYMBOL_LINK "ecsd_ect_shi_diag_data" 4 /end MEASUREMENT
/begin MEASUREMENT ecsd_ect_shi_diag_fl "ect start high diag fail" UBYTE b_true 0 0 0 1 BIT_MASK 0x04 ECU_ADDRESS 0x40004EA0 FORMAT "%1.0" SYMBOL_LINK "ecsd_ect_shi_diag_data" 4 /end MEASUREMENT
/begin MEASUREMENT ecsd_ect_shi_rpt_st "ect start high diag report state" UBYTE u_rpt_st 0 0 0 2 BIT_MASK 0x03 ECU_ADDRESS 0x40004EA0 FORMAT "%1.0" SYMBOL_LINK "ecsd_ect_shi_diag_data" 4 /end MEASUREMENT
/begin MEASUREMENT ecsd_eng_hi_fast_run "engine run fast from stall,not fully power down" UBYTE b_true 0 0 0.00 1.00 ECU_ADDRESS 0x40004EA0 FORMAT "%1.0" /end MEASUREMENT
/begin MEASUREMENT ecsd_eng_hi_flw_avg "engine high diag airflow average" UWORD u_g_per_sec 0 0 0 511.9921875 ECU_ADDRESS 0x40004EA0 /end MEASUREMENT
/begin MEASUREMENT ecsd_eng_hi_flw_mmv "engine high diag airflow mmv" UWORD u_g_per_sec 0 0 0 511.9921875 ECU_ADDRESS 0x40004EA0 /end MEASUREMENT
/begin MEASUREMENT ecsd_eng_hi_stl_dur "engine stall duration" UWORD u_16x_tmr 0 0 0 8191.875 ECU_ADDRESS 0x40004EA0 SYMBOL_LINK "ecsd_eng_hi_tmr" 0 /end MEASUREMENT
/begin MEASUREMENT ecsd_eng_hi_dly "diag delay" UWORD u_16x_tmr 0 0 0 8191.875 ECU_ADDRESS 0x40004EA0 SYMBOL_LINK "ecsd_eng_hi_tmr" 2 /end MEASUREMENT
/begin MEASUREMENT ecsd_ect_hi_en_st "ect diag high enable state" UBYTE u_ecsd_hi_en_st 0 0 0.00 11.00 ECU_ADDRESS 0x40004EA0 FORMAT "%2.0" /end MEASUREMENT
/begin MEASUREMENT ecsd_ect_hi_pass_cnts "high diag pass counts" UWORD u_cnts 0 0 0 65535 ECU_ADDRESS 0x40004EA0 FORMAT "%5.0" /end MEASUREMENT
/begin MEASUREMENT ecsd_ect_hi_fl_cnts "high diag fail counts" UWORD u_cnts 0 0 0 65535 ECU_ADDRESS 0x40004EA0 FORMAT "%5.0" /end MEASUREMENT
/begin MEASUREMENT ecsd_ect_hi_diag_fl "ect high diag fail" UBYTE b_true 0 0 0 1 ECU_ADDRESS 0x40004EA0 FORMAT "%1.0" /end MEASUREMENT
/begin MEASUREMENT ecsd_ect_hi_diag_fn "ect high diag finish" UBYTE b_true 0 0 0 1 ECU_ADDRESS 0x40004EA0 FORMAT "%1.0" /end MEASUREMENT
/begin MEASUREMENT ecsd_them_temp_thr "them ect thr" SWORD u_deg_C 0 0 -256 255.9921875 ECU_ADDRESS 0x40004EBC /end MEASUREMENT
/begin MEASUREMENT ecsd_them_diag_en_met "them diag enable met" UBYTE b_true 0 0 0 1 ECU_ADDRESS 0x40004EA0 FORMAT "%1.0" /end MEASUREMENT
/begin MEASUREMENT ecsd_them_warm_dur "them warm duration" UWORD u_500m_tmr 0 0 0 32767.5 ECU_ADDRESS 0x40004EA0 FORMAT "%6.1" /end MEASUREMENT
/begin MEASUREMENT ecsd_them_pass_cnts "them pass counts" UWORD u_cnts 0 0 0 65535 ECU_ADDRESS 0x40004EA0 FORMAT "%5.0" /end MEASUREMENT
/begin MEASUREMENT ecsd_them_fail_cnts "them fail counts" UWORD u_cnts 0 0 0 65535 ECU_ADDRESS 0x40004EA0 FORMAT "%5.0" /end MEASUREMENT
/begin MEASUREMENT ecsd_them_diag_fl "them diag fail" UBYTE b_true 0 0 0 1 ECU_ADDRESS 0x40004EA0 FORMAT "%1.0" /end MEASUREMENT
/begin MEASUREMENT ecsd_them_diag_fn "them diag finish" UBYTE b_true 0 0 0 1 ECU_ADDRESS 0x40004EA0 FORMAT "%1.0" /end MEASUREMENT
/begin MEASUREMENT ecsd_them_en_st "them enable state" UBYTE u_ecsd_diag_st 0 0 0.00 21.00 ECU_ADDRESS 0x40004EA0 FORMAT "%2.0" /end MEASUREMENT
/begin MEASUREMENT ecsd_cl_en_st "close loop diag enable state" UBYTE u_ecsd_diag_st 0 0 0.00 21.00 ECU_ADDRESS 0x40004EA0 FORMAT "%2.0" /end MEASUREMENT
/begin MEASUREMENT ecsd_ect_stck_fl_cnts "ect start high diag fail counts" UWORD u_cnts 0 0 0 65535 ECU_ADDRESS 0x40004EA0 FORMAT "%5.0" SYMBOL_LINK "ecsd_ect_stck_diag_data" 0 /end MEASUREMENT
/begin MEASUREMENT ecsd_ect_stck_diag_cnts "ect start high diag counts" UWORD u_cnts 0 0 0 65535 ECU_ADDRESS 0x40004EA0 FORMAT "%5.0" SYMBOL_LINK "ecsd_ect_stck_diag_data" 2 /end MEASUREMENT
/begin MEASUREMENT ecsd_ect_stck_en_met "ect start high diag enble met" UBYTE b_true 0 0 0 1 BIT_MASK 0x20 ECU_ADDRESS 0x40004EA0 FORMAT "%1.0" SYMBOL_LINK "ecsd_ect_stck_diag_data" 4 /end MEASUREMENT
/begin MEASUREMENT ecsd_ect_stck_fl_met "ect start high diag enble met" UBYTE b_true 0 0 0 1 BIT_MASK 0x10 ECU_ADDRESS 0x40004EA0 FORMAT "%1.0" SYMBOL_LINK "ecsd_ect_stck_diag_data" 4 /end MEASUREMENT
/begin MEASUREMENT ecsd_ect_stck_diag_fn "ect start high diag finish" UBYTE b_true 0 0 0 1 BIT_MASK 0x08 ECU_ADDRESS 0x40004EA0 FORMAT "%1.0" SYMBOL_LINK "ecsd_ect_stck_diag_data" 4 /end MEASUREMENT
/begin MEASUREMENT ecsd_ect_stck_diag_fl "ect start high diag fail" UBYTE b_true 0 0 0 1 BIT_MASK 0x04 ECU_ADDRESS 0x40004EA0 FORMAT "%1.0" SYMBOL_LINK "ecsd_ect_stck_diag_data" 4 /end MEASUREMENT
/begin MEASUREMENT ecsd_ect_stck_rpt_st "ect start high diag report state" UBYTE u_rpt_st 0 0 0 2 BIT_MASK 0x03 ECU_ADDRESS 0x40004EA0 FORMAT "%1.0" SYMBOL_LINK "ecsd_ect_stck_diag_data" 4 /end MEASUREMENT
/begin MEASUREMENT ecsd_eng_stck_fast_run "engine run fast from stall,not fully power down" UBYTE b_true 0 0 0.00 1.00 ECU_ADDRESS 0x40004EA0 FORMAT "%1.0" /end MEASUREMENT
/begin CHARACTERISTIC ECSD_V_ECT_SHRT_LO_FL_CNTS "ECT short low fail counts" VALUE 0x0002038C __UWORD_S 0 u_cnts 0 65535 FORMAT "%5.0" SYMBOL_LINK "ECSD_C_ECT_SHRT_LO_CNTS" 0 /end CHARACTERISTIC
/begin CHARACTERISTIC ECSD_V_ECT_SHRT_LO_DIAG_CNTS "ECT short low diag counts" VALUE 0x0002038C __UWORD_S 0 u_cnts 0 65535 FORMAT "%5.0" SYMBOL_LINK "ECSD_C_ECT_SHRT_LO_CNTS" 2 /end CHARACTERISTIC
/begin CHARACTERISTIC ECSD_V_ECT_SHRT_HI_FL_CNTS "ECT short high fail counts" VALUE 0x0002038C __UWORD_S 0 u_cnts 0 65535 FORMAT "%5.0" SYMBOL_LINK "ECSD_C_ECT_SHRT_HI_CNTS" 0 /end CHARACTERISTIC
/begin CHARACTERISTIC ECSD_V_ECT_SHRT_HI_DIAG_CNTS "ECT short high diag counts" VALUE 0x0002038C __UWORD_S 0 u_cnts 0 65535 FORMAT "%5.0" SYMBOL_LINK "ECSD_C_ECT_SHRT_HI_CNTS" 2 /end CHARACTERISTIC
/begin CHARACTERISTIC CPD_V_DRV_EN_VLT_HI "driver diag enable voltage high" VALUE 0x0002038C __UWORD_S 0 u_volt_32 0 31.99951171875 FORMAT "%4.2" /end CHARACTERISTIC
/begin CHARACTERISTIC CPD_V_DRV_EN_VLT_LO "driver diag enable voltage low" VALUE 0x0002038C __UWORD_S 0 u_volt_32 0 31.99951171875 FORMAT "%4.2" /end CHARACTERISTIC
/begin CHARACTERISTIC CPD_V_DRV_STRT_RLY_VLT_LO "starter relay diag enable voltage low" VALUE 0x0002038C __UWORD_S 0 u_volt_32 0 31.99951171875 FORMAT "%4.2" /end CHARACTERISTIC
/begin CHARACTERISTIC CPD_V_DRV_MPR_FL_DIAG_NUM "main relay diag fail other diag pass number" VALUE 0x0002038C __UBYTE_S 0 u_cnts 0 255 /end CHARACTERISTIC
/begin CHARACTERISTIC CPD_V_DRV_MPR_FL_CNTS "main relay diag fail counts" VALUE 0x0002038C __UWORD_S 0 u_cnts 0 65535 FORMAT "%5.0" /end CHARACTERISTIC
/begin CHARACTERISTIC CPD_V_DRV_MPR_DIAG_CNTS "main relay diag counts" VALUE 0x0002038C __UWORD_S 0 u_cnts 0 65535 FORMAT "%5.0" /end CHARACTERISTIC
/begin CHARACTERISTIC CPD_V_DRV_MPR_EN_DIAG_NUM "main relay diag enable other diag number" VALUE 0x0002038C __UBYTE_S 0 u_cnts 0 255 /end CHARACTERISTIC
/begin CHARACTERISTIC CPD_V_DRV_MPR_EN_DLY "main relay diag enable delay" VALUE 0x0002038C __UBYTE_S 0 u_16x_tmr 0 8191.875 FORMAT "%4.1" /end CHARACTERISTIC
/begin CHARACTERISTIC CPD_C_DRV_MPR_DIAG_LIST "main relay diag used other diag" CURVE 0x000200B0 __UBYTE_S 0 b_true 0 1 FORMAT "%1.0"
 /begin AXIS_DESCR FIX_AXIS NO_INPUT_QUANTITY u_drvd_list 143 0 142
  /begin FIX_AXIS_PAR_LIST 0 1 2 3 4 5 6 7 8 9 10 11 12 13 14 15 16 17 18 19 20 21 22 23 24 25 26 27 28 29 30 31 32 33 34 35 36 37 38 39 40 41 42 43 44 45 46 47 48 49 50 51 52 53 54 55 56 57 58 59 60 61 62 63 64 65 66 67 68 69 70 71 72 73 74 75 76 77 78 79 80 81 82 83 84 85 86 87 88 89 90 91 92 93 94 95 96 97 98 99 100 101 102 103 104 105 106 107 108 109 110 111 112 113 114 115 116 117 118 119 120 121 122 123 124 125 126 127 128 129 130 131 132 133 134 135 136 137 138 139 140 141 142 /end FIX_AXIS_PAR_LIST
 /end AXIS_DESCR
/end CHARACTERISTIC
/begin CHARACTERISTIC CPD_C_DRV_MPR_DIAG_DIS_LIST "diag disable list when main relay diag fail" CURVE 0x000200B0 __UBYTE_S 0 b_true 0 1 FORMAT "%1.0"
 /begin AXIS_DESCR FIX_AXIS NO_INPUT_QUANTITY u_drvd_list 143 0 142
  /begin FIX_AXIS_PAR_LIST 0 1 2 3 4 5 6 7 8 9 10 11 12 13 14 15 16 17 18 19 20 21 22 23 24 25 26 27 28 29 30 31 32 33 34 35 36 37 38 39 40 41 42 43 44 45 46 47 48 49 50 51 52 53 54 55 56 57 58 59 60 61 62 63 64 65 66 67 68 69 70 71 72 73 74 75 76 77 78 79 80 81 82 83 84 85 86 87 88 89 90 91 92 93 94 95 96 97 98 99 100 101 102 103 104 105 106 107 108 109 110 111 112 113 114 115 116 117 118 119 120 121 122 123 124 125 126 127 128 129 130 131 132 133 134 135 136 137 138 139 140 141 142 /end FIX_AXIS_PAR_LIST
 /end AXIS_DESCR
/end CHARACTERISTIC
/begin CHARACTERISTIC CPD_C_DRV_FL_CNTS "drive fail counts" CURVE 0x000200B0 __UBYTE_S 0 u_cnts 0 255
 /begin AXIS_DESCR FIX_AXIS NO_INPUT_QUANTITY u_drvd_list 143 0 142
  /begin FIX_AXIS_PAR_LIST 0 1 2 3 4 5 6 7 8 9 10 11 12 13 14 15 16 17 18 19 20 21 22 23 24 25 26 27 28 29 30 31 32 33 34 35 36 37 38 39 40 41 42 43 44 45 46 47 48 49 50 51 52 53 54 55 56 57 58 59 60 61 62 63 64 65 66 67 68 69 70 71 72 73 74 75 76 77 78 79 80 81 82 83 84 85 86 87 88 89 90 91 92 93 94 95 96 97 98 99 100 101 102 103 104 105 106 107 108 109 110 111 112 113 114 115 116 117 118 119 120 121 122 123 124 125 126 127 128 129 130 131 132 133 134 135 136 137 138 139 140 141 142 /end FIX_AXIS_PAR_LIST
 /end AXIS_DESCR
/end CHARACTERISTIC
/begin CHARACTERISTIC CPD_C_DRV_DIAG_CNTS "drive diag counts" CURVE 0x000200B0 __UBYTE_S 0 u_cnts 0 255
 /begin AXIS_DESCR FIX_AXIS NO_INPUT_QUANTITY u_drvd_list 143 0 142
  /begin FIX_AXIS_PAR_LIST 0 1 2 3 4 5 6 7 8 9 10 11 12 13 14 15 16 17 18 19 20 21 22 23 24 25 26 27 28 29 30 31 32 33 34 35 36 37 38 39 40 41 42 43 44 45 46 47 48 49 50 51 52 53 54 55 56 57 58 59 60 61 62 63 64 65 66 67 68 69 70 71 72 73 74 75 76 77 78 79 80 81 82 83 84 85 86 87 88 89 90 91 92 93 94 95 96 97 98 99 100 101 102 103 104 105 106 107 108 109 110 111 112 113 114 115 116 117 118 119 120 121 122 123 124 125 126 127 128 129 130 131 132 133 134 135 136 137 138 139 140 141 142 /end FIX_AXIS_PAR_LIST
 /end AXIS_DESCR
/end CHARACTERISTIC
/begin CHARACTERISTIC CPD_V_DRV_STRT_RLY_EN_SRC "starter relay diag enable crank req source" VALUE 0x0002038C __UBYTE_S 0 u_crk_src 0 2 FORMAT "%1.0" /end CHARACTERISTIC
/begin CHARACTERISTIC CPD_V_DRV_EGR_EN_RUN_MIN "EGR valve diag enable engine run min" VALUE 0x0002038C __UWORD_S 0 u_cnts 0 65535 FORMAT "%5.0" /end CHARACTERISTIC
/begin CHARACTERISTIC CPD_V_NS_EN_VLT_MIN "Neutral switch diag enable voltage min" VALUE 0x0002038C __UWORD_S 0 u_volt_32 0 31.99951171875 FORMAT "%4.2" SYMBOL_LINK "CPD_C_N_SW_DIAG_THR" 0 /end CHARACTERISTIC
/begin CHARACTERISTIC CPD_V_NS_EN_VLT_MAX "Neutral switch diag enable voltage max" VALUE 0x0002038C __UWORD_S 0 u_volt_32 0 31.99951171875 FORMAT "%4.2" SYMBOL_LINK "CPD_C_N_SW_DIAG_THR" 2 /end CHARACTERISTIC
/begin CHARACTERISTIC CPD_V_NS_PASS_TRSN_CNTS "Neutral switch diag pass transient counts" VALUE 0x0002038C __UBYTE_S 0 u_cnts 0 255 SYMBOL_LINK "CPD_C_N_SW_DIAG_THR" 4 /end CHARACTERISTIC
/begin CHARACTERISTIC CPD_V_NS_STK_ON_ESPD_MIN "Neutral switch stuck on diag enable engine speed min" VALUE 0x0002038C __UWORD_S 0 u_espd 0 8191.875000 FORMAT "%5.1" SYMBOL_LINK "CPD_C_N_SW_DIAG_THR" 6 /end CHARACTERISTIC
/begin CHARACTERISTIC CPD_V_NS_STK_ON_ESPD_MAX "Neutral switch stuck on diag enable engine speed max" VALUE 0x0002038C __UWORD_S 0 u_espd 0 8191.875000 FORMAT "%5.1" SYMBOL_LINK "CPD_C_N_SW_DIAG_THR" 8 /end CHARACTERISTIC
/begin CHARACTERISTIC CPD_V_NS_STK_ON_VSPD_MIN "Neutral switch stuck on diag enable vehicle speed max" VALUE 0x0002038C __UWORD_S 0 u_vspd 0 511.9921875 SYMBOL_LINK "CPD_C_N_SW_DIAG_THR" 10 /end CHARACTERISTIC
/begin CHARACTERISTIC CPD_V_NS_STK_ON_MAP_MIN "Neutral switch stuck on diag enable map min" VALUE 0x0002038C __UWORD_S 0 u_kPa_0_256 0 255.99609375 SYMBOL_LINK "CPD_C_N_SW_DIAG_THR" 12 /end CHARACTERISTIC
/begin CHARACTERISTIC CPD_V_NS_STK_ON_PPS_MIN "Neutral switch stuck on diag enable pps min" VALUE 0x0002038C __UWORD_S 0 u_pct 0 199.996948 SYMBOL_LINK "CPD_C_N_SW_DIAG_THR" 14 /end CHARACTERISTIC
/begin CHARACTERISTIC CPD_V_NS_STK_ON_FL_CNTS "Neutral switch diag stuck on fail counts" VALUE 0x0002038C __UBYTE_S 0 u_cnts 0 255 SYMBOL_LINK "CPD_C_N_SW_DIAG_THR" 16 /end CHARACTERISTIC
/begin CHARACTERISTIC CPD_V_NS_STK_ON_DUR "Neutral switch diag stuck on keep duration" VALUE 0x0002038C __UBYTE_S 0 u_16x_tmr 0 8191.875 FORMAT "%4.2" SYMBOL_LINK "CPD_C_N_SW_DIAG_THR" 17 /end CHARACTERISTIC
/begin CHARACTERISTIC CPD_V_NS_STK_ON_USE_ACC "Neutral switch diag stuck on use accumulated keep duration" VALUE 0x0002038C __UBYTE_S 0 b_true 0 1 FORMAT "%1.0" SYMBOL_LINK "CPD_C_N_SW_DIAG_THR" 18 /end CHARACTERISTIC
/begin CHARACTERISTIC CPD_V_NS_STK_OFF_ESPD_MIN "Neutral switch stuck off diag enable engine speed min" VALUE 0x0002038C __UWORD_S 0 u_espd 0 8191.875000 FORMAT "%5.1" SYMBOL_LINK "CPD_C_N_SW_DIAG_THR" 20 /end CHARACTERISTIC
/begin CHARACTERISTIC CPD_V_NS_STK_OFF_ESPD_MAX "Neutral switch stuck off diag enable engine speed max" VALUE 0x0002038C __UWORD_S 0 u_espd 0 8191.875000 FORMAT "%5.1" SYMBOL_LINK "CPD_C_N_SW_DIAG_THR" 22 /end CHARACTERISTIC
/begin CHARACTERISTIC CPD_V_NS_STK_OFF_VSPD_MIN "Neutral switch stuck off diag enable vehicle speed max" VALUE 0x0002038C __UWORD_S 0 u_vspd 0 511.9921875 SYMBOL_LINK "CPD_C_N_SW_DIAG_THR" 24 /end CHARACTERISTIC
/begin CHARACTERISTIC CPD_V_NS_STK_ON_MAP_MAX "Neutral switch stuck off diag enable map max" VALUE 0x0002038C __UWORD_S 0 u_kPa_0_256 0 255.99609375 SYMBOL_LINK "CPD_C_N_SW_DIAG_THR" 26 /end CHARACTERISTIC
/begin CHARACTERISTIC CPD_V_NS_STK_OFF_ECT_MIN "Neutral switch stuck off diag enable ect min" VALUE 0x0002038C __SWORD_S 0 u_deg_C -256 255.9921875 FORMAT "%4.1" SYMBOL_LINK "CPD_C_N_SW_DIAG_THR" 28 /end CHARACTERISTIC
/begin CHARACTERISTIC CPD_V_NS_STK_OFF_ECT_MAX "Neutral switch stuck off diag enable ect max" VALUE 0x0002038C __SWORD_S 0 u_deg_C -256 255.9921875 FORMAT "%4.1" SYMBOL_LINK "CPD_C_N_SW_DIAG_THR" 28 /end CHARACTERISTIC
/begin CHARACTERISTIC CPD_V_NS_STK_OFF_FL_CNTS "Neutral switch diag stuck off fail counts" VALUE 0x0002038C __UBYTE_S 0 u_cnts 0 255 SYMBOL_LINK "CPD_C_N_SW_DIAG_THR" 30 /end CHARACTERISTIC
/begin CHARACTERISTIC CPD_V_NS_STK_OFF_DUR "Neutral switch diag stuck off keep duration" VALUE 0x0002038C __UBYTE_S 0 u_16x_tmr 0 8191.875 FORMAT "%4.2" SYMBOL_LINK "CPD_C_N_SW_DIAG_THR" 32 /end CHARACTERISTIC
/begin CHARACTERISTIC CPD_V_NS_STK_OFF_USE_ACC "Neutral switch diag stuck off use accumulated keep duration" VALUE 0x0002038C __UBYTE_S 0 b_true 0 1 FORMAT "%1.0" SYMBOL_LINK "CPD_C_N_SW_DIAG_THR" 34 /end CHARACTERISTIC
/begin CHARACTERISTIC CPD_C_CLS_VSPD_LO "clutch switch stuck diag vehicle speed low" CURVE 0x000200B0 __UWORD_S 0 u_vspd 0 511.9921875 FORMAT "%4.1"
 /begin AXIS_DESCR FIX_AXIS NO_INPUT_QUANTITY u_cltch_typ 2 0 1 /begin FIX_AXIS_PAR_LIST 0 1 /end FIX_AXIS_PAR_LIST /end AXIS_DESCR
/end CHARACTERISTIC
/begin CHARACTERISTIC CPD_C_CLS_VSPD_HI "clutch switch stuck diag vehicle speed high" CURVE 0x000200B0 __UWORD_S 0 u_vspd 0 511.9921875 FORMAT "%4.1"
 /begin AXIS_DESCR FIX_AXIS NO_INPUT_QUANTITY u_cltch_typ 2 0 1 /begin FIX_AXIS_PAR_LIST 0 1 /end FIX_AXIS_PAR_LIST /end AXIS_DESCR
/end CHARACTERISTIC
/begin CHARACTERISTIC CPD_C_CLS_VSPD_LO_CNTS "clutch switch stuck diag vehicle speed low duration counts" CURVE 0x000200B0 __UBYTE_S 0 u_cnts 0 255
 /begin AXIS_DESCR FIX_AXIS NO_INPUT_QUANTITY u_cltch_typ 2 0 1 /begin FIX_AXIS_PAR_LIST 0 1 /end FIX_AXIS_PAR_LIST /end AXIS_DESCR
/end CHARACTERISTIC
/begin CHARACTERISTIC CPD_C_CLS_VSPD_HI_CNTS "clutch switch stuck diag vehicle speed high duration counts" CURVE 0x000200B0 __UBYTE_S 0 u_cnts 0 255
 /begin AXIS_DESCR FIX_AXIS NO_INPUT_QUANTITY u_cltch_typ 2 0 1 /begin FIX_AXIS_PAR_LIST 0 1 /end FIX_AXIS_PAR_LIST /end AXIS_DESCR
/end CHARACTERISTIC
/begin CHARACTERISTIC CPD_C_CLS_VSPD_TRS_CNTS "clutch switch stuck diag vehicle speed high duration counts" CURVE 0x000200B0 __UBYTE_S 0 u_cnts 0 255
 /begin AXIS_DESCR FIX_AXIS NO_INPUT_QUANTITY u_cltch_typ 2 0 1 /begin FIX_AXIS_PAR_LIST 0 1 /end FIX_AXIS_PAR_LIST /end AXIS_DESCR
/end CHARACTERISTIC
/begin CHARACTERISTIC CPD_V_SRLY_NO_DT_RLY "no drive train relay for starter relay diag" VALUE 0x0002038C __UBYTE_S 0 b_true 0 1 FORMAT "%1.0" /end CHARACTERISTIC
/begin CHARACTERISTIC CPD_V_DT_RLY_CTRL_TYP "drive train relay control type" VALUE 0x0002038C __UBYTE_S 0 u_dt_ctrl_typ 0 4 FORMAT "%1.0" /end CHARACTERISTIC
/begin CHARACTERISTIC CPD_V_SRLY_OPN_FL_DLY "starter relay open fail control active delay" VALUE 0x0002038C __UWORD_S 0 u_1x_tmr 0 511.9921875 FORMAT "%4.1" /end CHARACTERISTIC
/begin CHARACTERISTIC CPD_V_SRLY_STCK_EN_DLY "starter relay stuck diag enable delay" VALUE 0x0002038C __UWORD_S 0 u_16x_tmr 0 8191.875 /end CHARACTERISTIC
/begin CHARACTERISTIC CPD_V_SRLY_STCK_FL_CNTS "starter relay stuck diag fail counts" VALUE 0x0002038C __UWORD_S 0 u_cnts 0 65535 FORMAT "%5.0" SYMBOL_LINK "CPD_C_SRLY_STCK_CNTS" 0 /end CHARACTERISTIC
/begin CHARACTERISTIC CPD_V_SRLY_STCK_DIAG_CNTS "starter relay stuck diag counts" VALUE 0x0002038C __UWORD_S 0 u_cnts 0 65535 FORMAT "%5.0" SYMBOL_LINK "CPD_C_SRLY_STCK_CNTS" 2 /end CHARACTERISTIC
/begin CHARACTERISTIC CPD_V_SRLY_KEY_ON_DLY "starter relay diag keyon delay" VALUE 0x0002038C __UWORD_S 0 u_1x_tmr 0 511.9921875 FORMAT "%4.1" /end CHARACTERISTIC
/begin CHARACTERISTIC CPD_V_DRLY_STCK_VSPD "drive train relay diag enable vehicle speed" VALUE 0x0002038C __UWORD_S 0 u_1x_tmr 0 511.9921875 FORMAT "%4.1" /end CHARACTERISTIC
/begin CHARACTERISTIC CPD_V_DRLY_STCK_FL_CNTS "drive train relay stuck diag fail counts" VALUE 0x0002038C __UWORD_S 0 u_cnts 0 65535 FORMAT "%5.0" /end CHARACTERISTIC
/begin CHARACTERISTIC CPD_V_DRLY_STCK_DIAG_DUR "drive train relay diag duration" VALUE 0x0002038C __UWORD_S 0 u_1x_tmr 0 511.9921875 FORMAT "%4.1" /end CHARACTERISTIC
/begin CHARACTERISTIC CPD_V_SRLY_ST_OPN_FL_DLY "starter relay state open diag fail delay" VALUE 0x0002038C __UWORD_S 0 u_16x_tmr 0 8191.875 /end CHARACTERISTIC
/begin CHARACTERISTIC CPD_V_SRLY_ST_OPN_FL_CNTS "starter relay stuck diag fail counts" VALUE 0x0002038C __UWORD_S 0 u_cnts 0 65535 FORMAT "%5.0" SYMBOL_LINK "CPD_C_SRLY_ST_OPN_CNTS" 0 /end CHARACTERISTIC
/begin CHARACTERISTIC CPD_V_SRLY_ST_OPN_DIAG_CNTS "starter relay stuck diag counts" VALUE 0x0002038C __UWORD_S 0 u_cnts 0 65535 FORMAT "%5.0" SYMBOL_LINK "CPD_C_SRLY_ST_OPN_CNTS" 2 /end CHARACTERISTIC
/begin CHARACTERISTIC CPD_V_STRTER_FL_MAP_DLT "starter fail map delta" VALUE 0x0002038C __UWORD_S 0 u_kPa_0_256 0 255.99609375 /end CHARACTERISTIC
/begin CHARACTERISTIC CPD_V_STRTER_FL_DLY "starter fail delay" VALUE 0x0002038C __UWORD_S 0 u_1x_tmr 0 511.9921875 FORMAT "%4.1" /end CHARACTERISTIC
/begin CHARACTERISTIC CPD_V_SRLY_ST_OPN_CRK_VLT "starter state open diag enable voltage min" VALUE 0x0002038C __UWORD_S 0 u_volt_32 0 31.99951171875 FORMAT "%4.2" /end CHARACTERISTIC
/begin CHARACTERISTIC CPD_V_DT_EN_DLY "drive train diag enable delay" VALUE 0x0002038C __UWORD_S 0 u_16x_tmr 0 8191.875 /end CHARACTERISTIC
/begin CHARACTERISTIC CPD_V_DT_SHRT_LO_FL_CNTS "drive train low diag fail counts" VALUE 0x0002038C __UWORD_S 0 u_cnts 0 65535 FORMAT "%5.0" SYMBOL_LINK "CPD_C_DT_SHRT_LO_CNTS" 0 /end CHARACTERISTIC
/begin CHARACTERISTIC CPD_V_DT_SHRT_LO_DIAG_CNTS "drive train low diag counts" VALUE 0x0002038C __UWORD_S 0 u_cnts 0 65535 FORMAT "%5.0" SYMBOL_LINK "CPD_C_DT_SHRT_LO_CNTS" 2 /end CHARACTERISTIC
/begin CHARACTERISTIC CPD_V_DT_SHRT_HI_FL_CNTS "drive train high diag fail counts" VALUE 0x0002038C __UWORD_S 0 u_cnts 0 65535 FORMAT "%5.0" SYMBOL_LINK "CPD_C_DT_SHRT_HI_CNTS" 0 /end CHARACTERISTIC
/begin CHARACTERISTIC CPD_V_DT_SHRT_HI_DIAG_CNTS "drive train high diag counts" VALUE 0x0002038C __UWORD_S 0 u_cnts 0 65535 FORMAT "%5.0" SYMBOL_LINK "CPD_C_DT_SHRT_HI_CNTS" 2 /end CHARACTERISTIC
/begin CHARACTERISTIC CPD_V_DT_STCK_LO_VSPD "drive train stuck low enable vehicle speed min" VALUE 0x0002038C __UWORD_S 0 u_vspd 0 511.9921875 /end CHARACTERISTIC
/begin CHARACTERISTIC CPD_V_DT_STCK_LO_MAP "drive train stuck low enable map min" VALUE 0x0002038C __UWORD_S 0 u_kPa_0_256 0 255.99609375 /end CHARACTERISTIC
/begin CHARACTERISTIC CPD_V_DT_STCK_LO_ESPD_MIN "drive train stuck low enable engine speed min" VALUE 0x0002038C __UWORD_S 0 u_espd 0 8191.875000 FORMAT "%5.1" /end CHARACTERISTIC
/begin CHARACTERISTIC CPD_V_DT_STCK_LO_ESPD_MAX "drive train stuck low enable engine speed max" VALUE 0x0002038C __UWORD_S 0 u_espd 0 8191.875000 FORMAT "%5.1" /end CHARACTERISTIC
/begin CHARACTERISTIC CPD_V_DT_STCK_LO_TPS "drive train stuck low enable tps min" VALUE 0x0002038C __UWORD_S 0 u_pct 0 199.996948 FORMAT "%4.1" /end CHARACTERISTIC
/begin CHARACTERISTIC CPD_V_DT_STCK_LO_ECT "drive train stuck low enable ect min" VALUE 0x0002038C __SWORD_S 0 u_deg_C -256 255.9921875 FORMAT "%4.1" /end CHARACTERISTIC
/begin CHARACTERISTIC CPD_V_DT_STCK_HI_ECT "drive train stuck low enable ect min" VALUE 0x0002038C __SWORD_S 0 u_deg_C -256 255.9921875 FORMAT "%4.1" /end CHARACTERISTIC
/begin CHARACTERISTIC CPD_V_DT_STCK_HI_ESPD_DLT "drive train stuck high enable idle engine speed delta max" VALUE 0x0002038C __SWORD_S 0 u_espd -4096.0 4095.875 FORMAT "%4.1" /end CHARACTERISTIC
/begin CHARACTERISTIC CPD_V_DT_STCK_HI_FL_CNTS "drive train stuck high diag fail counts" VALUE 0x0002038C __UWORD_S 0 u_cnts 0 65535 FORMAT "%5.0" /end CHARACTERISTIC
/begin CHARACTERISTIC CPD_V_DT_STCK_LO_FL_CNTS "drive train stuck low diag fail counts" VALUE 0x0002038C __UWORD_S 0 u_cnts 0 65535 FORMAT "%5.0" /end CHARACTERISTIC
/begin CHARACTERISTIC CPD_V_DT_STCK_LO_DIAG_CNTS "drive train stuck low diag counts" VALUE 0x0002038C __UWORD_S 0 u_cnts 0 65535 FORMAT "%5.0" /end CHARACTERISTIC
/begin CHARACTERISTIC CPD_V_EGR_ERR_EN_IAT_MIN "EGR open position enable IAT min" VALUE 0x0002038C __SWORD_S 0 u_deg_C -256 255.9921875 /end CHARACTERISTIC
/begin CHARACTERISTIC CPD_V_EGR_ERR_PRE_CLS_MAX "EGR open position enable previous close min" VALUE 0x0002038C __UWORD_S 0 u_pct 0 199.996948 FORMAT "%4.1" /end CHARACTERISTIC
/begin CHARACTERISTIC CPD_V_EGR_ERR_PRE_CLS_DUR "EGR open position enable previous close duration" VALUE 0x0002038C __UWORD_S 0 u_16x_tmr 0 8191.875 /end CHARACTERISTIC
/begin CHARACTERISTIC CPD_V_EGR_ERR_HI_LO_THR "EGR open position high thr" VALUE 0x0002038C __UWORD_S 0 u_pct 0 199.996948 FORMAT "%4.1" /end CHARACTERISTIC
/begin CHARACTERISTIC CPD_V_EGR_ERR_HI_DLT "EGR open position high fail delta" VALUE 0x0002038C __UWORD_S 0 u_pct 0 199.996948 FORMAT "%4.1" /end CHARACTERISTIC
/begin CHARACTERISTIC CPD_V_EGR_ERR_LO_DLT "EGR open position low fail delta" VALUE 0x0002038C __UWORD_S 0 u_pct 0 199.996948 FORMAT "%4.1" /end CHARACTERISTIC
/begin CHARACTERISTIC CPD_V_EGR_ERR_SP_STBL_DLT "EGR open position setpoint stable delta" VALUE 0x0002038C __UWORD_S 0 u_pct 0 199.996948 FORMAT "%4.1" /end CHARACTERISTIC
/begin CHARACTERISTIC CPD_V_EGR_ERR_FL_LOG_CNTS "EGR open position fail log counts" VALUE 0x0002038C __UBYTE_S 0 u_cnts 0 255 /end CHARACTERISTIC
/begin CHARACTERISTIC CPD_V_EGR_ERR_FL_CNTS "EGR open position fail counts" VALUE 0x0002038C __UBYTE_S 0 u_cnts 0 255 /end CHARACTERISTIC
/begin CHARACTERISTIC CPD_V_ETC_PERF_THR_DYN_FAC "ETC performance thr dynamic factor" VALUE 0x0002038C __UWORD_S 0 u_fac_16 0 15.999756 FORMAT "%4.2" /end CHARACTERISTIC
/begin CHARACTERISTIC CPD_V_ETC_PERF_THR_DYN_DCY "ETC performance thr dynamic decay" VALUE 0x0002038C __UWORD_S 0 u_pct_r 0 127.998046875 /end CHARACTERISTIC
/begin CHARACTERISTIC CPD_C_ETC_PERF_DLT_THR_HI "ETC performance delta high thr" CURVE 0x000200B0 __SWORD_S 0 u_pct_r_s -128 127.99609375 FORMAT "%4.1" SYMBOL_LINK "CPD_C_ETC_PERF_DLT_THR_HI" 2
 /begin AXIS_DESCR FIX_AXIS thro_pos_sp u_pct 11 0 100
  /begin FIX_AXIS_PAR_LIST 0 3276.8 6553.6 9830.4 13107.2 16384 19660.8 22937.6 26214.4 29491.2 32768 /end FIX_AXIS_PAR_LIST
 /end AXIS_DESCR
/end CHARACTERISTIC
/begin CHARACTERISTIC CPD_V_ETC_PERF_THR_MAX "ETC performance thr dynamic decay" VALUE 0x0002038C __SWORD_S 0 u_pct_r_s 0 127.99609375 /end CHARACTERISTIC
/begin CHARACTERISTIC CPD_V_ETC_PERF_LO_INC_CNTS "ETC performance fail counts increase step" VALUE 0x0002038C __UWORD_S 0 u_cnts 0 65535 FORMAT "%5.0" SYMBOL_LINK "CPD_C_ETC_PERF_LO_CNTS" 0 /end CHARACTERISTIC
/begin CHARACTERISTIC CPD_V_ETC_PERF_LO_QK_DEC_CNTS "ETC performance fail counts quick decrease step" VALUE 0x0002038C __UWORD_S 0 u_cnts 0 65535 FORMAT "%5.0" SYMBOL_LINK "CPD_C_ETC_PERF_LO_CNTS" 2 /end CHARACTERISTIC
/begin CHARACTERISTIC CPD_V_ETC_PERF_LO_DEC_CNTS "ETC performance fail counts decrease step" VALUE 0x0002038C __UWORD_S 0 u_cnts 0 65535 FORMAT "%5.0" SYMBOL_LINK "CPD_C_ETC_PERF_LO_CNTS" 4 /end CHARACTERISTIC
/begin CHARACTERISTIC CPD_V_ETC_PERF_LO_FL_CNTS "ETC performance fail counts thr" VALUE 0x0002038C __UWORD_S 0 u_cnts 0 65535 FORMAT "%5.0" SYMBOL_LINK "CPD_C_ETC_PERF_LO_CNTS" 6 /end CHARACTERISTIC
/begin CHARACTERISTIC CPD_V_ETC_PERF_LO_STL_FL_CNTS "ETC performance stall fail counts thr" VALUE 0x0002038C __UWORD_S 0 u_cnts 0 65535 FORMAT "%5.0" SYMBOL_LINK "CPD_C_ETC_PERF_LO_CNTS" 8 /end CHARACTERISTIC
/begin CHARACTERISTIC CPD_V_ETC_PERF_LO_DIAG_CNTS "ETC performance stall diag counts" VALUE 0x0002038C __UWORD_S 0 u_cnts 0 65535 FORMAT "%5.0" SYMBOL_LINK "CPD_C_ETC_PERF_LO_CNTS" 10 /end CHARACTERISTIC
/begin CHARACTERISTIC CPD_V_ETC_PERF_HI_INC_CNTS "ETC performance fail counts increase step" VALUE 0x0002038C __UWORD_S 0 u_cnts 0 65535 FORMAT "%5.0" SYMBOL_LINK "CPD_C_ETC_PERF_HI_CNTS" 0 /end CHARACTERISTIC
/begin CHARACTERISTIC CPD_V_ETC_PERF_HI_QK_DEC_CNTS "ETC performance fail counts quick decrease step" VALUE 0x0002038C __UWORD_S 0 u_cnts 0 65535 FORMAT "%5.0" SYMBOL_LINK "CPD_C_ETC_PERF_HI_CNTS" 2 /end CHARACTERISTIC
/begin CHARACTERISTIC CPD_V_ETC_PERF_HI_DEC_CNTS "ETC performance fail counts decrease step" VALUE 0x0002038C __UWORD_S 0 u_cnts 0 65535 FORMAT "%5.0" SYMBOL_LINK "CPD_C_ETC_PERF_HI_CNTS" 4 /end CHARACTERISTIC
/begin CHARACTERISTIC CPD_V_ETC_PERF_HI_FL_CNTS "ETC performance fail counts thr" VALUE 0x0002038C __UWORD_S 0 u_cnts 0 65535 FORMAT "%5.0" SYMBOL_LINK "CPD_C_ETC_PERF_HI_CNTS" 6 /end CHARACTERISTIC
/begin CHARACTERISTIC CPD_V_ETC_PERF_HI_STL_FL_CNTS "ETC performance stall fail counts thr" VALUE 0x0002038C __UWORD_S 0 u_cnts 0 65535 FORMAT "%5.0" SYMBOL_LINK "CPD_C_ETC_PERF_HI_CNTS" 8 /end CHARACTERISTIC
/begin CHARACTERISTIC CPD_V_ETC_PERF_HI_DIAG_CNTS "ETC performance stall diag counts" VALUE 0x0002038C __UWORD_S 0 u_cnts 0 65535 FORMAT "%5.0" SYMBOL_LINK "CPD_C_ETC_PERF_HI_CNTS" 10 /end CHARACTERISTIC
/begin CHARACTERISTIC CPD_V_ETC_CTRL_PASS_RUN_MIN "ETC control mode pass runtime min" VALUE 0x0002038C __UWORD_S 0 u_1s_tmr 0 65535 /end CHARACTERISTIC
/begin CHARACTERISTIC CPD_V_ETC_PERF_SS_EN_SP_CHG "ETC steadystate performance enable setpoint change max" VALUE 0x0002038C __UWORD_S 0 u_pct_r 0 127.998046875 /end CHARACTERISTIC
/begin CHARACTERISTIC CPD_V_ETC_PERF_SS_EN_DLY "EGR steadystate performance enable delay" VALUE 0x0002038C __UWORD_S 0 u_2x_tmr 0 511.9921875 /end CHARACTERISTIC
/begin CHARACTERISTIC CPD_V_ETC_PERF_SS_FL_THR_HI "ETC steadystate performance fail delta thr high" VALUE 0x0002038C __UWORD_S 0 u_pct_r 0 127.998046875 /end CHARACTERISTIC
/begin CHARACTERISTIC CPD_V_ETC_PERF_SS_FL_THR_LO "ETC steadystate performance fail delta thr low" VALUE 0x0002038C __UWORD_S 0 u_pct_r 0 127.998046875 /end CHARACTERISTIC
/begin CHARACTERISTIC CPD_V_ETC_PERF_SS_POS_HI "ETC steadystate performance postion to use high fail thr" VALUE 0x0002038C __UWORD_S 0 u_pct_r 0 127.998046875 /end CHARACTERISTIC
/begin CHARACTERISTIC CPD_V_ETC_PERF_SS_FL_DUR "EGR steadystate performance fail duration" VALUE 0x0002038C __UWORD_S 0 u_2x_tmr 0 511.9921875 /end CHARACTERISTIC
/begin CHARACTERISTIC CPD_V_ETC_PERF_SS_DIAG_DUR "EGR steadystate performance diag duration" VALUE 0x0002038C __UWORD_S 0 u_2x_tmr 0 511.9921875 /end CHARACTERISTIC
/begin CHARACTERISTIC CPD_V_DRV_ESTA_LO_FL_CNTS "esta short low fail counts" VALUE 0x0002038C __UWORD_S 0 u_cnts 0 65535 FORMAT "%5.0" SYMBOL_LINK "CPD_C_DRV_ESTA_LO_CNTS" 0 /end CHARACTERISTIC
/begin CHARACTERISTIC CPD_V_DRV_ESTA_LO_DIAG_CNTS "esta short low diag counts" VALUE 0x0002038C __UWORD_S 0 u_cnts 0 65535 FORMAT "%5.0" SYMBOL_LINK "CPD_C_DRV_ESTA_LO_CNTS" 2 /end CHARACTERISTIC
/begin CHARACTERISTIC CPD_V_DRV_ESTA_HI_FL_CNTS "esta short high fail counts" VALUE 0x0002038C __UWORD_S 0 u_cnts 0 65535 FORMAT "%5.0" SYMBOL_LINK "CPD_C_DRV_ESTA_HI_CNTS" 0 /end CHARACTERISTIC
/begin CHARACTERISTIC CPD_V_DRV_ESTA_HI_DIAG_CNTS "esta short high diag counts" VALUE 0x0002038C __UWORD_S 0 u_cnts 0 65535 FORMAT "%5.0" SYMBOL_LINK "CPD_C_DRV_ESTA_HI_CNTS" 2 /end CHARACTERISTIC
/begin CHARACTERISTIC CPD_V_DRV_ESTA_OPN_FL_CNTS "esta short high fail counts" VALUE 0x0002038C __UWORD_S 0 u_cnts 0 65535 FORMAT "%5.0" SYMBOL_LINK "CPD_C_DRV_ESTA_OPN_CNTS" 0 /end CHARACTERISTIC
/begin CHARACTERISTIC CPD_V_DRV_ESTA_OPN_DIAG_CNTS "esta short high diag counts" VALUE 0x0002038C __UWORD_S 0 u_cnts 0 65535 FORMAT "%5.0" SYMBOL_LINK "CPD_C_DRV_ESTA_OPN_CNTS" 2 /end CHARACTERISTIC
/begin CHARACTERISTIC CPD_V_DRV_ESTB_LO_FL_CNTS "estb short low fail counts" VALUE 0x0002038C __UWORD_S 0 u_cnts 0 65535 FORMAT "%5.0" SYMBOL_LINK "CPD_C_DRV_ESTB_LO_CNTS" 0 /end CHARACTERISTIC
/begin CHARACTERISTIC CPD_V_DRV_ESTB_LO_DIAG_CNTS "estb short low diag counts" VALUE 0x0002038C __UWORD_S 0 u_cnts 0 65535 FORMAT "%5.0" SYMBOL_LINK "CPD_C_DRV_ESTB_LO_CNTS" 2 /end CHARACTERISTIC
/begin CHARACTERISTIC CPD_V_DRV_ESTB_HI_FL_CNTS "estb short high fail counts" VALUE 0x0002038C __UWORD_S 0 u_cnts 0 65535 FORMAT "%5.0" SYMBOL_LINK "CPD_C_DRV_ESTB_HI_CNTS" 0 /end CHARACTERISTIC
/begin CHARACTERISTIC CPD_V_DRV_ESTB_HI_DIAG_CNTS "estb short high diag counts" VALUE 0x0002038C __UWORD_S 0 u_cnts 0 65535 FORMAT "%5.0" SYMBOL_LINK "CPD_C_DRV_ESTB_HI_CNTS" 2 /end CHARACTERISTIC
/begin CHARACTERISTIC CPD_V_DRV_ESTB_OPN_FL_CNTS "estb short high fail counts" VALUE 0x0002038C __UWORD_S 0 u_cnts 0 65535 FORMAT "%5.0" SYMBOL_LINK "CPD_C_DRV_ESTB_OPN_CNTS" 0 /end CHARACTERISTIC
/begin CHARACTERISTIC CPD_V_DRV_ESTB_OPN_DIAG_CNTS "estb short high diag counts" VALUE 0x0002038C __UWORD_S 0 u_cnts 0 65535 FORMAT "%5.0" SYMBOL_LINK "CPD_C_DRV_ESTB_OPN_CNTS" 2 /end CHARACTERISTIC
/begin CHARACTERISTIC CPD_V_DRV_ESTC_LO_FL_CNTS "estc short low fail counts" VALUE 0x0002038C __UWORD_S 0 u_cnts 0 65535 FORMAT "%5.0" SYMBOL_LINK "CPD_C_DRV_ESTC_LO_CNTS" 0 /end CHARACTERISTIC
/begin CHARACTERISTIC CPD_V_DRV_ESTC_LO_DIAG_CNTS "estc short low diag counts" VALUE 0x0002038C __UWORD_S 0 u_cnts 0 65535 FORMAT "%5.0" SYMBOL_LINK "CPD_C_DRV_ESTC_LO_CNTS" 2 /end CHARACTERISTIC
/begin CHARACTERISTIC CPD_V_DRV_ESTC_HI_FL_CNTS "estc short high fail counts" VALUE 0x0002038C __UWORD_S 0 u_cnts 0 65535 FORMAT "%5.0" SYMBOL_LINK "CPD_C_DRV_ESTC_HI_CNTS" 0 /end CHARACTERISTIC
/begin CHARACTERISTIC CPD_V_DRV_ESTC_HI_DIAG_CNTS "estc short high diag counts" VALUE 0x0002038C __UWORD_S 0 u_cnts 0 65535 FORMAT "%5.0" SYMBOL_LINK "CPD_C_DRV_ESTC_HI_CNTS" 2 /end CHARACTERISTIC
/begin CHARACTERISTIC CPD_V_DRV_ESTC_OPN_FL_CNTS "estc short high fail counts" VALUE 0x0002038C __UWORD_S 0 u_cnts 0 65535 FORMAT "%5.0" SYMBOL_LINK "CPD_C_DRV_ESTC_OPN_CNTS" 0 /end CHARACTERISTIC
/begin CHARACTERISTIC CPD_V_DRV_ESTC_OPN_DIAG_CNTS "estc short high diag counts" VALUE 0x0002038C __UWORD_S 0 u_cnts 0 65535 FORMAT "%5.0" SYMBOL_LINK "CPD_C_DRV_ESTC_OPN_CNTS" 2 /end CHARACTERISTIC
/begin CHARACTERISTIC CPD_V_DRV_ESTD_LO_FL_CNTS "estd short low fail counts" VALUE 0x0002038C __UWORD_S 0 u_cnts 0 65535 FORMAT "%5.0" SYMBOL_LINK "CPD_C_DRV_ESTD_LO_CNTS" 0 /end CHARACTERISTIC
/begin CHARACTERISTIC CPD_V_DRV_ESTD_LO_DIAG_CNTS "estd short low diag counts" VALUE 0x0002038C __UWORD_S 0 u_cnts 0 65535 FORMAT "%5.0" SYMBOL_LINK "CPD_C_DRV_ESTD_LO_CNTS" 2 /end CHARACTERISTIC
/begin CHARACTERISTIC CPD_V_DRV_ESTD_HI_FL_CNTS "estd short high fail counts" VALUE 0x0002038C __UWORD_S 0 u_cnts 0 65535 FORMAT "%5.0" SYMBOL_LINK "CPD_C_DRV_ESTD_HI_CNTS" 0 /end CHARACTERISTIC
/begin CHARACTERISTIC CPD_V_DRV_ESTD_HI_DIAG_CNTS "estd short high diag counts" VALUE 0x0002038C __UWORD_S 0 u_cnts 0 65535 FORMAT "%5.0" SYMBOL_LINK "CPD_C_DRV_ESTD_HI_CNTS" 2 /end CHARACTERISTIC
/begin CHARACTERISTIC CPD_V_DRV_ESTD_OPN_FL_CNTS "estd short high fail counts" VALUE 0x0002038C __UWORD_S 0 u_cnts 0 65535 FORMAT "%5.0" SYMBOL_LINK "CPD_C_DRV_ESTD_OPN_CNTS" 0 /end CHARACTERISTIC
/begin CHARACTERISTIC CPD_V_DRV_ESTD_OPN_DIAG_CNTS "estd short high diag counts" VALUE 0x0002038C __UWORD_S 0 u_cnts 0 65535 FORMAT "%5.0" SYMBOL_LINK "CPD_C_DRV_ESTD_OPN_CNTS" 2 /end CHARACTERISTIC
/begin CHARACTERISTIC CPD_V_DRV_EST_EN_VLT "est diag enable voltage min" VALUE 0x0002038C __UWORD_S 0 u_volt_32 0 31.99951171875 FORMAT "%4.2" /end CHARACTERISTIC
/begin CHARACTERISTIC CPD_V_DRV_EST_EN_MPR_DLY "est diag enable main power relay delay" VALUE 0x0002038C __UWORD_S 0 u_1x_tmr 0 511.9921875 FORMAT "%4.1" /end CHARACTERISTIC
/begin CHARACTERISTIC CPD_V_DRV_EST_EN_RUN_DLY "est diag enable run delay" VALUE 0x0002038C __UWORD_S 0 u_1x_tmr 0 511.9921875 FORMAT "%4.1" /end CHARACTERISTIC
/begin CHARACTERISTIC ECSD_M_ECT_CL_DUR_THR "duration thr to close loop enable ECT" MAP 0x00020320 __UWORD_S 0 u_500m_tmr 0 32767.5 FORMAT "%6.1" SYMBOL_LINK "ECSD_M_ECT_CL_DUR_THR" 4
 /begin AXIS_DESCR COM_AXIS ecsd_ect_cl_dlt u_deg_C 9 -256 255.992188 AXIS_PTS_REF ECSD_X_ECT_DLT /end AXIS_DESCR
 /begin AXIS_DESCR COM_AXIS sys_air_flap_pct u_pct_1 6 0 99.9984741210937 AXIS_PTS_REF ECSD_X_AIR_FLAP_PCT /end AXIS_DESCR
/end CHARACTERISTIC
/begin AXIS_PTS ECSD_X_ECT_DLT "" 0x0002006C ecsd_ect_cl_dlt SSV__SWORD_S 0 u_deg_C 9 -256 255.992188 DEPOSIT ABSOLUTE SYMBOL_LINK "ECSD_X_ECT_DLT" 2 /end AXIS_PTS
/begin AXIS_PTS ECSD_X_AIR_FLAP_PCT "" 0x0002006C sys_air_flap_pct SSV__UWORD_S 0 u_pct_1 6 0 99.9984741210937 FORMAT "%4.2" DEPOSIT ABSOLUTE SYMBOL_LINK "ECSD_X_AIR_FLAP_PCT" 2 /end AXIS_PTS
/begin CHARACTERISTIC ECSD_C_ECT_CL_DIS_FLW "close loop enable ECT diag disable airflow sum max" CURVE 0x000200B0 __ULONG_S 0 u_g_per_sec_256 0 16777215.99609375 FORMAT "%9.1" SYMBOL_LINK "ECSD_C_ECT_CL_DIS_FLW" 4
 /begin AXIS_DESCR FIX_AXIS NO_INPUT_QUANTITY u_deg_C 9 -40 120 /begin FIX_AXIS_PAR_LIST -5120 -2560 0 2560 5120 7680 10240 12800 15360 /end FIX_AXIS_PAR_LIST /end AXIS_DESCR
/end CHARACTERISTIC
/begin CHARACTERISTIC ECSD_C_ECT_CL_DIS_IDL "close loop enable ECT diag disable idle duration max" CURVE 0x000200B0 __UWORD_S 0 u_500m_tmr 0 32767.5 FORMAT "%6.1" SYMBOL_LINK "ECSD_C_ECT_CL_DIS_IDL" 2
 /begin AXIS_DESCR FIX_AXIS NO_INPUT_QUANTITY u_deg_C 9 -40 120 /begin FIX_AXIS_PAR_LIST -5120 -2560 0 2560 5120 7680 10240 12800 15360 /end FIX_AXIS_PAR_LIST /end AXIS_DESCR
/end CHARACTERISTIC
/begin CHARACTERISTIC ECSD_V_RPT_KP_MIN "ECT report enable keep duration min" VALUE 0x0002038C __UWORD_S 0 u_cnts 0 65535 FORMAT "%5.0" /end CHARACTERISTIC
/begin CHARACTERISTIC ECSD_V_DIAG_EN_IAT_MIN "diag enable IAT min" VALUE 0x0002038C __SWORD_S 0 u_deg_C -256 255.992188 FORMAT "%4.1" /end CHARACTERISTIC
/begin CHARACTERISTIC ECSD_V_ECT_CL_FCO_NUM "ECT close loop enable fuel cut off number thr" VALUE 0x0002038C __UBYTE_S 0 u_cnts 0 4 FORMAT "%1.0" /end CHARACTERISTIC
/begin CHARACTERISTIC ECSD_C_ECT_CL_FCO_COOL_DLT "fuel cut off cool down time delta substract from ECT increase duration" CURVE 0x000200B0 __UWORD_S 0 u_500m_tmr 0 32767.5 FORMAT "%6.1" SYMBOL_LINK "ECSD_C_ECT_CL_FCO_COOL_DLT" 2
 /begin AXIS_DESCR COM_AXIS NO_INPUT_QUANTITY u_deg_C 5 -256 255.992188 AXIS_PTS_REF ECSD_X_T_DLT /end AXIS_DESCR
/end CHARACTERISTIC
/begin AXIS_PTS ECSD_X_T_DLT "" 0x0002006C NO_INPUT_QUANTITY SSV__SWORD_S 0 u_deg_C 5 -256 255.992188 DEPOSIT ABSOLUTE SYMBOL_LINK "ECSD_X_T_DLT" 2 /end AXIS_PTS
/begin CHARACTERISTIC ECSD_V_THEM_EN_IAT "thermostat diag enable IAT min" VALUE 0x0002038C __SWORD_S 0 u_deg_C -256 255.992188 FORMAT "%4.1" /end CHARACTERISTIC
/begin CHARACTERISTIC ECSD_V_THEM_EN_KEYON_ECT_DLT "thermostat diag enable keyon ECT delta" VALUE 0x0002038C __SWORD_S 0 u_deg_C -256 255.992188 FORMAT "%4.1" /end CHARACTERISTIC
/begin CHARACTERISTIC ECSD_V_THEM_FCO_NUM "thermostat fuel cut off number thr" VALUE 0x0002038C __UBYTE_S 0 u_cnts 0 4 FORMAT "%1.0" /end CHARACTERISTIC
/begin CHARACTERISTIC ECSD_C_THEM_FCO_COOL_DLT "fuel cut off cool down time delta substract from ECT increase duration" CURVE 0x000200B0 __UWORD_S 0 u_500m_tmr 0 32767.5 FORMAT "%6.1" SYMBOL_LINK "ECSD_C_THEM_FCO_COOL_DLT" 2
 /begin AXIS_DESCR COM_AXIS NO_INPUT_QUANTITY u_deg_C 5 -256 255.992188 AXIS_PTS_REF ECSD_X_T_DLT /end AXIS_DESCR
/end CHARACTERISTIC
/begin CHARACTERISTIC ECSD_C_THEM_ECT_THR "thermostat ECT setpoint" CURVE 0x000200B0 __SWORD_S 0 u_deg_C -256 255.992188 SYMBOL_LINK "ECSD_C_THEM_ECT_THR" 2
 /begin AXIS_DESCR COM_AXIS ecsd_ect_cl_dlt u_deg_C 9 -256 255.992188 AXIS_PTS_REF ECSD_X_ECT_DLT /end AXIS_DESCR
/end CHARACTERISTIC
/begin CHARACTERISTIC ECSD_M_THEM_DUR_THR "duration thr to thermostat ECT setpoint" MAP 0x00020320 __UWORD_S 0 u_500m_tmr 0 32767.5 FORMAT "%6.1" SYMBOL_LINK "ECSD_M_THEM_DUR_THR" 4
 /begin AXIS_DESCR COM_AXIS ecsd_ect_cl_dlt u_deg_C 9 -256 255.992188 AXIS_PTS_REF ECSD_X_ECT_DLT /end AXIS_DESCR
 /begin AXIS_DESCR COM_AXIS sys_air_flap_pct u_pct_1 6 0 99.9984741210937 AXIS_PTS_REF ECSD_X_AIR_FLAP_PCT /end AXIS_DESCR
/end CHARACTERISTIC
/begin CHARACTERISTIC ECSD_C_THEM_DIS_FLW "thermostat diag disable airflow sum max" CURVE 0x000200B0 __ULONG_S 0 u_g_per_sec_256 0 16777215.99609375 FORMAT "%9.1" SYMBOL_LINK "ECSD_C_THEM_DIS_FLW" 4
 /begin AXIS_DESCR FIX_AXIS NO_INPUT_QUANTITY u_deg_C 9 -40 120 /begin FIX_AXIS_PAR_LIST -5120 -2560 0 2560 5120 7680 10240 12800 15360 /end FIX_AXIS_PAR_LIST /end AXIS_DESCR
/end CHARACTERISTIC
/begin CHARACTERISTIC ECSD_C_THEM_DIS_IDL "thermostat diag disable idle duration max" CURVE 0x000200B0 __UWORD_S 0 u_500m_tmr 0 32767.5 FORMAT "%6.1" SYMBOL_LINK "ECSD_C_THEM_DIS_IDL" 2
 /begin AXIS_DESCR FIX_AXIS NO_INPUT_QUANTITY u_deg_C 9 -40 120 /begin FIX_AXIS_PAR_LIST -5120 -2560 0 2560 5120 7680 10240 12800 15360 /end FIX_AXIS_PAR_LIST /end AXIS_DESCR
/end CHARACTERISTIC
/begin CHARACTERISTIC ECSD_V_ECT_LO_EN_IAT_MAX "ECT low diag enable IAT max" VALUE 0x0002038C __SWORD_S 0 u_deg_C -256 255.992188 FORMAT "%4.1" /end CHARACTERISTIC
/begin CHARACTERISTIC ECSD_V_ECT_LO_EN_RUN_DLY "ECT low diag enable run delay" VALUE 0x0002038C __UWORD_S 0 u_1s_tmr 0 65535 /end CHARACTERISTIC
/begin CHARACTERISTIC ECSD_C_ECT_LO_AIR_FLW_MIN "ECT low diag airflow thr" CURVE 0x000200B0 __UWORD_S 0 u_g_per_sec 0 511.9921875 FORMAT "%4.1" SYMBOL_LINK "ECSD_C_ECT_LO_AIR_FLW_MIN" 2
 /begin AXIS_DESCR FIX_AXIS sys_keyon_iat u_deg_C 5 -40 40 /begin FIX_AXIS_PAR_LIST -5120 -2560 0 2560 5120 /end FIX_AXIS_PAR_LIST /end AXIS_DESCR
/end CHARACTERISTIC
/begin CHARACTERISTIC ECSD_C_ECT_LO_AIR_FLW_DUR "ECT low diag airflow condition met duration" CURVE 0x000200B0 __UWORD_S 0 u_500m_tmr 0 32767.5 FORMAT "%6.1" SYMBOL_LINK "ECSD_C_ECT_LO_AIR_FLW_DUR" 2
 /begin AXIS_DESCR FIX_AXIS sys_keyon_iat u_deg_C 5 -40 40 /begin FIX_AXIS_PAR_LIST -5120 -2560 0 2560 5120 /end FIX_AXIS_PAR_LIST /end AXIS_DESCR
/end CHARACTERISTIC
/begin CHARACTERISTIC ECSD_V_ECT_LO_FL_ECT_DLT "ECT low diag fail ECT delta" VALUE 0x0002038C __SWORD_S 0 u_deg_C -256 255.992188 FORMAT "%4.1" /end CHARACTERISTIC
/begin CHARACTERISTIC ECSD_V_ECT_LO_FL_CNTS "ECT low diag fail counts" VALUE 0x0002038C __UWORD_S 0 u_cnts 0 65535 FORMAT "%5.0" SYMBOL_LINK "ECSD_C_ECT_LO_CNTS" 0 /end CHARACTERISTIC
/begin CHARACTERISTIC ECSD_V_ECT_LO_DIAG_CNTS "ECT low diag counts" VALUE 0x0002038C __UWORD_S 0 u_cnts 0 65535 FORMAT "%5.0" SYMBOL_LINK "ECSD_C_ECT_LO_CNTS" 2 /end CHARACTERISTIC
/begin CHARACTERISTIC ECSD_V_ECT_LO_EN_OFFT_MIN "ECT low diag enable off time min" VALUE 0x0002038C __UWORD_S 0 u_min 0 65535 /end CHARACTERISTIC
/begin CHARACTERISTIC ECSD_V_ECT_SHI_EN_OFFT_MIN "ECT start high diag enable off time min" VALUE 0x0002038C __UWORD_S 0 u_min 0 65535 /end CHARACTERISTIC
/begin CHARACTERISTIC ECSD_V_ECT_SHI_EN_IAT_MAX "ECT start high diag enable IAT max" VALUE 0x0002038C __SWORD_S 0 u_deg_C -256 255.992188 FORMAT "%4.1" /end CHARACTERISTIC
/begin CHARACTERISTIC ECSD_V_ECT_SHI_FL_THR "ECT start high diag fail thr" VALUE 0x0002038C __SWORD_S 0 u_deg_C -256 255.992188 FORMAT "%4.1" /end CHARACTERISTIC
/begin CHARACTERISTIC ECSD_V_ECT_SHI_FL_CNTS "ECT start high diag fail counts" VALUE 0x0002038C __UWORD_S 0 u_cnts 0 65535 FORMAT "%5.0" SYMBOL_LINK "ECSD_C_ECT_LO_CNTS" 0 /end CHARACTERISTIC
/begin CHARACTERISTIC ECSD_V_ECT_SHI_DIAG_CNTS "ECT start high diag counts" VALUE 0x0002038C __UWORD_S 0 u_cnts 0 65535 FORMAT "%5.0" SYMBOL_LINK "ECSD_C_ECT_SHI_CNTS" 2 /end CHARACTERISTIC
/begin CHARACTERISTIC ECSD_V_ECT_SHRT_DUR "ECT short duration to bypass rationanlity diag" VALUE 0x0002038C __UWORD_S 0 u_500m_tmr 0 32767.5 FORMAT "%6.1" /end CHARACTERISTIC
/begin CHARACTERISTIC ECSD_V_IDL_VSPD_MAX "idle vehicle speed max" VALUE 0x0002038C __UWORD_S 0 u_vspd 0 511.9921875 /end CHARACTERISTIC
/begin CHARACTERISTIC ECSD_V_ECT_HI_EN_IAT_MAX "ECT high diag enable IAT max" VALUE 0x0002038C __SWORD_S 0 u_deg_C -256 255.992188 FORMAT "%4.1" /end CHARACTERISTIC
/begin CHARACTERISTIC ECSD_V_ECT_HI_OFFT "ECT high diag off time thr" VALUE 0x0002038C __UWORD_S 0 u_min 0 65535 /end CHARACTERISTIC
/begin CHARACTERISTIC ECSD_V_ECT_HI_KEYON_ECT_MAX "ECT high diag keyon ect max" VALUE 0x0002038C __SWORD_S 0 u_deg_C -256 255.992188 FORMAT "%4.1" /end CHARACTERISTIC
/begin CHARACTERISTIC ECSD_V_ECT_HI_EN_ECT_MIN "ECT high diag airflow accum start ECT min" VALUE 0x0002038C __SWORD_S 0 u_deg_C -256 255.992188 FORMAT "%4.1" /end CHARACTERISTIC
/begin CHARACTERISTIC ECSD_V_ECT_HI_AIR_FLW_FIL "ECT high diag airflow filter" VALUE 0x0002038C __UWORD_S 0 u_filter 0 0.9999847412109375 FORMAT "%4.3" /end CHARACTERISTIC
/begin CHARACTERISTIC ECSD_V_ECT_HI_DIAG_DLY "ECT high diag delay" VALUE 0x0002038C __UWORD_S 0 u_16x_tmr 0 8191.875 FORMAT "%4.2" /end CHARACTERISTIC
/begin CHARACTERISTIC ECSD_V_ECT_HI_FL_THR "ECT high diag fail ECT" VALUE 0x0002038C __SWORD_S 0 u_deg_C -256 255.992188 FORMAT "%4.1" /end CHARACTERISTIC
/begin CHARACTERISTIC ECSD_V_ECT_HI_AVG_FLW_THR "ECT high diag average flow high thr" VALUE 0x0002038C __UWORD_S 0 u_g_per_sec 0 511.9921875 /end CHARACTERISTIC
/begin CHARACTERISTIC ECSD_V_ECT_HI_MMV_FLW_THR "ECT high diag filtered flow high thr" VALUE 0x0002038C __UWORD_S 0 u_g_per_sec 0 511.9921875 /end CHARACTERISTIC
/begin CHARACTERISTIC ECSD_V_ECT_HI_PASS_DUR "ECT high diag pass duration" VALUE 0x0002038C __UWORD_S 0 u_16x_tmr 0 8191.875 FORMAT "%4.2" /end CHARACTERISTIC
/begin CHARACTERISTIC ECSD_V_ECT_HI_RPT_KP_MIN "ECT report enable keep duration min" VALUE 0x0002038C __UWORD_S 0 u_cnts 0 65535 FORMAT "%5.0" /end CHARACTERISTIC
/begin CHARACTERISTIC ECSD_V_ECT_HI_DIS_STOP_DUR "ECT high diag pass duration" VALUE 0x0002038C __UWORD_S 0 u_16x_tmr 0 8191.875 FORMAT "%4.2" /end CHARACTERISTIC
/begin CHARACTERISTIC ECSD_V_ECT_HI_FLW_INIT "ECT high diag filtered flow init" VALUE 0x0002038C __UWORD_S 0 u_g_per_sec 0 511.9921875 /end CHARACTERISTIC
/begin CHARACTERISTIC ECSD_V_ECT_STCK_EN_OFFT "ECT stuck diag off time thr" VALUE 0x0002038C __UWORD_S 0 u_min 0 65535 /end CHARACTERISTIC
/begin CHARACTERISTIC ECSD_V_ECT_STCK_FL_THR "ECT stuck diag fail thr" VALUE 0x0002038C __SWORD_S 0 u_deg_C -256 255.992188 FORMAT "%4.1" /end CHARACTERISTIC
/begin CHARACTERISTIC ECSD_V_ECT_STCK_FL_CNTS "ect stuck fail counts" VALUE 0x0002038C __UWORD_S 0 u_cnts 0 65535 FORMAT "%5.0" SYMBOL_LINK "ECSD_V_ECT_STCK_CNTS" 0 /end CHARACTERISTIC
/begin CHARACTERISTIC ECSD_V_ECT_STCK_DIAG_CNTS "ect stuck diag counts" VALUE 0x0002038C __UWORD_S 0 u_cnts 0 65535 FORMAT "%5.0" SYMBOL_LINK "ECSD_V_ECT_STCK_CNTS" 2 /end CHARACTERISTIC
/begin CHARACTERISTIC ERRM_AC_P_HI_TYP "AC press short high type" VALUE 0x2886C __UWORD_S 0 u_diag_typ 0 8 FORMAT "%1.0" BIT_MASK 0xF000 SYMBOL_LINK "ERRM_CFG_ARRY" 30 /end CHARACTERISTIC
/begin CHARACTERISTIC ERRM_AC_P_HI_MIL_ON "AC press short high MIL on enable" VALUE 0x2886C __UWORD_S 0 b_true 0 1 FORMAT "%1.0" BIT_MASK 0x0800 SYMBOL_LINK "ERRM_CFG_ARRY" 30 /end CHARACTERISTIC
/begin CHARACTERISTIC ERRM_AC_P_HI_DEN_GRP "AC press short high denom group" VALUE 0x2886C __UWORD_S 0 u_den_grp 0 63 FORMAT "%1.0" BIT_MASK 0x003F SYMBOL_LINK "ERRM_CFG_ARRY" 30 /end CHARACTERISTIC
/begin CHARACTERISTIC ERRM_AC_P_HI_DTC "AC press short high DTC" VALUE 0x2886C __UWORD_S 0 u_cnts 0 65535 FORMAT "%5.0" SYMBOL_LINK "ERRM_CFG_ARRY" 32 /end CHARACTERISTIC
/begin CHARACTERISTIC ERRM_AC_P_LO_TYP "AC press short low type" VALUE 0x2886C __UWORD_S 0 u_diag_typ 0 8 FORMAT "%1.0" BIT_MASK 0xF000 SYMBOL_LINK "ERRM_CFG_ARRY" 36 /end CHARACTERISTIC
/begin CHARACTERISTIC ERRM_AC_P_LO_MIL_ON "AC press short low MIL on enable" VALUE 0x2886C __UWORD_S 0 b_true 0 1 FORMAT "%1.0" BIT_MASK 0x0800 SYMBOL_LINK "ERRM_CFG_ARRY" 36 /end CHARACTERISTIC
/begin CHARACTERISTIC ERRM_AC_P_LO_DEN_GRP "AC press short low denom group" VALUE 0x2886C __UWORD_S 0 u_den_grp 0 63 FORMAT "%1.0" BIT_MASK 0x003F SYMBOL_LINK "ERRM_CFG_ARRY" 36 /end CHARACTERISTIC
/begin CHARACTERISTIC ERRM_AC_P_LO_DTC "AC press short low DTC" VALUE 0x2886C __UWORD_S 0 u_cnts 0 65535 FORMAT "%5.0" SYMBOL_LINK "ERRM_CFG_ARRY" 38 /end CHARACTERISTIC
/begin CHARACTERISTIC ERRM_AC_RLY_LO_TYP "AC relay short low type" VALUE 0x2886C __UWORD_S 0 u_diag_typ 0 8 FORMAT "%1.0" BIT_MASK 0xF000 SYMBOL_LINK "ERRM_CFG_ARRY" 48 /end CHARACTERISTIC
/begin CHARACTERISTIC ERRM_AC_RLY_LO_MIL_ON "AC relay short low MIL on enable" VALUE 0x2886C __UWORD_S 0 b_true 0 1 FORMAT "%1.0" BIT_MASK 0x0800 SYMBOL_LINK "ERRM_CFG_ARRY" 48 /end CHARACTERISTIC
/begin CHARACTERISTIC ERRM_AC_RLY_LO_DEN_GRP "AC relay short low denom group" VALUE 0x2886C __UWORD_S 0 u_den_grp 0 63 FORMAT "%1.0" BIT_MASK 0x003F SYMBOL_LINK "ERRM_CFG_ARRY" 48 /end CHARACTERISTIC
/begin CHARACTERISTIC ERRM_AC_RLY_LO_DTC "AC relay short low DTC" VALUE 0x2886C __UWORD_S 0 u_cnts 0 65535 FORMAT "%5.0" SYMBOL_LINK "ERRM_CFG_ARRY" 50 /end CHARACTERISTIC
/begin CHARACTERISTIC ERRM_AC_RLY_HI_TYP "AC relay short high type" VALUE 0x2886C __UWORD_S 0 u_diag_typ 0 8 FORMAT "%1.0" BIT_MASK 0xF000 SYMBOL_LINK "ERRM_CFG_ARRY" 42 /end CHARACTERISTIC
/begin CHARACTERISTIC ERRM_AC_RLY_HI_MIL_ON "AC relay short high MIL on enable" VALUE 0x2886C __UWORD_S 0 b_true 0 1 FORMAT "%1.0" BIT_MASK 0x0800 SYMBOL_LINK "ERRM_CFG_ARRY" 42 /end CHARACTERISTIC
/begin CHARACTERISTIC ERRM_AC_RLY_HI_DEN_GRP "AC relay short high denom group" VALUE 0x2886C __UWORD_S 0 u_den_grp 0 63 FORMAT "%1.0" BIT_MASK 0x003F SYMBOL_LINK "ERRM_CFG_ARRY" 42 /end CHARACTERISTIC
/begin CHARACTERISTIC ERRM_AC_RLY_HI_DTC "AC relay short high DTC" VALUE 0x2886C __UWORD_S 0 u_cnts 0 65535 FORMAT "%5.0" SYMBOL_LINK "ERRM_CFG_ARRY" 44 /end CHARACTERISTIC
/begin CHARACTERISTIC ERRM_BRK_LAMP_SW_TYP "break lamp switch type" VALUE 0x2886C __UWORD_S 0 u_diag_typ 0 8 FORMAT "%1.0" BIT_MASK 0xF000 SYMBOL_LINK "ERRM_CFG_ARRY" 54 /end CHARACTERISTIC
/begin CHARACTERISTIC ERRM_BRK_LAMP_SW_MIL_ON "break lamp switch MIL on enable" VALUE 0x2886C __UWORD_S 0 b_true 0 1 FORMAT "%1.0" BIT_MASK 0x0800 SYMBOL_LINK "ERRM_CFG_ARRY" 54 /end CHARACTERISTIC
/begin CHARACTERISTIC ERRM_BRK_LAMP_SW_DEN_GRP "break lamp switch denom group" VALUE 0x2886C __UWORD_S 0 u_den_grp 0 63 FORMAT "%1.0" BIT_MASK 0x003F SYMBOL_LINK "ERRM_CFG_ARRY" 54 /end CHARACTERISTIC
/begin CHARACTERISTIC ERRM_BRK_LAMP_SW_DTC "break lamp switch DTC" VALUE 0x2886C __UWORD_S 0 u_cnts 0 65535 FORMAT "%5.0" SYMBOL_LINK "ERRM_CFG_ARRY" 56 /end CHARACTERISTIC
/begin CHARACTERISTIC ERRM_BRK_SW_CORR_TYP "break switch correlation type" VALUE 0x2886C __UWORD_S 0 u_diag_typ 0 8 FORMAT "%1.0" BIT_MASK 0xF000 SYMBOL_LINK "ERRM_CFG_ARRY" 60 /end CHARACTERISTIC
/begin CHARACTERISTIC ERRM_BRK_SW_CORR_MIL_ON "break switch correlation MIL on enable" VALUE 0x2886C __UWORD_S 0 b_true 0 1 FORMAT "%1.0" BIT_MASK 0x0800 SYMBOL_LINK "ERRM_CFG_ARRY" 60 /end CHARACTERISTIC
/begin CHARACTERISTIC ERRM_BRK_SW_CORR_DEN_GRP "break switch correlation denom group" VALUE 0x2886C __UWORD_S 0 u_den_grp 0 63 FORMAT "%1.0" BIT_MASK 0x003F SYMBOL_LINK "ERRM_CFG_ARRY" 60 /end CHARACTERISTIC
/begin CHARACTERISTIC ERRM_BRK_SW_CORR_DTC "break switch correlation DTC" VALUE 0x2886C __UWORD_S 0 u_cnts 0 65535 FORMAT "%5.0" SYMBOL_LINK "ERRM_CFG_ARRY" 62 /end CHARACTERISTIC
/begin CHARACTERISTIC ERRM_CAM_OPN_TYP "cam open type" VALUE 0x2886C __UWORD_S 0 u_diag_typ 0 8 FORMAT "%1.0" BIT_MASK 0xF000 SYMBOL_LINK "ERRM_CFG_ARRY" 66 /end CHARACTERISTIC
/begin CHARACTERISTIC ERRM_CAM_OPN_MIL_ON "cam open MIL on enable" VALUE 0x2886C __UWORD_S 0 b_true 0 1 FORMAT "%1.0" BIT_MASK 0x0800 SYMBOL_LINK "ERRM_CFG_ARRY" 66 /end CHARACTERISTIC
/begin CHARACTERISTIC ERRM_CAM_OPN_DEN_GRP "cam open denom group" VALUE 0x2886C __UWORD_S 0 u_den_grp 0 63 FORMAT "%1.0" BIT_MASK 0x003F SYMBOL_LINK "ERRM_CFG_ARRY" 66 /end CHARACTERISTIC
/begin CHARACTERISTIC ERRM_CAM_OPN_DTC "cam open DTC" VALUE 0x2886C __UWORD_S 0 u_cnts 0 65535 FORMAT "%5.0" SYMBOL_LINK "ERRM_CFG_ARRY" 68 /end CHARACTERISTIC
/begin CHARACTERISTIC ERRM_CAM_PERF_TYP "cam performance type" VALUE 0x2886C __UWORD_S 0 u_diag_typ 0 8 FORMAT "%1.0" BIT_MASK 0xF000 SYMBOL_LINK "ERRM_CFG_ARRY" 72 /end CHARACTERISTIC
/begin CHARACTERISTIC ERRM_CAM_PERF_MIL_ON "cam performance MIL on enable" VALUE 0x2886C __UWORD_S 0 b_true 0 1 FORMAT "%1.0" BIT_MASK 0x0800 SYMBOL_LINK "ERRM_CFG_ARRY" 72 /end CHARACTERISTIC
/begin CHARACTERISTIC ERRM_CAM_PERF_DEN_GRP "cam performance denom group" VALUE 0x2886C __UWORD_S 0 u_den_grp 0 63 FORMAT "%1.0" BIT_MASK 0x003F SYMBOL_LINK "ERRM_CFG_ARRY" 72 /end CHARACTERISTIC
/begin CHARACTERISTIC ERRM_CAM_PERF_DTC "cam performance DTC" VALUE 0x2886C __UWORD_S 0 u_cnts 0 65535 FORMAT "%5.0" SYMBOL_LINK "ERRM_CFG_ARRY" 74 /end CHARACTERISTIC
/begin CHARACTERISTIC ERRM_CAN_BUS_OFF_TYP "can bus off type" VALUE 0x2886C __UWORD_S 0 u_diag_typ 0 8 FORMAT "%1.0" BIT_MASK 0xF000 SYMBOL_LINK "ERRM_CFG_ARRY" 84 /end CHARACTERISTIC
/begin CHARACTERISTIC ERRM_CAN_BUS_OFF_MIL_ON "can bus off MIL on enable" VALUE 0x2886C __UWORD_S 0 b_true 0 1 FORMAT "%1.0" BIT_MASK 0x0800 SYMBOL_LINK "ERRM_CFG_ARRY" 84 /end CHARACTERISTIC
/begin CHARACTERISTIC ERRM_CAN_BUS_OFF_DEN_GRP "can bus off denom group" VALUE 0x2886C __UWORD_S 0 u_den_grp 0 63 FORMAT "%1.0" BIT_MASK 0x003F SYMBOL_LINK "ERRM_CFG_ARRY" 84 /end CHARACTERISTIC
/begin CHARACTERISTIC ERRM_CAN_BUS_OFF_DTC "can bus off DTC" VALUE 0x2886C __UWORD_S 0 u_cnts 0 65535 FORMAT "%5.0" SYMBOL_LINK "ERRM_CFG_ARRY" 86 /end CHARACTERISTIC
/begin CHARACTERISTIC ERRM_CAN_COM_TYP "can bus communication type" VALUE 0x2886C __UWORD_S 0 u_diag_typ 0 8 FORMAT "%1.0" BIT_MASK 0xF000 SYMBOL_LINK "ERRM_CFG_ARRY" 90 /end CHARACTERISTIC
/begin CHARACTERISTIC ERRM_CAN_COM_MIL_ON "can bus communication MIL on enable" VALUE 0x2886C __UWORD_S 0 b_true 0 1 FORMAT "%1.0" BIT_MASK 0x0800 SYMBOL_LINK "ERRM_CFG_ARRY" 90 /end CHARACTERISTIC
/begin CHARACTERISTIC ERRM_CAN_COM_DEN_GRP "can bus communication denom group" VALUE 0x2886C __UWORD_S 0 u_den_grp 0 63 FORMAT "%1.0" BIT_MASK 0x003F SYMBOL_LINK "ERRM_CFG_ARRY" 90 /end CHARACTERISTIC
/begin CHARACTERISTIC ERRM_CAN_COM_DTC "can bus communication DTC" VALUE 0x2886C __UWORD_S 0 u_cnts 0 65535 FORMAT "%5.0" SYMBOL_LINK "ERRM_CFG_ARRY" 92 /end CHARACTERISTIC
/begin CHARACTERISTIC ERRM_CAN_TCM_TYP "can TCM communication type" VALUE 0x2886C __UWORD_S 0 u_diag_typ 0 8 FORMAT "%1.0" BIT_MASK 0xF000 SYMBOL_LINK "ERRM_CFG_ARRY" 96 /end CHARACTERISTIC
/begin CHARACTERISTIC ERRM_CAN_TCM_MIL_ON "can TCM communication MIL on enable" VALUE 0x2886C __UWORD_S 0 b_true 0 1 FORMAT "%1.0" BIT_MASK 0x0800 SYMBOL_LINK "ERRM_CFG_ARRY" 96 /end CHARACTERISTIC
/begin CHARACTERISTIC ERRM_CAN_TCM_DEN_GRP "can TCM communication denom group" VALUE 0x2886C __UWORD_S 0 u_den_grp 0 63 FORMAT "%1.0" BIT_MASK 0x003F SYMBOL_LINK "ERRM_CFG_ARRY" 96 /end CHARACTERISTIC
/begin CHARACTERISTIC ERRM_CAN_TCM_DTC "can TCM communication DTC" VALUE 0x2886C __UWORD_S 0 u_cnts 0 65535 FORMAT "%5.0" SYMBOL_LINK "ERRM_CFG_ARRY" 98 /end CHARACTERISTIC
/begin CHARACTERISTIC ERRM_CAN_TCS_TYP "can traction control system communication type" VALUE 0x2886C __UWORD_S 0 u_diag_typ 0 8 FORMAT "%1.0" BIT_MASK 0xF000 SYMBOL_LINK "ERRM_CFG_ARRY" 102 /end CHARACTERISTIC
/begin CHARACTERISTIC ERRM_CAN_TCS_MIL_ON "can traction control system communication MIL on enable" VALUE 0x2886C __UWORD_S 0 b_true 0 1 FORMAT "%1.0" BIT_MASK 0x0800 SYMBOL_LINK "ERRM_CFG_ARRY" 102 /end CHARACTERISTIC
/begin CHARACTERISTIC ERRM_CAN_TCS_DEN_GRP "can traction control system communication denom group" VALUE 0x2886C __UWORD_S 0 u_den_grp 0 63 FORMAT "%1.0" BIT_MASK 0x003F SYMBOL_LINK "ERRM_CFG_ARRY" 102 /end CHARACTERISTIC
/begin CHARACTERISTIC ERRM_CAN_TCS_DTC "can traction control system communication DTC" VALUE 0x2886C __UWORD_S 0 u_cnts 0 65535 FORMAT "%5.0" SYMBOL_LINK "ERRM_CFG_ARRY" 104 /end CHARACTERISTIC
/begin CHARACTERISTIC ERRM_CAN_ACC_TYP "can cruise control module communication type" VALUE 0x2886C __UWORD_S 0 u_diag_typ 0 8 FORMAT "%1.0" BIT_MASK 0xF000 SYMBOL_LINK "ERRM_CFG_ARRY" 108 /end CHARACTERISTIC
/begin CHARACTERISTIC ERRM_CAN_ACC_MIL_ON "can cruise control module communication MIL on enable" VALUE 0x2886C __UWORD_S 0 b_true 0 1 FORMAT "%1.0" BIT_MASK 0x0800 SYMBOL_LINK "ERRM_CFG_ARRY" 108 /end CHARACTERISTIC
/begin CHARACTERISTIC ERRM_CAN_ACC_DEN_GRP "can cruise control module communication denom group" VALUE 0x2886C __UWORD_S 0 u_den_grp 0 63 FORMAT "%1.0" BIT_MASK 0x003F SYMBOL_LINK "ERRM_CFG_ARRY" 108 /end CHARACTERISTIC
/begin CHARACTERISTIC ERRM_CAN_ACC_DTC "can cruise control module communication DTC" VALUE 0x2886C __UWORD_S 0 u_cnts 0 65535 FORMAT "%5.0" SYMBOL_LINK "ERRM_CFG_ARRY" 110 /end CHARACTERISTIC
/begin CHARACTERISTIC ERRM_CAN_4WD_TYP "can 4WD clutch control module communication type" VALUE 0x2886C __UWORD_S 0 u_diag_typ 0 8 FORMAT "%1.0" BIT_MASK 0xF000 SYMBOL_LINK "ERRM_CFG_ARRY" 114 /end CHARACTERISTIC
/begin CHARACTERISTIC ERRM_CAN_4WD_MIL_ON "can 4WD clutch control module communication MIL on enable" VALUE 0x2886C __UWORD_S 0 b_true 0 1 FORMAT "%1.0" BIT_MASK 0x0800 SYMBOL_LINK "ERRM_CFG_ARRY" 114 /end CHARACTERISTIC
/begin CHARACTERISTIC ERRM_CAN_4WD_DEN_GRP "can 4WD clutch control module communication denom group" VALUE 0x2886C __UWORD_S 0 u_den_grp 0 63 FORMAT "%1.0" BIT_MASK 0x003F SYMBOL_LINK "ERRM_CFG_ARRY" 114 /end CHARACTERISTIC
/begin CHARACTERISTIC ERRM_CAN_4WD_DTC "can 4WD clutch control module communication DTC" VALUE 0x2886C __UWORD_S 0 u_cnts 0 65535 FORMAT "%5.0" SYMBOL_LINK "ERRM_CFG_ARRY" 116 /end CHARACTERISTIC
/begin CHARACTERISTIC ERRM_CAN_ABS_TYP "can ABS communication type" VALUE 0x2886C __UWORD_S 0 u_diag_typ 0 8 FORMAT "%1.0" BIT_MASK 0xF000 SYMBOL_LINK "ERRM_CFG_ARRY" 120 /end CHARACTERISTIC
/begin CHARACTERISTIC ERRM_CAN_ABS_MIL_ON "can ABS communication MIL on enable" VALUE 0x2886C __UWORD_S 0 b_true 0 1 FORMAT "%1.0" BIT_MASK 0x0800 SYMBOL_LINK "ERRM_CFG_ARRY" 120 /end CHARACTERISTIC
/begin CHARACTERISTIC ERRM_CAN_ABS_DEN_GRP "can ABS communication denom group" VALUE 0x2886C __UWORD_S 0 u_den_grp 0 63 FORMAT "%1.0" BIT_MASK 0x003F SYMBOL_LINK "ERRM_CFG_ARRY" 120 /end CHARACTERISTIC
/begin CHARACTERISTIC ERRM_CAN_ABS_DTC "can ABS communication DTC" VALUE 0x2886C __UWORD_S 0 u_cnts 0 65535 FORMAT "%5.0" SYMBOL_LINK "ERRM_CFG_ARRY" 122 /end CHARACTERISTIC
/begin CHARACTERISTIC ERRM_CAN_BCM_TYP "can BCM communication type" VALUE 0x2886C __UWORD_S 0 u_diag_typ 0 8 FORMAT "%1.0" BIT_MASK 0xF000 SYMBOL_LINK "ERRM_CFG_ARRY" 126 /end CHARACTERISTIC
/begin CHARACTERISTIC ERRM_CAN_BCM_MIL_ON "can BCM communication MIL on enable" VALUE 0x2886C __UWORD_S 0 b_true 0 1 FORMAT "%1.0" BIT_MASK 0x0800 SYMBOL_LINK "ERRM_CFG_ARRY" 126 /end CHARACTERISTIC
/begin CHARACTERISTIC ERRM_CAN_BCM_DEN_GRP "can BCM communication denom group" VALUE 0x2886C __UWORD_S 0 u_den_grp 0 63 FORMAT "%1.0" BIT_MASK 0x003F SYMBOL_LINK "ERRM_CFG_ARRY" 126 /end CHARACTERISTIC
/begin CHARACTERISTIC ERRM_CAN_BCM_DTC "can BCM communication DTC" VALUE 0x2886C __UWORD_S 0 u_cnts 0 65535 FORMAT "%5.0" SYMBOL_LINK "ERRM_CFG_ARRY" 128 /end CHARACTERISTIC
/begin CHARACTERISTIC ERRM_ENS_PULS_TYP "ENS pulse type" VALUE 0x2886C __UWORD_S 0 u_diag_typ 0 8 FORMAT "%1.0" BIT_MASK 0xF000 SYMBOL_LINK "ERRM_CFG_ARRY" 132 /end CHARACTERISTIC
/begin CHARACTERISTIC ERRM_ENS_PULS_MIL_ON "ENS pulse MIL on enable" VALUE 0x2886C __UWORD_S 0 b_true 0 1 FORMAT "%1.0" BIT_MASK 0x0800 SYMBOL_LINK "ERRM_CFG_ARRY" 132 /end CHARACTERISTIC
/begin CHARACTERISTIC ERRM_ENS_PULS_DEN_GRP "ENS pulse denom group" VALUE 0x2886C __UWORD_S 0 u_den_grp 0 63 FORMAT "%1.0" BIT_MASK 0x003F SYMBOL_LINK "ERRM_CFG_ARRY" 132 /end CHARACTERISTIC
/begin CHARACTERISTIC ERRM_ENS_PULS_DTC "ENS pulse DTC" VALUE 0x2886C __UWORD_S 0 u_cnts 0 65535 FORMAT "%5.0" SYMBOL_LINK "ERRM_CFG_ARRY" 134 /end CHARACTERISTIC
/begin CHARACTERISTIC ERRM_CAN_IPC_TYP "can instrument panel cluster type" VALUE 0x2886C __UWORD_S 0 u_diag_typ 0 8 FORMAT "%1.0" BIT_MASK 0xF000 SYMBOL_LINK "ERRM_CFG_ARRY" 138 /end CHARACTERISTIC
/begin CHARACTERISTIC ERRM_CAN_IPC_MIL_ON "instrument panel cluster MIL on enable" VALUE 0x2886C __UWORD_S 0 b_true 0 1 FORMAT "%1.0" BIT_MASK 0x0800 SYMBOL_LINK "ERRM_CFG_ARRY" 138 /end CHARACTERISTIC
/begin CHARACTERISTIC ERRM_CAN_IPC_DEN_GRP "instrument panel cluster denom group" VALUE 0x2886C __UWORD_S 0 u_den_grp 0 63 FORMAT "%1.0" BIT_MASK 0x003F SYMBOL_LINK "ERRM_CFG_ARRY" 138 /end CHARACTERISTIC
/begin CHARACTERISTIC ERRM_CAN_IPC_DTC "instrument panel cluster DTC" VALUE 0x2886C __UWORD_S 0 u_cnts 0 65535 FORMAT "%5.0" SYMBOL_LINK "ERRM_CFG_ARRY" 140 /end CHARACTERISTIC
/begin CHARACTERISTIC ERRM_CAN_RCU_TYP "can restraints control module type" VALUE 0x2886C __UWORD_S 0 u_diag_typ 0 8 FORMAT "%1.0" BIT_MASK 0xF000 SYMBOL_LINK "ERRM_CFG_ARRY" 144 /end CHARACTERISTIC
/begin CHARACTERISTIC ERRM_CAN_RCU_MIL_ON "can restraints control module MIL on enable" VALUE 0x2886C __UWORD_S 0 b_true 0 1 FORMAT "%1.0" BIT_MASK 0x0800 SYMBOL_LINK "ERRM_CFG_ARRY" 144 /end CHARACTERISTIC
/begin CHARACTERISTIC ERRM_CAN_RCU_DEN_GRP "can restraints control module denom group" VALUE 0x2886C __UWORD_S 0 u_den_grp 0 63 FORMAT "%1.0" BIT_MASK 0x003F SYMBOL_LINK "ERRM_CFG_ARRY" 144 /end CHARACTERISTIC
/begin CHARACTERISTIC ERRM_CAN_RCU_DTC "can restraints control module DTC" VALUE 0x2886C __UWORD_S 0 u_cnts 0 65535 FORMAT "%5.0" SYMBOL_LINK "ERRM_CFG_ARRY" 146 /end CHARACTERISTIC
/begin CHARACTERISTIC ERRM_ESP_CHKSUM_TYP "can eps checksum type" VALUE 0x2886C __UWORD_S 0 u_diag_typ 0 8 FORMAT "%1.0" BIT_MASK 0xF000 SYMBOL_LINK "ERRM_CFG_ARRY" 150 /end CHARACTERISTIC
/begin CHARACTERISTIC ERRM_ESP_CHKSUM_MIL_ON "can eps checksum MIL on enable" VALUE 0x2886C __UWORD_S 0 b_true 0 1 FORMAT "%1.0" BIT_MASK 0x0800 SYMBOL_LINK "ERRM_CFG_ARRY" 150 /end CHARACTERISTIC
/begin CHARACTERISTIC ERRM_ESP_CHKSUM_DEN_GRP "can eps checksum denom group" VALUE 0x2886C __UWORD_S 0 u_den_grp 0 63 FORMAT "%1.0" BIT_MASK 0x003F SYMBOL_LINK "ERRM_CFG_ARRY" 150 /end CHARACTERISTIC
/begin CHARACTERISTIC ERRM_ESP_CHKSUM_DTC "can eps checksum DTC" VALUE 0x2886C __UWORD_S 0 u_cnts 0 65535 FORMAT "%5.0" SYMBOL_LINK "ERRM_CFG_ARRY" 152 /end CHARACTERISTIC
/begin CHARACTERISTIC ERRM_ESP_LIFE_TYP "can eps life signal type" VALUE 0x2886C __UWORD_S 0 u_diag_typ 0 8 FORMAT "%1.0" BIT_MASK 0xF000 SYMBOL_LINK "ERRM_CFG_ARRY" 156 /end CHARACTERISTIC
/begin CHARACTERISTIC ERRM_ESP_LIFE_MIL_ON "can eps life signal MIL on enable" VALUE 0x2886C __UWORD_S 0 b_true 0 1 FORMAT "%1.0" BIT_MASK 0x0800 SYMBOL_LINK "ERRM_CFG_ARRY" 156 /end CHARACTERISTIC
/begin CHARACTERISTIC ERRM_ESP_LIFE_DEN_GRP "can eps life signal denom group" VALUE 0x2886C __UWORD_S 0 u_den_grp 0 63 FORMAT "%1.0" BIT_MASK 0x003F SYMBOL_LINK "ERRM_CFG_ARRY" 156 /end CHARACTERISTIC
/begin CHARACTERISTIC ERRM_ESP_LIFE_DTC "can eps life signal DTC" VALUE 0x2886C __UWORD_S 0 u_cnts 0 65535 FORMAT "%5.0" SYMBOL_LINK "ERRM_CFG_ARRY" 158 /end CHARACTERISTIC
/begin CHARACTERISTIC ERRM_TCM_CHKSUM_TYP "can tcm checksum type" VALUE 0x2886C __UWORD_S 0 u_diag_typ 0 8 FORMAT "%1.0" BIT_MASK 0xF000 SYMBOL_LINK "ERRM_CFG_ARRY" 162 /end CHARACTERISTIC
/begin CHARACTERISTIC ERRM_TCM_CHKSUM_MIL_ON "can tcm checksum MIL on enable" VALUE 0x2886C __UWORD_S 0 b_true 0 1 FORMAT "%1.0" BIT_MASK 0x0800 SYMBOL_LINK "ERRM_CFG_ARRY" 162 /end CHARACTERISTIC
/begin CHARACTERISTIC ERRM_TCM_CHKSUM_DEN_GRP "can tcm checksum denom group" VALUE 0x2886C __UWORD_S 0 u_den_grp 0 63 FORMAT "%1.0" BIT_MASK 0x003F SYMBOL_LINK "ERRM_CFG_ARRY" 162 /end CHARACTERISTIC
/begin CHARACTERISTIC ERRM_TCM_CHKSUM_DTC "can tcm checksum DTC" VALUE 0x2886C __UWORD_S 0 u_cnts 0 65535 FORMAT "%5.0" SYMBOL_LINK "ERRM_CFG_ARRY" 164 /end CHARACTERISTIC
/begin CHARACTERISTIC ERRM_TCM_LIFE_TYP "can tcm life signal type" VALUE 0x2886C __UWORD_S 0 u_diag_typ 0 8 FORMAT "%1.0" BIT_MASK 0xF000 SYMBOL_LINK "ERRM_CFG_ARRY" 168 /end CHARACTERISTIC
/begin CHARACTERISTIC ERRM_TCM_LIFE_MIL_ON "can tcm life signal MIL on enable" VALUE 0x2886C __UWORD_S 0 b_true 0 1 FORMAT "%1.0" BIT_MASK 0x0800 SYMBOL_LINK "ERRM_CFG_ARRY" 168 /end CHARACTERISTIC
/begin CHARACTERISTIC ERRM_TCM_LIFE_DEN_GRP "can tcm life signal denom group" VALUE 0x2886C __UWORD_S 0 u_den_grp 0 63 FORMAT "%1.0" BIT_MASK 0x003F SYMBOL_LINK "ERRM_CFG_ARRY" 168 /end CHARACTERISTIC
/begin CHARACTERISTIC ERRM_TCM_LIFE_DTC "can tcm life signal DTC" VALUE 0x2886C __UWORD_S 0 u_cnts 0 65535 FORMAT "%5.0" SYMBOL_LINK "ERRM_CFG_ARRY" 170 /end CHARACTERISTIC
/begin CHARACTERISTIC ERRM_CAN_VLT_HI_TYP "can voltage high type" VALUE 0x2886C __UWORD_S 0 u_diag_typ 0 8 FORMAT "%1.0" BIT_MASK 0xF000 SYMBOL_LINK "ERRM_CFG_ARRY" 174 /end CHARACTERISTIC
/begin CHARACTERISTIC ERRM_CAN_VLT_HI_MIL_ON "can voltage high MIL on enable" VALUE 0x2886C __UWORD_S 0 b_true 0 1 FORMAT "%1.0" BIT_MASK 0x0800 SYMBOL_LINK "ERRM_CFG_ARRY" 174 /end CHARACTERISTIC
/begin CHARACTERISTIC ERRM_CAN_VLT_HI_DEN_GRP "can voltage high denom group" VALUE 0x2886C __UWORD_S 0 u_den_grp 0 63 FORMAT "%1.0" BIT_MASK 0x003F SYMBOL_LINK "ERRM_CFG_ARRY" 174 /end CHARACTERISTIC
/begin CHARACTERISTIC ERRM_CAN_VLT_HI_DTC "can voltage high DTC" VALUE 0x2886C __UWORD_S 0 u_cnts 0 65535 FORMAT "%5.0" SYMBOL_LINK "ERRM_CFG_ARRY" 176 /end CHARACTERISTIC
/begin CHARACTERISTIC ERRM_CAN_VLT_LO_TYP "can voltage low type" VALUE 0x2886C __UWORD_S 0 u_diag_typ 0 8 FORMAT "%1.0" BIT_MASK 0xF000 SYMBOL_LINK "ERRM_CFG_ARRY" 180 /end CHARACTERISTIC
/begin CHARACTERISTIC ERRM_CAN_VLT_LO_MIL_ON "can voltage low MIL on enable" VALUE 0x2886C __UWORD_S 0 b_true 0 1 FORMAT "%1.0" BIT_MASK 0x0800 SYMBOL_LINK "ERRM_CFG_ARRY" 180 /end CHARACTERISTIC
/begin CHARACTERISTIC ERRM_CAN_VLT_LO_DEN_GRP "can voltage low denom group" VALUE 0x2886C __UWORD_S 0 u_den_grp 0 63 FORMAT "%1.0" BIT_MASK 0x003F SYMBOL_LINK "ERRM_CFG_ARRY" 180 /end CHARACTERISTIC
/begin CHARACTERISTIC ERRM_CAN_VLT_LO_DTC "can voltage low DTC" VALUE 0x2886C __UWORD_S 0 u_cnts 0 65535 FORMAT "%5.0" SYMBOL_LINK "ERRM_CFG_ARRY" 182 /end CHARACTERISTIC
/begin CHARACTERISTIC ERRM_CAN_EPS_TYP "can EPS communication type" VALUE 0x2886C __UWORD_S 0 u_diag_typ 0 8 FORMAT "%1.0" BIT_MASK 0xF000 SYMBOL_LINK "ERRM_CFG_ARRY" 186 /end CHARACTERISTIC
/begin CHARACTERISTIC ERRM_CAN_EPS_MIL_ON "can EPS communication MIL on enable" VALUE 0x2886C __UWORD_S 0 b_true 0 1 FORMAT "%1.0" BIT_MASK 0x0800 SYMBOL_LINK "ERRM_CFG_ARRY" 186 /end CHARACTERISTIC
/begin CHARACTERISTIC ERRM_CAN_EPS_DEN_GRP "can EPS communication denom group" VALUE 0x2886C __UWORD_S 0 u_den_grp 0 63 FORMAT "%1.0" BIT_MASK 0x003F SYMBOL_LINK "ERRM_CFG_ARRY" 186 /end CHARACTERISTIC
/begin CHARACTERISTIC ERRM_CAN_EPS_DTC "can EPS communication DTC" VALUE 0x2886C __UWORD_S 0 u_cnts 0 65535 FORMAT "%5.0" SYMBOL_LINK "ERRM_CFG_ARRY" 188 /end CHARACTERISTIC
/begin CHARACTERISTIC ERRM_CAN_PEPS1_TYP "can PEPS communication type" VALUE 0x2886C __UWORD_S 0 u_diag_typ 0 8 FORMAT "%1.0" BIT_MASK 0xF000 SYMBOL_LINK "ERRM_CFG_ARRY" 192 /end CHARACTERISTIC
/begin CHARACTERISTIC ERRM_CAN_PEPS1_MIL_ON "can PEPS communication MIL on enable" VALUE 0x2886C __UWORD_S 0 b_true 0 1 FORMAT "%1.0" BIT_MASK 0x0800 SYMBOL_LINK "ERRM_CFG_ARRY" 192 /end CHARACTERISTIC
/begin CHARACTERISTIC ERRM_CAN_PEPS1_DEN_GRP "can PEPS communication denom group" VALUE 0x2886C __UWORD_S 0 u_den_grp 0 63 FORMAT "%1.0" BIT_MASK 0x003F SYMBOL_LINK "ERRM_CFG_ARRY" 192 /end CHARACTERISTIC
/begin CHARACTERISTIC ERRM_CAN_PEPS1_DTC "can PEPS communication DTC" VALUE 0x2886C __UWORD_S 0 u_cnts 0 65535 FORMAT "%5.0" SYMBOL_LINK "ERRM_CFG_ARRY" 194 /end CHARACTERISTIC
/begin CHARACTERISTIC ERRM_CAN_PEPS2_TYP "can PEPS communication type" VALUE 0x2886C __UWORD_S 0 u_diag_typ 0 8 FORMAT "%1.0" BIT_MASK 0xF000 SYMBOL_LINK "ERRM_CFG_ARRY" 198 /end CHARACTERISTIC
/begin CHARACTERISTIC ERRM_CAN_PEPS2_MIL_ON "can PEPS communication MIL on enable" VALUE 0x2886C __UWORD_S 0 b_true 0 1 FORMAT "%1.0" BIT_MASK 0x0800 SYMBOL_LINK "ERRM_CFG_ARRY" 198 /end CHARACTERISTIC
/begin CHARACTERISTIC ERRM_CAN_PEPS2_DEN_GRP "can PEPS communication denom group" VALUE 0x2886C __UWORD_S 0 u_den_grp 0 63 FORMAT "%1.0" BIT_MASK 0x003F SYMBOL_LINK "ERRM_CFG_ARRY" 198 /end CHARACTERISTIC
/begin CHARACTERISTIC ERRM_CAN_PEPS2_DTC "can PEPS communication DTC" VALUE 0x2886C __UWORD_S 0 u_cnts 0 65535 FORMAT "%5.0" SYMBOL_LINK "ERRM_CFG_ARRY" 200 /end CHARACTERISTIC
/begin CHARACTERISTIC ERRM_CAN_PEPS3_TYP "can PEPS communication type" VALUE 0x2886C __UWORD_S 0 u_diag_typ 0 8 FORMAT "%1.0" BIT_MASK 0xF000 SYMBOL_LINK "ERRM_CFG_ARRY" 204 /end CHARACTERISTIC
/begin CHARACTERISTIC ERRM_CAN_PEPS3_MIL_ON "can PEPS communication MIL on enable" VALUE 0x2886C __UWORD_S 0 b_true 0 1 FORMAT "%1.0" BIT_MASK 0x0800 SYMBOL_LINK "ERRM_CFG_ARRY" 204 /end CHARACTERISTIC
/begin CHARACTERISTIC ERRM_CAN_PEPS3_DEN_GRP "can PEPS communication denom group" VALUE 0x2886C __UWORD_S 0 u_den_grp 0 63 FORMAT "%1.0" BIT_MASK 0x003F SYMBOL_LINK "ERRM_CFG_ARRY" 204 /end CHARACTERISTIC
/begin CHARACTERISTIC ERRM_CAN_PEPS3_DTC "can PEPS communication DTC" VALUE 0x2886C __UWORD_S 0 u_cnts 0 65535 FORMAT "%5.0" SYMBOL_LINK "ERRM_CFG_ARRY" 206 /end CHARACTERISTIC
/begin CHARACTERISTIC ERRM_CAN_AC_TYP "can AC communication type" VALUE 0x2886C __UWORD_S 0 u_diag_typ 0 8 FORMAT "%1.0" BIT_MASK 0xF000 SYMBOL_LINK "ERRM_CFG_ARRY" 216 /end CHARACTERISTIC
/begin CHARACTERISTIC ERRM_CAN_AC_MIL_ON "can AC communication MIL on enable" VALUE 0x2886C __UWORD_S 0 b_true 0 1 FORMAT "%1.0" BIT_MASK 0x0800 SYMBOL_LINK "ERRM_CFG_ARRY" 216 /end CHARACTERISTIC
/begin CHARACTERISTIC ERRM_CAN_AC_DEN_GRP "can AC communication denom group" VALUE 0x2886C __UWORD_S 0 u_den_grp 0 63 FORMAT "%1.0" BIT_MASK 0x003F SYMBOL_LINK "ERRM_CFG_ARRY" 216 /end CHARACTERISTIC
/begin CHARACTERISTIC ERRM_CAN_AC_DTC "can AC communication DTC" VALUE 0x2886C __UWORD_S 0 u_cnts 0 65535 FORMAT "%5.0" SYMBOL_LINK "ERRM_CFG_ARRY" 218 /end CHARACTERISTIC
/begin CHARACTERISTIC ERRM_CAN_HCU_TYP "can HCU communication type" VALUE 0x2886C __UWORD_S 0 u_diag_typ 0 8 FORMAT "%1.0" BIT_MASK 0xF000 SYMBOL_LINK "ERRM_CFG_ARRY" 222 /end CHARACTERISTIC
/begin CHARACTERISTIC ERRM_CAN_HCU_MIL_ON "can HCU communication MIL on enable" VALUE 0x2886C __UWORD_S 0 b_true 0 1 FORMAT "%1.0" BIT_MASK 0x0800 SYMBOL_LINK "ERRM_CFG_ARRY" 222 /end CHARACTERISTIC
/begin CHARACTERISTIC ERRM_CAN_HCU_DEN_GRP "can HCU communication denom group" VALUE 0x2886C __UWORD_S 0 u_den_grp 0 63 FORMAT "%1.0" BIT_MASK 0x003F SYMBOL_LINK "ERRM_CFG_ARRY" 222 /end CHARACTERISTIC
/begin CHARACTERISTIC ERRM_CAN_HCU_DTC "can HCU communication DTC" VALUE 0x2886C __UWORD_S 0 u_cnts 0 65535 FORMAT "%5.0" SYMBOL_LINK "ERRM_CFG_ARRY" 224 /end CHARACTERISTIC
/begin CHARACTERISTIC ERRM_CAN_BSG_TYP "can BSG communication type" VALUE 0x2886C __UWORD_S 0 u_diag_typ 0 8 FORMAT "%1.0" BIT_MASK 0xF000 SYMBOL_LINK "ERRM_CFG_ARRY" 228 /end CHARACTERISTIC
/begin CHARACTERISTIC ERRM_CAN_BSG_MIL_ON "can BSG communication MIL on enable" VALUE 0x2886C __UWORD_S 0 b_true 0 1 FORMAT "%1.0" BIT_MASK 0x0800 SYMBOL_LINK "ERRM_CFG_ARRY" 228 /end CHARACTERISTIC
/begin CHARACTERISTIC ERRM_CAN_BSG_DEN_GRP "can BSG communication denom group" VALUE 0x2886C __UWORD_S 0 u_den_grp 0 63 FORMAT "%1.0" BIT_MASK 0x003F SYMBOL_LINK "ERRM_CFG_ARRY" 228 /end CHARACTERISTIC
/begin CHARACTERISTIC ERRM_CAN_BSG_DTC "can BSG communication DTC" VALUE 0x2886C __UWORD_S 0 u_cnts 0 65535 FORMAT "%5.0" SYMBOL_LINK "ERRM_CFG_ARRY" 230 /end CHARACTERISTIC
/begin CHARACTERISTIC ERRM_CAN_SAS_TYP "can SAS communication type" VALUE 0x2886C __UWORD_S 0 u_diag_typ 0 8 FORMAT "%1.0" BIT_MASK 0xF000 SYMBOL_LINK "ERRM_CFG_ARRY" 246 /end CHARACTERISTIC
/begin CHARACTERISTIC ERRM_CAN_SAS_MIL_ON "can SAS communication MIL on enable" VALUE 0x2886C __UWORD_S 0 b_true 0 1 FORMAT "%1.0" BIT_MASK 0x0800 SYMBOL_LINK "ERRM_CFG_ARRY" 246 /end CHARACTERISTIC
/begin CHARACTERISTIC ERRM_CAN_SAS_DEN_GRP "can SAS communication denom group" VALUE 0x2886C __UWORD_S 0 u_den_grp 0 63 FORMAT "%1.0" BIT_MASK 0x003F SYMBOL_LINK "ERRM_CFG_ARRY" 246 /end CHARACTERISTIC
/begin CHARACTERISTIC ERRM_CAN_SAS_DTC "can SAS communication DTC" VALUE 0x2886C __UWORD_S 0 u_cnts 0 65535 FORMAT "%5.0" SYMBOL_LINK "ERRM_CFG_ARRY" 248 /end CHARACTERISTIC
/begin CHARACTERISTIC ERRM_CAN_EPB_TYP "can EPB communication type" VALUE 0x2886C __UWORD_S 0 u_diag_typ 0 8 FORMAT "%1.0" BIT_MASK 0xF000 SYMBOL_LINK "ERRM_CFG_ARRY" 252 /end CHARACTERISTIC
/begin CHARACTERISTIC ERRM_CAN_EPB_MIL_ON "can EPB communication MIL on enable" VALUE 0x2886C __UWORD_S 0 b_true 0 1 FORMAT "%1.0" BIT_MASK 0x0800 SYMBOL_LINK "ERRM_CFG_ARRY" 252 /end CHARACTERISTIC
/begin CHARACTERISTIC ERRM_CAN_EPB_DEN_GRP "can EPB communication denom group" VALUE 0x2886C __UWORD_S 0 u_den_grp 0 63 FORMAT "%1.0" BIT_MASK 0x003F SYMBOL_LINK "ERRM_CFG_ARRY" 252 /end CHARACTERISTIC
/begin CHARACTERISTIC ERRM_CAN_EPB_DTC "can EPB communication DTC" VALUE 0x2886C __UWORD_S 0 u_cnts 0 65535 FORMAT "%5.0" SYMBOL_LINK "ERRM_CFG_ARRY" 254 /end CHARACTERISTIC
/begin CHARACTERISTIC ERRM_RCU_CHKSUM_TYP "can RCU checksum type" VALUE 0x2886C __UWORD_S 0 u_diag_typ 0 8 FORMAT "%1.0" BIT_MASK 0xF000 SYMBOL_LINK "ERRM_CFG_ARRY" 258 /end CHARACTERISTIC
/begin CHARACTERISTIC ERRM_RCU_CHKSUM_MIL_ON "can RCU checksum MIL on enable" VALUE 0x2886C __UWORD_S 0 b_true 0 1 FORMAT "%1.0" BIT_MASK 0x0800 SYMBOL_LINK "ERRM_CFG_ARRY" 258 /end CHARACTERISTIC
/begin CHARACTERISTIC ERRM_RCU_CHKSUM_DEN_GRP "can RCU checksum denom group" VALUE 0x2886C __UWORD_S 0 u_den_grp 0 63 FORMAT "%1.0" BIT_MASK 0x003F SYMBOL_LINK "ERRM_CFG_ARRY" 258 /end CHARACTERISTIC
/begin CHARACTERISTIC ERRM_RCU_CHKSUM_DTC "can RCU checksum DTC" VALUE 0x2886C __UWORD_S 0 u_cnts 0 65535 FORMAT "%5.0" SYMBOL_LINK "ERRM_CFG_ARRY" 260 /end CHARACTERISTIC
/begin CHARACTERISTIC ERRM_RCU_LIFE_TYP "can RCU life signal type" VALUE 0x2886C __UWORD_S 0 u_diag_typ 0 8 FORMAT "%1.0" BIT_MASK 0xF000 SYMBOL_LINK "ERRM_CFG_ARRY" 276 /end CHARACTERISTIC
/begin CHARACTERISTIC ERRM_RCU_LIFE_MIL_ON "can RCU life signal MIL on enable" VALUE 0x2886C __UWORD_S 0 b_true 0 1 FORMAT "%1.0" BIT_MASK 0x0800 SYMBOL_LINK "ERRM_CFG_ARRY" 276 /end CHARACTERISTIC
/begin CHARACTERISTIC ERRM_RCU_LIFE_DEN_GRP "can RCU life signal denom group" VALUE 0x2886C __UWORD_S 0 u_den_grp 0 63 FORMAT "%1.0" BIT_MASK 0x003F SYMBOL_LINK "ERRM_CFG_ARRY" 276 /end CHARACTERISTIC
/begin CHARACTERISTIC ERRM_RCU_LIFE_DTC "can RCU life signal DTC" VALUE 0x2886C __UWORD_S 0 u_cnts 0 65535 FORMAT "%5.0" SYMBOL_LINK "ERRM_CFG_ARRY" 278 /end CHARACTERISTIC
/begin CHARACTERISTIC ERRM_ACC_CHKSUM_TYP "can ACC checksum type" VALUE 0x2886C __UWORD_S 0 u_diag_typ 0 8 FORMAT "%1.0" BIT_MASK 0xF000 SYMBOL_LINK "ERRM_CFG_ARRY" 264 /end CHARACTERISTIC
/begin CHARACTERISTIC ERRM_ACC_CHKSUM_MIL_ON "can ACC checksum MIL on enable" VALUE 0x2886C __UWORD_S 0 b_true 0 1 FORMAT "%1.0" BIT_MASK 0x0800 SYMBOL_LINK "ERRM_CFG_ARRY" 264 /end CHARACTERISTIC
/begin CHARACTERISTIC ERRM_ACC_CHKSUM_DEN_GRP "can ACC checksum denom group" VALUE 0x2886C __UWORD_S 0 u_den_grp 0 63 FORMAT "%1.0" BIT_MASK 0x003F SYMBOL_LINK "ERRM_CFG_ARRY" 264 /end CHARACTERISTIC
/begin CHARACTERISTIC ERRM_ACC_CHKSUM_DTC "can ACC checksum DTC" VALUE 0x2886C __UWORD_S 0 u_cnts 0 65535 FORMAT "%5.0" SYMBOL_LINK "ERRM_CFG_ARRY" 266 /end CHARACTERISTIC
/begin CHARACTERISTIC ERRM_ACC_LIFE_TYP "can ACC life signal type" VALUE 0x2886C __UWORD_S 0 u_diag_typ 0 8 FORMAT "%1.0" BIT_MASK 0xF000 SYMBOL_LINK "ERRM_CFG_ARRY" 270 /end CHARACTERISTIC
/begin CHARACTERISTIC ERRM_ACC_LIFE_MIL_ON "can ACC life signal MIL on enable" VALUE 0x2886C __UWORD_S 0 b_true 0 1 FORMAT "%1.0" BIT_MASK 0x0800 SYMBOL_LINK "ERRM_CFG_ARRY" 270 /end CHARACTERISTIC
/begin CHARACTERISTIC ERRM_ACC_LIFE_DEN_GRP "can ACC life signal denom group" VALUE 0x2886C __UWORD_S 0 u_den_grp 0 63 FORMAT "%1.0" BIT_MASK 0x003F SYMBOL_LINK "ERRM_CFG_ARRY" 270 /end CHARACTERISTIC
/begin CHARACTERISTIC ERRM_ACC_LIFE_DTC "can ACC life signal DTC" VALUE 0x2886C __UWORD_S 0 u_cnts 0 65535 FORMAT "%5.0" SYMBOL_LINK "ERRM_CFG_ARRY" 272 /end CHARACTERISTIC
/begin CHARACTERISTIC ERRM_CAN_APA_TYP "can APA communication type" VALUE 0x2886C __UWORD_S 0 u_diag_typ 0 8 FORMAT "%1.0" BIT_MASK 0xF000 SYMBOL_LINK "ERRM_CFG_ARRY" 282 /end CHARACTERISTIC
/begin CHARACTERISTIC ERRM_CAN_APA_MIL_ON "can APA communication MIL on enable" VALUE 0x2886C __UWORD_S 0 b_true 0 1 FORMAT "%1.0" BIT_MASK 0x0800 SYMBOL_LINK "ERRM_CFG_ARRY" 282 /end CHARACTERISTIC
/begin CHARACTERISTIC ERRM_CAN_APA_DEN_GRP "can APA communication denom group" VALUE 0x2886C __UWORD_S 0 u_den_grp 0 63 FORMAT "%1.0" BIT_MASK 0x003F SYMBOL_LINK "ERRM_CFG_ARRY" 282 /end CHARACTERISTIC
/begin CHARACTERISTIC ERRM_CAN_APA_DTC "can APA communication DTC" VALUE 0x2886C __UWORD_S 0 u_cnts 0 65535 FORMAT "%5.0" SYMBOL_LINK "ERRM_CFG_ARRY" 284 /end CHARACTERISTIC
/begin CHARACTERISTIC ERRM_B1_CAT_TYP "bank1 catalyst type" VALUE 0x2886C __UWORD_S 0 u_diag_typ 0 8 FORMAT "%1.0" BIT_MASK 0xF000 SYMBOL_LINK "ERRM_CFG_ARRY" 288 /end CHARACTERISTIC
/begin CHARACTERISTIC ERRM_B1_CAT_MIL_ON "bank1 catalyst MIL on enable" VALUE 0x2886C __UWORD_S 0 b_true 0 1 FORMAT "%1.0" BIT_MASK 0x0800 SYMBOL_LINK "ERRM_CFG_ARRY" 288 /end CHARACTERISTIC
/begin CHARACTERISTIC ERRM_B1_CAT_DEN_GRP "bank1 catalyst denom group" VALUE 0x2886C __UWORD_S 0 u_den_grp 0 63 FORMAT "%1.0" BIT_MASK 0x003F SYMBOL_LINK "ERRM_CFG_ARRY" 288 /end CHARACTERISTIC
/begin CHARACTERISTIC ERRM_B1_CAT_DTC "bank1 catalyst DTC" VALUE 0x2886C __UWORD_S 0 u_cnts 0 65535 FORMAT "%5.0" SYMBOL_LINK "ERRM_CFG_ARRY" 290 /end CHARACTERISTIC
/begin CHARACTERISTIC ERRM_ECM_SEQ_TYP "ECM processor type" VALUE 0x2886C __UWORD_S 0 u_diag_typ 0 8 FORMAT "%1.0" BIT_MASK 0xF000 SYMBOL_LINK "ERRM_CFG_ARRY" 294 /end CHARACTERISTIC
/begin CHARACTERISTIC ERRM_ECM_SEQ_MIL_ON "ECM processor MIL on enable" VALUE 0x2886C __UWORD_S 0 b_true 0 1 FORMAT "%1.0" BIT_MASK 0x0800 SYMBOL_LINK "ERRM_CFG_ARRY" 294 /end CHARACTERISTIC
/begin CHARACTERISTIC ERRM_ECM_SEQ_DEN_GRP "ECM processor denom group" VALUE 0x2886C __UWORD_S 0 u_den_grp 0 63 FORMAT "%1.0" BIT_MASK 0x003F SYMBOL_LINK "ERRM_CFG_ARRY" 294 /end CHARACTERISTIC
/begin CHARACTERISTIC ERRM_ECM_SEQ_DTC "ECM processor DTC" VALUE 0x2886C __UWORD_S 0 u_cnts 0 65535 FORMAT "%5.0" SYMBOL_LINK "ERRM_CFG_ARRY" 296 /end CHARACTERISTIC
/begin CHARACTERISTIC ERRM_ECT_HI_TYP "ECT short high type" VALUE 0x2886C __UWORD_S 0 u_diag_typ 0 8 FORMAT "%1.0" BIT_MASK 0xF000 SYMBOL_LINK "ERRM_CFG_ARRY" 300 /end CHARACTERISTIC
/begin CHARACTERISTIC ERRM_ECT_HI_MIL_ON "ECT short high MIL on enable" VALUE 0x2886C __UWORD_S 0 b_true 0 1 FORMAT "%1.0" BIT_MASK 0x0800 SYMBOL_LINK "ERRM_CFG_ARRY" 300 /end CHARACTERISTIC
/begin CHARACTERISTIC ERRM_ECT_HI_DEN_GRP "ECT short high denom group" VALUE 0x2886C __UWORD_S 0 u_den_grp 0 63 FORMAT "%1.0" BIT_MASK 0x003F SYMBOL_LINK "ERRM_CFG_ARRY" 300 /end CHARACTERISTIC
/begin CHARACTERISTIC ERRM_ECT_HI_DTC "ECT short high DTC" VALUE 0x2886C __UWORD_S 0 u_cnts 0 65535 FORMAT "%5.0" SYMBOL_LINK "ERRM_CFG_ARRY" 302 /end CHARACTERISTIC
/begin CHARACTERISTIC ERRM_ECT_LO_TYP "ECT short low type" VALUE 0x2886C __UWORD_S 0 u_diag_typ 0 8 FORMAT "%1.0" BIT_MASK 0xF000 SYMBOL_LINK "ERRM_CFG_ARRY" 306 /end CHARACTERISTIC
/begin CHARACTERISTIC ERRM_ECT_LO_MIL_ON "ECT short low MIL on enable" VALUE 0x2886C __UWORD_S 0 b_true 0 1 FORMAT "%1.0" BIT_MASK 0x0800 SYMBOL_LINK "ERRM_CFG_ARRY" 306 /end CHARACTERISTIC
/begin CHARACTERISTIC ERRM_ECT_LO_DEN_GRP "ECT short low denom group" VALUE 0x2886C __UWORD_S 0 u_den_grp 0 63 FORMAT "%1.0" BIT_MASK 0x003F SYMBOL_LINK "ERRM_CFG_ARRY" 306 /end CHARACTERISTIC
/begin CHARACTERISTIC ERRM_ECT_LO_DTC "ECT short low DTC" VALUE 0x2886C __UWORD_S 0 u_cnts 0 65535 FORMAT "%5.0" SYMBOL_LINK "ERRM_CFG_ARRY" 308 /end CHARACTERISTIC
/begin CHARACTERISTIC ERRM_ECT_CL_TYP "ECT fuel close loop type" VALUE 0x2886C __UWORD_S 0 u_diag_typ 0 8 FORMAT "%1.0" BIT_MASK 0xF000 SYMBOL_LINK "ERRM_CFG_ARRY" 324 /end CHARACTERISTIC
/begin CHARACTERISTIC ERRM_ECT_CL_MIL_ON "ECT fuel close loop MIL on enable" VALUE 0x2886C __UWORD_S 0 b_true 0 1 FORMAT "%1.0" BIT_MASK 0x0800 SYMBOL_LINK "ERRM_CFG_ARRY" 324 /end CHARACTERISTIC
/begin CHARACTERISTIC ERRM_ECT_CL_DEN_GRP "ECT fuel close loop denom group" VALUE 0x2886C __UWORD_S 0 u_den_grp 0 63 FORMAT "%1.0" BIT_MASK 0x003F SYMBOL_LINK "ERRM_CFG_ARRY" 324 /end CHARACTERISTIC
/begin CHARACTERISTIC ERRM_ECT_CL_DTC "ECT fuel close loop DTC" VALUE 0x2886C __UWORD_S 0 u_cnts 0 65535 FORMAT "%5.0" SYMBOL_LINK "ERRM_CFG_ARRY" 326 /end CHARACTERISTIC
/begin CHARACTERISTIC ERRM_ECT_RAT_HI_TYP "ECT high rationality type" VALUE 0x2886C __UWORD_S 0 u_diag_typ 0 8 FORMAT "%1.0" BIT_MASK 0xF000 SYMBOL_LINK "ERRM_CFG_ARRY" 330 /end CHARACTERISTIC
/begin CHARACTERISTIC ERRM_ECT_RAT_HI_MIL_ON "ECT high rationality MIL on enable" VALUE 0x2886C __UWORD_S 0 b_true 0 1 FORMAT "%1.0" BIT_MASK 0x0800 SYMBOL_LINK "ERRM_CFG_ARRY" 330 /end CHARACTERISTIC
/begin CHARACTERISTIC ERRM_ECT_RAT_HI_DEN_GRP "ECT high rationality denom group" VALUE 0x2886C __UWORD_S 0 u_den_grp 0 63 FORMAT "%1.0" BIT_MASK 0x003F SYMBOL_LINK "ERRM_CFG_ARRY" 330 /end CHARACTERISTIC
/begin CHARACTERISTIC ERRM_ECT_RAT_HI_DTC "ECT high rationality DTC" VALUE 0x2886C __UWORD_S 0 u_cnts 0 65535 FORMAT "%5.0" SYMBOL_LINK "ERRM_CFG_ARRY" 332 /end CHARACTERISTIC
/begin CHARACTERISTIC ERRM_ECT_THEMO_TYP "Thermostat type" VALUE 0x2886C __UWORD_S 0 u_diag_typ 0 8 FORMAT "%1.0" BIT_MASK 0xF000 SYMBOL_LINK "ERRM_CFG_ARRY" 336 /end CHARACTERISTIC
/begin CHARACTERISTIC ERRM_ECT_THEMO_MIL_ON "Thermostat MIL on enable" VALUE 0x2886C __UWORD_S 0 b_true 0 1 FORMAT "%1.0" BIT_MASK 0x0800 SYMBOL_LINK "ERRM_CFG_ARRY" 336 /end CHARACTERISTIC
/begin CHARACTERISTIC ERRM_ECT_THEMO_DEN_GRP "Thermostat denom group" VALUE 0x2886C __UWORD_S 0 u_den_grp 0 63 FORMAT "%1.0" BIT_MASK 0x003F SYMBOL_LINK "ERRM_CFG_ARRY" 336 /end CHARACTERISTIC
/begin CHARACTERISTIC ERRM_ECT_THEMO_DTC "Thermostat DTC" VALUE 0x2886C __UWORD_S 0 u_cnts 0 65535 FORMAT "%5.0" SYMBOL_LINK "ERRM_CFG_ARRY" 338 /end CHARACTERISTIC
/begin CHARACTERISTIC ERRM_ECT_STRT_HI_TYP "ECT start high type" VALUE 0x2886C __UWORD_S 0 u_diag_typ 0 8 FORMAT "%1.0" BIT_MASK 0xF000 SYMBOL_LINK "ERRM_CFG_ARRY" 348 /end CHARACTERISTIC
/begin CHARACTERISTIC ERRM_ECT_STRT_HI_MIL_ON "ECT start high MIL on enable" VALUE 0x2886C __UWORD_S 0 b_true 0 1 FORMAT "%1.0" BIT_MASK 0x0800 SYMBOL_LINK "ERRM_CFG_ARRY" 348 /end CHARACTERISTIC
/begin CHARACTERISTIC ERRM_ECT_STRT_HI_DEN_GRP "ECT start high denom group" VALUE 0x2886C __UWORD_S 0 u_den_grp 0 63 FORMAT "%1.0" BIT_MASK 0x003F SYMBOL_LINK "ERRM_CFG_ARRY" 348 /end CHARACTERISTIC
/begin CHARACTERISTIC ERRM_ECT_STRT_HI_DTC "ECT start high DTC" VALUE 0x2886C __UWORD_S 0 u_cnts 0 65535 FORMAT "%5.0" SYMBOL_LINK "ERRM_CFG_ARRY" 350 /end CHARACTERISTIC
/begin CHARACTERISTIC ERRM_ECT_RAT_LO_TYP "ECT low rationality type" VALUE 0x2886C __UWORD_S 0 u_diag_typ 0 8 FORMAT "%1.0" BIT_MASK 0xF000 SYMBOL_LINK "ERRM_CFG_ARRY" 354 /end CHARACTERISTIC
/begin CHARACTERISTIC ERRM_ECT_RAT_LO_MIL_ON "ECT rationality MIL on enable" VALUE 0x2886C __UWORD_S 0 b_true 0 1 FORMAT "%1.0" BIT_MASK 0x0800 SYMBOL_LINK "ERRM_CFG_ARRY" 354 /end CHARACTERISTIC
/begin CHARACTERISTIC ERRM_ECT_RAT_LO_DEN_GRP "ECT rationality denom group" VALUE 0x2886C __UWORD_S 0 u_den_grp 0 63 FORMAT "%1.0" BIT_MASK 0x003F SYMBOL_LINK "ERRM_CFG_ARRY" 354 /end CHARACTERISTIC
/begin CHARACTERISTIC ERRM_ECT_RAT_LO_DTC "ECT rationality DTC" VALUE 0x2886C __UWORD_S 0 u_cnts 0 65535 FORMAT "%5.0" SYMBOL_LINK "ERRM_CFG_ARRY" 356 /end CHARACTERISTIC
/begin CHARACTERISTIC ERRM_CRK_PERF_TYP "crank sensor noise type" VALUE 0x2886C __UWORD_S 0 u_diag_typ 0 8 FORMAT "%1.0" BIT_MASK 0xF000 SYMBOL_LINK "ERRM_CFG_ARRY" 360 /end CHARACTERISTIC
/begin CHARACTERISTIC ERRM_CRK_PERF_MIL_ON "crank sensor noise MIL on enable" VALUE 0x2886C __UWORD_S 0 b_true 0 1 FORMAT "%1.0" BIT_MASK 0x0800 SYMBOL_LINK "ERRM_CFG_ARRY" 360 /end CHARACTERISTIC
/begin CHARACTERISTIC ERRM_CRK_PERF_DEN_GRP "crank sensor noise denom group" VALUE 0x2886C __UWORD_S 0 u_den_grp 0 63 FORMAT "%1.0" BIT_MASK 0x003F SYMBOL_LINK "ERRM_CFG_ARRY" 360 /end CHARACTERISTIC
/begin CHARACTERISTIC ERRM_CRK_PERF_DTC "crank sensor noise DTC" VALUE 0x2886C __UWORD_S 0 u_cnts 0 65535 FORMAT "%5.0" SYMBOL_LINK "ERRM_CFG_ARRY" 362 /end CHARACTERISTIC
/begin CHARACTERISTIC ERRM_CRK_OPN_TYP "crank sensor no signal type" VALUE 0x2886C __UWORD_S 0 u_diag_typ 0 8 FORMAT "%1.0" BIT_MASK 0xF000 SYMBOL_LINK "ERRM_CFG_ARRY" 366 /end CHARACTERISTIC
/begin CHARACTERISTIC ERRM_CRK_OPN_MIL_ON "crank sensor no signal MIL on enable" VALUE 0x2886C __UWORD_S 0 b_true 0 1 FORMAT "%1.0" BIT_MASK 0x0800 SYMBOL_LINK "ERRM_CFG_ARRY" 366 /end CHARACTERISTIC
/begin CHARACTERISTIC ERRM_CRK_OPN_DEN_GRP "crank sensor no signal denom group" VALUE 0x2886C __UWORD_S 0 u_den_grp 0 63 FORMAT "%1.0" BIT_MASK 0x003F SYMBOL_LINK "ERRM_CFG_ARRY" 366 /end CHARACTERISTIC
/begin CHARACTERISTIC ERRM_CRK_OPN_DTC "crank sensor no signal DTC" VALUE 0x2886C __UWORD_S 0 u_cnts 0 65535 FORMAT "%5.0" SYMBOL_LINK "ERRM_CFG_ARRY" 368 /end CHARACTERISTIC
/begin CHARACTERISTIC ERRM_PPS_CORR_TYP "PPS correlation type" VALUE 0x2886C __UWORD_S 0 u_diag_typ 0 8 FORMAT "%1.0" BIT_MASK 0xF000 SYMBOL_LINK "ERRM_CFG_ARRY" 378 SYMBOL_LINK "ERRM_CFG_ARRY" 426 /end CHARACTERISTIC
/begin CHARACTERISTIC ERRM_PPS_CORR_MIL_ON "PPS correlation MIL on enable" VALUE 0x2886C __UWORD_S 0 b_true 0 1 FORMAT "%1.0" BIT_MASK 0x0800 SYMBOL_LINK "ERRM_CFG_ARRY" 378 SYMBOL_LINK "ERRM_CFG_ARRY" 426 /end CHARACTERISTIC
/begin CHARACTERISTIC ERRM_PPS_CORR_DEN_GRP "PPS correlation denom group" VALUE 0x2886C __UWORD_S 0 u_den_grp 0 63 FORMAT "%1.0" BIT_MASK 0x003F SYMBOL_LINK "ERRM_CFG_ARRY" 378 SYMBOL_LINK "ERRM_CFG_ARRY" 426 /end CHARACTERISTIC
/begin CHARACTERISTIC ERRM_PPS_CORR_DTC "PPS correlation DTC" VALUE 0x2886C __UWORD_S 0 u_cnts 0 65535 FORMAT "%5.0" SYMBOL_LINK "ERRM_CFG_ARRY" 380 SYMBOL_LINK "ERRM_CFG_ARRY" 428 /end CHARACTERISTIC
/begin CHARACTERISTIC ERRM_PPS1_LO_TYP "PPS1 low type" VALUE 0x2886C __UWORD_S 0 u_diag_typ 0 8 FORMAT "%1.0" BIT_MASK 0xF000 SYMBOL_LINK "ERRM_CFG_ARRY" 384 SYMBOL_LINK "ERRM_CFG_ARRY" 432 /end CHARACTERISTIC
/begin CHARACTERISTIC ERRM_PPS1_LO_MIL_ON "PPS1 low MIL on enable" VALUE 0x2886C __UWORD_S 0 b_true 0 1 FORMAT "%1.0" BIT_MASK 0x0800 SYMBOL_LINK "ERRM_CFG_ARRY" 384 SYMBOL_LINK "ERRM_CFG_ARRY" 432 /end CHARACTERISTIC
/begin CHARACTERISTIC ERRM_PPS1_LO_DEN_GRP "PPS1 low denom group" VALUE 0x2886C __UWORD_S 0 u_den_grp 0 63 FORMAT "%1.0" BIT_MASK 0x003F SYMBOL_LINK "ERRM_CFG_ARRY" 384 SYMBOL_LINK "ERRM_CFG_ARRY" 432 /end CHARACTERISTIC
/begin CHARACTERISTIC ERRM_PPS1_LO_DTC "PPS1 low DTC" VALUE 0x2886C __UWORD_S 0 u_cnts 0 65535 FORMAT "%5.0" SYMBOL_LINK "ERRM_CFG_ARRY" 386 SYMBOL_LINK "ERRM_CFG_ARRY" 434 /end CHARACTERISTIC
/begin CHARACTERISTIC ERRM_PPS2_LO_TYP "PPS2 low type" VALUE 0x2886C __UWORD_S 0 u_diag_typ 0 8 FORMAT "%1.0" BIT_MASK 0xF000 SYMBOL_LINK "ERRM_CFG_ARRY" 390 SYMBOL_LINK "ERRM_CFG_ARRY" 438 /end CHARACTERISTIC
/begin CHARACTERISTIC ERRM_PPS2_LO_MIL_ON "PPS2 low MIL on enable" VALUE 0x2886C __UWORD_S 0 b_true 0 1 FORMAT "%1.0" BIT_MASK 0x0800 SYMBOL_LINK "ERRM_CFG_ARRY" 390 SYMBOL_LINK "ERRM_CFG_ARRY" 438 /end CHARACTERISTIC
/begin CHARACTERISTIC ERRM_PPS2_LO_DEN_GRP "PPS2 low denom group" VALUE 0x2886C __UWORD_S 0 u_den_grp 0 63 FORMAT "%1.0" BIT_MASK 0x003F SYMBOL_LINK "ERRM_CFG_ARRY" 390 SYMBOL_LINK "ERRM_CFG_ARRY" 438 /end CHARACTERISTIC
/begin CHARACTERISTIC ERRM_PPS2_LO_DTC "PPS2 low DTC" VALUE 0x2886C __UWORD_S 0 u_cnts 0 65535 FORMAT "%5.0" SYMBOL_LINK "ERRM_CFG_ARRY" 392 SYMBOL_LINK "ERRM_CFG_ARRY" 440 /end CHARACTERISTIC
/begin CHARACTERISTIC ERRM_PPS1_HI_TYP "PPS1 high type" VALUE 0x2886C __UWORD_S 0 u_diag_typ 0 8 FORMAT "%1.0" BIT_MASK 0xF000 SYMBOL_LINK "ERRM_CFG_ARRY" 396 SYMBOL_LINK "ERRM_CFG_ARRY" 444 /end CHARACTERISTIC
/begin CHARACTERISTIC ERRM_PPS1_HI_MIL_ON "PPS1 high MIL on enable" VALUE 0x2886C __UWORD_S 0 b_true 0 1 FORMAT "%1.0" BIT_MASK 0x0800 SYMBOL_LINK "ERRM_CFG_ARRY" 396 SYMBOL_LINK "ERRM_CFG_ARRY" 444 /end CHARACTERISTIC
/begin CHARACTERISTIC ERRM_PPS1_HI_DEN_GRP "PPS1 high denom group" VALUE 0x2886C __UWORD_S 0 u_den_grp 0 63 FORMAT "%1.0" BIT_MASK 0x003F SYMBOL_LINK "ERRM_CFG_ARRY" 396 SYMBOL_LINK "ERRM_CFG_ARRY" 444 /end CHARACTERISTIC
/begin CHARACTERISTIC ERRM_PPS1_HI_DTC "PPS1 high DTC" VALUE 0x2886C __UWORD_S 0 u_cnts 0 65535 FORMAT "%5.0" SYMBOL_LINK "ERRM_CFG_ARRY" 398 SYMBOL_LINK "ERRM_CFG_ARRY" 446 /end CHARACTERISTIC
/begin CHARACTERISTIC ERRM_PPS2_HI_TYP "PPS2 high type" VALUE 0x2886C __UWORD_S 0 u_diag_typ 0 8 FORMAT "%1.0" BIT_MASK 0xF000 SYMBOL_LINK "ERRM_CFG_ARRY" 402 SYMBOL_LINK "ERRM_CFG_ARRY" 450 /end CHARACTERISTIC
/begin CHARACTERISTIC ERRM_PPS2_HI_MIL_ON "PPS2 high MIL on enable" VALUE 0x2886C __UWORD_S 0 b_true 0 1 FORMAT "%1.0" BIT_MASK 0x0800 SYMBOL_LINK "ERRM_CFG_ARRY" 402 SYMBOL_LINK "ERRM_CFG_ARRY" 450 /end CHARACTERISTIC
/begin CHARACTERISTIC ERRM_PPS2_HI_DEN_GRP "PPS2 high denom group" VALUE 0x2886C __UWORD_S 0 u_den_grp 0 63 FORMAT "%1.0" BIT_MASK 0x003F SYMBOL_LINK "ERRM_CFG_ARRY" 402 SYMBOL_LINK "ERRM_CFG_ARRY" 450 /end CHARACTERISTIC
/begin CHARACTERISTIC ERRM_PPS2_HI_DTC "PPS2 high DTC" VALUE 0x2886C __UWORD_S 0 u_cnts 0 65535 FORMAT "%5.0" SYMBOL_LINK "ERRM_CFG_ARRY" 404 SYMBOL_LINK "ERRM_CFG_ARRY" 452 /end CHARACTERISTIC
/begin CHARACTERISTIC ERRM_ECM_ETC_RDNT_TYP "ETC redundant control type" VALUE 0x2886C __UWORD_S 0 u_diag_typ 0 8 FORMAT "%1.0" BIT_MASK 0xF000 SYMBOL_LINK "ERRM_CFG_ARRY" 408 SYMBOL_LINK "ERRM_CFG_ARRY" 456 /end CHARACTERISTIC
/begin CHARACTERISTIC ERRM_ECM_ETC_RDNT_MIL_ON "ETC redundant control MIL on enable" VALUE 0x2886C __UWORD_S 0 b_true 0 1 FORMAT "%1.0" BIT_MASK 0x0800 SYMBOL_LINK "ERRM_CFG_ARRY" 408 SYMBOL_LINK "ERRM_CFG_ARRY" 456 /end CHARACTERISTIC
/begin CHARACTERISTIC ERRM_ECM_ETC_RDNT_DEN_GRP "ETC redundant control denom group" VALUE 0x2886C __UWORD_S 0 u_den_grp 0 63 FORMAT "%1.0" BIT_MASK 0x003F SYMBOL_LINK "ERRM_CFG_ARRY" 408 SYMBOL_LINK "ERRM_CFG_ARRY" 456 /end CHARACTERISTIC
/begin CHARACTERISTIC ERRM_ECM_ETC_RDNT_DTC "ETC redundant control DTC" VALUE 0x2886C __UWORD_S 0 u_cnts 0 65535 FORMAT "%5.0" SYMBOL_LINK "ERRM_CFG_ARRY" 410 SYMBOL_LINK "ERRM_CFG_ARRY" 458 /end CHARACTERISTIC
/begin CHARACTERISTIC ERRM_ETC_IDL_TYP "ETC force idle control type" VALUE 0x2886C __UWORD_S 0 u_diag_typ 0 8 FORMAT "%1.0" BIT_MASK 0xF000 SYMBOL_LINK "ERRM_CFG_ARRY" 414 SYMBOL_LINK "ERRM_CFG_ARRY" 462 /end CHARACTERISTIC
/begin CHARACTERISTIC ERRM_ETC_IDL_MIL_ON "ETC force idle control MIL on enable" VALUE 0x2886C __UWORD_S 0 b_true 0 1 FORMAT "%1.0" BIT_MASK 0x0800 SYMBOL_LINK "ERRM_CFG_ARRY" 414 SYMBOL_LINK "ERRM_CFG_ARRY" 462 /end CHARACTERISTIC
/begin CHARACTERISTIC ERRM_ETC_IDL_DEN_GRP "ETC force idle control denom group" VALUE 0x2886C __UWORD_S 0 u_den_grp 0 63 FORMAT "%1.0" BIT_MASK 0x003F SYMBOL_LINK "ERRM_CFG_ARRY" 414 SYMBOL_LINK "ERRM_CFG_ARRY" 462 /end CHARACTERISTIC
/begin CHARACTERISTIC ERRM_ETC_IDL_DTC "ETC force idle control DTC" VALUE 0x2886C __UWORD_S 0 u_cnts 0 65535 FORMAT "%5.0" SYMBOL_LINK "ERRM_CFG_ARRY" 416 SYMBOL_LINK "ERRM_CFG_ARRY" 464 /end CHARACTERISTIC
/begin CHARACTERISTIC ERRM_ETC_SHUT_TYP "ETC engine shutdown type" VALUE 0x2886C __UWORD_S 0 u_diag_typ 0 8 FORMAT "%1.0" BIT_MASK 0xF000 SYMBOL_LINK "ERRM_CFG_ARRY" 420 SYMBOL_LINK "ERRM_CFG_ARRY" 468 /end CHARACTERISTIC
/begin CHARACTERISTIC ERRM_ETC_SHUT_MIL_ON "ETC engine shutdown MIL on enable" VALUE 0x2886C __UWORD_S 0 b_true 0 1 FORMAT "%1.0" BIT_MASK 0x0800 SYMBOL_LINK "ERRM_CFG_ARRY" 420 SYMBOL_LINK "ERRM_CFG_ARRY" 468 /end CHARACTERISTIC
/begin CHARACTERISTIC ERRM_ETC_SHUT_DEN_GRP "ETC engine shutdown denom group" VALUE 0x2886C __UWORD_S 0 u_den_grp 0 63 FORMAT "%1.0" BIT_MASK 0x003F SYMBOL_LINK "ERRM_CFG_ARRY" 420 SYMBOL_LINK "ERRM_CFG_ARRY" 468 /end CHARACTERISTIC
/begin CHARACTERISTIC ERRM_ETC_SHUT_DTC "ETC engine shutdown DTC" VALUE 0x2886C __UWORD_S 0 u_cnts 0 65535 FORMAT "%5.0" SYMBOL_LINK "ERRM_CFG_ARRY" 422 SYMBOL_LINK "ERRM_CFG_ARRY" 470 /end CHARACTERISTIC
/begin CHARACTERISTIC ERRM_ETC_LMT_TYP "ETC limit power type" VALUE 0x2886C __UWORD_S 0 u_diag_typ 0 8 FORMAT "%1.0" BIT_MASK 0xF000 SYMBOL_LINK "ERRM_CFG_ARRY" 426 SYMBOL_LINK "ERRM_CFG_ARRY" 474 /end CHARACTERISTIC
/begin CHARACTERISTIC ERRM_ETC_LMT_MIL_ON "ETC limit power MIL on enable" VALUE 0x2886C __UWORD_S 0 b_true 0 1 FORMAT "%1.0" BIT_MASK 0x0800 SYMBOL_LINK "ERRM_CFG_ARRY" 426 SYMBOL_LINK "ERRM_CFG_ARRY" 474 /end CHARACTERISTIC
/begin CHARACTERISTIC ERRM_ETC_LMT_DEN_GRP "ETC limit power denom group" VALUE 0x2886C __UWORD_S 0 u_den_grp 0 63 FORMAT "%1.0" BIT_MASK 0x003F SYMBOL_LINK "ERRM_CFG_ARRY" 426 SYMBOL_LINK "ERRM_CFG_ARRY" 474 /end CHARACTERISTIC
/begin CHARACTERISTIC ERRM_ETC_LMT_DTC "ETC limit power DTC" VALUE 0x2886C __UWORD_S 0 u_cnts 0 65535 FORMAT "%5.0" SYMBOL_LINK "ERRM_CFG_ARRY" 428 SYMBOL_LINK "ERRM_CFG_ARRY" 476 /end CHARACTERISTIC
/begin CHARACTERISTIC ERRM_ETC_OUT_CTRL_TYP "ETC out of control type" VALUE 0x2886C __UWORD_S 0 u_diag_typ 0 8 FORMAT "%1.0" BIT_MASK 0xF000 SYMBOL_LINK "ERRM_CFG_ARRY" 432 SYMBOL_LINK "ERRM_CFG_ARRY" 480 /end CHARACTERISTIC
/begin CHARACTERISTIC ERRM_ETC_OUT_CTRL_MIL_ON "ETC out of control MIL on enable" VALUE 0x2886C __UWORD_S 0 b_true 0 1 FORMAT "%1.0" BIT_MASK 0x0800 SYMBOL_LINK "ERRM_CFG_ARRY" 432 SYMBOL_LINK "ERRM_CFG_ARRY" 480 /end CHARACTERISTIC
/begin CHARACTERISTIC ERRM_ETC_OUT_CTRL_DEN_GRP "ETC out of control denom group" VALUE 0x2886C __UWORD_S 0 u_den_grp 0 63 FORMAT "%1.0" BIT_MASK 0x003F SYMBOL_LINK "ERRM_CFG_ARRY" 432 SYMBOL_LINK "ERRM_CFG_ARRY" 480 /end CHARACTERISTIC
/begin CHARACTERISTIC ERRM_ETC_OUT_CTRL_DTC "ETC out of control DTC" VALUE 0x2886C __UWORD_S 0 u_cnts 0 65535 FORMAT "%5.0" SYMBOL_LINK "ERRM_CFG_ARRY" 434 SYMBOL_LINK "ERRM_CFG_ARRY" 482 /end CHARACTERISTIC
/begin CHARACTERISTIC ERRM_TPS1_LO_TYP "TPS1 low type" VALUE 0x2886C __UWORD_S 0 u_diag_typ 0 8 FORMAT "%1.0" BIT_MASK 0xF000 SYMBOL_LINK "ERRM_CFG_ARRY" 438 SYMBOL_LINK "ERRM_CFG_ARRY" 486 /end CHARACTERISTIC
/begin CHARACTERISTIC ERRM_TPS1_LO_MIL_ON "TPS1 low MIL on enable" VALUE 0x2886C __UWORD_S 0 b_true 0 1 FORMAT "%1.0" BIT_MASK 0x0800 SYMBOL_LINK "ERRM_CFG_ARRY" 438 SYMBOL_LINK "ERRM_CFG_ARRY" 486 /end CHARACTERISTIC
/begin CHARACTERISTIC ERRM_TPS1_LO_DEN_GRP "TPS1 low denom group" VALUE 0x2886C __UWORD_S 0 u_den_grp 0 63 FORMAT "%1.0" BIT_MASK 0x003F SYMBOL_LINK "ERRM_CFG_ARRY" 438 SYMBOL_LINK "ERRM_CFG_ARRY" 486 /end CHARACTERISTIC
/begin CHARACTERISTIC ERRM_TPS1_LO_DTC "TPS1 low DTC" VALUE 0x2886C __UWORD_S 0 u_cnts 0 65535 FORMAT "%5.0" SYMBOL_LINK "ERRM_CFG_ARRY" 440 SYMBOL_LINK "ERRM_CFG_ARRY" 488 /end CHARACTERISTIC
/begin CHARACTERISTIC ERRM_TPS2_LO_TYP "TPS2 low type" VALUE 0x2886C __UWORD_S 0 u_diag_typ 0 8 FORMAT "%1.0" BIT_MASK 0xF000 SYMBOL_LINK "ERRM_CFG_ARRY" 444 SYMBOL_LINK "ERRM_CFG_ARRY" 492 /end CHARACTERISTIC
/begin CHARACTERISTIC ERRM_TPS2_LO_MIL_ON "TPS2 low MIL on enable" VALUE 0x2886C __UWORD_S 0 b_true 0 1 FORMAT "%1.0" BIT_MASK 0x0800 SYMBOL_LINK "ERRM_CFG_ARRY" 444 SYMBOL_LINK "ERRM_CFG_ARRY" 492 /end CHARACTERISTIC
/begin CHARACTERISTIC ERRM_TPS2_LO_DEN_GRP "TPS2 low denom group" VALUE 0x2886C __UWORD_S 0 u_den_grp 0 63 FORMAT "%1.0" BIT_MASK 0x003F SYMBOL_LINK "ERRM_CFG_ARRY" 444 SYMBOL_LINK "ERRM_CFG_ARRY" 492 /end CHARACTERISTIC
/begin CHARACTERISTIC ERRM_TPS2_LO_DTC "TPS2 low DTC" VALUE 0x2886C __UWORD_S 0 u_cnts 0 65535 FORMAT "%5.0" SYMBOL_LINK "ERRM_CFG_ARRY" 446 SYMBOL_LINK "ERRM_CFG_ARRY" 494 /end CHARACTERISTIC
/begin CHARACTERISTIC ERRM_TPS1_HI_TYP "TPS1 high type" VALUE 0x2886C __UWORD_S 0 u_diag_typ 0 8 FORMAT "%1.0" BIT_MASK 0xF000 SYMBOL_LINK "ERRM_CFG_ARRY" 450 SYMBOL_LINK "ERRM_CFG_ARRY" 498 /end CHARACTERISTIC
/begin CHARACTERISTIC ERRM_TPS1_HI_MIL_ON "TPS1 high MIL on enable" VALUE 0x2886C __UWORD_S 0 b_true 0 1 FORMAT "%1.0" BIT_MASK 0x0800 SYMBOL_LINK "ERRM_CFG_ARRY" 450 SYMBOL_LINK "ERRM_CFG_ARRY" 498 /end CHARACTERISTIC
/begin CHARACTERISTIC ERRM_TPS1_HI_DEN_GRP "TPS1 high denom group" VALUE 0x2886C __UWORD_S 0 u_den_grp 0 63 FORMAT "%1.0" BIT_MASK 0x003F SYMBOL_LINK "ERRM_CFG_ARRY" 450 SYMBOL_LINK "ERRM_CFG_ARRY" 498 /end CHARACTERISTIC
/begin CHARACTERISTIC ERRM_TPS1_HI_DTC "TPS1 high DTC" VALUE 0x2886C __UWORD_S 0 u_cnts 0 65535 FORMAT "%5.0" SYMBOL_LINK "ERRM_CFG_ARRY" 452 SYMBOL_LINK "ERRM_CFG_ARRY" 500 /end CHARACTERISTIC
/begin CHARACTERISTIC ERRM_TPS2_HI_TYP "TPS2 high type" VALUE 0x2886C __UWORD_S 0 u_diag_typ 0 8 FORMAT "%1.0" BIT_MASK 0xF000 SYMBOL_LINK "ERRM_CFG_ARRY" 456 SYMBOL_LINK "ERRM_CFG_ARRY" 504 /end CHARACTERISTIC
/begin CHARACTERISTIC ERRM_TPS2_HI_MIL_ON "TPS2 high MIL on enable" VALUE 0x2886C __UWORD_S 0 b_true 0 1 FORMAT "%1.0" BIT_MASK 0x0800 SYMBOL_LINK "ERRM_CFG_ARRY" 456 SYMBOL_LINK "ERRM_CFG_ARRY" 504 /end CHARACTERISTIC
/begin CHARACTERISTIC ERRM_TPS2_HI_DEN_GRP "TPS2 high denom group" VALUE 0x2886C __UWORD_S 0 u_den_grp 0 63 FORMAT "%1.0" BIT_MASK 0x003F SYMBOL_LINK "ERRM_CFG_ARRY" 456 SYMBOL_LINK "ERRM_CFG_ARRY" 504 /end CHARACTERISTIC
/begin CHARACTERISTIC ERRM_TPS2_HI_DTC "TPS2 high DTC" VALUE 0x2886C __UWORD_S 0 u_cnts 0 65535 FORMAT "%5.0" SYMBOL_LINK "ERRM_CFG_ARRY" 458 SYMBOL_LINK "ERRM_CFG_ARRY" 506 /end CHARACTERISTIC
/begin CHARACTERISTIC ERRM_TPS_CORR_TYP "TPS correlation type" VALUE 0x2886C __UWORD_S 0 u_diag_typ 0 8 FORMAT "%1.0" BIT_MASK 0xF000 SYMBOL_LINK "ERRM_CFG_ARRY" 474 SYMBOL_LINK "ERRM_CFG_ARRY" 522 /end CHARACTERISTIC
/begin CHARACTERISTIC ERRM_TPS_CORR_MIL_ON "TPS correlation MIL on enable" VALUE 0x2886C __UWORD_S 0 b_true 0 1 FORMAT "%1.0" BIT_MASK 0x0800 SYMBOL_LINK "ERRM_CFG_ARRY" 474 SYMBOL_LINK "ERRM_CFG_ARRY" 522 /end CHARACTERISTIC
/begin CHARACTERISTIC ERRM_TPS_CORR_DEN_GRP "TPS correlation denom group" VALUE 0x2886C __UWORD_S 0 u_den_grp 0 63 FORMAT "%1.0" BIT_MASK 0x003F SYMBOL_LINK "ERRM_CFG_ARRY" 474 SYMBOL_LINK "ERRM_CFG_ARRY" 522 /end CHARACTERISTIC
/begin CHARACTERISTIC ERRM_TPS_CORR_DTC "TPS correlation DTC" VALUE 0x2886C __UWORD_S 0 u_cnts 0 65535 FORMAT "%5.0" SYMBOL_LINK "ERRM_CFG_ARRY" 476 SYMBOL_LINK "ERRM_CFG_ARRY" 524 /end CHARACTERISTIC
/begin CHARACTERISTIC ERRM_TPS_DFLT_TYP "TPS default position type" VALUE 0x2886C __UWORD_S 0 u_diag_typ 0 8 FORMAT "%1.0" BIT_MASK 0xF000 SYMBOL_LINK "ERRM_CFG_ARRY" 480 SYMBOL_LINK "ERRM_CFG_ARRY" 528 /end CHARACTERISTIC
/begin CHARACTERISTIC ERRM_TPS_DFLT_MIL_ON "TPS default position MIL on enable" VALUE 0x2886C __UWORD_S 0 b_true 0 1 FORMAT "%1.0" BIT_MASK 0x0800 SYMBOL_LINK "ERRM_CFG_ARRY" 480 SYMBOL_LINK "ERRM_CFG_ARRY" 528 /end CHARACTERISTIC
/begin CHARACTERISTIC ERRM_TPS_DFLT_DEN_GRP "TPS default position denom group" VALUE 0x2886C __UWORD_S 0 u_den_grp 0 63 FORMAT "%1.0" BIT_MASK 0x003F SYMBOL_LINK "ERRM_CFG_ARRY" 480 SYMBOL_LINK "ERRM_CFG_ARRY" 528 /end CHARACTERISTIC
/begin CHARACTERISTIC ERRM_TPS_DFLT_DTC "TPS default position DTC" VALUE 0x2886C __UWORD_S 0 u_cnts 0 65535 FORMAT "%5.0" SYMBOL_LINK "ERRM_CFG_ARRY" 482 SYMBOL_LINK "ERRM_CFG_ARRY" 530 /end CHARACTERISTIC
/begin CHARACTERISTIC ERRM_REF_VOLT1_TYP "sensor ref volt1 type" VALUE 0x2886C __UWORD_S 0 u_diag_typ 0 8 FORMAT "%1.0" BIT_MASK 0xF000 SYMBOL_LINK "ERRM_CFG_ARRY" 486 SYMBOL_LINK "ERRM_CFG_ARRY" 534 /end CHARACTERISTIC
/begin CHARACTERISTIC ERRM_REF_VOLT1_MIL_ON "sensor ref volt1 MIL on enable" VALUE 0x2886C __UWORD_S 0 b_true 0 1 FORMAT "%1.0" BIT_MASK 0x0800 SYMBOL_LINK "ERRM_CFG_ARRY" 486 SYMBOL_LINK "ERRM_CFG_ARRY" 534 /end CHARACTERISTIC
/begin CHARACTERISTIC ERRM_REF_VOLT1_DEN_GRP "sensor ref volt1 denom group" VALUE 0x2886C __UWORD_S 0 u_den_grp 0 63 FORMAT "%1.0" BIT_MASK 0x003F SYMBOL_LINK "ERRM_CFG_ARRY" 486 SYMBOL_LINK "ERRM_CFG_ARRY" 534 /end CHARACTERISTIC
/begin CHARACTERISTIC ERRM_REF_VOLT1_DTC "sensor ref volt1 DTC" VALUE 0x2886C __UWORD_S 0 u_cnts 0 65535 FORMAT "%5.0" SYMBOL_LINK "ERRM_CFG_ARRY" 488 SYMBOL_LINK "ERRM_CFG_ARRY" 536 /end CHARACTERISTIC
/begin CHARACTERISTIC ERRM_REF_VOLT2_TYP "sensor ref volt2 type" VALUE 0x2886C __UWORD_S 0 u_diag_typ 0 8 FORMAT "%1.0" BIT_MASK 0xF000 SYMBOL_LINK "ERRM_CFG_ARRY" 492 SYMBOL_LINK "ERRM_CFG_ARRY" 540 /end CHARACTERISTIC
/begin CHARACTERISTIC ERRM_REF_VOLT2_MIL_ON "sensor ref volt2 MIL on enable" VALUE 0x2886C __UWORD_S 0 b_true 0 1 FORMAT "%1.0" BIT_MASK 0x0800 SYMBOL_LINK "ERRM_CFG_ARRY" 492 SYMBOL_LINK "ERRM_CFG_ARRY" 540 /end CHARACTERISTIC
/begin CHARACTERISTIC ERRM_REF_VOLT2_DEN_GRP "sensor ref volt2 denom group" VALUE 0x2886C __UWORD_S 0 u_den_grp 0 63 FORMAT "%1.0" BIT_MASK 0x003F SYMBOL_LINK "ERRM_CFG_ARRY" 492 SYMBOL_LINK "ERRM_CFG_ARRY" 540 /end CHARACTERISTIC
/begin CHARACTERISTIC ERRM_REF_VOLT2_DTC "sensor ref volt2 DTC" VALUE 0x2886C __UWORD_S 0 u_cnts 0 65535 FORMAT "%5.0" SYMBOL_LINK "ERRM_CFG_ARRY" 494 SYMBOL_LINK "ERRM_CFG_ARRY" 542 /end CHARACTERISTIC
/begin CHARACTERISTIC ERRM_ETC_MOTOR_PERF_TYP "ETC motor performance type" VALUE 0x2886C __UWORD_S 0 u_diag_typ 0 8 FORMAT "%1.0" BIT_MASK 0xF000 SYMBOL_LINK "ERRM_CFG_ARRY" 498 SYMBOL_LINK "ERRM_CFG_ARRY" 546 /end CHARACTERISTIC
/begin CHARACTERISTIC ERRM_ETC_MOTOR_PERF_MIL_ON "ETC motor performance MIL on enable" VALUE 0x2886C __UWORD_S 0 b_true 0 1 FORMAT "%1.0" BIT_MASK 0x0800 SYMBOL_LINK "ERRM_CFG_ARRY" 498 SYMBOL_LINK "ERRM_CFG_ARRY" 546 /end CHARACTERISTIC
/begin CHARACTERISTIC ERRM_ETC_MOTOR_PERF_DEN_GRP "ETC motor performance denom group" VALUE 0x2886C __UWORD_S 0 u_den_grp 0 63 FORMAT "%1.0" BIT_MASK 0x003F SYMBOL_LINK "ERRM_CFG_ARRY" 498 SYMBOL_LINK "ERRM_CFG_ARRY" 546 /end CHARACTERISTIC
/begin CHARACTERISTIC ERRM_ETC_MOTOR_PERF_DTC "ETC motor performance DTC" VALUE 0x2886C __UWORD_S 0 u_cnts 0 65535 FORMAT "%5.0" SYMBOL_LINK "ERRM_CFG_ARRY" 500 SYMBOL_LINK "ERRM_CFG_ARRY" 548 /end CHARACTERISTIC
/begin CHARACTERISTIC ERRM_ETC_MOTOR_SS_TYP "ETC motor steady state performance type" VALUE 0x2886C __UWORD_S 0 u_diag_typ 0 8 FORMAT "%1.0" BIT_MASK 0xF000 SYMBOL_LINK "ERRM_CFG_ARRY" 504 SYMBOL_LINK "ERRM_CFG_ARRY" 552 /end CHARACTERISTIC
/begin CHARACTERISTIC ERRM_ETC_MOTOR_SS_MIL_ON "ETC motor steady state performance MIL on enable" VALUE 0x2886C __UWORD_S 0 b_true 0 1 FORMAT "%1.0" BIT_MASK 0x0800 SYMBOL_LINK "ERRM_CFG_ARRY" 504 SYMBOL_LINK "ERRM_CFG_ARRY" 552 /end CHARACTERISTIC
/begin CHARACTERISTIC ERRM_ETC_MOTOR_SS_DEN_GRP "ETC motor steady state performance denom group" VALUE 0x2886C __UWORD_S 0 u_den_grp 0 63 FORMAT "%1.0" BIT_MASK 0x003F SYMBOL_LINK "ERRM_CFG_ARRY" 504 SYMBOL_LINK "ERRM_CFG_ARRY" 552 /end CHARACTERISTIC
/begin CHARACTERISTIC ERRM_ETC_MOTOR_SS_DTC "ETC motor steady state performance DTC" VALUE 0x2886C __UWORD_S 0 u_cnts 0 65535 FORMAT "%5.0" SYMBOL_LINK "ERRM_CFG_ARRY" 506 SYMBOL_LINK "ERRM_CFG_ARRY" 554 /end CHARACTERISTIC
/begin CHARACTERISTIC ERRM_CP_FLW_TYP "purge flow type" VALUE 0x2886C __UWORD_S 0 u_diag_typ 0 8 FORMAT "%1.0" BIT_MASK 0xF000 SYMBOL_LINK "ERRM_CFG_ARRY" 510 SYMBOL_LINK "ERRM_CFG_ARRY" 558 /end CHARACTERISTIC
/begin CHARACTERISTIC ERRM_CP_FLW_MIL_ON "purge flow MIL on enable" VALUE 0x2886C __UWORD_S 0 b_true 0 1 FORMAT "%1.0" BIT_MASK 0x0800 SYMBOL_LINK "ERRM_CFG_ARRY" 510 SYMBOL_LINK "ERRM_CFG_ARRY" 558 /end CHARACTERISTIC
/begin CHARACTERISTIC ERRM_CP_FLW_DEN_GRP "purge flow denom group" VALUE 0x2886C __UWORD_S 0 u_den_grp 0 63 FORMAT "%1.0" BIT_MASK 0x003F SYMBOL_LINK "ERRM_CFG_ARRY" 510 SYMBOL_LINK "ERRM_CFG_ARRY" 558 /end CHARACTERISTIC
/begin CHARACTERISTIC ERRM_CP_FLW_DTC "purge flow DTC" VALUE 0x2886C __UWORD_S 0 u_cnts 0 65535 FORMAT "%5.0" SYMBOL_LINK "ERRM_CFG_ARRY" 512 SYMBOL_LINK "ERRM_CFG_ARRY" 560 /end CHARACTERISTIC
/begin CHARACTERISTIC ERRM_CP_L_LEAK_TYP "purge large leak type" VALUE 0x2886C __UWORD_S 0 u_diag_typ 0 8 FORMAT "%1.0" BIT_MASK 0xF000 SYMBOL_LINK "ERRM_CFG_ARRY" 516 SYMBOL_LINK "ERRM_CFG_ARRY" 564 /end CHARACTERISTIC
/begin CHARACTERISTIC ERRM_CP_L_LEAK_MIL_ON "purge large leak MIL on enable" VALUE 0x2886C __UWORD_S 0 b_true 0 1 FORMAT "%1.0" BIT_MASK 0x0800 SYMBOL_LINK "ERRM_CFG_ARRY" 516 SYMBOL_LINK "ERRM_CFG_ARRY" 564 /end CHARACTERISTIC
/begin CHARACTERISTIC ERRM_CP_L_LEAK_DEN_GRP "purge large leak denom group" VALUE 0x2886C __UWORD_S 0 u_den_grp 0 63 FORMAT "%1.0" BIT_MASK 0x003F SYMBOL_LINK "ERRM_CFG_ARRY" 516 SYMBOL_LINK "ERRM_CFG_ARRY" 564 /end CHARACTERISTIC
/begin CHARACTERISTIC ERRM_CP_L_LEAK_DTC "purge large leak DTC" VALUE 0x2886C __UWORD_S 0 u_cnts 0 65535 FORMAT "%5.0" SYMBOL_LINK "ERRM_CFG_ARRY" 518 SYMBOL_LINK "ERRM_CFG_ARRY" 566 /end CHARACTERISTIC
/begin CHARACTERISTIC ERRM_CP_S_LEAK_TYP "purge small leak type" VALUE 0x2886C __UWORD_S 0 u_diag_typ 0 8 FORMAT "%1.0" BIT_MASK 0xF000 SYMBOL_LINK "ERRM_CFG_ARRY" 522 SYMBOL_LINK "ERRM_CFG_ARRY" 570 /end CHARACTERISTIC
/begin CHARACTERISTIC ERRM_CP_S_LEAK_MIL_ON "purge small leak MIL on enable" VALUE 0x2886C __UWORD_S 0 b_true 0 1 FORMAT "%1.0" BIT_MASK 0x0800 SYMBOL_LINK "ERRM_CFG_ARRY" 522 SYMBOL_LINK "ERRM_CFG_ARRY" 570 /end CHARACTERISTIC
/begin CHARACTERISTIC ERRM_CP_S_LEAK_DEN_GRP "purge small leak denom group" VALUE 0x2886C __UWORD_S 0 u_den_grp 0 63 FORMAT "%1.0" BIT_MASK 0x003F SYMBOL_LINK "ERRM_CFG_ARRY" 522 SYMBOL_LINK "ERRM_CFG_ARRY" 570 /end CHARACTERISTIC
/begin CHARACTERISTIC ERRM_CP_S_LEAK_DTC "purge small leak DTC" VALUE 0x2886C __UWORD_S 0 u_cnts 0 65535 FORMAT "%5.0" SYMBOL_LINK "ERRM_CFG_ARRY" 524 SYMBOL_LINK "ERRM_CFG_ARRY" 572 /end CHARACTERISTIC
/begin CHARACTERISTIC ERRM_CP_VS_LEAK_TYP "purge very small leak type" VALUE 0x2886C __UWORD_S 0 u_diag_typ 0 8 FORMAT "%1.0" BIT_MASK 0xF000 SYMBOL_LINK "ERRM_CFG_ARRY" 528 SYMBOL_LINK "ERRM_CFG_ARRY" 576 /end CHARACTERISTIC
/begin CHARACTERISTIC ERRM_CP_VS_LEAK_MIL_ON "purge very small leak MIL on enable" VALUE 0x2886C __UWORD_S 0 b_true 0 1 FORMAT "%1.0" BIT_MASK 0x0800 SYMBOL_LINK "ERRM_CFG_ARRY" 528 SYMBOL_LINK "ERRM_CFG_ARRY" 576 /end CHARACTERISTIC
/begin CHARACTERISTIC ERRM_CP_VS_LEAK_DEN_GRP "purge very small leak denom group" VALUE 0x2886C __UWORD_S 0 u_den_grp 0 63 FORMAT "%1.0" BIT_MASK 0x003F SYMBOL_LINK "ERRM_CFG_ARRY" 528 SYMBOL_LINK "ERRM_CFG_ARRY" 576 /end CHARACTERISTIC
/begin CHARACTERISTIC ERRM_CP_VS_LEAK_DTC "purge very small leak DTC" VALUE 0x2886C __UWORD_S 0 u_cnts 0 65535 FORMAT "%5.0" SYMBOL_LINK "ERRM_CFG_ARRY" 530 SYMBOL_LINK "ERRM_CFG_ARRY" 578 /end CHARACTERISTIC
/begin CHARACTERISTIC ERRM_CP_VENT_RES_TYP "purge vent restricted type" VALUE 0x2886C __UWORD_S 0 u_diag_typ 0 8 FORMAT "%1.0" BIT_MASK 0xF000 SYMBOL_LINK "ERRM_CFG_ARRY" 534 SYMBOL_LINK "ERRM_CFG_ARRY" 582 /end CHARACTERISTIC
/begin CHARACTERISTIC ERRM_CP_VENT_RES_MIL_ON "purge vent restricted MIL on enable" VALUE 0x2886C __UWORD_S 0 b_true 0 1 FORMAT "%1.0" BIT_MASK 0x0800 SYMBOL_LINK "ERRM_CFG_ARRY" 534 SYMBOL_LINK "ERRM_CFG_ARRY" 582 /end CHARACTERISTIC
/begin CHARACTERISTIC ERRM_CP_VENT_RES_DEN_GRP "purge vent restricted denom group" VALUE 0x2886C __UWORD_S 0 u_den_grp 0 63 FORMAT "%1.0" BIT_MASK 0x003F SYMBOL_LINK "ERRM_CFG_ARRY" 534 SYMBOL_LINK "ERRM_CFG_ARRY" 582 /end CHARACTERISTIC
/begin CHARACTERISTIC ERRM_CP_VENT_RES_DTC "purge vent restricted DTC" VALUE 0x2886C __UWORD_S 0 u_cnts 0 65535 FORMAT "%5.0" SYMBOL_LINK "ERRM_CFG_ARRY" 536 SYMBOL_LINK "ERRM_CFG_ARRY" 584 /end CHARACTERISTIC
/begin CHARACTERISTIC ERRM_ECM_RAM_TYP "ECM ram type" VALUE 0x2886C __UWORD_S 0 u_diag_typ 0 8 FORMAT "%1.0" BIT_MASK 0xF000 SYMBOL_LINK "ERRM_CFG_ARRY" 540 SYMBOL_LINK "ERRM_CFG_ARRY" 588 /end CHARACTERISTIC
/begin CHARACTERISTIC ERRM_ECM_RAM_MIL_ON "ECM ram MIL on enable" VALUE 0x2886C __UWORD_S 0 b_true 0 1 FORMAT "%1.0" BIT_MASK 0x0800 SYMBOL_LINK "ERRM_CFG_ARRY" 540 SYMBOL_LINK "ERRM_CFG_ARRY" 588 /end CHARACTERISTIC
/begin CHARACTERISTIC ERRM_ECM_RAM_DEN_GRP "ECM ram denom group" VALUE 0x2886C __UWORD_S 0 u_den_grp 0 63 FORMAT "%1.0" BIT_MASK 0x003F SYMBOL_LINK "ERRM_CFG_ARRY" 540 SYMBOL_LINK "ERRM_CFG_ARRY" 588 /end CHARACTERISTIC
/begin CHARACTERISTIC ERRM_ECM_RAM_DTC "ECM ram DTC" VALUE 0x2886C __UWORD_S 0 u_cnts 0 65535 FORMAT "%5.0" SYMBOL_LINK "ERRM_CFG_ARRY" 542 SYMBOL_LINK "ERRM_CFG_ARRY" 590 /end CHARACTERISTIC
/begin CHARACTERISTIC ERRM_ECM_STACK_TYP "ECM stack type" VALUE 0x2886C __UWORD_S 0 u_diag_typ 0 8 FORMAT "%1.0" BIT_MASK 0xF000 SYMBOL_LINK "ERRM_CFG_ARRY" 546 SYMBOL_LINK "ERRM_CFG_ARRY" 594 /end CHARACTERISTIC
/begin CHARACTERISTIC ERRM_ECM_STACK_MIL_ON "ECM stack MIL on enable" VALUE 0x2886C __UWORD_S 0 b_true 0 1 FORMAT "%1.0" BIT_MASK 0x0800 SYMBOL_LINK "ERRM_CFG_ARRY" 546 SYMBOL_LINK "ERRM_CFG_ARRY" 594 /end CHARACTERISTIC
/begin CHARACTERISTIC ERRM_ECM_STACK_DEN_GRP "ECM stack denom group" VALUE 0x2886C __UWORD_S 0 u_den_grp 0 63 FORMAT "%1.0" BIT_MASK 0x003F SYMBOL_LINK "ERRM_CFG_ARRY" 546 SYMBOL_LINK "ERRM_CFG_ARRY" 594 /end CHARACTERISTIC
/begin CHARACTERISTIC ERRM_ECM_STACK_DTC "ECM stack DTC" VALUE 0x2886C __UWORD_S 0 u_cnts 0 65535 FORMAT "%5.0" SYMBOL_LINK "ERRM_CFG_ARRY" 548 SYMBOL_LINK "ERRM_CFG_ARRY" 596 /end CHARACTERISTIC
/begin CHARACTERISTIC ERRM_ECM_ROM_TYP "ECM rom type" VALUE 0x2886C __UWORD_S 0 u_diag_typ 0 8 FORMAT "%1.0" BIT_MASK 0xF000 SYMBOL_LINK "ERRM_CFG_ARRY" 552 SYMBOL_LINK "ERRM_CFG_ARRY" 600 /end CHARACTERISTIC
/begin CHARACTERISTIC ERRM_ECM_ROM_MIL_ON "ECM rom MIL on enable" VALUE 0x2886C __UWORD_S 0 b_true 0 1 FORMAT "%1.0" BIT_MASK 0x0800 SYMBOL_LINK "ERRM_CFG_ARRY" 552 SYMBOL_LINK "ERRM_CFG_ARRY" 600 /end CHARACTERISTIC
/begin CHARACTERISTIC ERRM_ECM_ROM_DEN_GRP "ECM rom denom group" VALUE 0x2886C __UWORD_S 0 u_den_grp 0 63 FORMAT "%1.0" BIT_MASK 0x003F SYMBOL_LINK "ERRM_CFG_ARRY" 552 SYMBOL_LINK "ERRM_CFG_ARRY" 600 /end CHARACTERISTIC
/begin CHARACTERISTIC ERRM_ECM_ROM_DTC "ECM rom DTC" VALUE 0x2886C __UWORD_S 0 u_den_grp 0 65535 FORMAT "%1.0" BIT_MASK 0x003F SYMBOL_LINK "ERRM_CFG_ARRY" 554 SYMBOL_LINK "ERRM_CFG_ARRY" 602 /end CHARACTERISTIC
/begin CHARACTERISTIC ERRM_FLV_HI_TYP "fuel level short high type" VALUE 0x2886C __UWORD_S 0 u_diag_typ 0 8 FORMAT "%1.0" BIT_MASK 0xF000 SYMBOL_LINK "ERRM_CFG_ARRY" 588 SYMBOL_LINK "ERRM_CFG_ARRY" 636 /end CHARACTERISTIC
/begin CHARACTERISTIC ERRM_FLV_HI_MIL_ON "fuel level short high MIL on enable" VALUE 0x2886C __UWORD_S 0 b_true 0 1 FORMAT "%1.0" BIT_MASK 0x0800 SYMBOL_LINK "ERRM_CFG_ARRY" 588 SYMBOL_LINK "ERRM_CFG_ARRY" 636 /end CHARACTERISTIC
/begin CHARACTERISTIC ERRM_FLV_HI_DEN_GRP "fuel level short high denom group" VALUE 0x2886C __UWORD_S 0 u_den_grp 0 63 FORMAT "%1.0" BIT_MASK 0x003F SYMBOL_LINK "ERRM_CFG_ARRY" 588 SYMBOL_LINK "ERRM_CFG_ARRY" 636 /end CHARACTERISTIC
/begin CHARACTERISTIC ERRM_FLV_HI_DTC "fuel level short high DTC" VALUE 0x2886C __UWORD_S 0 u_cnts 0 65535 FORMAT "%5.0" SYMBOL_LINK "ERRM_CFG_ARRY" 590 SYMBOL_LINK "ERRM_CFG_ARRY" 638 /end CHARACTERISTIC
/begin CHARACTERISTIC ERRM_FLV_LO_TYP "fuel level short low type" VALUE 0x2886C __UWORD_S 0 u_diag_typ 0 8 FORMAT "%1.0" BIT_MASK 0xF000 SYMBOL_LINK "ERRM_CFG_ARRY" 594 SYMBOL_LINK "ERRM_CFG_ARRY" 642 /end CHARACTERISTIC
/begin CHARACTERISTIC ERRM_FLV_LO_MIL_ON "fuel level short low MIL on enable" VALUE 0x2886C __UWORD_S 0 b_true 0 1 FORMAT "%1.0" BIT_MASK 0x0800 SYMBOL_LINK "ERRM_CFG_ARRY" 594 SYMBOL_LINK "ERRM_CFG_ARRY" 642 /end CHARACTERISTIC
/begin CHARACTERISTIC ERRM_FLV_LO_DEN_GRP "fuel level short low denom group" VALUE 0x2886C __UWORD_S 0 u_den_grp 0 63 FORMAT "%1.0" BIT_MASK 0x003F SYMBOL_LINK "ERRM_CFG_ARRY" 594 SYMBOL_LINK "ERRM_CFG_ARRY" 642 /end CHARACTERISTIC
/begin CHARACTERISTIC ERRM_FLV_LO_DTC "fuel level short low DTC" VALUE 0x2886C __UWORD_S 0 u_cnts 0 65535 FORMAT "%5.0" SYMBOL_LINK "ERRM_CFG_ARRY" 596 SYMBOL_LINK "ERRM_CFG_ARRY" 644 /end CHARACTERISTIC
/begin CHARACTERISTIC ERRM_B1_FUEL_IDL_LEAN_TYP "bank1 idle fuel system lean type" VALUE 0x2886C __UWORD_S 0 u_diag_typ 0 8 FORMAT "%1.0" BIT_MASK 0xF000 SYMBOL_LINK "ERRM_CFG_ARRY" 624 SYMBOL_LINK "ERRM_CFG_ARRY" 672 /end CHARACTERISTIC
/begin CHARACTERISTIC ERRM_B1_FUEL_IDL_LEAN_MIL_ON "bank1 idle fuel system lean MIL on enable" VALUE 0x2886C __UWORD_S 0 b_true 0 1 FORMAT "%1.0" BIT_MASK 0x0800 SYMBOL_LINK "ERRM_CFG_ARRY" 624 SYMBOL_LINK "ERRM_CFG_ARRY" 672 /end CHARACTERISTIC
/begin CHARACTERISTIC ERRM_B1_FUEL_IDL_LEAN_DEN_GRP "bank1 idle fuel system lean denom group" VALUE 0x2886C __UWORD_S 0 u_den_grp 0 63 FORMAT "%1.0" BIT_MASK 0x003F SYMBOL_LINK "ERRM_CFG_ARRY" 624 SYMBOL_LINK "ERRM_CFG_ARRY" 672 /end CHARACTERISTIC
/begin CHARACTERISTIC ERRM_B1_FUEL_IDL_LEAN_DTC "bank1 idle fuel system lean DTC" VALUE 0x2886C __UWORD_S 0 u_cnts 0 65535 FORMAT "%5.0" SYMBOL_LINK "ERRM_CFG_ARRY" 626 SYMBOL_LINK "ERRM_CFG_ARRY" 674 /end CHARACTERISTIC
/begin CHARACTERISTIC ERRM_B1_FUEL_IDL_RICH_TYP "bank1 idle fuel system rich type" VALUE 0x2886C __UWORD_S 0 u_diag_typ 0 8 FORMAT "%1.0" BIT_MASK 0xF000 SYMBOL_LINK "ERRM_CFG_ARRY" 630 SYMBOL_LINK "ERRM_CFG_ARRY" 678 /end CHARACTERISTIC
/begin CHARACTERISTIC ERRM_B1_FUEL_IDL_RICH_MIL_ON "bank1 fuel system rich MIL on enable" VALUE 0x2886C __UWORD_S 0 b_true 0 1 FORMAT "%1.0" BIT_MASK 0x0800 SYMBOL_LINK "ERRM_CFG_ARRY" 630 SYMBOL_LINK "ERRM_CFG_ARRY" 678 /end CHARACTERISTIC
/begin CHARACTERISTIC ERRM_B1_FUEL_IDL_RICH_DEN_GRP "bank1 fuel system rich denom group" VALUE 0x2886C __UWORD_S 0 u_den_grp 0 63 FORMAT "%1.0" BIT_MASK 0x003F SYMBOL_LINK "ERRM_CFG_ARRY" 630 SYMBOL_LINK "ERRM_CFG_ARRY" 678 /end CHARACTERISTIC
/begin CHARACTERISTIC ERRM_B1_FUEL_IDL_RICH_DTC "bank1 fuel system rich DTC" VALUE 0x2886C __UWORD_S 0 u_cnts 0 65535 FORMAT "%5.0" SYMBOL_LINK "ERRM_CFG_ARRY" 632 SYMBOL_LINK "ERRM_CFG_ARRY" 680 /end CHARACTERISTIC
/begin CHARACTERISTIC ERRM_B1_FUEL_LEAN_TYP "bank1 fuel system lean type" VALUE 0x2886C __UWORD_S 0 u_diag_typ 0 8 FORMAT "%1.0" BIT_MASK 0xF000 SYMBOL_LINK "ERRM_CFG_ARRY" 636 SYMBOL_LINK "ERRM_CFG_ARRY" 684 /end CHARACTERISTIC
/begin CHARACTERISTIC ERRM_B1_FUEL_LEAN_MIL_ON "bank1 fuel system lean MIL on enable" VALUE 0x2886C __UWORD_S 0 b_true 0 1 FORMAT "%1.0" BIT_MASK 0x0800 SYMBOL_LINK "ERRM_CFG_ARRY" 636 SYMBOL_LINK "ERRM_CFG_ARRY" 684 /end CHARACTERISTIC
/begin CHARACTERISTIC ERRM_B1_FUEL_LEAN_DEN_GRP "bank1 fuel system lean denom group" VALUE 0x2886C __UWORD_S 0 u_den_grp 0 63 FORMAT "%1.0" BIT_MASK 0x003F SYMBOL_LINK "ERRM_CFG_ARRY" 636 SYMBOL_LINK "ERRM_CFG_ARRY" 684 /end CHARACTERISTIC
/begin CHARACTERISTIC ERRM_B1_FUEL_LEAN_DTC "bank1 fuel system lean DTC" VALUE 0x2886C __UWORD_S 0 u_cnts 0 65535 FORMAT "%5.0" SYMBOL_LINK "ERRM_CFG_ARRY" 638 SYMBOL_LINK "ERRM_CFG_ARRY" 686 /end CHARACTERISTIC
/begin CHARACTERISTIC ERRM_B1_FUEL_RICH_TYP "bank1 fuel system rich type" VALUE 0x2886C __UWORD_S 0 u_diag_typ 0 8 FORMAT "%1.0" BIT_MASK 0xF000 SYMBOL_LINK "ERRM_CFG_ARRY" 642 SYMBOL_LINK "ERRM_CFG_ARRY" 690 /end CHARACTERISTIC
/begin CHARACTERISTIC ERRM_B1_FUEL_RICH_MIL_ON "bank1 fuel system rich MIL on enable" VALUE 0x2886C __UWORD_S 0 b_true 0 1 FORMAT "%1.0" BIT_MASK 0x0800 SYMBOL_LINK "ERRM_CFG_ARRY" 642 SYMBOL_LINK "ERRM_CFG_ARRY" 690 /end CHARACTERISTIC
/begin CHARACTERISTIC ERRM_B1_FUEL_RICH_DEN_GRP "bank1 fuel system rich denom group" VALUE 0x2886C __UWORD_S 0 u_den_grp 0 63 FORMAT "%1.0" BIT_MASK 0x003F SYMBOL_LINK "ERRM_CFG_ARRY" 642 SYMBOL_LINK "ERRM_CFG_ARRY" 690 /end CHARACTERISTIC
/begin CHARACTERISTIC ERRM_B1_FUEL_RICH_DTC "bank1 fuel system rich DTC" VALUE 0x2886C __UWORD_S 0 u_cnts 0 65535 FORMAT "%5.0" SYMBOL_LINK "ERRM_CFG_ARRY" 644 SYMBOL_LINK "ERRM_CFG_ARRY" 692 /end CHARACTERISTIC
/begin CHARACTERISTIC ERRM_GEAR_R_TYP "gear reverse type" VALUE 0x2886C __UWORD_S 0 u_diag_typ 0 8 FORMAT "%1.0" BIT_MASK 0xF000 SYMBOL_LINK "ERRM_CFG_ARRY" 648 SYMBOL_LINK "ERRM_CFG_ARRY" 696 /end CHARACTERISTIC
/begin CHARACTERISTIC ERRM_GEAR_R_MIL_ON "gear reverse MIL on enable" VALUE 0x2886C __UWORD_S 0 b_true 0 1 FORMAT "%1.0" BIT_MASK 0x0800 SYMBOL_LINK "ERRM_CFG_ARRY" 648 SYMBOL_LINK "ERRM_CFG_ARRY" 696 /end CHARACTERISTIC
/begin CHARACTERISTIC ERRM_GEAR_R_DEN_GRP "gear reverse denom group" VALUE 0x2886C __UWORD_S 0 u_den_grp 0 63 FORMAT "%1.0" BIT_MASK 0x003F SYMBOL_LINK "ERRM_CFG_ARRY" 648 SYMBOL_LINK "ERRM_CFG_ARRY" 696 /end CHARACTERISTIC
/begin CHARACTERISTIC ERRM_GEAR_R_DTC "gear reverse DTC" VALUE 0x2886C __UWORD_S 0 u_cnts 0 65535 FORMAT "%5.0" SYMBOL_LINK "ERRM_CFG_ARRY" 650 SYMBOL_LINK "ERRM_CFG_ARRY" 698 /end CHARACTERISTIC
/begin CHARACTERISTIC ERRM_GEAR_1_TYP "gear 1 type" VALUE 0x2886C __UWORD_S 0 u_diag_typ 0 8 FORMAT "%1.0" BIT_MASK 0xF000 SYMBOL_LINK "ERRM_CFG_ARRY" 654 SYMBOL_LINK "ERRM_CFG_ARRY" 702 /end CHARACTERISTIC
/begin CHARACTERISTIC ERRM_GEAR_1_MIL_ON "gear 1 MIL on enable" VALUE 0x2886C __UWORD_S 0 b_true 0 1 FORMAT "%1.0" BIT_MASK 0x0800 SYMBOL_LINK "ERRM_CFG_ARRY" 654 SYMBOL_LINK "ERRM_CFG_ARRY" 702 /end CHARACTERISTIC
/begin CHARACTERISTIC ERRM_GEAR_1_DEN_GRP "gear 1 denom group" VALUE 0x2886C __UWORD_S 0 u_den_grp 0 63 FORMAT "%1.0" BIT_MASK 0x003F SYMBOL_LINK "ERRM_CFG_ARRY" 654 SYMBOL_LINK "ERRM_CFG_ARRY" 702 /end CHARACTERISTIC
/begin CHARACTERISTIC ERRM_GEAR_1_DTC "gear 1 DTC" VALUE 0x2886C __UWORD_S 0 u_cnts 0 65535 FORMAT "%5.0" SYMBOL_LINK "ERRM_CFG_ARRY" 656 SYMBOL_LINK "ERRM_CFG_ARRY" 704 /end CHARACTERISTIC
/begin CHARACTERISTIC ERRM_GEAR_2_TYP "gear 2 type" VALUE 0x2886C __UWORD_S 0 u_diag_typ 0 8 FORMAT "%1.0" BIT_MASK 0xF000 SYMBOL_LINK "ERRM_CFG_ARRY" 660 SYMBOL_LINK "ERRM_CFG_ARRY" 708 /end CHARACTERISTIC
/begin CHARACTERISTIC ERRM_GEAR_2_MIL_ON "gear 2 MIL on enable" VALUE 0x2886C __UWORD_S 0 b_true 0 1 FORMAT "%1.0" BIT_MASK 0x0800 SYMBOL_LINK "ERRM_CFG_ARRY" 660 SYMBOL_LINK "ERRM_CFG_ARRY" 708 /end CHARACTERISTIC
/begin CHARACTERISTIC ERRM_GEAR_2_DEN_GRP "gear 2 denom group" VALUE 0x2886C __UWORD_S 0 u_den_grp 0 63 FORMAT "%1.0" BIT_MASK 0x003F SYMBOL_LINK "ERRM_CFG_ARRY" 660 SYMBOL_LINK "ERRM_CFG_ARRY" 708 /end CHARACTERISTIC
/begin CHARACTERISTIC ERRM_GEAR_2_DTC "gear 2 DTC" VALUE 0x2886C __UWORD_S 0 u_cnts 0 65535 FORMAT "%5.0" SYMBOL_LINK "ERRM_CFG_ARRY" 662 SYMBOL_LINK "ERRM_CFG_ARRY" 710 /end CHARACTERISTIC
/begin CHARACTERISTIC ERRM_GEAR_3_TYP "gear 3 type" VALUE 0x2886C __UWORD_S 0 u_diag_typ 0 8 FORMAT "%1.0" BIT_MASK 0xF000 SYMBOL_LINK "ERRM_CFG_ARRY" 666 SYMBOL_LINK "ERRM_CFG_ARRY" 714 /end CHARACTERISTIC
/begin CHARACTERISTIC ERRM_GEAR_3_MIL_ON "gear 3 MIL on enable" VALUE 0x2886C __UWORD_S 0 b_true 0 1 FORMAT "%1.0" BIT_MASK 0x0800 SYMBOL_LINK "ERRM_CFG_ARRY" 666 SYMBOL_LINK "ERRM_CFG_ARRY" 714 /end CHARACTERISTIC
/begin CHARACTERISTIC ERRM_GEAR_3_DEN_GRP "gear 3 denom group" VALUE 0x2886C __UWORD_S 0 u_den_grp 0 63 FORMAT "%1.0" BIT_MASK 0x003F SYMBOL_LINK "ERRM_CFG_ARRY" 666 SYMBOL_LINK "ERRM_CFG_ARRY" 714 /end CHARACTERISTIC
/begin CHARACTERISTIC ERRM_GEAR_3_DTC "gear 3 DTC" VALUE 0x2886C __UWORD_S 0 u_cnts 0 65535 FORMAT "%5.0" SYMBOL_LINK "ERRM_CFG_ARRY" 668 SYMBOL_LINK "ERRM_CFG_ARRY" 716 /end CHARACTERISTIC
/begin CHARACTERISTIC ERRM_GEAR_4_TYP "gear 4 type" VALUE 0x2886C __UWORD_S 0 u_diag_typ 0 8 FORMAT "%1.0" BIT_MASK 0xF000 SYMBOL_LINK "ERRM_CFG_ARRY" 672 SYMBOL_LINK "ERRM_CFG_ARRY" 720 /end CHARACTERISTIC
/begin CHARACTERISTIC ERRM_GEAR_4_MIL_ON "gear 4 MIL on enable" VALUE 0x2886C __UWORD_S 0 b_true 0 1 FORMAT "%1.0" BIT_MASK 0x0800 SYMBOL_LINK "ERRM_CFG_ARRY" 672 SYMBOL_LINK "ERRM_CFG_ARRY" 720 /end CHARACTERISTIC
/begin CHARACTERISTIC ERRM_GEAR_4_DEN_GRP "gear 4 denom group" VALUE 0x2886C __UWORD_S 0 u_den_grp 0 63 FORMAT "%1.0" BIT_MASK 0x003F SYMBOL_LINK "ERRM_CFG_ARRY" 672 SYMBOL_LINK "ERRM_CFG_ARRY" 720 /end CHARACTERISTIC
/begin CHARACTERISTIC ERRM_GEAR_4_DTC "gear 4 DTC" VALUE 0x2886C __UWORD_S 0 u_cnts 0 65535 FORMAT "%5.0" SYMBOL_LINK "ERRM_CFG_ARRY" 674 SYMBOL_LINK "ERRM_CFG_ARRY" 722 /end CHARACTERISTIC
/begin CHARACTERISTIC ERRM_GEAR_5_TYP "gear 5 type" VALUE 0x2886C __UWORD_S 0 u_diag_typ 0 8 FORMAT "%1.0" BIT_MASK 0xF000 SYMBOL_LINK "ERRM_CFG_ARRY" 678 SYMBOL_LINK "ERRM_CFG_ARRY" 726 /end CHARACTERISTIC
/begin CHARACTERISTIC ERRM_GEAR_5_MIL_ON "gear 5 MIL on enable" VALUE 0x2886C __UWORD_S 0 b_true 0 1 FORMAT "%1.0" BIT_MASK 0x0800 SYMBOL_LINK "ERRM_CFG_ARRY" 678 SYMBOL_LINK "ERRM_CFG_ARRY" 726 /end CHARACTERISTIC
/begin CHARACTERISTIC ERRM_GEAR_5_DEN_GRP "gear 5 denom group" VALUE 0x2886C __UWORD_S 0 u_den_grp 0 63 FORMAT "%1.0" BIT_MASK 0x003F SYMBOL_LINK "ERRM_CFG_ARRY" 678 SYMBOL_LINK "ERRM_CFG_ARRY" 726 /end CHARACTERISTIC
/begin CHARACTERISTIC ERRM_GEAR_5_DTC "gear 5 DTC" VALUE 0x2886C __UWORD_S 0 u_cnts 0 65535 FORMAT "%5.0" SYMBOL_LINK "ERRM_CFG_ARRY" 680 SYMBOL_LINK "ERRM_CFG_ARRY" 728 /end CHARACTERISTIC
/begin CHARACTERISTIC ERRM_IAT_LO_TYP "IAT short low type" VALUE 0x2886C __UWORD_S 0 u_diag_typ 0 8 FORMAT "%1.0" BIT_MASK 0xF000 SYMBOL_LINK "ERRM_CFG_ARRY" 684 SYMBOL_LINK "ERRM_CFG_ARRY" 732 /end CHARACTERISTIC
/begin CHARACTERISTIC ERRM_IAT_LO_MIL_ON "IAT short low MIL on enable" VALUE 0x2886C __UWORD_S 0 b_true 0 1 FORMAT "%1.0" BIT_MASK 0x0800 SYMBOL_LINK "ERRM_CFG_ARRY" 684 SYMBOL_LINK "ERRM_CFG_ARRY" 732 /end CHARACTERISTIC
/begin CHARACTERISTIC ERRM_IAT_LO_DEN_GRP "IAT short low denom group" VALUE 0x2886C __UWORD_S 0 u_den_grp 0 63 FORMAT "%1.0" BIT_MASK 0x003F SYMBOL_LINK "ERRM_CFG_ARRY" 684 SYMBOL_LINK "ERRM_CFG_ARRY" 732 /end CHARACTERISTIC
/begin CHARACTERISTIC ERRM_IAT_LO_DTC "IAT short low DTC" VALUE 0x2886C __UWORD_S 0 u_cnts 0 65535 FORMAT "%5.0" SYMBOL_LINK "ERRM_CFG_ARRY" 686 SYMBOL_LINK "ERRM_CFG_ARRY" 734 /end CHARACTERISTIC
/begin CHARACTERISTIC ERRM_IAT_HI_TYP "IAT short high type" VALUE 0x2886C __UWORD_S 0 u_diag_typ 0 8 FORMAT "%1.0" BIT_MASK 0xF000 SYMBOL_LINK "ERRM_CFG_ARRY" 702 SYMBOL_LINK "ERRM_CFG_ARRY" 738 /end CHARACTERISTIC
/begin CHARACTERISTIC ERRM_IAT_HI_MIL_ON "IAT short high MIL on enable" VALUE 0x2886C __UWORD_S 0 b_true 0 1 FORMAT "%1.0" BIT_MASK 0x0800 SYMBOL_LINK "ERRM_CFG_ARRY" 702 SYMBOL_LINK "ERRM_CFG_ARRY" 738 /end CHARACTERISTIC
/begin CHARACTERISTIC ERRM_IAT_HI_DEN_GRP "IAT short high denom group" VALUE 0x2886C __UWORD_S 0 u_den_grp 0 63 FORMAT "%1.0" BIT_MASK 0x003F SYMBOL_LINK "ERRM_CFG_ARRY" 702 SYMBOL_LINK "ERRM_CFG_ARRY" 738 /end CHARACTERISTIC
/begin CHARACTERISTIC ERRM_IAT_HI_DTC "IAT short high DTC" VALUE 0x2886C __UWORD_S 0 u_cnts 0 65535 FORMAT "%5.0" SYMBOL_LINK "ERRM_CFG_ARRY" 704 SYMBOL_LINK "ERRM_CFG_ARRY" 740 /end CHARACTERISTIC
/begin CHARACTERISTIC ERRM_IAT_HI_RAT_TYP "IAT short high rationality type" VALUE 0x2886C __UWORD_S 0 u_diag_typ 0 8 FORMAT "%1.0" BIT_MASK 0xF000 SYMBOL_LINK "ERRM_CFG_ARRY" 756 SYMBOL_LINK "ERRM_CFG_ARRY" 756 /end CHARACTERISTIC
/begin CHARACTERISTIC ERRM_IAT_HI_RAT_MIL_ON "IAT short high rationality MIL on enable" VALUE 0x2886C __UWORD_S 0 b_true 0 1 FORMAT "%1.0" BIT_MASK 0x0800 SYMBOL_LINK "ERRM_CFG_ARRY" 756 SYMBOL_LINK "ERRM_CFG_ARRY" 756 /end CHARACTERISTIC
/begin CHARACTERISTIC ERRM_IAT_HI_RAT_DEN_GRP "IAT short high rationality denom group" VALUE 0x2886C __UWORD_S 0 u_den_grp 0 63 FORMAT "%1.0" BIT_MASK 0x003F SYMBOL_LINK "ERRM_CFG_ARRY" 756 SYMBOL_LINK "ERRM_CFG_ARRY" 756 /end CHARACTERISTIC
/begin CHARACTERISTIC ERRM_IAT_HI_RAT_DTC "IAT short high rationality DTC" VALUE 0x2886C __UWORD_S 0 u_cnts 0 65535 FORMAT "%5.0" SYMBOL_LINK "ERRM_CFG_ARRY" 758 SYMBOL_LINK "ERRM_CFG_ARRY" 758 /end CHARACTERISTIC
/begin CHARACTERISTIC ERRM_IAT_LO_RAT_TYP "IAT short low rationality type" VALUE 0x2886C __UWORD_S 0 u_diag_typ 0 8 FORMAT "%1.0" BIT_MASK 0xF000 SYMBOL_LINK "ERRM_CFG_ARRY" 774 SYMBOL_LINK "ERRM_CFG_ARRY" 762 /end CHARACTERISTIC
/begin CHARACTERISTIC ERRM_IAT_LO_RAT_MIL_ON "IAT short low rationality MIL on enable" VALUE 0x2886C __UWORD_S 0 b_true 0 1 FORMAT "%1.0" BIT_MASK 0x0800 SYMBOL_LINK "ERRM_CFG_ARRY" 774 SYMBOL_LINK "ERRM_CFG_ARRY" 762 /end CHARACTERISTIC
/begin CHARACTERISTIC ERRM_IAT_LO_RAT_DEN_GRP "IAT short low rationality denom group" VALUE 0x2886C __UWORD_S 0 u_den_grp 0 63 FORMAT "%1.0" BIT_MASK 0x003F SYMBOL_LINK "ERRM_CFG_ARRY" 774 SYMBOL_LINK "ERRM_CFG_ARRY" 762 /end CHARACTERISTIC
/begin CHARACTERISTIC ERRM_IAT_LO_RAT_DTC "IAT short low rationality DTC" VALUE 0x2886C __UWORD_S 0 u_cnts 0 65535 FORMAT "%5.0" SYMBOL_LINK "ERRM_CFG_ARRY" 776 SYMBOL_LINK "ERRM_CFG_ARRY" 764 /end CHARACTERISTIC
/begin CHARACTERISTIC ERRM_IDL_HI_TYP "idle speed high type" VALUE 0x2886C __UWORD_S 0 u_diag_typ 0 8 FORMAT "%1.0" BIT_MASK 0xF000 SYMBOL_LINK "ERRM_CFG_ARRY" 828 SYMBOL_LINK "ERRM_CFG_ARRY" 780 /end CHARACTERISTIC
/begin CHARACTERISTIC ERRM_IDL_HI_MIL_ON "idle speed high MIL on enable" VALUE 0x2886C __UWORD_S 0 b_true 0 1 FORMAT "%1.0" BIT_MASK 0x0800 SYMBOL_LINK "ERRM_CFG_ARRY" 828 SYMBOL_LINK "ERRM_CFG_ARRY" 780 /end CHARACTERISTIC
/begin CHARACTERISTIC ERRM_IDL_HI_DEN_GRP "idle speed high denom group" VALUE 0x2886C __UWORD_S 0 u_den_grp 0 63 FORMAT "%1.0" BIT_MASK 0x003F SYMBOL_LINK "ERRM_CFG_ARRY" 828 SYMBOL_LINK "ERRM_CFG_ARRY" 780 /end CHARACTERISTIC
/begin CHARACTERISTIC ERRM_IDL_HI_DTC "idle speed high DTC" VALUE 0x2886C __UWORD_S 0 u_cnts 0 65535 FORMAT "%5.0" SYMBOL_LINK "ERRM_CFG_ARRY" 830 SYMBOL_LINK "ERRM_CFG_ARRY" 782 /end CHARACTERISTIC
/begin CHARACTERISTIC ERRM_IDL_LO_TYP "idle speed low type" VALUE 0x2886C __UWORD_S 0 u_diag_typ 0 8 FORMAT "%1.0" BIT_MASK 0xF000 SYMBOL_LINK "ERRM_CFG_ARRY" 834 SYMBOL_LINK "ERRM_CFG_ARRY" 786 /end CHARACTERISTIC
/begin CHARACTERISTIC ERRM_IDL_LO_MIL_ON "idle speed low MIL on enable" VALUE 0x2886C __UWORD_S 0 b_true 0 1 FORMAT "%1.0" BIT_MASK 0x0800 SYMBOL_LINK "ERRM_CFG_ARRY" 834 SYMBOL_LINK "ERRM_CFG_ARRY" 786 /end CHARACTERISTIC
/begin CHARACTERISTIC ERRM_IDL_LO_DEN_GRP "idle speed low denom group" VALUE 0x2886C __UWORD_S 0 u_den_grp 0 63 FORMAT "%1.0" BIT_MASK 0x003F SYMBOL_LINK "ERRM_CFG_ARRY" 834 SYMBOL_LINK "ERRM_CFG_ARRY" 786 /end CHARACTERISTIC
/begin CHARACTERISTIC ERRM_IDL_LO_DTC "idle speed low DTC" VALUE 0x2886C __UWORD_S 0 u_cnts 0 65535 FORMAT "%5.0" SYMBOL_LINK "ERRM_CFG_ARRY" 836 SYMBOL_LINK "ERRM_CFG_ARRY" 788 /end CHARACTERISTIC
/begin CHARACTERISTIC ERRM_IDL_CAT_LO_TYP "cataylst heat idle speed low type" VALUE 0x2886C __UWORD_S 0 u_diag_typ 0 8 FORMAT "%1.0" BIT_MASK 0xF000 SYMBOL_LINK "ERRM_CFG_ARRY" 840 SYMBOL_LINK "ERRM_CFG_ARRY" 792 /end CHARACTERISTIC
/begin CHARACTERISTIC ERRM_IDL_CAT_LO_MIL_ON "cataylst heat idle speed low MIL on enable" VALUE 0x2886C __UWORD_S 0 b_true 0 1 FORMAT "%1.0" BIT_MASK 0x0800 SYMBOL_LINK "ERRM_CFG_ARRY" 840 SYMBOL_LINK "ERRM_CFG_ARRY" 792 /end CHARACTERISTIC
/begin CHARACTERISTIC ERRM_IDL_CAT_LO_DEN_GRP "cataylst heat idle speed low denom group" VALUE 0x2886C __UWORD_S 0 u_den_grp 0 63 FORMAT "%1.0" BIT_MASK 0x003F SYMBOL_LINK "ERRM_CFG_ARRY" 840 SYMBOL_LINK "ERRM_CFG_ARRY" 792 /end CHARACTERISTIC
/begin CHARACTERISTIC ERRM_IDL_CAT_LO_DTC "cataylst heat idle speed low DTC" VALUE 0x2886C __UWORD_S 0 u_cnts 0 65535 FORMAT "%5.0" SYMBOL_LINK "ERRM_CFG_ARRY" 842 SYMBOL_LINK "ERRM_CFG_ARRY" 794 /end CHARACTERISTIC
/begin CHARACTERISTIC ERRM_KNCK_SYS_TYP "knock system type" VALUE 0x2886C __UWORD_S 0 u_diag_typ 0 8 FORMAT "%1.0" BIT_MASK 0xF000 SYMBOL_LINK "ERRM_CFG_ARRY" 846 SYMBOL_LINK "ERRM_CFG_ARRY" 798 /end CHARACTERISTIC
/begin CHARACTERISTIC ERRM_KNCK_SYS_MIL_ON "knock system MIL on enable" VALUE 0x2886C __UWORD_S 0 b_true 0 1 FORMAT "%1.0" BIT_MASK 0x0800 SYMBOL_LINK "ERRM_CFG_ARRY" 846 SYMBOL_LINK "ERRM_CFG_ARRY" 798 /end CHARACTERISTIC
/begin CHARACTERISTIC ERRM_KNCK_SYS_DEN_GRP "knock system denom group" VALUE 0x2886C __UWORD_S 0 u_den_grp 0 63 FORMAT "%1.0" BIT_MASK 0x003F SYMBOL_LINK "ERRM_CFG_ARRY" 846 SYMBOL_LINK "ERRM_CFG_ARRY" 798 /end CHARACTERISTIC
/begin CHARACTERISTIC ERRM_KNCK_SYS_LO_DTC "knock system DTC" VALUE 0x2886C __UWORD_S 0 u_cnts 0 65535 FORMAT "%5.0" SYMBOL_LINK "ERRM_CFG_ARRY" 848 SYMBOL_LINK "ERRM_CFG_ARRY" 800 /end CHARACTERISTIC
/begin CHARACTERISTIC ERRM_KNCK_SNSR_TYP "knock sensor type" VALUE 0x2886C __UWORD_S 0 u_diag_typ 0 8 FORMAT "%1.0" BIT_MASK 0xF000 SYMBOL_LINK "ERRM_CFG_ARRY" 852 SYMBOL_LINK "ERRM_CFG_ARRY" 804 /end CHARACTERISTIC
/begin CHARACTERISTIC ERRM_KNCK_SNSR_MIL_ON "knock sensor MIL on enable" VALUE 0x2886C __UWORD_S 0 b_true 0 1 FORMAT "%1.0" BIT_MASK 0x0800 SYMBOL_LINK "ERRM_CFG_ARRY" 852 SYMBOL_LINK "ERRM_CFG_ARRY" 804 /end CHARACTERISTIC
/begin CHARACTERISTIC ERRM_KNCK_SNSR_DEN_GRP "knock sensor denom group" VALUE 0x2886C __UWORD_S 0 u_den_grp 0 63 FORMAT "%1.0" BIT_MASK 0x003F SYMBOL_LINK "ERRM_CFG_ARRY" 852 SYMBOL_LINK "ERRM_CFG_ARRY" 804 /end CHARACTERISTIC
/begin CHARACTERISTIC ERRM_KNCK_SNSR_LO_DTC "knock sensor DTC" VALUE 0x2886C __UWORD_S 0 u_cnts 0 65535 FORMAT "%5.0" SYMBOL_LINK "ERRM_CFG_ARRY" 854 SYMBOL_LINK "ERRM_CFG_ARRY" 806 /end CHARACTERISTIC
/begin CHARACTERISTIC ERRM_ECM_CLK_TYP "ECM clock type" VALUE 0x2886C __UWORD_S 0 u_diag_typ 0 8 FORMAT "%1.0" BIT_MASK 0xF000 SYMBOL_LINK "ERRM_CFG_ARRY" 876 SYMBOL_LINK "ERRM_CFG_ARRY" 828 /end CHARACTERISTIC
/begin CHARACTERISTIC ERRM_ECM_CLK_MIL_ON "ECM clock MIL on enable" VALUE 0x2886C __UWORD_S 0 b_true 0 1 FORMAT "%1.0" BIT_MASK 0x0800 SYMBOL_LINK "ERRM_CFG_ARRY" 876 SYMBOL_LINK "ERRM_CFG_ARRY" 828 /end CHARACTERISTIC
/begin CHARACTERISTIC ERRM_ECM_CLK_DEN_GRP "ECM clock denom group" VALUE 0x2886C __UWORD_S 0 u_den_grp 0 63 FORMAT "%1.0" BIT_MASK 0x003F SYMBOL_LINK "ERRM_CFG_ARRY" 876 SYMBOL_LINK "ERRM_CFG_ARRY" 828 /end CHARACTERISTIC
/begin CHARACTERISTIC ERRM_ECM_CLK_DTC "ECM clock DTC" VALUE 0x2886C __UWORD_S 0 u_cnts 0 65535 FORMAT "%5.0" SYMBOL_LINK "ERRM_CFG_ARRY" 878 SYMBOL_LINK "ERRM_CFG_ARRY" 830 /end CHARACTERISTIC
/begin CHARACTERISTIC ERRM_MAP_RAT_DCL_TYP "MAP/TPS decelerate rationality type" VALUE 0x2886C __UWORD_S 0 u_diag_typ 0 8 FORMAT "%1.0" BIT_MASK 0xF000 SYMBOL_LINK "ERRM_CFG_ARRY" 888 SYMBOL_LINK "ERRM_CFG_ARRY" 840 /end CHARACTERISTIC
/begin CHARACTERISTIC ERRM_MAP_RAT_DCL_MIL_ON "MAP/TPS decelerate rationality MIL on enable" VALUE 0x2886C __UWORD_S 0 b_true 0 1 FORMAT "%1.0" BIT_MASK 0x0800 SYMBOL_LINK "ERRM_CFG_ARRY" 888 SYMBOL_LINK "ERRM_CFG_ARRY" 840 /end CHARACTERISTIC
/begin CHARACTERISTIC ERRM_MAP_RAT_DCL_DEN_GRP "MAP/TPS decelerate rationality denom group" VALUE 0x2886C __UWORD_S 0 u_den_grp 0 63 FORMAT "%1.0" BIT_MASK 0x003F SYMBOL_LINK "ERRM_CFG_ARRY" 888 SYMBOL_LINK "ERRM_CFG_ARRY" 840 /end CHARACTERISTIC
/begin CHARACTERISTIC ERRM_MAP_RAT_DCL_DTC "MAP/TPS decelerate rationality DTC" VALUE 0x2886C __UWORD_S 0 u_cnts 0 65535 FORMAT "%5.0" SYMBOL_LINK "ERRM_CFG_ARRY" 890 SYMBOL_LINK "ERRM_CFG_ARRY" 842 /end CHARACTERISTIC
/begin CHARACTERISTIC ERRM_MAP_RAT_LO_TYP "MAP/TPS low load rationality type" VALUE 0x2886C __UWORD_S 0 u_diag_typ 0 8 FORMAT "%1.0" BIT_MASK 0xF000 SYMBOL_LINK "ERRM_CFG_ARRY" 894 SYMBOL_LINK "ERRM_CFG_ARRY" 846 /end CHARACTERISTIC
/begin CHARACTERISTIC ERRM_MAP_RAT_LO_MIL_ON "MAP/TPS low load rationality MIL on enable" VALUE 0x2886C __UWORD_S 0 b_true 0 1 FORMAT "%1.0" BIT_MASK 0x0800 SYMBOL_LINK "ERRM_CFG_ARRY" 894 SYMBOL_LINK "ERRM_CFG_ARRY" 846 /end CHARACTERISTIC
/begin CHARACTERISTIC ERRM_MAP_RAT_LO_DEN_GRP "MAP/TPS low load rationality denom group" VALUE 0x2886C __UWORD_S 0 u_den_grp 0 63 FORMAT "%1.0" BIT_MASK 0x003F SYMBOL_LINK "ERRM_CFG_ARRY" 894 SYMBOL_LINK "ERRM_CFG_ARRY" 846 /end CHARACTERISTIC
/begin CHARACTERISTIC ERRM_MAP_RAT_LO_DTC "MAP/TPS low load rationality DTC" VALUE 0x2886C __UWORD_S 0 u_cnts 0 65535 FORMAT "%5.0" SYMBOL_LINK "ERRM_CFG_ARRY" 896 SYMBOL_LINK "ERRM_CFG_ARRY" 848 /end CHARACTERISTIC
/begin CHARACTERISTIC ERRM_MAP_RAT_HI_TYP "MAP/TPS high load rationality type" VALUE 0x2886C __UWORD_S 0 u_diag_typ 0 8 FORMAT "%1.0" BIT_MASK 0xF000 SYMBOL_LINK "ERRM_CFG_ARRY" 900 SYMBOL_LINK "ERRM_CFG_ARRY" 852 /end CHARACTERISTIC
/begin CHARACTERISTIC ERRM_MAP_RAT_HI_MIL_ON "MAP/TPS high load rationality MIL on enable" VALUE 0x2886C __UWORD_S 0 b_true 0 1 FORMAT "%1.0" BIT_MASK 0x0800 SYMBOL_LINK "ERRM_CFG_ARRY" 900 SYMBOL_LINK "ERRM_CFG_ARRY" 852 /end CHARACTERISTIC
/begin CHARACTERISTIC ERRM_MAP_RAT_HI_DEN_GRP "MAP/TPS high load rationality denom group" VALUE 0x2886C __UWORD_S 0 u_den_grp 0 63 FORMAT "%1.0" BIT_MASK 0x003F SYMBOL_LINK "ERRM_CFG_ARRY" 900 SYMBOL_LINK "ERRM_CFG_ARRY" 852 /end CHARACTERISTIC
/begin CHARACTERISTIC ERRM_MAP_RAT_HI_DTC "MAP/TPS high load rationality DTC" VALUE 0x2886C __UWORD_S 0 u_cnts 0 65535 FORMAT "%5.0" SYMBOL_LINK "ERRM_CFG_ARRY" 902 SYMBOL_LINK "ERRM_CFG_ARRY" 854 /end CHARACTERISTIC
/begin CHARACTERISTIC ERRM_ALT_FB_TYP "alternator PWM feedback type" VALUE 0x2886C __UWORD_S 0 u_diag_typ 0 8 FORMAT "%1.0" BIT_MASK 0xF000 SYMBOL_LINK "ERRM_CFG_ARRY" 906 SYMBOL_LINK "ERRM_CFG_ARRY" 858 /end CHARACTERISTIC
/begin CHARACTERISTIC ERRM_ALT_FB_MIL_ON "alternator PWM feedback MIL on enable" VALUE 0x2886C __UWORD_S 0 b_true 0 1 FORMAT "%1.0" BIT_MASK 0x0800 SYMBOL_LINK "ERRM_CFG_ARRY" 906 SYMBOL_LINK "ERRM_CFG_ARRY" 858 /end CHARACTERISTIC
/begin CHARACTERISTIC ERRM_ALT_FB_DEN_GRP "alternator PWM feedback denom group" VALUE 0x2886C __UWORD_S 0 u_den_grp 0 63 FORMAT "%1.0" BIT_MASK 0x003F SYMBOL_LINK "ERRM_CFG_ARRY" 906 SYMBOL_LINK "ERRM_CFG_ARRY" 858 /end CHARACTERISTIC
/begin CHARACTERISTIC ERRM_ALT_FB_DTC "alternator PWM feedback DTC" VALUE 0x2886C __UWORD_S 0 u_cnts 0 65535 FORMAT "%5.0" SYMBOL_LINK "ERRM_CFG_ARRY" 908 SYMBOL_LINK "ERRM_CFG_ARRY" 860 /end CHARACTERISTIC
/begin CHARACTERISTIC ERRM_MIL_TYP "MIL circuit type" VALUE 0x2886C __UWORD_S 0 u_diag_typ 0 8 FORMAT "%1.0" BIT_MASK 0xF000 SYMBOL_LINK "ERRM_CFG_ARRY" 912 SYMBOL_LINK "ERRM_CFG_ARRY" 864 /end CHARACTERISTIC
/begin CHARACTERISTIC ERRM_MIL_MIL_ON "MIL circuit MIL on enable" VALUE 0x2886C __UWORD_S 0 b_true 0 1 FORMAT "%1.0" BIT_MASK 0x0800 SYMBOL_LINK "ERRM_CFG_ARRY" 912 SYMBOL_LINK "ERRM_CFG_ARRY" 864 /end CHARACTERISTIC
/begin CHARACTERISTIC ERRM_MIL_DEN_GRP "MIL circuit denom group" VALUE 0x2886C __UWORD_S 0 u_den_grp 0 63 FORMAT "%1.0" BIT_MASK 0x003F SYMBOL_LINK "ERRM_CFG_ARRY" 912 SYMBOL_LINK "ERRM_CFG_ARRY" 864 /end CHARACTERISTIC
/begin CHARACTERISTIC ERRM_MIL_DTC "MIL circuit DTC" VALUE 0x2886C __UWORD_S 0 u_cnts 0 65535 FORMAT "%5.0" SYMBOL_LINK "ERRM_CFG_ARRY" 914 SYMBOL_LINK "ERRM_CFG_ARRY" 866 /end CHARACTERISTIC
/begin CHARACTERISTIC ERRM_ABS_PWM_TYP "ABS pwm type" VALUE 0x2886C __UWORD_S 0 u_diag_typ 0 8 FORMAT "%1.0" BIT_MASK 0xF000 SYMBOL_LINK "ERRM_CFG_ARRY" 930 SYMBOL_LINK "ERRM_CFG_ARRY" 882 /end CHARACTERISTIC
/begin CHARACTERISTIC ERRM_ABS_PWM_MIL_ON "ABS pwm MIL on enable" VALUE 0x2886C __UWORD_S 0 b_true 0 1 FORMAT "%1.0" BIT_MASK 0x0800 SYMBOL_LINK "ERRM_CFG_ARRY" 930 SYMBOL_LINK "ERRM_CFG_ARRY" 882 /end CHARACTERISTIC
/begin CHARACTERISTIC ERRM_ABS_PWM_DEN_GRP "ABS pwm denom group" VALUE 0x2886C __UWORD_S 0 u_den_grp 0 63 FORMAT "%1.0" BIT_MASK 0x003F SYMBOL_LINK "ERRM_CFG_ARRY" 930 SYMBOL_LINK "ERRM_CFG_ARRY" 882 /end CHARACTERISTIC
/begin CHARACTERISTIC ERRM_ABS_PWM_DTC "ABS pwm DTC" VALUE 0x2886C __UWORD_S 0 u_cnts 0 65535 FORMAT "%5.0" SYMBOL_LINK "ERRM_CFG_ARRY" 932 SYMBOL_LINK "ERRM_CFG_ARRY" 884 /end CHARACTERISTIC
/begin COMPU_METHOD u_volt_32 "voltage" RAT_FUNC "%6.4" "V" COEFFS 0.0 1.0 0.000000 0.0 0.0 0.00048828125 /end COMPU_METHOD
/begin COMPU_METHOD u_kPa_0_256 "press" RAT_FUNC "%5.2" "kPa" COEFFS 0.0 1.0 0.000000 0.0 0.0 0.00390625 /end COMPU_METHOD
/begin COMPU_METHOD u_fac_16 "factor" RAT_FUNC "%5.3" "fac" COEFFS 0.0 1.0 0.000000 0.0 0.0 0.000244140625 /end COMPU_METHOD
/begin COMPU_METHOD u_deg_C "degC" RAT_FUNC "%5.2" "¡æ" COEFFS 0.0 1.0 0.0 0.0 0.0 0.0078125 /end COMPU_METHOD
/begin COMPU_METHOD u_filter "filter" RAT_FUNC "%11.10" "coef" COEFFS 0.0 1.0 0.0 0.0 0.0 0.0000152587890625 /end COMPU_METHOD
/begin COMPU_METHOD u_cnts "counts" RAT_FUNC "%3.0" "cnts" COEFFS 0.0 1.0 0.0 0.0 0.0 1.0 /end COMPU_METHOD
/begin COMPU_METHOD u_min "min timer" RAT_FUNC "%5.0" "min" COEFFS 0.0 1.0 0.0 0.0 0.0 1.00 /end COMPU_METHOD
/begin COMPU_METHOD u_1x_tmr "7.81 timer" RAT_FUNC "%4.3" "s" COEFFS 0.0 1.0 0.0 0.0 0.0 0.0078125 /end COMPU_METHOD
/begin COMPU_METHOD u_2x_tmr "15.6 timer" RAT_FUNC "%6.2" "s" COEFFS 0.0 1.0 0.0 0.0 0.0 0.015625 /end COMPU_METHOD
/begin COMPU_METHOD u_16x_tmr "125 timer" RAT_FUNC "%5.1" "s" COEFFS 0.0 1.0 0.0 0.0 0.0 0.125 /end COMPU_METHOD
/begin COMPU_METHOD u_1s_tmr "1 sec timer" RAT_FUNC "%5.0" "s" COEFFS 0.0 1.0 0.0 0.0 0.0 1.0 /end COMPU_METHOD
/begin COMPU_METHOD u_500m_tmr "500ms timer" RAT_FUNC "%5.0" "s" COEFFS 0.0 1.0 0.0 0.0 0.0 0.5 /end COMPU_METHOD
/begin COMPU_METHOD b_true "" TAB_VERB "%6.3" "" COMPU_TAB_REF b_true /end COMPU_METHOD
/begin COMPU_VTAB b_true "" TAB_VERB 2 0 "FALSE" 1 "TRUE" /end COMPU_VTAB
/begin COMPU_METHOD u_espd "engine speed" RAT_FUNC "%5.2" "rpm" COEFFS 0.0 1.0 0.000000 0.0 0.0 0.125 /end COMPU_METHOD
/begin COMPU_METHOD u_vspd "vehicle speed" RAT_FUNC "%5.2" "kph" COEFFS 0.0 1.0 0.000000 0.0 0.0 0.0078125 /end COMPU_METHOD
/begin COMPU_METHOD u_pct "percentage" RAT_FUNC "%5.2" "%" COEFFS 0.0 1.0 0.000000 0.0 0.0 0.0030517578125 /end COMPU_METHOD
/begin COMPU_METHOD u_pct_1 "percentage" RAT_FUNC "%5.2" "%" COEFFS 0.0 1.0 0.000000 0.0 0.0 0.00152587890625 /end COMPU_METHOD
/begin COMPU_METHOD u_pct_r "real pct" RAT_FUNC "%5.2" "%" COEFFS 0.0 1.0 0.000000 0.0 0.0 0.001953125 /end COMPU_METHOD
/begin COMPU_METHOD u_pct_r_s "real pct" RAT_FUNC "%5.2" "%" COEFFS 0.0 1.0 0.000000 0.0 0.0 0.00390625 /end COMPU_METHOD
/begin COMPU_METHOD u_g_per_sec "g per second" RAT_FUNC "%5.2" "g/s" COEFFS 0.0 1.0 0.000000 0.0 0.0 0.0078125 /end COMPU_METHOD
/begin COMPU_METHOD u_g_per_sec_256 "g per second" RAT_FUNC "%5.2" "g/s" COEFFS 0.0 1.0 0.000000 0.0 0.0 0.00390625 /end COMPU_METHOD
/begin COMPU_METHOD u_dtc_typ "" TAB_VERB "%5.0" "" COMPU_TAB_REF u_dtc_typ /end COMPU_METHOD
/begin COMPU_VTAB u_dtc_typ "" TAB_VERB 291 0 "NONE" 5 "AC_P_HI" 6 "AC_P_LO" 7 "AC_RLY_HI" 8 "AC_RLY_LO" 9 "BRK_LAMP_SWTCH" 10 "BRK_SWTCH_CORR" 11 "CAM_OPN" 12 "CAM_RAT" 14 "CAN_BUS_OFF" 15 "CAN_COM" 16 "CAN_TCM" 17 "CAN_TCS" 18 "CAN_ACC" 19 "CAN_4WD" 20 "CAN_ABS" 21 "CAN_BCM" 22 "ENS_PULSE" 23 "CAN_IPC" 24 "CAN_RCU" 25 "CAN_ESP_CHKSUM" 26 "CAN_ESP_LIFE_SGNL" 27 "CAN_TCM_CHKSUM" 28 "CAN_TCM_LIFE_SGNL" 29 "CAN_VOLT_HI" 30 "CAN_VOLT_LO" 31 "CAN_EPS" 32 "CAN_PEPS1" 33 "CAN_PEPS2" 34 "CAN_PEPS3" 36 "CAN_AC" 37 "CAN_HCU" 38 "CAN_BSG" 40 "CAN_GW" 41 "CAN_SAS" 42 "CAN_EPB" 43 "CAN_RCU_CHKSUM" 44 "CAN_ACC_CHKSUM" 45 "CAN_ACC_LIFE_SGNL" 46 "CAN_RCU_LIFE_SGNL" 47 "CAN_APA" 48 "B1_CAT" 49 "ECM_PROC" 50 "ECT_SHORT_HI" 51 "ECT_SHORT_LO" 54 "ECT_FUEL_CL" 55 "ECT_RAT_HI" 56 "ECT_THERMOSTAT" 58 "ECT_STRT_HI" 59 "ECT_RAT_LO" 60 "CRK_PERF" 61 "CRK_OPEN" 63 "PPS_CORR" 64 "PPS1_LO" 65 "PPS2_LO" 66 "PPS1_HI" 67 "PPS2_HI" 68 "ETC_RDNT" 69 "ETC_IDL" 70 "ETC_OFF" 71 "ETC_LMT" 72 "ETC_OUT_CTRL" 73 "TPS1_LO" 74 "TPS2_LO" 75 "TPS1_HI" 76 "TPS2_HI" 79 "TPS_CORR" 80 "TPS_DEFAULT" 81 "VREF1_VLT" 82 "VREF2_VLT" 83 "ETC_MOTOR_PERF" 84 "ETC_MOTOR_SS" 85 "PURG_FLW" 86 "PURG_LARGE_LEAK" 87 "PURG_SAMLL_LEAK" 88 "PURG_VERY_SMALL_LEAK" 89 "VENT_RESTRICTED" 90 "ECM_RAM" 91 "ECM_STACK" 92 "ECM_ROM" 98 "FLV_HI" 99 "FLV_LO" 104 "FUEL_B1_IDL_LEAN" 105 "FUEL_B1_IDL_RICH" 106 "FUEL_B1_LEAN" 107 "FUEL_B1_RICH" 108 "GEAR_R" 109 "GEAR_1" 110 "GEAR_2" 111 "GEAR_3" 112 "GEAR_4" 113 "GEAR_5" 114 "IAT_LO" 115 "BOOST_T_LO" 117 "IAT_HI" 118 "BOOST_T_HI" 126 "IAT_HI_HI_RAT" 127 "BOOST_T_HI_RAT" 129 "IAT_LO_RAT" 130 "BOOST_T_LO_RAT" 138 "IDL_ESPD_HI" 139 "IDL_ESPD_LO" 140 "IDL_CAT_ESPD_LO" 141 "KNCK_SYS" 142 "KNCK_SNSR" 146 "ECM_CLK" 147 "MAP_START_RAT" 148 "MAP_TPS_DCL_COR" 149 "MAP_TPS_LO_COR" 150 "MAP_TPS_HI_COR" 151 "ALT_FB" 152 "MIL_CIRCUIT" 153 "MISFIRE" 155 "RR_ABS_PWM" 158 "G_SENSOR_LO" 159 "G_SENSOR_HI" 169 "BAT_VLT_HI" 170 "BAT_VLT_LO" 171 "TANK_P_HI" 172 "TANK_P_LO" 173 "TANK_P_STUCK" 174 "TANK_P_NOISE" 181 "CRK_LRN" 190 "VSPD_OPN" 191 "B1_EXH_CAM_TOOTH" 192 "B1_EXH_CAM_COR" 193 "B1_EXH_VLV_STUK" 194 "B1_EXH_CAM_SLOW" 195 "B1_EXH_VVT_PERF" 196 "B1_INTK_CAM_TOOTH" 197 "B1_INTK_CAM_COR" 198 "B1_INTK_VLV_STUK" 199 "B1_INTK_CAM_SLOW" 200 "B1_INTK_VVT_PERF" 202 "FAN1_CIRCUIT" 203 "FAN2_CIRCUIT" 204 "PWM_FAN" 205 "ECM_COP" 206 "MPR_CIRCUIT" 207 "PURGE_LO" 208 "PURGE_HI" 209 "UO2_HT_LO" 210 "UO2_HT_HI" 211 "DO2_HT_LO" 212 "DO2_HT_HI" 213 "INJ_CYL1_LO" 214 "INJ_CYL1_HI" 215 "INJ_CYL2_LO" 216 "INJ_CYL2_HI" 217 "INJ_CYL3_LO" 218 "INJ_CYL3_HI" 219 "INJ_CYL4_LO" 220 "INJ_CYL4_HI" 221 "FPR_CIRCUIT" 222 "B1_INTK_VVT_HI" 223 "B1_INTK_VVT_LO" 224 "B1_INTK_VVT_OPN" 225 "B1_EXH_VVT_HI" 226 "B1_EXH_VVT_LO" 227 "B1_EXH_VVT_OPN" 228 "ESTA_LO" 229 "ESTA_HI" 230 "ESTA_OPN" 231 "ESTB_LO" 232 "ESTB_HI" 233 "ESTB_OPN" 234 "ESTC_LO" 235 "ESTC_HI" 236 "ESTC_OPN" 237 "ESTD_LO" 238 "ESTD_HI" 239 "ESTD_OPN" 254 "VENT_VLV_LO" 255 "VENT_VLV_HI" 260 "ECM_AD" 261 "ECM_SW_VER" 262 "PS_P_LO" 263 "PS_P_HI" 265 "CRUZ_AN" 266 "CRUZ_ON" 267 "CRUZ_CANCEL" 268 "CRUZ_RES" 269 "CRUZ_SET" 270 "CRUZ_DIST" 271 "CRUZ_LMT" 272 "CRUZ_ON_STUCK" 273 "CRUZ_CANCEL_STUCK" 274 "CRUZ_RES_STUCK" 275 "CRUZ_SET_STUCK" 276 "CRUZ_DIST_STUCK" 277 "CRUZ_LMT_STUCK" 278 "ECM_AD0" 279 "ECM_AD1" 280 "ECM_GPR" 281 "WSS_OPEN" 290 "MAIN_RLY_OUT" 291 "B1_DO2_PUC_RESP" 292 "MISFIRE_CYL1" 293 "MISFIRE_CYL2" 294 "MISFIRE_CYL3" 295 "MISFIRE_CYL4" 297 "IG_ADV" 298 "ELEC_THEM_HI" 299 "ELEC_THEM_LO" 300 "TURB_OVR_BST" 301 "TURB_UNDER_BST" 302 "WGV_LO" 303 "WGV_HI" 304 "WGV_OPN" 308 "BYPASS_VLV_LO" 309 "BYPASS_VLV_HI" 310 "BYPASS_VLV_OPN" 314 "INTER_FAN_LO" 315 "INTER_FAN_HI" 316 "INTER_FAN_OPN" 320 "INTER_PUMP_LO" 321 "INTER_PUMP_HI" 322 "INTER_PUMP_OPN" 335 "B1_DO2_POW_RESP" 336 "BAT_TEMP_HI" 337 "BAT_NO_CHRG" 338 "BAT_LO_SOC" 339 "SYS_VLT_LO" 340 "SYS_VLT_RAT" 341 "BAT_SOC_RAT" 342 "ALT_TEMP_HI" 343 "ALT_MECH" 344 "ALT_ELEC" 345 "START_RLYA_HI" 346 "START_RLYA_LO" 347 "START_RLYB_HI" 348 "START_RLYB_LO" 351 "BRK_PUMP_PRES_LO" 352 "BRK_PUMP_PRES_HI" 357 "TCM_FAIL" 366 "LIN_ERR" 370 "BAT_SENSOR" 371 "BAT_SENSOR_COMM" 372 "LIN_ALT_COM" 375 "AC_TEMP_LO" 376 "AC_TEMP_HI" 380 "CLTCH_TOP_RLS" 381 "CLTCH_TOP_DPRS" 382 "CLTCH_BOT_RLS" 383 "CLTCH_BOT_DPRS" 386 "GEAR_N_SW_STUCK_N" 387 "GEAR_N_SW_STUCK_NON" 389 "AMP_HI" 390 "BOOST_P_HI" 391 "MAP_HI" 392 "AMP_LO" 393 "BOOST_P_LO" 394 "MAP_LO" 401 "AMP_STRT_COR" 402 "BSTP_STRT_COR" 403 "MAP_STRT_COR" 413 "FUEL_CAP_OPN" 438 "B1_UO2_OPN" 439 "B1_UO2_LO" 440 "B1_UO2_HI" 441 "B1_UO2_POW_LEAN" 442 "B1_UO2_PUC_RICH" 443 "B1_DO2_OPN" 444 "B1_DO2_LO" 445 "B1_DO2_HI" 446 "B1_DO2_POW_LEAN" 447 "B1_DO2_DFCO_RICH" 448 "B1_UO2_SW_CNTS" 449 "B1_UO2_RL_AVG" 450 "B1_UO2_LR_AVG" 451 "B1_UO2_RAT" 455 "B1_UO2_UNDER_HT" 456 "B1_DO2_UNDER_HT" 457 "B1_UO2_OVER_HT" 458 "B1_DO2_OVER_HT" 459 "IMMO_AUTH" 460 "IMMO_RSP" 461 "IMMO_ECM_LRN" 471 "STRT_RLY_OPN" 472 "STRT_RLY_STUCK" 473 "TRN_RLY_STCK" 474 "STRT_ST_OPN" 475 "STRT_DMG" 476 "DRV_TRN_LO" 477 "DRV_TRN_HI" 478 "DRV_TRN_STCKLO" 479 "DRV_TRN_STCKHI" 481 "PWM_PMP_HI" 482 "PWM_PMP_LO" 483 "PWM_PMP_OPN" 494 "VREF3_VLT" /end COMPU_VTAB
/begin COMPU_VTAB u_dtc_typ "" TAB_VERB 278 0 "NONE" 5 "AC_P_HI" 6 "AC_P_LO" 7 "AC_RLY_HI" 8 "AC_RLY_LO" 9 "BRK_LAMP_SWTCH" 10 "BRK_SWTCH_CORR" 11 "CAM_OPN" 12 "CAM_RAT" 14 "CAN_BUS_OFF" 15 "CAN_COM" 16 "CAN_TCM" 17 "CAN_TCS" 18 "CAN_ACC" 19 "CAN_4WD" 20 "CAN_ABS" 21 "CAN_BCM" 22 "ENS_PULSE" 23 "CAN_IPC" 24 "CAN_RCU" 25 "CAN_ESP_CHKSUM" 26 "CAN_ESP_LIFE_SGNL" 27 "CAN_TCM_CHKSUM" 28 "CAN_TCM_LIFE_SGNL" 29 "CAN_VOLT_HI" 30 "CAN_VOLT_LO" 31 "CAN_EPS" 32 "CAN_PEPS1" 33 "CAN_PEPS2" 34 "CAN_PEPS3" 36 "CAN_AC" 37 "CAN_HCU" 38 "CAN_BSG" 40 "CAN_GW" 41 "CAN_SAS" 42 "CAN_EPB" 43 "CAN_RCU_CHKSUM" 44 "CAN_ACC_CHK_SUM" 45 "CAN_ACC_LIFE_SGNL" 46 "CAN_RCU_LIFE_SGNL" 47 "CAN_APA" 48 "B1_CAT" 49 "ECM_PROC" 50 "ECT_SHORT_HI" 51 "ECT_SHORT_LO" 54 "ECT_FUEL_CL" 55 "ECT_RAT_HI" 56 "ECT_THERMOSTAT" 58 "ECT_STRT_HI" 59 "ECT_RAT_LO" 60 "CRK_PERF" 61 "CRK_OPEN" 62 "EGR_POS_HI" 63 "EGR_POS_LO" 64 "EGR_ZERO_INIT" 65 "EGR_ZERO_CHG" 66 "EGR_FLW" 67 "EGR_CLS_POS" 68 "EGR_STUCK" 69 "EGR_POS_ERR" 71 "PPS_CORR" 72 "PPS1_LO" 73 "PPS2_LO" 74 "PPS1_HI" 75 "PPS2_HI" 76 "ETC_RDNT" 77 "ETC_IDL" 78 "ETC_OFF" 79 "ETC_LMT" 80 "ETC_OUT_CTRL" 81 "TPS1_LO" 82 "TPS2_LO" 83 "TPS1_HI" 84 "TPS2_HI" 87 "TPS_CORR" 88 "TPS_DEFAULT" 89 "VREF1_VLT" 90 "VREF2_VLT" 91 "ETC_MOTOR_PERF" 92 "ETC_MOTOR_SS" 93 "PURG_FLW" 94 "PURG_LARGE_LEAK" 95 "PURG_SAMLL_LEAK" 96 "PURG_VERY_SMALL_LEAK" 97 "VENT_RESTRICTED" 98 "ECM_RAM" 99 "ECM_STACK" 100 "ECM_ROM" 106 "FLV_HI" 107 "FLV_LO" 112 "FUEL_B1_IDL_LEAN" 113 "FUEL_B1_IDL_RICH" 114 "FUEL_B1_LEAN" 115 "FUEL_B1_RICH" 116 "GEAR_R" 117 "GEAR_1" 118 "GEAR_2" 119 "GEAR_3" 120 "GEAR_4" 121 "GEAR_5" 122 "IAT_LO" 123 "IAT_HI" 126 "IAT_HI_HI_RAT" 127 "IAT_LO_RAT" 130 "IDL_ESPD_HI" 131 "IDL_ESPD_LO" 132 "IDL_CAT_ESPD_LO" 133 "KNCK_SYS" 134 "KNCK_SNSR" 138 "ECM_CLK" 140 "MAP_TPS_DCL_COR" 141 "MAP_TPS_LO_COR" 142 "MAP_TPS_HI_COR" 143 "ALT_FB" 144 "MIL_CIRCUIT" 145 "MISFIRE" 147 "RR_ABS_PWM" 150 "G_SENSOR_LO" 151 "G_SENSOR_HI" 161 "BAT_VLT_HI" 162 "BAT_VLT_LO" 163 "TANK_P_HI" 164 "TANK_P_LO" 165 "TANK_P_STUCK" 166 "TANK_P_NOISE" 173 "CRK_LRN" 182 "VSPD_OPN" 183 "B1_EXH_CAM_TOOTH" 184 "B1_EXH_CAM_COR" 185 "B1_EXH_VLV_STUK" 186 "B1_EXH_CAM_SLOW" 187 "B1_EXH_VVT_PERF" 188 "B1_INTK_CAM_TOOTH" 189 "B1_INTK_CAM_COR" 190 "B1_INTK_VLV_STUK" 191 "B1_INTK_CAM_SLOW" 192 "B1_INTK_VVT_PERF" 194 "FAN1_CIRCUIT" 195 "FAN2_CIRCUIT" 196 "PWM_FAN" 197 "ECM_COP" 198 "MPR_CIRCUIT" 199 "PURGE_LO" 200 "PURGE_HI" 201 "UO2_HT_LO" 202 "UO2_HT_HI" 203 "DO2_HT_LO" 204 "DO2_HT_HI" 205 "INJ_CYL1_LO" 206 "INJ_CYL1_HI" 207 "INJ_CYL2_LO" 208 "INJ_CYL2_HI" 209 "INJ_CYL3_LO" 210 "INJ_CYL3_HI" 211 "INJ_CYL4_LO" 212 "INJ_CYL4_HI" 213 "FPR_CIRCUIT" 214 "B1_INTK_VVT_HI" 215 "B1_INTK_VVT_LO" 216 "B1_INTK_VVT_OPN" 217 "B1_EXH_VVT_HI" 218 "B1_EXH_VVT_LO" 219 "B1_EXH_VVT_OPN" 220 "ESTA_LO" 221 "ESTA_HI" 222 "ESTA_OPN" 223 "ESTB_LO" 224 "ESTB_HI" 225 "ESTB_OPN" 226 "ESTC_LO" 227 "ESTC_HI" 228 "ESTC_OPN" 229 "ESTD_LO" 230 "ESTD_HI" 231 "ESTD_OPN" 246 "VENT_VLV_LO" 247 "VENT_VLV_HI" 252 "ECM_AD" 253 "ECM_SW_VER" 254 "PS_P_LO" 255 "PS_P_HI" 257 "CRUZ_AN" 258 "CRUZ_ON" 259 "CRUZ_CANCEL" 260 "CRUZ_RES" 261 "CRUZ_SET" 262 "CRUZ_DIST" 263 "CRUZ_LMT" 264 "CRUZ_ON_STUCK" 265 "CRUZ_CANCEL_STUCK" 266 "CRUZ_RES_STUCK" 267 "CRUZ_SET_STUCK" 268 "CRUZ_DIST_STUCK" 269 "CRUZ_LMT_STUCK" 270 "ECM_AD0" 271 "ECM_AD1" 272 "ECM_GPR" 273 "WSS_OPEN" 281 "EGR_VLV_CIRCUIT" 283 "MAIN_RLY_OUT" 284 "B1_DO2_PUC_RESP" 285 "MISFIRE_CYL1" 286 "MISFIRE_CYL2" 287 "MISFIRE_CYL3" 288 "MISFIRE_CYL4" 290 "IG_ADV" 291 "ELEC_THEM_HI" 292 "ELEC_THEM_LO" 293 "B1_DO2_POW_RESP" 294 "BAT_TEMP_HI" 295 "BAT_NO_CHRG" 296 "BAT_LO_SOC" 297 "SYS_VLT_LO" 298 "SYS_VLT_RAT" 299 "BAT_SOC_RAT" 300 "ALT_TEMP_HI" 301 "ALT_MECH" 302 "ALT_ELEC" 303 "START_RLYA_HI" 304 "START_RLYA_LO" 305 "START_RLYB_HI" 306 "START_RLYB_LO" 309 "BRK_PUMP_PRES_LO" 310 "BRK_PUMP_PRES_HI" 315 "TCM_FAIL" 321 "LIN_ERR" 325 "BAT_SENSOR" 326 "BAT_SENSOR_COMM" 327 "LIN_ALT_COM" 330 "AC_TEMP_LO" 331 "AC_TEMP_HI" 335 "CLTCH_TOP_RLS" 336 "CLTCH_TOP_DPRS" 337 "CLTCH_BOT_RLS" 338 "CLTCH_BOT_DPRS" 341 "GEAR_N_SW_STUCK_N" 342 "GEAR_N_SW_STUCK_NON" 344 "AMP_HI" 345 "MAP_HI" 346 "AMP_LO" 347 "MAP_LO" 352 "AMP_STRT_COR" 353 "MAP_STRT_COR" 360 "FUEL_CAP_OPN" 385 "B1_UO2_OPN" 386 "B1_UO2_LO" 387 "B1_UO2_HI" 388 "B1_UO2_POW_LEAN" 389 "B1_UO2_PUC_RICH" 390 "B1_DO2_OPN" 391 "B1_DO2_LO" 392 "B1_DO2_HI" 393 "B1_DO2_POW_LEAN" 394 "B1_DO2_DFCO_RICH" 395 "B1_UO2_SW_CNTS" 396 "B1_UO2_RL_AVG" 397 "B1_UO2_LR_AVG" 398 "B1_UO2_RAT" 402 "B1_UO2_UNDER_HT" 403 "B1_DO2_UNDER_HT" 404 "B1_UO2_OVER_HT" 405 "B1_DO2_OVER_HT" 406 "IMMO_AUTH" 407 "IMMO_RSP" 408 "IMMO_ECM_LRN" 418 "STRT_RLY_OPN" 419 "STRT_RLY_STUCK" 420 "TRN_RLY_STCK" 421 "STRT_ST_OPN" 422 "STRT_DMG" 423 "DRV_TRN_LO" 424 "DRV_TRN_HI" 425 "DRV_TRN_STCKLO" 426 "DRV_TRN_STCKHI" 428 "PWM_PMP_HI" 429 "PWM_PMP_LO" 430 "PWM_PMP_OPN" 441 "VREF3_VLT" /end COMPU_VTAB
/begin COMPU_METHOD u_rpt_st "" TAB_VERB "%5.0" "" COMPU_TAB_REF u_rpt_st /end COMPU_METHOD
/begin COMPU_VTAB u_rpt_st "" TAB_VERB 3 0 "NO_REPORT" 1 "PASS" 2 "FAIL" /end COMPU_VTAB
/begin COMPU_METHOD u_diag_typ "" TAB_VERB "%5.0" "" COMPU_TAB_REF u_diag_typ /end COMPU_METHOD
/begin COMPU_VTAB u_diag_typ "" TAB_VERB 5 0 "BYPASS" 1 "LIGHT_SVS" 2 "LIGHT_3RD_TRIP" 4 "LIGHT_2ND_TRIP" 8 "LIGHT_1ST_TRIP" /end COMPU_VTAB
/begin COMPU_METHOD u_den_grp "" TAB_VERB "%5.0" "" COMPU_TAB_REF u_den_grp /end COMPU_METHOD
/begin COMPU_VTAB u_den_grp "" TAB_VERB 34 0 "INTERNAL_USE" 1 "GENERIC" 2 "B1_CFD" 3 "B2_CFD" 4 "EGR_FLW" 5 "B1_EXH_CAM_ST" 6 "B1_EXH_VVT_STUK" 7 "B1_EXH_VVT_POS" 8 "B1_EXH_VVT_RESP" 9 "B2_EXH_CAM_ST" 10 "B2_EXH_VVT_STUK" 11 "B2_EXH_VVT_POS" 12 "B2_EXH_VVT_RESP" 13 "B1_INTK_CAM_ST" 14 "B1_INTK_VVT_STUK" 15 "B1_INTK_VVT_POS" 16 "B1_INTK_VVT_RESP" 17 "B2_INTK_CAM_ST" 18 "B2_INTK_VVT_STUK" 19 "B2_INTK_VVT_POS" 20 "B2_INTK_VVT_RESP" 21 "EVAM_PURGE_FLOW" 22 "EVAM_SMALL_LEAK" 23 "B1S1_RSP_SW_TMS" 24 "B1S1_RSP_RCH_LEAN" 25 "B1S1_RSP_LEAN_RCH" 26 "B1S1_RSP_RATIO" 27 "" 28 "" 29 "" 30 "B1S2_PUC_RESP" 31 "B1S2_POW_RESP" 32 "B1_SECOND_AIR" 33 "B2_SECOND_AIR" /end COMPU_VTAB
/begin COMPU_METHOD u_drvd_list "" TAB_VERB "%10.4" "" COMPU_TAB_REF u_drvd_list /end COMPU_METHOD
/begin COMPU_VTAB u_drvd_list "" TAB_VERB 143 0 "MIL_ON" 1 "MIL_OFF" 2 "FAN2_ON" 3 "FAN2_OFF" 4 "FAN1_ON" 5 "FAN1_OFF" 6 "FAN_PWM_ON" 7 "FAN_PWM_OFF" 8 "VENT_SOL_ON" 9 "VENT_SOL_OFF" 10 "AC_RELAY_ON" 11 "AC_RELAY_OFF" 12 "MAIN_RLY_ON" 13 "MAIN_RLY_OFF" 14 "CANISTER_PURGE_ON" 15 "CANISTER_PURGE_OFF" 16 "B1_UP_O2_HEATER_ON" 17 "B1_UP_O2_HEATER_OFF" 18 "B2_UP_O2_HEATER_ON" 19 "B2_UP_O2_HEATER_OFF" 20 "B1_DWN_O2_HEATER_ON" 21 "B1_DWN_O2_HEATER_OFF" 22 "B2_DWN_O2_HEATER_ON" 23 "B2_DWN_O2_HEATER_OFF" 24 "B1_INTK_VVT_ON" 25 "B1_INTK_VVT_OFF" 26 "B1_EXH_VVT_ON" 27 "B1_EXH_VVT_OFF" 28 "B2_INTK_VVT_ON" 29 "B2_INTK_VVT_OFF" 30 "B2_EXH_VVT_ON" 31 "B2_EXH_VVT_OFF" 32 "INJ_A_ON" 33 "INJ_A_OFF" 34 "INJ_B_ON" 35 "INJ_B_OFF" 36 "INJ_C_ON" 37 "INJ_C_OFF" 38 "INJ_D_ON" 39 "INJ_D_OFF" 40 "INJ_E_ON" 41 "INJ_E_OFF" 42 "INJ_F_ON" 43 "INJ_F_OFF" 44 "INJ_G_ON" 45 "INJ_G_OFF" 46 "INJ_H_ON" 47 "INJ_H_OFF" 48 "FUEL_PUMP_ON" 49 "FUEL_PUMP_OFF" 50 "RESERVE" 51 "RESERVE" 52 "RESERVE" 53 "RESERVE" 54 "RESERVE" 55 "RESERVE" 56 "RESERVE" 57 "RESERVE" 58 "RESERVE" 59 "RESERVE" 60 "RESERVE" 61 "RESERVE" 62 "RESERVE" 63 "RESERVE" 64 "RESERVE" 65 "RESERVE" 66 "RESERVE" 67 "RESERVE" 68 "RESERVE" 69 "RESERVE" 70 "RESERVE" 71 "RESERVE" 72 "STARTER_RELAY_ON" 73 "STARTER_RELAY_OFF" 74 "ELEC_THEM_ON" 75 "ELEC_THEM_OFF" 76 "LEGR_ON" 77 "LEGR_OFF" 78 "BRK_PUMP_ON" 79 "BRK_PUMP_OFF" 80 "VCM_VLV_ON" 81 "VCM_VLV_OFF" 82 "GEN_PWM_ON" 83 "GEN_PWM_OFF" 84 "RESERVE" 85 "RESERVE" 86 "RESERVE" 87 "RESERVE" 88 "RESERVE" 89 "RESERVE" 90 "RESERVE" 91 "RESERVE" 92 "RESERVE" 93 "RESERVE" 94 "RESERVE" 95 "RESERVE" 96 "RESERVE" 97 "RESERVE" 98 "RESERVE" 99 "RESERVE" 100 "RESERVE" 101 "RESERVE" 102 "RESERVE" 103 "RESERVE" 104 "RESERVE" 105 "RESERVE" 106 "RESERVE" 107 "RESERVE" 108 "RESERVE" 109 "RESERVE" 110 "RESERVE" 111 "RESERVE" 112 "RESERVE" 113 "RESERVE" 114 "RESERVE" 115 "RESERVE" 116 "RESERVE" 117 "RESERVE" 118 "RESERVE" 119 "RESERVE" 120 "RESERVE" 121 "RESERVE" 122 "RESERVE" 123 "RESERVE" 124 "STARTER_RELAY2_ON" 125 "STARTER_RELAY2_OFF" 126 "EXH_BRAKE_RLY_ON" 127 "EXH_BRAKE_RLY_OFF" 128 "FAN3_ON" 129 "FAN3_OFF" 130 "WATER_PUMP_PWM_STB" 131 "WATER_PUMP_PWM_STG" 132 "WATER_PUMP_PWM_OPEN" 133 "CNG_A_ON" 134 "CNG_A_OFF" 135 "CNG_B_ON" 136 "CNG_B_OFF" 137 "CNG_C_ON" 138 "CNG_C_OFF" 139 "CNG_D_ON" 140 "CNG_D_OFF" 141 "CNG_TANK_VLV_ON" 142 "CNG_TANK_VLV_OFF" /end COMPU_VTAB
/begin COMPU_METHOD u_crk_src "" TAB_VERB "%10.4" "" COMPU_TAB_REF u_crk_src /end COMPU_METHOD
/begin COMPU_VTAB u_crk_src "" TAB_VERB 3 0 "COM" 1 "HS_STATE" 2 "CRANK_SW" /end COMPU_VTAB
/begin COMPU_METHOD u_cltch_typ "" TAB_VERB "%10.4" "" COMPU_TAB_REF u_cltch_typ /end COMPU_METHOD
/begin COMPU_VTAB u_cltch_typ "" TAB_VERB 2 0 "TOP" 1 "BOTTOM" /end COMPU_VTAB
/begin COMPU_METHOD u_dt_ctrl_typ "" TAB_VERB "%10.4" "" COMPU_TAB_REF u_dt_ctrl_typ /end COMPU_METHOD
/begin COMPU_VTAB u_dt_ctrl_typ "" TAB_VERB 5 0 "UNUSE" 1 "TCU_ECU" 2 "TCU" 3 "ECU" 4 "PN" /end COMPU_VTAB
/begin COMPU_METHOD u_gram_l_16777216 "gram" RAT_FUNC "%8.3" "g" COEFFS 0.0 1.0 0.000000 0.0 0.0 0.00390625 /end COMPU_METHOD
/begin COMPU_METHOD u_ecsd_hi_en_st "" TAB_VERB "%10.4" "" COMPU_TAB_REF u_ecsd_hi_en_st /end COMPU_METHOD
/begin COMPU_VTAB u_ecsd_hi_en_st "" TAB_VERB 12 0 "DIAG_BYPASS" 1 "INITIAL" 2 "TEST_FINISH" 3 "FAIL_ACTV" 4 "IAT_HIGH" 5 "HOT_START" 6 "STALL_LONG" 7 "ECT_OUT" 8 "ECT_LOW" 9 "ENABLE" 10 "STALL" 11 "AIRFLOW" /end COMPU_VTAB
/begin COMPU_METHOD u_ecsd_diag_st "" TAB_VERB "%10.4" "" COMPU_TAB_REF u_ecsd_diag_st /end COMPU_METHOD
/begin COMPU_VTAB u_ecsd_diag_st "" TAB_VERB 20 0 "INITIAL" 1 "BYPASS" 2 "FAIL_ACTV" 3 "OFF_TIME_SHORT" 4 "RUNTIME_AND_OFF_TM" 5 "IAT_LOW" 6 "ECT_NOT_MET" 7 "STALL" 8 "STARTUP_INIT" 9 "NO_REPORT_FAIL" 10 "ECT_OUT" 11 "AMB_T_LOW" 12 "HOT_STARTUP" 13 "LOW_HEATING" 14 "WAITING_FOR_WARM" 17 "FINISH" 18 "ENABLE" 19 "UNKOWN" 20 "FINISH" 21 "ECT_OUT" /end COMPU_VTAB
/begin COMPU_METHOD u_egr_area "" TAB_VERB "%6.3" "" COMPU_TAB_REF u_egr_area /end COMPU_METHOD
/begin COMPU_VTAB u_egr_area "" TAB_VERB 3 0 "DISABLE" 1 "HIGH" 2 "LOW" /end COMPU_VTAB
/begin COMPU_METHOD u_egr_err_st "" TAB_VERB "%6.3" "" COMPU_TAB_REF u_egr_err_st /end COMPU_METHOD
/begin COMPU_VTAB u_egr_err_st "" TAB_VERB 3 0 "UNKNOWN" 1 "PASS" 2 "FAIL" /end COMPU_VTAB
/begin COMPU_METHOD p_t_GPF_PCT_0_100 "" RAT_FUNC "%7.6" "1/%" COEFFS 0.0 1.0 0.0 0.0 0.0 0.0000152587890625 /end COMPU_METHOD
/begin COMPU_METHOD p_t_GPF_SM_N2048_2048_LONG "Ax + B" RAT_FUNC "%4.0" "g" COEFFS 0.0 1.0 0.000000 0.0 0.0 0.000000953674 /end COMPU_METHOD
/begin FUNCTION cpd_drv "engine coolant system diag"
 /begin DEF_CHARACTERISTIC CPD_V_DRV_EN_VLT_HI CPD_V_DRV_EN_VLT_LO CPD_V_DRV_STRT_RLY_VLT_LO CPD_V_DRV_MPR_FL_DIAG_NUM CPD_V_DRV_MPR_FL_CNTS CPD_V_DRV_MPR_DIAG_CNTS CPD_V_DRV_MPR_EN_DIAG_NUM CPD_V_DRV_MPR_EN_DLY CPD_C_DRV_MPR_DIAG_LIST CPD_C_DRV_MPR_DIAG_DIS_LIST CPD_V_DRV_STRT_RLY_EN_SRC CPD_V_DRV_EGR_EN_RUN_MIN CPD_V_NS_EN_VLT_MIN CPD_V_NS_EN_VLT_MAX CPD_V_NS_PASS_TRSN_CNTS CPD_V_NS_STK_ON_ESPD_MIN CPD_V_NS_STK_ON_ESPD_MAX CPD_V_NS_STK_ON_VSPD_MIN CPD_V_NS_STK_ON_MAP_MIN CPD_V_NS_STK_ON_PPS_MIN CPD_V_NS_STK_ON_FL_CNTS CPD_V_NS_STK_ON_DUR CPD_V_NS_STK_ON_USE_ACC CPD_V_NS_STK_OFF_ESPD_MIN CPD_V_NS_STK_OFF_ESPD_MAX CPD_V_NS_STK_OFF_VSPD_MIN CPD_V_NS_STK_ON_MAP_MAX CPD_V_NS_STK_OFF_ECT_MIN CPD_V_NS_STK_OFF_ECT_MAX CPD_V_NS_STK_OFF_FL_CNTS CPD_V_NS_STK_OFF_DUR CPD_V_NS_STK_OFF_USE_ACC CPD_C_CLS_VSPD_LO CPD_C_CLS_VSPD_HI CPD_C_CLS_VSPD_LO_CNTS CPD_C_CLS_VSPD_HI_CNTS CPD_C_CLS_VSPD_TRS_CNTS CPD_V_SRLY_NO_DT_RLY CPD_V_DT_RLY_CTRL_TYP CPD_V_SRLY_OPN_FL_DLY CPD_V_SRLY_STCK_EN_DLY CPD_V_SRLY_STCK_FL_CNTS CPD_V_SRLY_STCK_DIAG_CNTS CPD_V_SRLY_KEY_ON_DLY CPD_V_DRLY_STCK_VSPD CPD_V_DRLY_STCK_FL_CNTS CPD_V_DRLY_STCK_DIAG_DUR CPD_V_SRLY_ST_OPN_FL_DLY CPD_V_SRLY_ST_OPN_FL_CNTS CPD_V_SRLY_ST_OPN_DIAG_CNTS CPD_V_STRTER_FL_MAP_DLT CPD_V_STRTER_FL_DLY CPD_V_SRLY_ST_OPN_CRK_VLT CPD_V_DT_EN_DLY CPD_V_DT_SHRT_LO_FL_CNTS CPD_V_DT_SHRT_LO_DIAG_CNTS CPD_V_DT_SHRT_HI_FL_CNTS CPD_V_DT_SHRT_HI_DIAG_CNTS CPD_V_DT_STCK_LO_VSPD CPD_V_DT_STCK_LO_MAP CPD_V_DT_STCK_LO_ESPD_MIN CPD_V_DT_STCK_LO_ESPD_MAX CPD_V_DT_STCK_LO_TPS CPD_V_DT_STCK_LO_ECT CPD_V_DT_STCK_HI_ECT CPD_V_DT_STCK_HI_ESPD_DLT CPD_V_DT_STCK_HI_FL_CNTS CPD_V_DT_STCK_LO_FL_CNTS CPD_V_DT_STCK_LO_DIAG_CNTS CPD_V_ETC_PERF_THR_DYN_FAC CPD_V_ETC_PERF_THR_DYN_DCY CPD_C_ETC_PERF_DLT_THR_HI CPD_V_ETC_PERF_THR_MAX CPD_V_ETC_PERF_LO_INC_CNTS CPD_V_ETC_PERF_LO_QK_DEC_CNTS CPD_V_ETC_PERF_LO_DEC_CNTS CPD_V_ETC_PERF_LO_FL_CNTS CPD_V_ETC_PERF_LO_STL_FL_CNTS CPD_V_ETC_PERF_LO_DIAG_CNTS CPD_V_ETC_PERF_HI_INC_CNTS CPD_V_ETC_PERF_HI_QK_DEC_CNTS CPD_V_ETC_PERF_HI_DEC_CNTS CPD_V_ETC_PERF_HI_FL_CNTS CPD_V_ETC_PERF_HI_STL_FL_CNTS CPD_V_ETC_PERF_HI_DIAG_CNTS CPD_V_ETC_CTRL_PASS_RUN_MIN CPD_V_ETC_PERF_SS_EN_SP_CHG CPD_V_ETC_PERF_SS_EN_DLY CPD_V_ETC_PERF_SS_FL_THR_HI CPD_V_ETC_PERF_SS_FL_THR_LO CPD_V_ETC_PERF_SS_POS_HI CPD_V_ETC_PERF_SS_FL_DUR CPD_V_ETC_PERF_SS_DIAG_DUR CPD_C_DRV_FL_CNTS CPD_C_DRV_DIAG_CNTS CPD_V_DRV_ESTA_LO_FL_CNTS CPD_V_DRV_ESTA_LO_DIAG_CNTS CPD_V_DRV_ESTA_HI_FL_CNTS CPD_V_DRV_ESTA_HI_DIAG_CNTS CPD_V_DRV_ESTA_OPN_FL_CNTS CPD_V_DRV_ESTA_OPN_DIAG_CNTS CPD_V_DRV_ESTB_LO_FL_CNTS CPD_V_DRV_ESTB_LO_DIAG_CNTS CPD_V_DRV_ESTB_HI_FL_CNTS CPD_V_DRV_ESTB_HI_DIAG_CNTS CPD_V_DRV_ESTB_OPN_FL_CNTS CPD_V_DRV_ESTB_OPN_DIAG_CNTS CPD_V_DRV_ESTC_LO_FL_CNTS CPD_V_DRV_ESTC_LO_DIAG_CNTS CPD_V_DRV_ESTC_HI_FL_CNTS CPD_V_DRV_ESTC_HI_DIAG_CNTS CPD_V_DRV_ESTC_OPN_FL_CNTS CPD_V_DRV_ESTC_OPN_DIAG_CNTS CPD_V_DRV_ESTD_LO_FL_CNTS CPD_V_DRV_ESTD_LO_DIAG_CNTS CPD_V_DRV_ESTD_HI_FL_CNTS CPD_V_DRV_ESTD_HI_DIAG_CNTS CPD_V_DRV_ESTD_OPN_FL_CNTS CPD_V_DRV_ESTD_OPN_DIAG_CNTS CPD_V_DRV_EST_EN_VLT CPD_V_DRV_EST_EN_MPR_DLY CPD_V_DRV_EST_EN_RUN_DLY CPD_V_EGR_ERR_EN_IAT_MIN CPD_V_EGR_ERR_PRE_CLS_MAX CPD_V_EGR_ERR_PRE_CLS_DUR CPD_V_EGR_ERR_HI_LO_THR CPD_V_EGR_ERR_HI_DLT CPD_V_EGR_ERR_LO_DLT CPD_V_EGR_ERR_SP_STBL_DLT CPD_V_EGR_ERR_FL_LOG_CNTS CPD_V_EGR_ERR_FL_CNTS /end DEF_CHARACTERISTIC
 /begin OUT_MEASUREMENT cpd_drv_en cpd_drv_fl_met cpd_drv_fl_cnt cpd_drv_diag_cnt cpd_drv_fn cpd_drv_fl cpd_drv_rpt_st cpd_egr_vlv_met cpd_egr_vlv_cls_dur cpd_egr_err_en cpd_egr_sp_unstbl cpd_egr_err_fl_thr cpd_egr_sp_max cpd_egr_sp_min cpd_egr_err_ar_stbl cpd_egr_err_ar cpd_egr_err_st cpd_egr_err_log_cnt cpd_egr_err_fl_cnt cpd_egr_err_fl cpd_egr_err_fn /end OUT_MEASUREMENT
/end FUNCTION
/begin FUNCTION cpd "component diag" /begin SUB_FUNCTION cpd_analog cpd_discrete cpd_drv /end SUB_FUNCTION /end FUNCTION
/begin FUNCTION engd "engine system diag" /begin DEF_CHARACTERISTIC /end DEF_CHARACTERISTIC /begin OUT_MEASUREMENT /end OUT_MEASUREMENT /end FUNCTION
/begin FUNCTION ecsd "engine coolant system diag"
 /begin DEF_CHARACTERISTIC ECSD_M_ECT_CL_DUR_THR ECSD_X_ECT_DLT ECSD_X_AIR_FLAP_PCT ECSD_C_ECT_CL_DIS_FLW ECSD_C_ECT_CL_DIS_IDL ECSD_V_RPT_KP_MIN ECSD_V_DIAG_EN_IAT_MIN ECSD_V_ECT_CL_FCO_NUM ECSD_C_ECT_CL_FCO_COOL_DLT ECSD_X_T_DLT ECSD_V_THEM_EN_IAT ECSD_V_THEM_EN_KEYON_ECT_DLT ECSD_V_THEM_FCO_NUM ECSD_C_THEM_FCO_COOL_DLT ECSD_C_THEM_ECT_THR ECSD_M_THEM_DUR_THR ECSD_C_THEM_DIS_FLW ECSD_C_THEM_DIS_IDL ECSD_V_ECT_LO_EN_IAT_MAX ECSD_V_ECT_LO_EN_RUN_DLY ECSD_C_ECT_LO_AIR_FLW_MIN ECSD_C_ECT_LO_AIR_FLW_DUR ECSD_V_ECT_LO_FL_ECT_DLT ECSD_V_ECT_LO_FL_CNTS ECSD_V_ECT_LO_DIAG_CNTS ECSD_V_ECT_LO_EN_OFFT_MIN ECSD_V_ECT_SHI_EN_OFFT_MIN ECSD_V_ECT_SHI_EN_IAT_MAX ECSD_V_ECT_SHI_FL_THR ECSD_V_ECT_SHI_FL_CNTS ECSD_V_ECT_SHI_DIAG_CNTS ECSD_V_ECT_SHRT_DUR ECSD_V_IDL_VSPD_MAX ECSD_V_ECT_HI_EN_IAT_MAX ECSD_V_ECT_HI_OFFT ECSD_V_ECT_HI_KEYON_ECT_MAX ECSD_V_ECT_HI_EN_ECT_MIN ECSD_V_ECT_HI_AIR_FLW_FIL ECSD_V_ECT_HI_DIAG_DLY ECSD_V_ECT_HI_FL_THR ECSD_V_ECT_HI_AVG_FLW_THR ECSD_V_ECT_HI_MMV_FLW_THR ECSD_V_ECT_HI_PASS_DUR ECSD_V_ECT_HI_RPT_KP_MIN ECSD_V_ECT_HI_DIS_STOP_DUR ECSD_V_ECT_HI_FLW_INIT ECSD_V_ECT_STCK_EN_OFFT ECSD_V_ECT_STCK_FL_THR ECSD_V_ECT_STCK_FL_CNTS ECSD_V_ECT_STCK_DIAG_CNTS ECSD_V_ECT_SHRT_LO_FL_CNTS ECSD_V_ECT_SHRT_LO_DIAG_CNTS ECSD_V_ECT_SHRT_HI_FL_CNTS ECSD_V_ECT_SHRT_HI_DIAG_CNTS /end DEF_CHARACTERISTIC
 /begin OUT_MEASUREMENT ecsd_ect_cl_dlt ecsd_ect_shrt_hi_fl_cnts ecsd_ect_shrt_hi_diag_cnts ecsd_ect_shrt_hi_en ecsd_ect_shrt_hi_met ecsd_ect_shrt_hi_fn ecsd_ect_shrt_hi_fl ecsd_ect_shrt_hi_rpt_st ecsd_ect_shrt_lo_fl_cnts ecsd_ect_shrt_lo_diag_cnts ecsd_ect_shrt_lo_en ecsd_ect_shrt_lo_met ecsd_ect_shrt_lo_fn ecsd_ect_shrt_lo_fl ecsd_ect_shrt_lo_rpt_st ecsd_cl_ect_thr ecsd_cl_pass_cnts ecsd_cl_fail_cnts ecsd_cl_diag_fn ecsd_cl_diag_fl ecsd_cl_warm_dur ecsd_diag_flw_int ecsd_diag_idl_tmr ecsd_them_diag_en_met ecsd_iat_raw_max ecsd_iat_min ecsd_eng_lo_fast_run ecsd_ect_raw_out ecsd_ect_lo_air_flw_dur ecsd_ect_lo_chg_dlt ecsd_key_on_ect ecsd_ect_lo_fl_cnts ecsd_ect_lo_diag_cnts ecsd_ect_lo_en_met ecsd_ect_lo_fl_met ecsd_ect_lo_diag_fn ecsd_ect_lo_diag_fl ecsd_ect_lo_rpt_st ecsd_eng_shi_fast_run ecsd_ect_shi_fl_cnts ecsd_ect_shi_diag_cnts ecsd_ect_shi_en_met ecsd_ect_shi_fl_met ecsd_ect_shi_diag_fn ecsd_ect_shi_diag_fl ecsd_ect_shi_rpt_st ecsd_eng_hi_fast_run ecsd_eng_hi_flw_avg ecsd_eng_hi_flw_mmv ecsd_eng_hi_stl_dur ecsd_eng_hi_dly ecsd_ect_hi_en_st ecsd_ect_hi_pass_cnts ecsd_ect_hi_fl_cnts ecsd_ect_hi_diag_fl ecsd_ect_hi_diag_fn ecsd_them_temp_thr ecsd_them_warm_dur ecsd_them_pass_cnts ecsd_them_fail_cnts ecsd_them_diag_fl ecsd_them_diag_fn ecsd_them_en_st ecsd_cl_en_st ecsd_trip_ect_min ecsd_eng_stck_fast_run ecsd_ect_stck_fl_cnts ecsd_ect_stck_diag_cnts ecsd_ect_stck_en_met ecsd_ect_stck_fl_met ecsd_ect_stck_diag_fn ecsd_ect_stck_diag_fl ecsd_ect_stck_rpt_st /end OUT_MEASUREMENT
/end FUNCTION
/begin FUNCTION errm ""
 /begin DEF_CHARACTERISTIC ERRM_AC_P_HI_TYP ERRM_AC_P_HI_MIL_ON ERRM_AC_P_HI_DEN_GRP ERRM_AC_P_HI_DTC ERRM_AC_P_LO_TYP ERRM_AC_P_LO_MIL_ON ERRM_AC_P_LO_DEN_GRP ERRM_AC_P_LO_DTC ERRM_AC_RLY_HI_TYP ERRM_AC_RLY_HI_MIL_ON ERRM_AC_RLY_HI_DEN_GRP ERRM_AC_RLY_HI_DTC ERRM_AC_RLY_LO_TYP ERRM_AC_RLY_LO_MIL_ON ERRM_AC_RLY_LO_DEN_GRP ERRM_AC_RLY_LO_DTC ERRM_BRK_LAMP_SW_TYP ERRM_BRK_LAMP_SW_MIL_ON ERRM_BRK_LAMP_SW_DEN_GRP ERRM_BRK_LAMP_SW_DTC ERRM_BRK_SW_CORR_TYP ERRM_BRK_SW_CORR_MIL_ON ERRM_BRK_SW_CORR_DEN_GRP ERRM_BRK_SW_CORR_DTC ERRM_CAM_OPN_TYP ERRM_CAM_OPN_MIL_ON ERRM_CAM_OPN_DEN_GRP ERRM_CAM_OPN_DTC ERRM_CAM_PERF_TYP ERRM_CAM_PERF_MIL_ON ERRM_CAM_PERF_DEN_GRP ERRM_CAM_PERF_DTC ERRM_CAN_BUS_OFF_TYP ERRM_CAN_BUS_OFF_MIL_ON ERRM_CAN_BUS_OFF_DEN_GRP ERRM_CAN_BUS_OFF_DTC ERRM_CAN_COM_TYP ERRM_CAN_COM_MIL_ON ERRM_CAN_COM_DEN_GRP ERRM_CAN_COM_DTC ERRM_CAN_TCM_TYP ERRM_CAN_TCM_MIL_ON ERRM_CAN_TCM_DEN_GRP ERRM_CAN_TCM_DTC ERRM_CAN_TCS_TYP ERRM_CAN_TCS_MIL_ON ERRM_CAN_TCS_DEN_GRP ERRM_CAN_TCS_DTC ERRM_CAN_ACC_TYP ERRM_CAN_ACC_MIL_ON ERRM_CAN_ACC_DEN_GRP ERRM_CAN_ACC_DTC ERRM_CAN_4WD_TYP ERRM_CAN_4WD_MIL_ON ERRM_CAN_4WD_DEN_GRP ERRM_CAN_4WD_DTC ERRM_CAN_ABS_TYP ERRM_CAN_ABS_MIL_ON ERRM_CAN_ABS_DEN_GRP ERRM_CAN_ABS_DTC ERRM_CAN_BCM_TYP ERRM_CAN_BCM_MIL_ON ERRM_CAN_BCM_DEN_GRP ERRM_CAN_BCM_DTC ERRM_ENS_PULS_TYP ERRM_ENS_PULS_MIL_ON ERRM_ENS_PULS_DEN_GRP ERRM_ENS_PULS_DTC ERRM_CAN_IPC_TYP ERRM_CAN_IPC_MIL_ON ERRM_CAN_IPC_DEN_GRP ERRM_CAN_IPC_DTC ERRM_CAN_RCU_TYP ERRM_CAN_RCU_MIL_ON ERRM_CAN_RCU_DEN_GRP ERRM_CAN_RCU_DTC ERRM_ESP_CHKSUM_TYP ERRM_ESP_CHKSUM_MIL_ON ERRM_ESP_CHKSUM_DEN_GRP ERRM_ESP_CHKSUM_DTC ERRM_ESP_LIFE_TYP ERRM_ESP_LIFE_MIL_ON ERRM_ESP_LIFE_DEN_GRP ERRM_ESP_LIFE_DTC ERRM_TCM_CHKSUM_TYP ERRM_TCM_CHKSUM_MIL_ON ERRM_TCM_CHKSUM_DEN_GRP ERRM_TCM_CHKSUM_DTC ERRM_TCM_LIFE_TYP ERRM_TCM_LIFE_MIL_ON ERRM_TCM_LIFE_DEN_GRP ERRM_TCM_LIFE_DTC ERRM_CAN_VLT_HI_TYP ERRM_CAN_VLT_HI_MIL_ON ERRM_CAN_VLT_HI_DEN_GRP ERRM_CAN_VLT_HI_DTC ERRM_CAN_VLT_LO_TYP ERRM_CAN_VLT_LO_MIL_ON ERRM_CAN_VLT_LO_DEN_GRP ERRM_CAN_VLT_LO_DTC ERRM_CAN_EPS_TYP ERRM_CAN_EPS_MIL_ON ERRM_CAN_EPS_DEN_GRP ERRM_CAN_EPS_DTC ERRM_CAN_PEPS1_TYP ERRM_CAN_PEPS1_MIL_ON ERRM_CAN_PEPS1_DEN_GRP ERRM_CAN_PEPS1_DTC ERRM_CAN_PEPS2_TYP ERRM_CAN_PEPS2_MIL_ON ERRM_CAN_PEPS2_DEN_GRP ERRM_CAN_PEPS2_DTC ERRM_CAN_PEPS3_TYP ERRM_CAN_PEPS3_MIL_ON ERRM_CAN_PEPS3_DEN_GRP ERRM_CAN_PEPS3_DTC ERRM_CAN_AC_TYP ERRM_CAN_AC_MIL_ON ERRM_CAN_AC_DEN_GRP ERRM_CAN_AC_DTC ERRM_CAN_HCU_TYP ERRM_CAN_HCU_MIL_ON ERRM_CAN_HCU_DEN_GRP ERRM_CAN_HCU_DTC ERRM_CAN_BSG_TYP ERRM_CAN_BSG_MIL_ON ERRM_CAN_BSG_DEN_GRP ERRM_CAN_BSG_DTC ERRM_CAN_SAS_TYP ERRM_CAN_SAS_MIL_ON ERRM_CAN_SAS_DEN_GRP ERRM_CAN_SAS_DTC ERRM_CAN_EPB_TYP ERRM_CAN_EPB_MIL_ON ERRM_CAN_EPB_DEN_GRP ERRM_CAN_EPB_DTC ERRM_RCU_CHKSUM_TYP ERRM_RCU_CHKSUM_MIL_ON ERRM_RCU_CHKSUM_DEN_GRP ERRM_RCU_CHKSUM_DTC ERRM_RCU_LIFE_TYP ERRM_RCU_LIFE_MIL_ON ERRM_RCU_LIFE_DEN_GRP ERRM_RCU_LIFE_DTC ERRM_ACC_CHKSUM_TYP ERRM_ACC_CHKSUM_MIL_ON ERRM_ACC_CHKSUM_DEN_GRP ERRM_ACC_CHKSUM_DTC ERRM_ACC_LIFE_TYP ERRM_ACC_LIFE_MIL_ON ERRM_ACC_LIFE_DEN_GRP ERRM_ACC_LIFE_DTC ERRM_CAN_APA_TYP ERRM_CAN_APA_MIL_ON ERRM_CAN_APA_DEN_GRP ERRM_CAN_APA_DTC ERRM_B1_CAT_TYP ERRM_B1_CAT_MIL_ON ERRM_B1_CAT_DEN_GRP ERRM_B1_CAT_DTC ERRM_ECM_SEQ_TYP ERRM_ECM_SEQ_MIL_ON ERRM_ECM_SEQ_DEN_GRP ERRM_ECM_SEQ_DTC ERRM_ECT_HI_TYP ERRM_ECT_HI_MIL_ON ERRM_ECT_HI_DEN_GRP ERRM_ECT_HI_DTC ERRM_ECT_LO_TYP ERRM_ECT_LO_MIL_ON ERRM_ECT_LO_DEN_GRP ERRM_ECT_LO_DTC ERRM_ECT_CL_TYP ERRM_ECT_CL_MIL_ON ERRM_ECT_CL_DEN_GRP ERRM_ECT_CL_DTC ERRM_ECT_RAT_HI_TYP ERRM_ECT_RAT_HI_MIL_ON ERRM_ECT_RAT_HI_DEN_GRP ERRM_ECT_RAT_HI_DTC ERRM_ECT_THEMO_TYP ERRM_ECT_THEMO_MIL_ON ERRM_ECT_THEMO_DEN_GRP ERRM_ECT_THEMO_DTC ERRM_ECT_STRT_HI_TYP ERRM_ECT_STRT_HI_MIL_ON ERRM_ECT_STRT_HI_DEN_GRP ERRM_ECT_STRT_HI_DTC ERRM_ECT_RAT_LO_TYP ERRM_ECT_RAT_LO_MIL_ON ERRM_ECT_RAT_LO_DEN_GRP ERRM_ECT_RAT_LO_DTC ERRM_CRK_PERF_TYP ERRM_CRK_PERF_MIL_ON ERRM_CRK_PERF_DEN_GRP ERRM_CRK_PERF_DTC ERRM_CRK_OPN_TYP ERRM_CRK_OPN_MIL_ON ERRM_CRK_OPN_DEN_GRP ERRM_CRK_OPN_DTC ERRM_PPS_CORR_TYP ERRM_PPS_CORR_MIL_ON ERRM_PPS_CORR_DEN_GRP ERRM_PPS_CORR_DTC ERRM_PPS1_LO_TYP ERRM_PPS1_LO_MIL_ON ERRM_PPS1_LO_DEN_GRP ERRM_PPS1_LO_DTC ERRM_PPS2_LO_TYP ERRM_PPS2_LO_MIL_ON ERRM_PPS2_LO_DEN_GRP ERRM_PPS2_LO_DTC ERRM_PPS1_HI_TYP ERRM_PPS1_HI_MIL_ON ERRM_PPS1_HI_DEN_GRP ERRM_PPS1_HI_DTC ERRM_PPS2_HI_TYP ERRM_PPS2_HI_MIL_ON ERRM_PPS2_HI_DEN_GRP ERRM_PPS2_HI_DTC ERRM_ECM_ETC_RDNT_TYP ERRM_ECM_ETC_RDNT_MIL_ON ERRM_ECM_ETC_RDNT_DEN_GRP ERRM_ECM_ETC_RDNT_DTC ERRM_ETC_IDL_TYP ERRM_ETC_IDL_MIL_ON ERRM_ETC_IDL_DEN_GRP ERRM_ETC_IDL_DTC ERRM_ETC_SHUT_TYP ERRM_ETC_SHUT_MIL_ON ERRM_ETC_SHUT_DEN_GRP ERRM_ETC_SHUT_DTC ERRM_ETC_LMT_TYP ERRM_ETC_LMT_MIL_ON ERRM_ETC_LMT_DEN_GRP ERRM_ETC_LMT_DTC ERRM_ETC_OUT_CTRL_TYP ERRM_ETC_OUT_CTRL_MIL_ON ERRM_ETC_OUT_CTRL_DEN_GRP ERRM_ETC_OUT_CTRL_DTC ERRM_TPS1_LO_TYP ERRM_TPS1_LO_MIL_ON ERRM_TPS1_LO_DEN_GRP ERRM_TPS1_LO_DTC ERRM_TPS2_LO_TYP ERRM_TPS2_LO_MIL_ON ERRM_TPS2_LO_DEN_GRP ERRM_TPS2_LO_DTC ERRM_TPS1_HI_TYP ERRM_TPS1_HI_MIL_ON ERRM_TPS1_HI_DEN_GRP ERRM_TPS1_HI_DTC ERRM_TPS2_HI_TYP ERRM_TPS2_HI_MIL_ON ERRM_TPS2_HI_DEN_GRP ERRM_TPS2_HI_DTC ERRM_TPS_CORR_TYP ERRM_TPS_CORR_MIL_ON ERRM_TPS_CORR_DEN_GRP ERRM_TPS_CORR_DTC ERRM_TPS_DFLT_TYP ERRM_TPS_DFLT_MIL_ON ERRM_TPS_DFLT_DEN_GRP ERRM_TPS_DFLT_DTC ERRM_REF_VOLT1_TYP ERRM_REF_VOLT1_MIL_ON ERRM_REF_VOLT1_DEN_GRP ERRM_REF_VOLT1_DTC ERRM_REF_VOLT2_TYP ERRM_REF_VOLT2_MIL_ON ERRM_REF_VOLT2_DEN_GRP ERRM_REF_VOLT2_DTC ERRM_ETC_MOTOR_PERF_TYP ERRM_ETC_MOTOR_PERF_MIL_ON ERRM_ETC_MOTOR_PERF_DEN_GRP ERRM_ETC_MOTOR_PERF_DTC ERRM_ETC_MOTOR_SS_TYP ERRM_ETC_MOTOR_SS_MIL_ON ERRM_ETC_MOTOR_SS_DEN_GRP ERRM_ETC_MOTOR_SS_DTC ERRM_CP_FLW_TYP ERRM_CP_FLW_MIL_ON ERRM_CP_FLW_DEN_GRP ERRM_CP_FLW_DTC ERRM_CP_L_LEAK_TYP ERRM_CP_L_LEAK_MIL_ON ERRM_CP_L_LEAK_DEN_GRP ERRM_CP_L_LEAK_DTC ERRM_CP_S_LEAK_TYP ERRM_CP_S_LEAK_MIL_ON ERRM_CP_S_LEAK_DEN_GRP ERRM_CP_S_LEAK_DTC ERRM_CP_VS_LEAK_TYP ERRM_CP_VS_LEAK_MIL_ON ERRM_CP_VS_LEAK_DEN_GRP ERRM_CP_VS_LEAK_DTC ERRM_CP_VENT_RES_TYP ERRM_CP_VENT_RES_MIL_ON ERRM_CP_VENT_RES_DEN_GRP ERRM_CP_VENT_RES_DTC ERRM_ECM_RAM_TYP ERRM_ECM_RAM_MIL_ON ERRM_ECM_RAM_DEN_GRP ERRM_ECM_RAM_DTC ERRM_ECM_STACK_TYP ERRM_ECM_STACK_MIL_ON ERRM_ECM_STACK_DEN_GRP ERRM_ECM_STACK_DTC ERRM_ECM_ROM_TYP ERRM_ECM_ROM_MIL_ON ERRM_ECM_ROM_DEN_GRP ERRM_ECM_ROM_DTC ERRM_FLV_HI_TYP ERRM_FLV_HI_MIL_ON ERRM_FLV_HI_DEN_GRP ERRM_FLV_HI_DTC ERRM_FLV_LO_TYP ERRM_FLV_LO_MIL_ON ERRM_FLV_LO_DEN_GRP ERRM_FLV_LO_DTC ERRM_B1_FUEL_LEAN_TYP ERRM_B1_FUEL_LEAN_MIL_ON ERRM_B1_FUEL_LEAN_DEN_GRP ERRM_B1_FUEL_LEAN_DTC ERRM_B1_FUEL_RICH_TYP ERRM_B1_FUEL_RICH_MIL_ON ERRM_B1_FUEL_RICH_DEN_GRP ERRM_B1_FUEL_RICH_DTC ERRM_B1_FUEL_IDL_LEAN_TYP ERRM_B1_FUEL_IDL_LEAN_MIL_ON ERRM_B1_FUEL_IDL_LEAN_DEN_GRP ERRM_B1_FUEL_IDL_LEAN_DTC ERRM_B1_FUEL_IDL_RICH_TYP ERRM_B1_FUEL_IDL_RICH_MIL_ON ERRM_B1_FUEL_IDL_RICH_DEN_GRP ERRM_B1_FUEL_IDL_RICH_DTC ERRM_GEAR_R_TYP ERRM_GEAR_R_MIL_ON ERRM_GEAR_R_DEN_GRP ERRM_GEAR_R_DTC ERRM_GEAR_1_TYP ERRM_GEAR_1_MIL_ON ERRM_GEAR_1_DEN_GRP ERRM_GEAR_1_DTC ERRM_GEAR_2_TYP ERRM_GEAR_2_MIL_ON ERRM_GEAR_2_DEN_GRP ERRM_GEAR_2_DTC ERRM_GEAR_3_TYP ERRM_GEAR_3_MIL_ON ERRM_GEAR_3_DEN_GRP ERRM_GEAR_3_DTC ERRM_GEAR_4_TYP ERRM_GEAR_4_MIL_ON ERRM_GEAR_4_DEN_GRP ERRM_GEAR_4_DTC ERRM_GEAR_5_TYP ERRM_GEAR_5_MIL_ON ERRM_GEAR_5_DEN_GRP ERRM_GEAR_5_DTC ERRM_IAT_LO_TYP ERRM_IAT_LO_MIL_ON ERRM_IAT_LO_DEN_GRP ERRM_IAT_LO_DTC ERRM_IAT_HI_TYP ERRM_IAT_HI_MIL_ON ERRM_IAT_HI_DEN_GRP ERRM_IAT_HI_DTC ERRM_IAT_HI_RAT_TYP ERRM_IAT_HI_RAT_MIL_ON ERRM_IAT_HI_RAT_DEN_GRP ERRM_IAT_HI_RAT_DTC ERRM_IAT_LO_RAT_TYP ERRM_IAT_LO_RAT_MIL_ON ERRM_IAT_LO_RAT_DEN_GRP ERRM_IAT_LO_RAT_DTC ERRM_IDL_HI_TYP ERRM_IDL_HI_MIL_ON ERRM_IDL_HI_DEN_GRP ERRM_IDL_HI_DTC ERRM_IDL_LO_TYP ERRM_IDL_LO_MIL_ON ERRM_IDL_LO_DEN_GRP ERRM_IDL_LO_DTC ERRM_IDL_CAT_LO_TYP ERRM_IDL_CAT_LO_MIL_ON ERRM_IDL_CAT_LO_DEN_GRP ERRM_IDL_CAT_LO_DTC ERRM_KNCK_SYS_TYP ERRM_KNCK_SYS_MIL_ON ERRM_KNCK_SYS_DEN_GRP ERRM_KNCK_SYS_LO_DTC ERRM_KNCK_SNSR_TYP ERRM_KNCK_SNSR_MIL_ON ERRM_KNCK_SNSR_DEN_GRP ERRM_KNCK_SNSR_LO_DTC ERRM_ECM_CLK_TYP ERRM_ECM_CLK_MIL_ON ERRM_ECM_CLK_DEN_GRP ERRM_ECM_CLK_DTC ERRM_MAP_RAT_DCL_TYP ERRM_MAP_RAT_DCL_MIL_ON ERRM_MAP_RAT_DCL_DEN_GRP ERRM_MAP_RAT_DCL_DTC ERRM_MAP_RAT_LO_TYP ERRM_MAP_RAT_LO_MIL_ON ERRM_MAP_RAT_LO_DEN_GRP ERRM_MAP_RAT_LO_DTC ERRM_MAP_RAT_HI_TYP ERRM_MAP_RAT_HI_MIL_ON ERRM_MAP_RAT_HI_DEN_GRP ERRM_MAP_RAT_HI_DTC ERRM_ALT_FB_TYP ERRM_ALT_FB_MIL_ON ERRM_ALT_FB_DEN_GRP ERRM_ALT_FB_DTC ERRM_ABS_PWM_TYP ERRM_ABS_PWM_MIL_ON ERRM_ABS_PWM_DEN_GRP ERRM_ABS_PWM_DTC ERRM_MIL_TYP ERRM_MIL_MIL_ON ERRM_MIL_DEN_GRP ERRM_MIL_DTC /end DEF_CHARACTERISTIC
 /begin OUT_MEASUREMENT errm_curr_dtc errm_hist_dtc errm_curr_dtc_typ errm_hist_dtc_typ errm_iupr_denom errm_iupr_numrtr errm_iupr_gen_denom errm_iupr_ign_cnts errm_ign_cyc_tmr errm_den_runtm_tmr errm_den_cp_run_tmr errm_den_vspd_tmr errm_den_idl_tmr errm_b1_air_on_tmr errm_b2_air_on_tmr errm_iupr_fault_actv errm_iupr_fault_actv_nv errm_iupr_cmn_met errm_iupr_amp_met errm_iupr_amb_t_met errm_iupr_idl_met errm_iupr_run_met errm_iupr_vspd_met errm_iupr_ign_cnts_nv errm_iupr_gen_denom_nv errm_iupr_evam_numrtr_nv errm_iupr_evam_denom_nv errm_iupr_egr_vvt_numrtr_nv errm_iupr_egr_vvt_denom_nv errm_iupr_b1_uo2_numrtr_nv errm_iupr_b1_uo2_denom_nv errm_iupr_b1_do2_numrtr_nv errm_iupr_b1_do2_denom_nv errm_iupr_b1_cfd_numrtr_nv errm_iupr_b1_cfd_denom_nv errm_iupr_denom_nv errm_iupr_numrtr_nv errm_iupr_air_denom_nv errm_iupr_air_numrtr_nv errm_iupr_b2_cfd_denom_nv errm_iupr_b2_uo2_denom_nv errm_iupr_b2_do2_denom_nv errm_iupr_b2_cfd_numrtr_nv errm_iupr_b2_do2_numrtr_nv errm_iupr_b2_uo2_numrtr_nv errm_warm_cnts errm_map_fl_met errm_map_fl_actv errm_amp_shrt_actv errm_map_shrt_actv errm_amp_shrt_trip errm_map_shrt_trip errm_ect_fl_actv errm_ect_shrt_met errm_ac_t_shrt_actv errm_iat_shrt_actv errm_iat_shrt_met errm_iat_fl_actv errm_cpu_ad_fl errm_tps_fl_actv errm_tps_shrt_fl_met errm_mf_light_req errm_flv_fl errm_inj_fl_actv errm_est_fl_trip errm_bstp_shrt_actv errm_bstp_shrt_trip /end OUT_MEASUREMENT
/end FUNCTION
/begin RECORD_LAYOUT __UBYTE_S FNC_VALUES 1 UBYTE COLUMN_DIR DIRECT /end RECORD_LAYOUT
/begin RECORD_LAYOUT __UWORD_S FNC_VALUES 1 UWORD COLUMN_DIR DIRECT /end RECORD_LAYOUT
/begin RECORD_LAYOUT __ULONG_S FNC_VALUES 1 ULONG COLUMN_DIR DIRECT /end RECORD_LAYOUT
/begin RECORD_LAYOUT __SWORD_S FNC_VALUES 1 SWORD COLUMN_DIR DIRECT /end RECORD_LAYOUT
/begin RECORD_LAYOUT SSV__UWORD_S AXIS_PTS_X 1 UWORD INDEX_INCR DIRECT /end RECORD_LAYOUT
/begin RECORD_LAYOUT SSV__SWORD_S AXIS_PTS_X 1 SWORD INDEX_INCR DIRECT /end RECORD_LAYOUT
/end MODULE
/end PROJECT
