ASAP2_VERSION 1 60
/begin PROJECT FC33 ""
/begin HEADER "" VERSION "1.0" /end HEADER
/begin MODULE FC33 ""
/begin MOD_COMMON "" BYTE_ORDER MSB_FIRST ALIGNMENT_LONG 2 ALIGNMENT_WORD 1 /end MOD_COMMON
/begin MEASUREMENT hw_nv_fl "true means NVRAM fail happened" UBYTE b_true 0 0 0.00 1.00 BIT_MASK 0x1 ECU_ADDRESS 0x400050DA FORMAT "%1.0" /end MEASUREMENT
/begin MEASUREMENT sys_espd_acl "engine speed acceleration" SWORD u_espd_acl 0 0 -4096 4095.875 ECU_ADDRESS 0x400050DA FORMAT "%6.2" /end MEASUREMENT
/begin MEASUREMENT afm_mdl_amp "model map" UWORD u_kPa_0_256 0 0 0 255.99609375 ECU_ADDRESS 0x400050DA /end MEASUREMENT
/begin MEASUREMENT fmsp_uo2_rch "fuel up o2 rich" UBYTE b_true 0 0 0.00 1.00 BIT_MASK 0x1 ECU_ADDRESS 0x400050DA FORMAT "%1.0" /end MEASUREMENT
/begin MEASUREMENT fmsp_tf_ref_cnts "counts of reference event since fmsp_fuel_st==RUN" UWORD u_cnts 0 0 0.00 65535.00 ECU_ADDRESS 0x4000440A FORMAT "%5.0" /end MEASUREMENT
/begin MEASUREMENT tq_drv_trn_prot_actv "true means drivetrain protection torque limitation is active" UBYTE b_true 0 0 0.00 1.00 BIT_MASK 0x40 ECU_ADDRESS 0x400050DA FORMAT "%1.0" /end MEASUREMENT
/begin MEASUREMENT tq_cyls_en_max "Max number of cylinders allowed to enable fueling by torq control" UBYTE u_cnts 0 0 0 255 ECU_ADDRESS 0x400050DA /end MEASUREMENT
/begin MEASUREMENT tq_fc_actv "true means torque fuel cut off active" UBYTE b_true 0 0 0.00 1.00 BIT_MASK 0x80 ECU_ADDRESS 0x400050DA FORMAT "%1.0" /end MEASUREMENT
/begin MEASUREMENT aux_srly_fco_req "true means fuel cut off is requested due to starter relay fault" UBYTE b_true 0 0 0.00 1.00 BIT_MASK 0x40 ECU_ADDRESS 0x400050DA FORMAT "%1.0" /end MEASUREMENT
/begin MEASUREMENT ensc_idl_flw_st "engine start compensation term of OL idle flow" UWORD u_pct 0 0 0 199.9969482421875 ECU_ADDRESS 0x4000DA4E /end MEASUREMENT
/begin MEASUREMENT thro_actr_typ "actor type" UBYTE u_thro_actr_typ 0 0 0 3 ECU_ADDRESS 0x400050DA FORMAT "%1.0" /end MEASUREMENT
/begin MEASUREMENT errm_map_shrt_actv "map short fail active" UBYTE b_true 0 0 0.00 1.00 BIT_MASK 0x1 ECU_ADDRESS 0x4000440A FORMAT "%1.0" SYMBOL_LINK "errm_press_shrt_actv" 1 /end MEASUREMENT
/begin MEASUREMENT errm_boost_t_shrt_actv "boost temp short fail active" UBYTE b_true 0 0 0.00 1.00 BIT_MASK 0x1 ECU_ADDRESS 0x4000440A FORMAT "%1.0" SYMBOL_LINK "errm_temp_shrt_actv" 2 /end MEASUREMENT
/begin MEASUREMENT errm_boost_t_shrt_met "boost temp short fail met" UBYTE b_true 0 0 0.00 1.00 BIT_MASK 0x1 ECU_ADDRESS 0x4000440A FORMAT "%1.0" SYMBOL_LINK "errm_temp_shrt_met" 2 /end MEASUREMENT
/begin MEASUREMENT errm_map_shrt_trip "map short fail this keyon" UBYTE b_true 0 0 0.00 1.00 BIT_MASK 0x1 ECU_ADDRESS 0x4000440A FORMAT "%1.0" SYMBOL_LINK "errm_press_shrt_trip" 1 /end MEASUREMENT
/begin MEASUREMENT cfd_af_rmp_actv "true means af is currently ramping due to CFD" UBYTE b_true 0 0 0.00 1.00 BIT_MASK 0x1 ECU_ADDRESS 0x400050DA FORMAT "%1.0" /end MEASUREMENT
/begin MEASUREMENT cfd_af_actv "current af in CFD" UWORD u_afr 0 0 0.0 31.99951171875 ECU_ADDRESS 0x4000DA4E /end MEASUREMENT
/begin MEASUREMENT osd_rsp_pow_tm_raw "raw response time of last do2 sensor POW response diag" UWORD u_1x_tmr 0 0 0.0 511.9921875 ECU_ADDRESS 0x4000DA4E FORMAT "%6.3" /end MEASUREMENT
/begin MEASUREMENT osd_rsp_pow_fn "do2 sensor POW response diag finished" UBYTE b_true 0 0 0.00 1.00 BIT_MASK 0x1 ECU_ADDRESS 0x40003F41 FORMAT "%1.0" /end MEASUREMENT
/begin MEASUREMENT osd_rsp_pow_fl "do2 sensor POW response diag failed" UBYTE b_true 0 0 0.00 1.00 BIT_MASK 0x1 ECU_ADDRESS 0x40003F41 FORMAT "%1.0" /end MEASUREMENT
/begin MEASUREMENT cpd_map_hi_fl_cnt "map sensor short high fail counts" UWORD u_cnts 0 0 0 65535 ECU_ADDRESS 0x40004EA0 FORMAT "%5.0" SYMBOL_LINK "cpd_map_hi_fl_cnt" 6 /end MEASUREMENT
/begin MEASUREMENT cpd_map_hi_diag_cnt "map sensor short high diag counts" UWORD u_cnts 0 0 0 65535 ECU_ADDRESS 0x40004EA0 FORMAT "%5.0" SYMBOL_LINK "cpd_map_hi_diag_cnt" 8 /end MEASUREMENT
/begin MEASUREMENT cpd_map_hi_diag_en "map sensor short high diag enable conditions met" UBYTE b_true 0 0 0.00 1.00 BIT_MASK 0x20 ECU_ADDRESS 0x40004EA0 FORMAT "%5.0" SYMBOL_LINK "cpd_map_hi_diag_en" 10 /end MEASUREMENT
/begin MEASUREMENT cpd_map_hi_fl_met "map sensor short high diag fail conditions met" UBYTE b_true 0 0 0.00 1.00 BIT_MASK 0x10 ECU_ADDRESS 0x40004EA0 FORMAT "%5.0" SYMBOL_LINK "cpd_map_hi_fl_met" 10 /end MEASUREMENT
/begin MEASUREMENT cpd_map_hi_fn "map sensor short high diag finish" UBYTE b_true 0 0 0.00 1.00 BIT_MASK 0x08 ECU_ADDRESS 0x40004EA0 FORMAT "%5.0" SYMBOL_LINK "cpd_map_hi_fn" 10 /end MEASUREMENT
/begin MEASUREMENT cpd_map_hi_fl "map sensor short high diag fail" UBYTE b_true 0 0 0.00 1.00 BIT_MASK 0x04 ECU_ADDRESS 0x40004EA0 FORMAT "%5.0" SYMBOL_LINK "cpd_map_hi_fl" 10 /end MEASUREMENT
/begin MEASUREMENT cpd_map_hi_rpt_st "map sensor short high diag report state" UBYTE u_rpt_st 0 0 0.00 2.00 BIT_MASK 0x03 ECU_ADDRESS 0x40004EA0 SYMBOL_LINK "cpd_map_hi_rpt_st" 10 /end MEASUREMENT
/begin MEASUREMENT cpd_map_lo_fl_cnt "map sensor short low fail counts" UWORD u_cnts 0 0 0 65535 ECU_ADDRESS 0x40004EA0 FORMAT "%5.0" SYMBOL_LINK "cpd_map_lo_fl_cnt" 6 /end MEASUREMENT
/begin MEASUREMENT cpd_map_lo_diag_cnt "map sensor short low diag counts" UWORD u_cnts 0 0 0 65535 ECU_ADDRESS 0x40004EA0 FORMAT "%5.0" SYMBOL_LINK "cpd_map_lo_diag_cnt" 8 /end MEASUREMENT
/begin MEASUREMENT cpd_map_lo_diag_en "map sensor short low diag enable conditions met" UBYTE b_true 0 0 0.00 1.00 BIT_MASK 0x20 ECU_ADDRESS 0x40004EA0 FORMAT "%5.0" SYMBOL_LINK "cpd_map_lo_diag_en" 10 /end MEASUREMENT
/begin MEASUREMENT cpd_map_lo_fl_met "map sensor short low diag fail conditions met" UBYTE b_true 0 0 0.00 1.00 BIT_MASK 0x10 ECU_ADDRESS 0x40004EA0 FORMAT "%5.0" SYMBOL_LINK "cpd_map_lo_fl_met" 10 /end MEASUREMENT
/begin MEASUREMENT cpd_map_lo_fn "map sensor short low diag finish" UBYTE b_true 0 0 0.00 1.00 BIT_MASK 0x08 ECU_ADDRESS 0x40004EA0 FORMAT "%5.0" SYMBOL_LINK "cpd_map_lo_fn" 10 /end MEASUREMENT
/begin MEASUREMENT cpd_map_lo_fl "map sensor short low diag fail" UBYTE b_true 0 0 0.00 1.00 BIT_MASK 0x04 ECU_ADDRESS 0x40004EA0 FORMAT "%5.0" SYMBOL_LINK "cpd_map_lo_fl" 10 /end MEASUREMENT
/begin MEASUREMENT cpd_map_lo_rpt_st "map sensor short low diag report state" UBYTE u_rpt_st 0 0 0.00 2.00 BIT_MASK 0x03 ECU_ADDRESS 0x40004EA0 SYMBOL_LINK "cpd_map_lo_rpt_st" 10 /end MEASUREMENT
/begin MEASUREMENT cpd_ac_t_hi_fl "ac temp high fail" UBYTE b_true 0 0 0.00 1.00 ECU_ADDRESS 0x40004EA0 FORMAT "%1.0" /end MEASUREMENT
/begin MEASUREMENT cpd_ac_t_lo_fl "ac temp low fail" UBYTE b_true 0 0 0.00 1.00 ECU_ADDRESS 0x40004EA0 FORMAT "%1.0" /end MEASUREMENT
/begin MEASUREMENT ecsd_ect_lo_en_st "ect low enable state" UBYTE u_ecsd_lo_en_st 0 0 0.00 12.00 ECU_ADDRESS 0x40004EA0 FORMAT "%2.0" /end MEASUREMENT
/*-----------GPF Engine Out----------*/ /*-----------GPF Regen---------------*/
/begin MEASUREMENT gpf_regen_stat_cond_st_eng_runtime "" UBYTE b_true 0 0 0.00 1.00 BIT_MASK 0x80 ECU_ADDRESS 0x40001B61 FORMAT "%1.0" SYMBOL_LINK "gpf_regen_stat_cond_st" 0 /end MEASUREMENT
/begin MEASUREMENT gpf_regen_stat_cond_st_IMEP "" UBYTE b_true 0 0 0.00 1.00 BIT_MASK 0x40 ECU_ADDRESS 0x40001B61 FORMAT "%1.0" SYMBOL_LINK "gpf_regen_stat_cond_st" 0 /end MEASUREMENT
/begin MEASUREMENT gpf_regen_stat_cond_st_BAT_volt "" UBYTE b_true 0 0 0.00 1.00 BIT_MASK 0x20 ECU_ADDRESS 0x40001B61 FORMAT "%1.0" SYMBOL_LINK "gpf_regen_stat_cond_st" 0 /end MEASUREMENT
/begin MEASUREMENT gpf_regen_stat_cond_st_tank_level "" UBYTE b_true 0 0 0.00 1.00 BIT_MASK 0x10 ECU_ADDRESS 0x40001B61 FORMAT "%1.0" SYMBOL_LINK "gpf_regen_stat_cond_st" 0 /end MEASUREMENT
/begin MEASUREMENT gpf_regen_stat_cond_st_IAT "" UBYTE b_true 0 0 0.00 1.00 BIT_MASK 0x08 ECU_ADDRESS 0x40001B61 FORMAT "%1.0" SYMBOL_LINK "gpf_regen_stat_cond_st" 0 /end MEASUREMENT
/begin MEASUREMENT gpf_regen_stat_cond_st_MPH "" UBYTE b_true 0 0 0.00 1.00 BIT_MASK 0x04 ECU_ADDRESS 0x40001B61 FORMAT "%1.0" SYMBOL_LINK "gpf_regen_stat_cond_st" 0 /end MEASUREMENT
/begin MEASUREMENT gpf_regen_stat_cond_st_RPM "" UBYTE b_true 0 0 0.00 1.00 BIT_MASK 0x02 ECU_ADDRESS 0x40001B61 FORMAT "%1.0" SYMBOL_LINK "gpf_regen_stat_cond_st" 0 /end MEASUREMENT
/begin MEASUREMENT gpf_regen_stat_cond_st_BYPASS "" UBYTE b_true 0 0 0.00 1.00 BIT_MASK 0x01 ECU_ADDRESS 0x40001B61 FORMAT "%1.0" SYMBOL_LINK "gpf_regen_stat_cond_st" 0 /end MEASUREMENT
/begin MEASUREMENT gpf_regen_oper_cond_st_CLNT "" UBYTE b_true 0 0 0.00 1.00 BIT_MASK 0x80 ECU_ADDRESS 0x40001B61 FORMAT "%1.0" SYMBOL_LINK "gpf_regen_oper_cond_st" 0 /end MEASUREMENT
/begin MEASUREMENT gpf_regen_oper_cond_st_INLET "" UBYTE b_true 0 0 0.00 1.00 BIT_MASK 0x40 ECU_ADDRESS 0x40001B61 FORMAT "%1.0" SYMBOL_LINK "gpf_regen_oper_cond_st" 0 /end MEASUREMENT
/begin MEASUREMENT gpf_regen_oper_cond_st_OIL "" UBYTE b_true 0 0 0.00 1.00 BIT_MASK 0x20 ECU_ADDRESS 0x40001B61 FORMAT "%1.0" SYMBOL_LINK "gpf_regen_oper_cond_st" 0 /end MEASUREMENT
/begin MEASUREMENT gpf_regen_oper_cond_st_TURBO "" UBYTE b_true 0 0 0.00 1.00 BIT_MASK 0x10 ECU_ADDRESS 0x40001B61 FORMAT "%1.0" SYMBOL_LINK "gpf_regen_oper_cond_st" 0 /end MEASUREMENT
/begin MEASUREMENT gpf_regen_oper_cond_st_TWC "" UBYTE b_true 0 0 0.00 1.00 BIT_MASK 0x08 ECU_ADDRESS 0x40001B61 FORMAT "%1.0" SYMBOL_LINK "gpf_regen_oper_cond_st" 0 /end MEASUREMENT
/begin MEASUREMENT gpf_regen_oper_cond_st_BYPASS "" UBYTE b_true 0 0 0.00 1.00 BIT_MASK 0x04 ECU_ADDRESS 0x40001B61 FORMAT "%1.0" SYMBOL_LINK "gpf_regen_oper_cond_st" 0 /end MEASUREMENT
/begin MEASUREMENT gpf_crtic_soot_req "" UBYTE b_true 0 0 0.00 1.00 ECU_ADDRESS 0x40001B61 FORMAT "%1.0" /end MEASUREMENT
/begin MEASUREMENT gpf_ht_regen_req "" UBYTE b_true 0 0 0.00 1.00 ECU_ADDRESS 0x40001B61 FORMAT "%1.0" /end MEASUREMENT
/begin MEASUREMENT gpf_hi_o2_regen_req "" UBYTE b_true 0 0 0.00 1.00 ECU_ADDRESS 0x40001B61 FORMAT "%1.0" /end MEASUREMENT
/begin MEASUREMENT gpf_hi_soot_regen_req "" UBYTE b_true 0 0 0.00 1.00 ECU_ADDRESS 0x40001B61 FORMAT "%1.0" /end MEASUREMENT
/begin MEASUREMENT gpf_low_temp_regen_req "" UBYTE b_true 0 0 0.00 1.00 ECU_ADDRESS 0x40001B61 FORMAT "%1.0" /end MEASUREMENT
/begin MEASUREMENT gpf_regen_rtm "" UWORD p_t_GPF_COUNT_0_65535 0 0.000000 0.000000 65535 ECU_ADDRESS 0x40001B61 /end MEASUREMENT
/begin MEASUREMENT gpf_regen_conds_met "" UBYTE b_true 0 0 0.00 1.00 ECU_ADDRESS 0x40001B61 FORMAT "%1.0" /end MEASUREMENT
/begin MEASUREMENT gpf_regen_tm " " UWORD u_2x_tmr 0 0 0.0 1023.984375 ECU_ADDRESS 0x40004D90 /end MEASUREMENT
/begin MEASUREMENT gpf_sel_accu_soot "ratio" UWORD u_fac_256 0 0 0 255.99609375 ECU_ADDRESS 0x4000561A FORMAT "%6.3" /end MEASUREMENT
/begin MEASUREMENT gpf_eo_accu_soot "ratio" UWORD u_fac_256 0 0 0 255.99609375 ECU_ADDRESS 0x4000561A FORMAT "%6.3" /end MEASUREMENT
/begin MEASUREMENT gpf_dp_accu_soot "ratio" UWORD u_fac_256 0 0 0 255.99609375 ECU_ADDRESS 0x4000561A FORMAT "%6.3" /end MEASUREMENT
/begin MEASUREMENT gpf_sel_soot_tot "" UWORD p_t_GPF_SM_0_128 0 0.000000 0.000000 127.998047 ECU_ADDRESS 0x40001B61 /end MEASUREMENT
/begin MEASUREMENT gpf_regen_req "" UBYTE b_true 0 0 0.00 1.00 ECU_ADDRESS 0x40001B61 FORMAT "%1.0" /end MEASUREMENT
/begin MEASUREMENT gpf_low_temp_regen_tm " " UWORD u_2x_tmr 0 0 0.0 1023.984375 ECU_ADDRESS 0x40004D90 /end MEASUREMENT
/begin MEASUREMENT gpf_o2_temp_max_thresh "" SWORD p_t_GPF_TEMP_N2048_2048 0 0.000000 -2048 2047.937500 ECU_ADDRESS 0x40001B61 /end MEASUREMENT
/begin MEASUREMENT gpf_hi_soot_regen_enbl_tm " " UWORD u_2x_tmr 0 0 0.0 1023.984375 ECU_ADDRESS 0x40004D90 /end MEASUREMENT
/begin MEASUREMENT gpf_hi_soot_regen_dsbl_tm " " UWORD u_2x_tmr 0 0 0.0 1023.984375 ECU_ADDRESS 0x40004D90 /end MEASUREMENT
/begin MEASUREMENT gpf_trgt_afr "" UWORD u_afr 0 0 0.0 31.99951171875 ECU_ADDRESS 0x40002582 /end MEASUREMENT
/begin MEASUREMENT gpf_trgt_temp "" SWORD p_t_GPF_TEMP_N2048_2048 0 0.000000 -2048 2047.937500 ECU_ADDRESS 0x40001B61 /end MEASUREMENT
/begin MEASUREMENT gpf_trgt_temp_diff "" SWORD p_t_GPF_TEMP_N2048_2048 0 0.000000 -2048 2047.937500 ECU_ADDRESS 0x40001B61 /end MEASUREMENT
/begin MEASUREMENT gpf_add_tq "" UWORD p_t_GPF_TRQ_0_255 0 0.000000 0 255 ECU_ADDRESS 0x40001B61 /end MEASUREMENT
/begin MEASUREMENT gpf_afr "" UWORD u_afr 0 0 0.0 31.99951171875 ECU_ADDRESS 0x40002582 /end MEASUREMENT
/begin MEASUREMENT gpf_ash_rst_tm_thresh " " UWORD u_2x_tmr 0 0 0.0 1023.984375 ECU_ADDRESS 0x40004D90 /end MEASUREMENT
/*-----------GPF Regen---------------*/ /*-----------GPF IO------------------*/
/begin MEASUREMENT gpf_dp_avg_flt "" SWORD p_t_GPF_DP_N128_128 0 0.000000 -128 127.996094 ECU_ADDRESS 0x40001B61 /end MEASUREMENT
/begin MEASUREMENT gpf_temp_in_flt "" SWORD p_t_GPF_TEMP_N2048_2048 0 0.000000 -2048 2047.937500 ECU_ADDRESS 0x40001B61 /end MEASUREMENT
/begin MEASUREMENT gpf_temp_in_flt_k "" UWORD p_t_GPF_TEMPK_0_2048 0 0.000000 0 2047.968750 ECU_ADDRESS 0x40001B61 /end MEASUREMENT
/begin MEASUREMENT gpf_dp "" SWORD p_t_GPF_DP_N128_128 0 0.000000 -128 127.996094 ECU_ADDRESS 0x40001B61 /end MEASUREMENT
/begin MEASUREMENT gpf_dp_raw "" UWORD u_pct_1 0 0 0 99.9984741210937 ECU_ADDRESS 0x40004E0E FORMAT "%4.1" /end MEASUREMENT
/begin MEASUREMENT gpf_temp_in_k "" UWORD p_t_GPF_TEMPK_0_2048 0 0.000000 0 2047.968750 ECU_ADDRESS 0x40001B61 /end MEASUREMENT
/begin MEASUREMENT gpf_temp_in_raw "" UWORD u_pct_1 0 0 0 99.9984741210937 ECU_ADDRESS 0x40004E0E FORMAT "%4.1" /end MEASUREMENT
/begin MEASUREMENT gpf_puc_dsbl "gpf disable PUC." UBYTE b_true 0 0 0.00 1.00 ECU_ADDRESS 0x40001B61 FORMAT "%1.0" /end MEASUREMENT
/begin CHARACTERISTIC HW_V_EST_CFG "EST config" VALUE 0x0002038C __UBYTE_S 0 u_est_cfg 0 1 FORMAT "%1.0" /end CHARACTERISTIC
/begin CHARACTERISTIC SYS_V_CRU_SW_TYP "cruise switch type" VALUE 0x0002038C __UBYTE_S 0 u_cru_sw_typ 0 1 FORMAT "%1.0" /end CHARACTERISTIC
/begin CHARACTERISTIC AFM_V_IAT_MDL_CFG "Intake temperature model axis config" VALUE 0x0002038C __UBYTE_S 0 u_iat_cfg 0 1 FORMAT "%1.0" /end CHARACTERISTIC
/begin CHARACTERISTIC FMSP_M_RUN_AF_BS "run af base" MAP 0x00020320 __UBYTE_S 0 u_afr_b 0 31.875 FORMAT "%4.2" SYMBOL_LINK "FMSP_M_RUN_AF_BS" 3
 /begin AXIS_DESCR FIX_AXIS sys_eng_spd u_espd 17 0 6400
  /begin FIX_AXIS_PAR_LIST 0 3200 6400 9600 12800 16000 19200 22400 25600 28800 32000 35200 38400 41600 44800 48000 51200 /end FIX_AXIS_PAR_LIST
 /end AXIS_DESCR
 /begin AXIS_DESCR FIX_AXIS sys_map u_kPa_0_256 24 20 255
  /begin FIX_AXIS_PAR_LIST 5120 7680 10240 12800 14080 15360 16640 17920 19200 20480 21760 23040 24320 25600 28160 30720 33280 35840 38400 40960 43520 46080 48640 51200 /end FIX_AXIS_PAR_LIST
 /end AXIS_DESCR
/end CHARACTERISTIC
/begin CHARACTERISTIC FMSP_M_TF_WALL_FILM_FAC "factor of injected fuel into wall film term" MAP 0x39A2B __UWORD_S 0 u_fac_1 0 0.999984741210937 FORMAT "%6.5" SYMBOL_LINK "FMSP_M_TF_WALL_FILM_FAC" 4
 /begin AXIS_DESCR FIX_AXIS afm_intk_vlv_t u_deg_K_512 9 243 403 /begin FIX_AXIS_PAR_LIST 31104 33664 36224 38784 41344 43904 46464 49024 51584 /end FIX_AXIS_PAR_LIST /end AXIS_DESCR
 /begin AXIS_DESCR FIX_AXIS sys_map u_kPa_0_256 9 20 200 /begin FIX_AXIS_PAR_LIST 5120 7680 10240 12800 15360 17920 20480 23040 25600 /end FIX_AXIS_PAR_LIST /end AXIS_DESCR
/end CHARACTERISTIC
/begin CHARACTERISTIC FMSP_M_TF_NEG_MAP_FAC "map factor used to calculate fmsp_tf_comp when fmsp_tf_comp<0" MAP 0x39A2B __UWORD_S 0 u_fac_4 0 3.99993896484375 FORMAT "%6.5" SYMBOL_LINK "FMSP_M_TF_NEG_MAP_FAC" 4
 /begin AXIS_DESCR FIX_AXIS afm_intk_vlv_t u_deg_K_512 9 243 403 /begin FIX_AXIS_PAR_LIST 31104 33664 36224 38784 41344 43904 46464 49024 51584 /end FIX_AXIS_PAR_LIST /end AXIS_DESCR
 /begin AXIS_DESCR FIX_AXIS sys_map u_kPa_0_256 9 20 200 /begin FIX_AXIS_PAR_LIST 5120 7680 10240 12800 15360 17920 20480 23040 25600 /end FIX_AXIS_PAR_LIST /end AXIS_DESCR
/end CHARACTERISTIC
/begin AXIS_PTS IG_X_IMEP_B "imep breakpoint" 0x0002006C tq_estd_imep_ref SSV__UWORD_S 0 u_kPa_0_4096 17 0.000000 4095.937500 DEPOSIT ABSOLUTE SYMBOL_LINK "IG_X_IMEP_B" 2 /end AXIS_PTS
/begin AXIS_PTS IG_X_IMEP_B "imep breakpoint" 0x0002006C tq_estd_imep_ref SSV__UWORD_S 0 u_kPa_0_4096 25 0.000000 4095.937500 DEPOSIT ABSOLUTE SYMBOL_LINK "IG_X_IMEP_B" 2 /end AXIS_PTS
/begin CHARACTERISTIC IG_M_IGA_VVT_BIAS "vvt bias of base ignition angle" MAP 0x00020320 __SBYTE_S 0 u_iga_n_b -64 63.5 SYMBOL_LINK "IG_M_IGA_VVT_BIAS" 3
 /begin AXIS_DESCR COM_AXIS sys_eng_spd u_espd 15 0.000000 8191.875000 AXIS_PTS_REF VVT_X_ESPD_A /end AXIS_DESCR
 /begin AXIS_DESCR COM_AXIS tq_estd_imep_ref u_kPa_0_4096 25 0.000000 4095.937500 AXIS_PTS_REF IG_X_IMEP_B /end AXIS_DESCR
/end CHARACTERISTIC
/begin AXIS_PTS TQ_X_ESPD_C "engine speed breakpoint" 0x0002006C sys_eng_spd SSV__UWORD_S 0 u_espd 21 0.000000 8191.875000 FORMAT "%5.1" DEPOSIT ABSOLUTE SYMBOL_LINK "TQ_X_ESPD_C" 2 /end AXIS_PTS
/begin CHARACTERISTIC TQ_C_PMP_MEP_THRO "pumping mean effective pressure from throttle" CURVE 0x000200B0 __SWORD_S 0 u_kPa_512n_512p -512 511.984375 FORMAT "%4.1" SYMBOL_LINK "TQ_C_PMP_MEP_THRO" 2
 /begin AXIS_DESCR FIX_AXIS tq_exh_to_intk_p_dlt u_kPa_256n_256p 25 -20 220
  /begin FIX_AXIS_PAR_LIST -2560 -1280 0 1280 2560 3840 5120 6400 7680 8960 10240 11520 12800 14080 15360 16640 17920 19200 20480 21760 23040 24320 25600 26880 28160 /end FIX_AXIS_PAR_LIST
 /end AXIS_DESCR
/end CHARACTERISTIC
/begin CHARACTERISTIC TQ_M_PMP_MEP_VALV "pumping mean effective pressure from valve" MAP 0x00020320 __SWORD_S 0 u_kPa_512n_512p -512 511.984375 FORMAT "%4.1" SYMBOL_LINK "TQ_M_PMP_MEP_VALV" 4
 /begin AXIS_DESCR FIX_AXIS afm_stk_flw_pct u_pct_8 25 0 240
  /begin FIX_AXIS_PAR_LIST 0 819 1638 2457 3276 4096 4915 5734 6553 7372 8192 9011 9830 10649 11468 12288 13107 13926 14745 15564 16384 17203 18022 18841 19660 /end FIX_AXIS_PAR_LIST
 /end AXIS_DESCR
 /begin AXIS_DESCR COM_AXIS sys_eng_spd u_espd 21 0.000000 8191.875000 AXIS_PTS_REF TQ_X_ESPD_C /end AXIS_DESCR
/end CHARACTERISTIC
/begin CHARACTERISTIC TQ_V_SLW_MODE_ESPD_THR "engine speed threshold below which to enable torque slow control mode when PUC disable due to catalyst temp high" VALUE 0x3964E __UWORD_S 0 u_espd 0.0 8191.875 FORMAT "%6.2" /end CHARACTERISTIC
/begin CHARACTERISTIC TQ_V_MS_AFR_MN "Min AFR limit for air mass calculation." VALUE 0x0002038C __UWORD_S 0 u_afr 0 31.99951171875 FORMAT "%5.0" /end CHARACTERISTIC
/begin CHARACTERISTIC EXTC_M_CAT_T_BASE "cat temp base" MAP 0x00020320 __SWORD_S 0 u_deg_C_n2048_p2048 -2048 2047.9375 SYMBOL_LINK "EXTC_M_CAT_T_BASE" 4
 /begin AXIS_DESCR FIX_AXIS tq_imep_ref u_kPa_0_4096 17 0 1600
  /begin FIX_AXIS_PAR_LIST 0 1600 3200 4800 6400 8000 9600 11200 12800 14400 16000 17600 19200 20800 22400 24000 25600 /end FIX_AXIS_PAR_LIST
 /end AXIS_DESCR
 /begin AXIS_DESCR FIX_AXIS sys_eng_spd u_espd 9 0 6400 /begin FIX_AXIS_PAR_LIST 0 6400 12800 19200 25600 32000 38400 44800 51200 /end FIX_AXIS_PAR_LIST /end AXIS_DESCR
/end CHARACTERISTIC
/begin AXIS_PTS KNCK_X_IMEP "" 0x0002006C tq_imep_ref SSV__UWORD_S 0 u_kPa_0_4096 13 0 4095.937500 DEPOSIT ABSOLUTE SYMBOL_LINK "KNCK_X_IMEP" 2 /end AXIS_PTS
/begin CHARACTERISTIC KNCK_M_WIN_STRT_ANG "Beginning of measurement knock window" MAP 0x00020320 __SWORD_S 0 u_crk_ang_a -512 511.984375 SYMBOL_LINK "KNCK_M_WIN_STRT_ANG" 4
 /begin AXIS_DESCR COM_AXIS tq_imep_ref u_kPa_0_4096 22 0 4095.937500 AXIS_PTS_REF KNCK_X_IMEP /end AXIS_DESCR
 /begin AXIS_DESCR FIX_AXIS sys_eng_spd u_espd 15 800 6400
  /begin FIX_AXIS_PAR_LIST 6400 9600 12800 16000 19200 22400 25600 28800 32000 35200 38400 41600 44800 48000 51200 /end FIX_AXIS_PAR_LIST
 /end AXIS_DESCR
/end CHARACTERISTIC
/begin AXIS_PTS KNCK_X_IMEP "" 0x0002006C tq_imep_ref SSV__UWORD_S 0 u_kPa_0_4096 22 0 4095.937500 DEPOSIT ABSOLUTE SYMBOL_LINK "KNCK_X_IMEP" 2 /end AXIS_PTS
/begin CHARACTERISTIC VVT_M_INTK_SP "intake vvt setpoint" MAP 0x00020320 __SBYTE_S 0 u_iga_64n_64p_b -64 63.5 SYMBOL_LINK "VVT_M_INTK_SP" 3
 /begin AXIS_DESCR COM_AXIS sys_eng_spd u_espd 15 0.000000 8191.875000 AXIS_PTS_REF VVT_X_ESPD_A /end AXIS_DESCR
 /begin AXIS_DESCR FIX_AXIS tq_estd_imep_ref u_kPa_0_4096 25 0 2400
  /begin FIX_AXIS_PAR_LIST 0 1600 3200 4800 6400 8000 9600 11200 12800 14400 16000 17600 19200 20800 22400 24000 25600 27200 28800 30400 32000 33600 35200 36800 38400 /end FIX_AXIS_PAR_LIST
 /end AXIS_DESCR
/end CHARACTERISTIC
/begin CHARACTERISTIC VVT_M_EXH_SP "exhaust vvt setpoint" MAP 0x00020320 __SBYTE_S 0 u_iga_64n_64p_b -64 63.5 SYMBOL_LINK "VVT_M_EXH_SP" 3
 /begin AXIS_DESCR COM_AXIS sys_eng_spd u_espd 15 0.000000 8191.875000 AXIS_PTS_REF VVT_X_ESPD_A /end AXIS_DESCR
 /begin AXIS_DESCR FIX_AXIS tq_estd_imep_ref u_kPa_0_4096 25 0 2400
  /begin FIX_AXIS_PAR_LIST 0 1600 3200 4800 6400 8000 9600 11200 12800 14400 16000 17600 19200 20800 22400 24000 25600 27200 28800 30400 32000 33600 35200 36800 38400 /end FIX_AXIS_PAR_LIST
 /end AXIS_DESCR
/end CHARACTERISTIC
/begin AXIS_PTS VVT_X_ESPD_A "espd breakpoint" 0x0002006C sys_eng_spd SSV__UWORD_S 0 u_espd 15 0.000000 8191.875000 FORMAT "%5.1" DEPOSIT ABSOLUTE SYMBOL_LINK "VVT_X_ESPD_A" 2 /end AXIS_PTS
/begin CHARACTERISTIC OSD_C_UO2_HI_ECT_THR "min engine coolant threshold to enable uo2 short high diag" CURVE 0x000200B0 __SWORD_S 0 u_deg_C -256 255.9921875 SYMBOL_LINK "OSD_C_UO2_HI_ECT_THR" 2
 /begin AXIS_DESCR FIX_AXIS sys_keyon_ect u_deg_C 5 -40 40 /begin FIX_AXIS_PAR_LIST -5120 -2560 0 2560 5120 /end FIX_AXIS_PAR_LIST /end AXIS_DESCR
/end CHARACTERISTIC
/begin CHARACTERISTIC OSD_V_UO2_HI_EN_DLY "delay time to enable uo2 short high diag" VALUE 0x0002038C __UWORD_S 0 u_16x_tmr 0.0 8191.875 FORMAT "%6.2" /end CHARACTERISTIC
/begin CHARACTERISTIC OSD_V_UO2_HI_RUN_MIN "min engine runtime threshold to enable uo2 short high diag" VALUE 0x0002038C __UWORD_S 0 u_1s_tmr 0 65535 /end CHARACTERISTIC
/begin CHARACTERISTIC FS_V_EN_AMP "fuel system enable amp min" VALUE 0x0002038C __UWORD_S 0 u_kPa_0_256 0 255.99609375 FORMAT "%4.1" /end CHARACTERISTIC
/begin CHARACTERISTIC FS_V_EN_IAT "fuel system enable iat min" VALUE 0x0002038C __SWORD_S 0 u_deg_C -256 255.9921875 FORMAT "%4.1" /end CHARACTERISTIC
/begin CHARACTERISTIC FS_V_EN_VLT "fuel system enable voltage min" VALUE 0x0002038C __UWORD_S 0 u_volt_32 0 31.99951171875 FORMAT "%5.3" /end CHARACTERISTIC
/begin CHARACTERISTIC FS_C_EN_AR "fuel system enable cell" CURVE 0x000200B0 __UBYTE_S 0 b_enable 0 1 FORMAT "%5.2"
 /begin AXIS_DESCR FIX_AXIS fmsp_adp_area u_cnts 16 0 15 /begin FIX_AXIS_PAR_LIST 0 1 2 3 4 5 6 7 8 9 10 11 12 13 14 15 /end FIX_AXIS_PAR_LIST /end AXIS_DESCR
/end CHARACTERISTIC
/begin CHARACTERISTIC FS_C_DIAG_CNTS "idle fuel system diag counts" CURVE 0x000200B0 __UBYTE_S 0 u_cnts 0 255
 /begin AXIS_DESCR FIX_AXIS fmsp_adp_area u_cnts 16 0 15 /begin FIX_AXIS_PAR_LIST 0 1 2 3 4 5 6 7 8 9 10 11 12 13 14 15 /end FIX_AXIS_PAR_LIST /end AXIS_DESCR
/end CHARACTERISTIC
/begin CHARACTERISTIC FS_C_LEAN_FL_CNTS "fuel system lean fail counts" CURVE 0x000200B0 __UBYTE_S 0 u_cnts 0 255
 /begin AXIS_DESCR FIX_AXIS fmsp_adp_area u_cnts 16 0 15 /begin FIX_AXIS_PAR_LIST 0 1 2 3 4 5 6 7 8 9 10 11 12 13 14 15 /end FIX_AXIS_PAR_LIST /end AXIS_DESCR
/end CHARACTERISTIC
/begin CHARACTERISTIC FS_C_RICH_FL_CNTS "fuel system rich fail counts" CURVE 0x000200B0 __UBYTE_S 0 u_cnts 0 255
 /begin AXIS_DESCR FIX_AXIS fmsp_adp_area u_cnts 16 0 15 /begin FIX_AXIS_PAR_LIST 0 1 2 3 4 5 6 7 8 9 10 11 12 13 14 15 /end FIX_AXIS_PAR_LIST /end AXIS_DESCR
/end CHARACTERISTIC
/begin CHARACTERISTIC FS_C_LEAN_MET_DLY "fuel system lean met delay" CURVE 0x000200B0 __UWORD_S 0 u_250m_tmr 0 16383.75 FORMAT "%7.2"
 /begin AXIS_DESCR FIX_AXIS fmsp_adp_area u_cnts 16 0 15 /begin FIX_AXIS_PAR_LIST 0 1 2 3 4 5 6 7 8 9 10 11 12 13 14 15 /end FIX_AXIS_PAR_LIST /end AXIS_DESCR
/end CHARACTERISTIC
/begin CHARACTERISTIC FS_C_RICH_MET_DLY "fuel system rich met delay" CURVE 0x000200B0 __UWORD_S 0 u_250m_tmr 0 16383.75 FORMAT "%7.2"
 /begin AXIS_DESCR FIX_AXIS fmsp_adp_area u_cnts 16 0 15 /begin FIX_AXIS_PAR_LIST 0 1 2 3 4 5 6 7 8 9 10 11 12 13 14 15 /end FIX_AXIS_PAR_LIST /end AXIS_DESCR
/end CHARACTERISTIC
/begin CHARACTERISTIC FS_V_PASS_AR_CNTS "fuel system pass area counts min" VALUE 0x0002038C __UBYTE_S 0 u_cnts 0 255 /end CHARACTERISTIC
/begin CHARACTERISTIC CPD_V_MAP_VLT_HI "map short high fail voltage" VALUE 0x0002038C __UWORD_S 0 u_ad_volt 0 4.9999237060546875 FORMAT "%4.3" SYMBOL_LINK "CPD_C_P_VLT_HI" 2 /end CHARACTERISTIC
/begin CHARACTERISTIC CPD_V_MAP_HI_FL_CNTS "map short high fail counts" VALUE 0x0002038C __UWORD_S 0 u_cnts 0 65535 FORMAT "%5.0" SYMBOL_LINK "CPD_C_P_HI_FL_CNTS" 4 /end CHARACTERISTIC
/begin CHARACTERISTIC CPD_V_MAP_VLT_LO "map short low fail voltage" VALUE 0x0002038C __UWORD_S 0 u_ad_volt 0 4.9999237060546875 FORMAT "%4.3" SYMBOL_LINK "CPD_C_P_VLT_LO" 2 /end CHARACTERISTIC
/begin CHARACTERISTIC CPD_V_MAP_LO_FL_CNTS "map short high fail conts" VALUE 0x0002038C __UWORD_S 0 u_cnts 0 65535 FORMAT "%5.0" SYMBOL_LINK "CPD_C_P_LO_FL_CNTS" 4 /end CHARACTERISTIC
/begin CHARACTERISTIC CPD_V_MAP_HI_EN_RUN_MIN "map short high enable engine run min" VALUE 0x0002038C __UWORD_S 0 u_1s_tmr 0 65535 SYMBOL_LINK "CPD_C_P_HI_EN_RUN_MIN" 2 /end CHARACTERISTIC
/begin CHARACTERISTIC CPD_C_COR_P_STRT_CMP_CFG "start up press correlation compare source config" CURVE 0x000200B0 __UBYTE_S 0 u_press_snsr 0 1 FORMAT "%1.0"
 /begin AXIS_DESCR FIX_AXIS NO_INPUT_QUANTITY u_press_snsr 2 0 1 /begin FIX_AXIS_PAR_LIST 0 1 /end FIX_AXIS_PAR_LIST /end AXIS_DESCR
/end CHARACTERISTIC
/begin CHARACTERISTIC CPD_C_COR_P_STRT_FL_DLT "start up press correlation fail delta" CURVE 0x000200B0 __UWORD_S 0 u_kPa_0_256 0 255.99609375
 /begin AXIS_DESCR FIX_AXIS NO_INPUT_QUANTITY u_press_snsr 2 0 1 /begin FIX_AXIS_PAR_LIST 0 1 /end FIX_AXIS_PAR_LIST /end AXIS_DESCR
/end CHARACTERISTIC
/begin CHARACTERISTIC CPD_V_COR_MAP_STRT_FL_CNTS "MAP start up correlation fail counts" VALUE 0x0002038C __UWORD_S 0 u_cnts 0 65535 FORMAT "%5.0" SYMBOL_LINK "CPD_M_COR_P_STRT_CNTS" 4 /end CHARACTERISTIC
/begin CHARACTERISTIC CPD_V_COR_MAP_STRT_DIAG_CNTS "MAP start up correlation diag counts" VALUE 0x0002038C __UWORD_S 0 u_cnts 0 65535 FORMAT "%5.0" SYMBOL_LINK "CPD_M_COR_P_STRT_CNTS" 6 /end CHARACTERISTIC
/begin CHARACTERISTIC CPD_M_AIRT_RAT_AMBT_CHG_THR "MAP TPS drive rationality low load diag fail thr" MAP 0x00020320 __SWORD_S 0 u_deg_C -256 255.9921875 FORMAT "%4.1"
 /begin AXIS_DESCR FIX_AXIS NO_INPUT_QUANTITY u_t_snsr 2 0 1 /begin FIX_AXIS_PAR_LIST 0 1 /end FIX_AXIS_PAR_LIST /end AXIS_DESCR
 /begin AXIS_DESCR FIX_AXIS NO_INPUT_QUANTITY u_t_dir 2 0 1 /begin FIX_AXIS_PAR_LIST 0 1 /end FIX_AXIS_PAR_LIST /end AXIS_DESCR
/end CHARACTERISTIC
/begin CHARACTERISTIC CPD_C_AIRT_RAT_CMP_CFG "temp rationality diag compare config" CURVE 0x000200B0 __UBYTE_S 0 u_t_cmp_snsr 0 3 FORMAT "%1.0"
 /begin AXIS_DESCR FIX_AXIS NO_INPUT_QUANTITY u_t_cmp_snsr 4 0 3 /begin FIX_AXIS_PAR_LIST 0 1 2 3 /end FIX_AXIS_PAR_LIST /end AXIS_DESCR
/end CHARACTERISTIC
/begin CHARACTERISTIC CPD_C_ETC_PERF_DLT_THR_LO "ETC performance delta low thr" CURVE 0x000200B0 __SWORD_S 0 u_pct_r_s -128 127.99609375 FORMAT "%4.1"
 /begin AXIS_DESCR FIX_AXIS thro_pos_sp u_pct 11 0 100
  /begin FIX_AXIS_PAR_LIST 0 3276.8 6553.6 9830.4 13107.2 16384 19660.8 22937.6 26214.4 29491.2 32768 /end FIX_AXIS_PAR_LIST
 /end AXIS_DESCR
/end CHARACTERISTIC
/begin CHARACTERISTIC ERRM_ABS_PWM_DTY_TYP "ABS pwm duty type" VALUE 0x2886C __UWORD_S 0 u_diag_typ 0 8 FORMAT "%1.0" BIT_MASK 0xF000 SYMBOL_LINK "ERRM_CFG_ARRY" 936 SYMBOL_LINK "ERRM_CFG_ARRY" 888 /end CHARACTERISTIC
/begin CHARACTERISTIC ERRM_ABS_PWM_DTY_MIL_ON "ABS pwm duty MIL on enable" VALUE 0x2886C __UWORD_S 0 b_true 0 1 FORMAT "%1.0" BIT_MASK 0x0800 SYMBOL_LINK "ERRM_CFG_ARRY" 936 SYMBOL_LINK "ERRM_CFG_ARRY" 888 /end CHARACTERISTIC
/begin CHARACTERISTIC ERRM_ABS_PWM_DTY_DEN_GRP "ABS pwm duty denom group" VALUE 0x2886C __UWORD_S 0 u_den_grp 0 63 FORMAT "%1.0" BIT_MASK 0x003F SYMBOL_LINK "ERRM_CFG_ARRY" 936 SYMBOL_LINK "ERRM_CFG_ARRY" 888 /end CHARACTERISTIC
/begin CHARACTERISTIC ERRM_ABS_PWM_DTY_DTC "ABS pwm duty DTC" VALUE 0x2886C __UWORD_S 0 u_cnts 0 65535 FORMAT "%5.0" SYMBOL_LINK "ERRM_CFG_ARRY" 938 SYMBOL_LINK "ERRM_CFG_ARRY" 890 /end CHARACTERISTIC
/begin CHARACTERISTIC EVAM_V_CON_LRN_EN_VAC "con learn enable tank vac" VALUE 0x0002038C __SWORD_S 0 u_kPa_8n_8p -8 7.999755859375 FORMAT "%4.3" /end CHARACTERISTIC
/*--------------GPF EO-------------------------*/ /*--------------GPF Regen----------------------*/
/begin CHARACTERISTIC GPF_C_REGEN_MIN_RT "" CURVE 0x65840 __UWORD_S 0 p_t_GPF_COUNT_0_65535 0 65535 SYMBOL_LINK "GPF_C_REGEN_MIN_RT" 2
 /begin AXIS_DESCR COM_AXIS sys_keyon_ect u_deg_C 22 -256 255.9921875 AXIS_PTS_REF GPF_X_REGEN_MIN_RT /end AXIS_DESCR
/end CHARACTERISTIC
/begin AXIS_PTS GPF_X_REGEN_MIN_RT "" 0x65834 sys_keyon_ect SSV__SWORD_S 0 u_deg_C 22 -256 255.9921875 FORMAT "%4.1" DEPOSIT ABSOLUTE SYMBOL_LINK "GPF_X_REGEN_MIN_RT" 2 /end AXIS_PTS
/begin CHARACTERISTIC GPF_V_OPER_CONDS_OVERRIDE "" VALUE 0x67264 __UBYTE_S 0 b_true 0 1 FORMAT "%1.0" /end CHARACTERISTIC
/begin CHARACTERISTIC GPF_V_STAT_CONDS_OVERRIDE "" VALUE 0x67264 __UBYTE_S 0 b_true 0 1 FORMAT "%1.0" /end CHARACTERISTIC
/begin CHARACTERISTIC GPF_V_REGEN_EN_IMEP_MIN "IMEP threshold " VALUE 0x35E52 __UWORD_S 0 u_kPa_0_4096 0 4095.937500 /end CHARACTERISTIC
/begin CHARACTERISTIC GPF_V_REGEN_EN_IMEP_HYST "IMEP threshold hyst " VALUE 0x35E52 __UWORD_S 0 u_kPa_0_4096 0 4095.937500 /end CHARACTERISTIC
/begin CHARACTERISTIC GPF_V_REGEN_EN_BAT_MIN "" VALUE 0x64AFA __UWORD_S 0 u_volt_32 0 31.99951171875 FORMAT "%4.2" /end CHARACTERISTIC
/begin CHARACTERISTIC GPF_V_REGEN_EN_BAT_HYST "" VALUE 0x64AFA __UWORD_S 0 u_volt_32 0 31.99951171875 FORMAT "%4.2" /end CHARACTERISTIC
/begin CHARACTERISTIC GPF_V_REGEN_EN_TANK_LVL_MIN "fuel level" VALUE 0x650E8 __UWORD_S 0 u_pct_1 0 99.9984741210937 FORMAT "%5.3" /end CHARACTERISTIC
/begin CHARACTERISTIC GPF_V_REGEN_EN_TANK_LVL_HYST "fuel level" VALUE 0x650E8 __UWORD_S 0 u_pct_1 0 99.9984741210937 FORMAT "%5.3" /end CHARACTERISTIC
/begin CHARACTERISTIC GPF_V_REGEN_EN_IAT_MIN "" VALUE 0x6511A __SWORD_S 0 u_deg_C -256 255.9921875 /end CHARACTERISTIC
/begin CHARACTERISTIC GPF_V_REGEN_EN_IAT_HYST "" VALUE 0x6511A __SWORD_S 0 u_deg_C -256 255.9921875 /end CHARACTERISTIC
/begin CHARACTERISTIC GPF_V_REGEN_EN_VSPD_MIN "" VALUE 0x65110 __UWORD_S 0 u_vspd 0 511.9921875 /end CHARACTERISTIC
/begin CHARACTERISTIC GPF_V_REGEN_EN_VSPD_HYST "" VALUE 0x65110 __UWORD_S 0 u_vspd 0 511.9921875 /end CHARACTERISTIC
/begin CHARACTERISTIC GPF_V_REGEN_EN_RPM_MIN "engine speed min" VALUE 0x23306 __UWORD_S 0 u_espd 0 8191.875 FORMAT "%5.1" /end CHARACTERISTIC
/begin CHARACTERISTIC GPF_V_REGEN_EN_RPM_HYST "engine speed min hyst" VALUE 0x23306 __UWORD_S 0 u_espd 0 8191.875 FORMAT "%5.1" /end CHARACTERISTIC
/begin CHARACTERISTIC GPF_V_REGEN_ECT_MIN "" VALUE 0x6511A __SWORD_S 0 u_deg_C -256 255.9921875 /end CHARACTERISTIC
/begin CHARACTERISTIC GPF_V_REGEN_ECT_MAX "" VALUE 0x6511A __SWORD_S 0 u_deg_C -256 255.9921875 /end CHARACTERISTIC
/begin CHARACTERISTIC GPF_V_REGEN_EN_INLET_TEMP_MIN "" VALUE 0x6511A __SWORD_S 0 p_t_GPF_TEMP_N2048_2048 -2048 2047.937500 /end CHARACTERISTIC
/begin CHARACTERISTIC GPF_V_REGEN_EN_INLET_TEMP_MAX "" VALUE 0x6511A __SWORD_S 0 p_t_GPF_TEMP_N2048_2048 -2048 2047.937500 /end CHARACTERISTIC
/begin CHARACTERISTIC GPF_V_REGEN_EN_OIL_TEMP_MIN "" VALUE 0x6511A __SWORD_S 0 u_deg_C -256 255.9921875 /end CHARACTERISTIC
/begin CHARACTERISTIC GPF_V_REGEN_EN_OIL_TEMP_MAX "" VALUE 0x6511A __SWORD_S 0 u_deg_C -256 255.9921875 /end CHARACTERISTIC
/begin CHARACTERISTIC GPF_V_REGEN_EN_TURBO_TEMP_MIN "" VALUE 0x3A282 __UWORD_S 0 u_deg_K 0 2047.96875 FORMAT "%5.1" /end CHARACTERISTIC
/begin CHARACTERISTIC GPF_V_REGEN_EN_TURBO_TEMP_MAX "" VALUE 0x3A282 __UWORD_S 0 u_deg_K 0 2047.96875 FORMAT "%5.1" /end CHARACTERISTIC
/begin CHARACTERISTIC GPF_V_REGEN_EN_TWC_TEMP_MIN "cat temp min" VALUE 0x657E8 __SWORD_S 0 u_deg_C_n2048_p2048 -2048 2047.9375 /end CHARACTERISTIC
/begin CHARACTERISTIC GPF_V_REGEN_EN_TWC_TEMP_MAX "cat temp max" VALUE 0x657E8 __SWORD_S 0 u_deg_C_n2048_p2048 -2048 2047.9375 /end CHARACTERISTIC
/begin CHARACTERISTIC GPF_V_REGEN_ACT_TM_MAX "" VALUE 0x2332A __UWORD_S 0 u_2x_tmr 0 1023.984375 /end CHARACTERISTIC
/begin CHARACTERISTIC GPF_V_SOOT_LD_PCT "" VALUE 0x2332A __UWORD_S 0 p_t_GPF_SL_PCT_0_128 0 128 /end CHARACTERISTIC
/begin CHARACTERISTIC GPF_V_FORC_EO_SOOT "" VALUE 0x67264 __UBYTE_S 0 b_true 0 1 FORMAT "%1.0" /end CHARACTERISTIC
/begin CHARACTERISTIC GPF_V_REGEN_REQ_HI "" VALUE 0x6527E __UWORD_S 0 u_fac_256 0 255.99609375 FORMAT "%6.3" /end CHARACTERISTIC
/begin CHARACTERISTIC GPF_V_REGEN_REQ_HYS "" VALUE 0x6527E __UWORD_S 0 u_fac_256 0 255.99609375 FORMAT "%6.3" /end CHARACTERISTIC
/begin CHARACTERISTIC GPF_V_CRTIC_SOOT_THR "" VALUE 0x6527E __UWORD_S 0 u_fac_256 0 255.99609375 FORMAT "%6.3" /end CHARACTERISTIC
/begin CHARACTERISTIC GPF_V_LOW_TEMP_THR "" VALUE 0x6511A __SWORD_S 0 p_t_GPF_TEMP_N2048_2048 -2048 2047.937500 /end CHARACTERISTIC
/begin CHARACTERISTIC GPF_V_LOW_TEMP_TM_MAX "" VALUE 0x2332A __UWORD_S 0 u_2x_tmr 0 1023.984375 /end CHARACTERISTIC
/begin CHARACTERISTIC GPF_V_HT_MOD_INLET_TEMP_HYST "" VALUE 0x6511A __SWORD_S 0 p_t_GPF_TEMP_N2048_2048 -2048 2047.937500 /end CHARACTERISTIC
/begin CHARACTERISTIC GPF_V_HT_MOD_INLET_TEMP_MIN "" VALUE 0x6511A __SWORD_S 0 p_t_GPF_TEMP_N2048_2048 -2048 2047.937500 /end CHARACTERISTIC
/begin CHARACTERISTIC GPF_C_HI_O2_TMP_THR "" CURVE 0x65840 __SWORD_S 0 p_t_GPF_TEMP_N2048_2048 -2048 2047.937500 SYMBOL_LINK "GPF_C_HI_O2_TMP_THR" 2
 /begin AXIS_DESCR COM_AXIS gpf_sel_accu_soot u_fac_256 22 0 255.99609375 AXIS_PTS_REF GPF_X_HI_O2_TMP_SOOT_LOAD /end AXIS_DESCR
/end CHARACTERISTIC
/begin AXIS_PTS GPF_X_HI_O2_TMP_SOOT_LOAD "" 0x65834 gpf_sel_accu_soot SSV__UWORD_S 0 u_fac_256 22 0 255.99609375 FORMAT "%6.3" DEPOSIT ABSOLUTE SYMBOL_LINK "GPF_X_HI_O2_TMP_SOOT_LOAD" 2 /end AXIS_PTS
/begin CHARACTERISTIC GPF_V_HT_O2_TEMP_THR_HYST "" VALUE 0x6511A __SWORD_S 0 p_t_GPF_TEMP_N2048_2048 -2048 2047.937500 /end CHARACTERISTIC
/begin CHARACTERISTIC GPF_V_HI_SOOT_LO_ESPD "engine speed min" VALUE 0x23306 __UWORD_S 0 u_espd 0 8191.875 FORMAT "%5.1" /end CHARACTERISTIC
/begin CHARACTERISTIC GPF_V_HI_SOOT_HI_ESPD "engine speed HI" VALUE 0x23306 __UWORD_S 0 u_espd 0 8191.875 FORMAT "%5.1" /end CHARACTERISTIC
/begin CHARACTERISTIC GPF_V_HI_SOOT_LO_IMEP "IMEP threshold " VALUE 0x35E52 __UWORD_S 0 u_kPa_0_4096 0 4095.937500 /end CHARACTERISTIC
/begin CHARACTERISTIC GPF_V_HI_SOOT_HI_IMEP "IMEP threshold " VALUE 0x35E52 __UWORD_S 0 u_kPa_0_4096 0 4095.937500 /end CHARACTERISTIC
/begin CHARACTERISTIC GPF_V_HI_SOOT_LO_TEMP "" VALUE 0x6511A __SWORD_S 0 p_t_GPF_TEMP_N2048_2048 -2048 2047.937500 /end CHARACTERISTIC
/begin CHARACTERISTIC GPF_V_HI_SOOT_HI_TEMP "" VALUE 0x6511A __SWORD_S 0 p_t_GPF_TEMP_N2048_2048 -2048 2047.937500 /end CHARACTERISTIC
/begin CHARACTERISTIC GPF_V_HI_SOOT_PEDPOS_MAX "" VALUE 0x67EF8 __UWORD_S 0 u_pct_r 0 127.998046875 /end CHARACTERISTIC
/begin CHARACTERISTIC GPF_V_HI_SOOT_THR "" VALUE 0x6527E __UWORD_S 0 u_fac_256 0 255.99609375 FORMAT "%6.3" /end CHARACTERISTIC
/begin CHARACTERISTIC GPF_V_HI_SOOT_DLY_UP "" VALUE 0x2332A __UWORD_S 0 u_2x_tmr 0 1023.984375 /end CHARACTERISTIC
/begin CHARACTERISTIC GPF_V_HI_SOOT_DLY_DWN "" VALUE 0x2332A __UWORD_S 0 u_2x_tmr 0 1023.984375 /end CHARACTERISTIC
/begin CHARACTERISTIC GPF_V_TRGT_DFT_AFR "" VALUE 0x23304 __UWORD_S 0 u_afr 0 31.99951171875 FORMAT "%4.2" /end CHARACTERISTIC
/begin CHARACTERISTIC GPF_V_TRGT_DFT_TEMP "" VALUE 0x6511A __SWORD_S 0 p_t_GPF_TEMP_N2048_2048 -2048 2047.937500 /end CHARACTERISTIC
/begin CHARACTERISTIC GPF_V_TRGT_HT_AFR "" VALUE 0x23304 __UWORD_S 0 u_afr 0 31.99951171875 FORMAT "%4.2" /end CHARACTERISTIC
/begin CHARACTERISTIC GPF_V_TRGT_HT_TEMP "" VALUE 0x6511A __SWORD_S 0 p_t_GPF_TEMP_N2048_2048 -2048 2047.937500 /end CHARACTERISTIC
/begin CHARACTERISTIC GPF_V_TRGT_O2_AFR "" VALUE 0x23304 __UWORD_S 0 u_afr 0 31.99951171875 FORMAT "%4.2" /end CHARACTERISTIC
/begin CHARACTERISTIC GPF_V_TRGT_O2_TEMP "" VALUE 0x6511A __SWORD_S 0 p_t_GPF_TEMP_N2048_2048 -2048 2047.937500 /end CHARACTERISTIC
/begin CHARACTERISTIC GPF_V_TRGT_HI_SOOT_AFR "" VALUE 0x23304 __UWORD_S 0 u_afr 0 31.99951171875 FORMAT "%4.2" /end CHARACTERISTIC
/begin CHARACTERISTIC GPF_V_TRGT_HI_SOOT_TEMP "" VALUE 0x6511A __SWORD_S 0 p_t_GPF_TEMP_N2048_2048 -2048 2047.937500 /end CHARACTERISTIC
/begin CHARACTERISTIC GPF_M_ACT_RGN_TRQ "" MAP 0x341D4 __UWORD_S 0 p_t_GPF_TRQ_0_255 0 255 SYMBOL_LINK "GPF_M_ACT_RGN_TRQ" 4
 /begin AXIS_DESCR COM_AXIS gpf_trgt_temp_diff p_t_GPF_TEMP_N2048_2048 15 -2048 2047.937500 AXIS_PTS_REF GPF_X_ACT_RGN_TRQ_DLT_TEMP /end AXIS_DESCR
 /begin AXIS_DESCR COM_AXIS sys_eng_spd u_espd 20 0 8191.875 AXIS_PTS_REF GPF_X_ACT_RGN_TRQ_RPM /end AXIS_DESCR
/end CHARACTERISTIC
/begin AXIS_PTS GPF_X_ACT_RGN_TRQ_RPM "axis of " 0x341C6 sys_eng_spd SSV__UWORD_S 0 u_espd 20 0 8191.875 FORMAT "%5.1" DEPOSIT ABSOLUTE SYMBOL_LINK "GPF_X_ACT_RGN_TRQ_RPM" 2 /end AXIS_PTS
/begin AXIS_PTS GPF_X_ACT_RGN_TRQ_DLT_TEMP "axis of " 0x341BA gpf_trgt_temp_diff SSV__SWORD_S 0 p_t_GPF_TEMP_N2048_2048 15 -2048 2047.937500 DEPOSIT ABSOLUTE SYMBOL_LINK "GPF_X_ACT_RGN_TRQ_DLT_TEMP" 2 /end AXIS_PTS
/begin CHARACTERISTIC GPF_M_RST_TM "" MAP 0x341D4 __UWORD_S 0 u_2x_tmr 0 1023.984375 SYMBOL_LINK "GPF_M_RST_TM" 4
 /begin AXIS_DESCR COM_AXIS gpf_sel_accu_soot u_fac_256 8 0 255.99609375 AXIS_PTS_REF GPF_X_RST_TM_SOOT_LD /end AXIS_DESCR
 /begin AXIS_DESCR COM_AXIS gpf_temp_in_flt p_t_GPF_TEMP_N2048_2048 8 -2048 2047.937500 AXIS_PTS_REF GPF_X_RST_TM_TEMP /end AXIS_DESCR
/end CHARACTERISTIC
/begin AXIS_PTS GPF_X_RST_TM_SOOT_LD "axis of " 0x341C6 gpf_sel_accu_soot SSV__UWORD_S 0 u_fac_256 8 0 255.99609375 FORMAT "%6.3" DEPOSIT ABSOLUTE SYMBOL_LINK "GPF_X_RST_TM_SOOT_LD" 2 /end AXIS_PTS
/begin AXIS_PTS GPF_X_RST_TM_TEMP "axis of " 0x341BA gpf_temp_in_flt SSV__SWORD_S 0 p_t_GPF_TEMP_N2048_2048 8 -2048 2047.937500 DEPOSIT ABSOLUTE SYMBOL_LINK "GPF_X_RST_TM_TEMP" 2 /end AXIS_PTS
/*--------------GPF Regen----------------------*/ /*--------------GPF IO-------------------------*/
/begin CHARACTERISTIC GPF_V_DP_FAC "" VALUE 0x2331E __SWORD_S 0 u_kPa_128n_128p -128 127.99609375 /end CHARACTERISTIC
/begin CHARACTERISTIC GPF_V_DP_OFST "" VALUE 0x2331E __SWORD_S 0 u_kPa_128n_128p -128 127.99609375 /end CHARACTERISTIC
/begin CHARACTERISTIC GPF_V_DP_FILT "filter" VALUE 0x6509C __UWORD_S 0 u_filter 0 0.9999847412109375 FORMAT "%10.9" /end CHARACTERISTIC
/begin CHARACTERISTIC GPF_V_IN_TEMP_INST "" VALUE 0x67264 __UBYTE_S 0 b_true 0 1 FORMAT "%1.0" /end CHARACTERISTIC
/begin CHARACTERISTIC GPF_C_IN_TEMP "" CURVE 0x65840 __UWORD_S 0 p_t_GPF_TEMPK_0_2048 0 2047.968750 SYMBOL_LINK "GPF_C_IN_TEMP" 2
 /begin AXIS_DESCR COM_AXIS gpf_temp_in_raw u_pct_1 21 0 99.9984741210937 AXIS_PTS_REF GPF_X_IN_TEMP /end AXIS_DESCR
/end CHARACTERISTIC
/begin AXIS_PTS GPF_X_IN_TEMP "" 0x65834 gpf_temp_in_raw SSV__UWORD_S 0 u_pct_1 21 0 99.9984741210937 FORMAT "%4.1" DEPOSIT ABSOLUTE SYMBOL_LINK "GPF_X_IN_TEMP" 2 /end AXIS_PTS
/begin CHARACTERISTIC GPF_V_IN_TEMP_FILT "filter" VALUE 0x6509C __UWORD_S 0 u_filter 0 0.9999847412109375 FORMAT "%10.9" /end CHARACTERISTIC
/begin CHARACTERISTIC GPF_V_CFG "0:No GPF     1:Underfloor GPF    2:Coupled GPF" VALUE 0x67264 __UBYTE_S 0 u_cnts 0 2 FORMAT "%1.0" /end CHARACTERISTIC
/begin CHARACTERISTIC GPF_M_TEMP_FAC "" MAP 0x341D4 __UWORD_S 0 u_fac_2 0 1.999969482421875 FORMAT "%4.3" SYMBOL_LINK "GPF_M_TEMP_FAC" 4
 /begin AXIS_DESCR COM_AXIS NO_INPUT_QUANTITY p_t_GPF_MAS_FLW_0_512 10 0 511.9921875 AXIS_PTS_REF GPF_X_TEMP_FLW /end AXIS_DESCR
 /begin AXIS_DESCR COM_AXIS sys_eng_spd u_espd 12 0 8191.875 AXIS_PTS_REF GPF_X_TEMP_ESPD /end AXIS_DESCR
/end CHARACTERISTIC
/begin AXIS_PTS GPF_X_TEMP_ESPD "axis of " 0x341C6 sys_eng_spd SSV__UWORD_S 0 u_espd 12 0 8191.875 FORMAT "%5.1" DEPOSIT ABSOLUTE SYMBOL_LINK "GPF_X_TEMP_ESPD" 2 /end AXIS_PTS
/begin AXIS_PTS GPF_X_TEMP_FLW "axis of " 0x341BA NO_INPUT_QUANTITY SSV__UWORD_S 0 p_t_GPF_MAS_FLW_0_512 10 0 511.9921875 DEPOSIT ABSOLUTE SYMBOL_LINK "GPF_X_TEMP_FLW" 2 /end AXIS_PTS
/begin CHARACTERISTIC GPF_V_ASH_LRN_DSBL "" VALUE 0x67264 __UBYTE_S 0 b_true 0 1 FORMAT "%1.0" /end CHARACTERISTIC
/*--------------GPF IO-------------------------*/
/begin COMPU_METHOD u_ad_volt "ad voltage" RAT_FUNC "%6.4" "V" COEFFS 0.0 1.0 0.000000 0.0 0.0 0.0000762939453125 /end COMPU_METHOD
/begin COMPU_METHOD u_volt_32 "voltage" RAT_FUNC "%6.4" "V" COEFFS 0.0 1.0 0.000000 0.0 0.0 0.00048828125 /end COMPU_METHOD
/begin COMPU_METHOD u_kPa_0_256 "press" RAT_FUNC "%5.2" "kPa" COEFFS 0.0 1.0 0.000000 0.0 0.0 0.00390625 /end COMPU_METHOD
/begin COMPU_METHOD u_kPa_8n_8p "press" RAT_FUNC "%6.5" "kPa" COEFFS 0.0 1.0 0.000000 0.0 0.0 0.000244140625 /end COMPU_METHOD
/begin COMPU_METHOD u_kPa_128n_128p "press" RAT_FUNC "%5.2" "kPa" COEFFS 0.0 1.0 0.000000 0.0 0.0 0.00390625 /end COMPU_METHOD
/begin COMPU_METHOD u_kPa_256n_256p "press" RAT_FUNC "%5.2" "kPa" COEFFS 0.0 1.0 0.000000 0.0 0.0 0.0078125 /end COMPU_METHOD
/begin COMPU_METHOD u_kPa_512n_512p "press" RAT_FUNC "%5.2" "kPa" COEFFS 0.0 1.0 0.000000 0.0 0.0 0.015625 /end COMPU_METHOD
/begin COMPU_METHOD u_fac_4 "factor" RAT_FUNC "%5.4" "fac" COEFFS 0.0 1.0 0.000000 0.0 0.0 0.00006103515625 /end COMPU_METHOD
/begin COMPU_METHOD u_fac_2 "factor" RAT_FUNC "%3.2" "fac" COEFFS 0.0 1.0 0.000000 0.0 0.0 0.000030517578125 /end COMPU_METHOD
/begin COMPU_METHOD u_fac_1 "factor" RAT_FUNC "%4.3" "fac" COEFFS 0.0 1.0 0.000000 0.0 0.0 0.0000152587890625 /end COMPU_METHOD
/begin COMPU_METHOD u_deg_K_512 "degK" RAT_FUNC "%6.2" "K" COEFFS 0.0 1.0 0.0 0.0 0.0 0.0078125 /end COMPU_METHOD
/begin COMPU_METHOD u_deg_K "degK" RAT_FUNC "%6.2" "K" COEFFS 0.0 1.0 0.0 0.0 0.0 0.03125 /end COMPU_METHOD
/begin COMPU_METHOD u_deg_C "degC" RAT_FUNC "%5.2" "¡æ" COEFFS 0.0 1.0 0.0 0.0 0.0 0.0078125 /end COMPU_METHOD
/begin COMPU_METHOD u_deg_C_n2048_p2048 "degC" RAT_FUNC "%5.1" "¡æ" COEFFS 0.0 1.0 0.0 0.0 0.0 0.0625 /end COMPU_METHOD
/begin COMPU_METHOD u_filter "filter" RAT_FUNC "%11.10" "coef" COEFFS 0.0 1.0 0.0 0.0 0.0 0.0000152587890625 /end COMPU_METHOD
/begin COMPU_METHOD u_cnts "counts" RAT_FUNC "%3.0" "cnts" COEFFS 0.0 1.0 0.0 0.0 0.0 1.0 /end COMPU_METHOD
/begin COMPU_METHOD u_1x_tmr "7.81 timer" RAT_FUNC "%4.3" "s" COEFFS 0.0 1.0 0.0 0.0 0.0 0.0078125 /end COMPU_METHOD
/begin COMPU_METHOD u_2x_tmr "15.6 timer" RAT_FUNC "%6.2" "s" COEFFS 0.0 1.0 0.0 0.0 0.0 0.015625 /end COMPU_METHOD
/begin COMPU_METHOD u_16x_tmr "125 timer" RAT_FUNC "%5.1" "s" COEFFS 0.0 1.0 0.0 0.0 0.0 0.125 /end COMPU_METHOD
/begin COMPU_METHOD u_1s_tmr "1 sec timer" RAT_FUNC "%5.0" "s" COEFFS 0.0 1.0 0.0 0.0 0.0 1.0 /end COMPU_METHOD
/begin COMPU_METHOD u_250m_tmr "250ms timer" RAT_FUNC "%5.0" "s" COEFFS 0.0 1.0 0.0 0.0 0.0 0.25 /end COMPU_METHOD
/begin COMPU_METHOD b_true "" TAB_VERB "%6.3" "" COMPU_TAB_REF b_true /end COMPU_METHOD
/begin COMPU_VTAB b_true "" TAB_VERB 2 0 "FALSE" 1 "TRUE" /end COMPU_VTAB
/begin COMPU_METHOD b_enable "" TAB_VERB "%6.3" "" COMPU_TAB_REF b_enable /end COMPU_METHOD
/begin COMPU_VTAB b_enable "" TAB_VERB 2 0 "DISABLE" 1 "ENABLE" /end COMPU_VTAB
/begin COMPU_METHOD u_espd "engine speed" RAT_FUNC "%5.2" "rpm" COEFFS 0.0 1.0 0.000000 0.0 0.0 0.125 /end COMPU_METHOD
/begin COMPU_METHOD u_espd_acl "engine speed acc" RAT_FUNC "%5.2" "rpm/s" COEFFS 0.0 1.0 0.000000 0.0 0.0 0.125 /end COMPU_METHOD
/begin COMPU_METHOD u_vspd "vehicle speed" RAT_FUNC "%5.2" "kph" COEFFS 0.0 1.0 0.000000 0.0 0.0 0.0078125 /end COMPU_METHOD
/begin COMPU_METHOD u_pct "percentage" RAT_FUNC "%5.2" "%" COEFFS 0.0 1.0 0.000000 0.0 0.0 0.0030517578125 /end COMPU_METHOD
/begin COMPU_METHOD u_pct_1 "percentage" RAT_FUNC "%5.2" "%" COEFFS 0.0 1.0 0.000000 0.0 0.0 0.00152587890625 /end COMPU_METHOD
/begin COMPU_METHOD u_pct_8 "percentage" RAT_FUNC "%5.2" "%" COEFFS 0.0 1.0 0.000000 0.0 0.0 0.01220703125 /end COMPU_METHOD
/begin COMPU_METHOD u_pct_r "real pct" RAT_FUNC "%5.2" "%" COEFFS 0.0 1.0 0.000000 0.0 0.0 0.001953125 /end COMPU_METHOD
/begin COMPU_METHOD u_pct_r_s "real pct" RAT_FUNC "%5.2" "%" COEFFS 0.0 1.0 0.000000 0.0 0.0 0.00390625 /end COMPU_METHOD
/begin COMPU_METHOD u_afr "airfuel" RAT_FUNC "%3.1" "Ratio" COEFFS 0.0 1.0 0.000000 0.0 0.0 0.00048828125 /end COMPU_METHOD
/begin COMPU_METHOD u_afr_b "airfuel" RAT_FUNC "%3.1" "Ratio" COEFFS 0.0 1.0 0.000000 0.0 0.0 0.125 /end COMPU_METHOD
/begin COMPU_METHOD u_kPa_0_4096 "IMEP" RAT_FUNC "%6.2" "kPa" COEFFS 0.0 1.0 0.000000 0.0 0.0 0.0625 /end COMPU_METHOD
/begin COMPU_METHOD u_iga_64n_64p_b "ignition angle" RAT_FUNC "%3.1" "Deg" COEFFS 0.0 1.0 0.000000 0.0 0.0 0.5 /end COMPU_METHOD
/begin COMPU_METHOD u_iga_n_b "ignition angle" RAT_FUNC "%3.1" "Deg" COEFFS 0.0 1.0 0.0 0.0 0.0 0.5 /end COMPU_METHOD
/begin COMPU_METHOD u_crk_ang_a "crankshaft angle" RAT_FUNC "%6.4" "Deg" COEFFS 0.0 1.0 0.000000 0.0 0.0 0.015625 /end COMPU_METHOD
/begin COMPU_METHOD u_rpt_st "" TAB_VERB "%5.0" "" COMPU_TAB_REF u_rpt_st /end COMPU_METHOD
/begin COMPU_VTAB u_rpt_st "" TAB_VERB 3 0 "NO_REPORT" 1 "PASS" 2 "FAIL" /end COMPU_VTAB
/begin COMPU_METHOD u_diag_typ "" TAB_VERB "%5.0" "" COMPU_TAB_REF u_diag_typ /end COMPU_METHOD
/begin COMPU_VTAB u_diag_typ "" TAB_VERB 5 0 "BYPASS" 1 "LIGHT_SVS" 2 "LIGHT_3RD_TRIP" 4 "LIGHT_2ND_TRIP" 8 "LIGHT_1ST_TRIP" /end COMPU_VTAB
/begin COMPU_METHOD u_den_grp "" TAB_VERB "%5.0" "" COMPU_TAB_REF u_den_grp /end COMPU_METHOD
/begin COMPU_VTAB u_den_grp "" TAB_VERB 34 0 "INTERNAL_USE" 1 "GENERIC" 2 "B1_CFD" 3 "B2_CFD" 4 "EGR_FLW" 5 "B1_EXH_CAM_ST" 6 "B1_EXH_VVT_STUK" 7 "B1_EXH_VVT_POS" 8 "B1_EXH_VVT_RESP" 9 "B2_EXH_CAM_ST" 10 "B2_EXH_VVT_STUK" 11 "B2_EXH_VVT_POS" 12 "B2_EXH_VVT_RESP" 13 "B1_INTK_CAM_ST" 14 "B1_INTK_VVT_STUK" 15 "B1_INTK_VVT_POS" 16 "B1_INTK_VVT_RESP" 17 "B2_INTK_CAM_ST" 18 "B2_INTK_VVT_STUK" 19 "B2_INTK_VVT_POS" 20 "B2_INTK_VVT_RESP" 21 "EVAM_PURGE_FLOW" 22 "EVAM_SMALL_LEAK" 23 "B1S1_RSP_SW_TMS" 24 "B1S1_RSP_RCH_LEAN" 25 "B1S1_RSP_LEAN_RCH" 26 "B1S1_RSP_RATIO" 27 "" 28 "" 29 "" 30 "B1S2_PUC_RESP" 31 "B1S2_POW_RESP" 32 "B1_SECOND_AIR" 33 "B2_SECOND_AIR" /end COMPU_VTAB
/begin COMPU_METHOD u_thro_actr_typ "" TAB_VERB "%6.3" "" COMPU_TAB_REF u_thro_actr_typ /end COMPU_METHOD
/begin COMPU_VTAB u_thro_actr_typ "" TAB_VERB 4 0 "OFF" 1 "LEARN" 2 "NORMAL" 3 "SLEW" /end COMPU_VTAB
/begin COMPU_METHOD u_cru_sw_typ "" TAB_VERB "%6.3" "" COMPU_TAB_REF u_cru_sw_typ /end COMPU_METHOD
/begin COMPU_VTAB u_cru_sw_typ "" TAB_VERB 2 0 "ANALOG" 1 "DISCRETE" /end COMPU_VTAB
/begin COMPU_METHOD u_fac_256 "ratio" RAT_FUNC "%5.2" "ratio" COEFFS 0.0 1.0 0.000000 0.0 0.0 0.00390625 /end COMPU_METHOD
/begin COMPU_METHOD u_press_snsr "" TAB_VERB "%6.3" "" COMPU_TAB_REF u_press_snsr /end COMPU_METHOD
/begin COMPU_VTAB u_press_snsr "" TAB_VERB 3 0 "AMP" 1 "BOOST_P" 2 "MAP" /end COMPU_VTAB
/begin COMPU_VTAB u_press_snsr "" TAB_VERB 2 0 "AMP" 1 "MAP" /end COMPU_VTAB
/begin COMPU_METHOD u_t_snsr "" TAB_VERB "%6.3" "" COMPU_TAB_REF u_t_snsr /end COMPU_METHOD
/begin COMPU_VTAB u_t_snsr "" TAB_VERB 3 0 "IAT" 1 "BOOST_T" 2 "UNUSE" /end COMPU_VTAB
/begin COMPU_VTAB u_t_snsr "" TAB_VERB 2 0 "IAT" 1 "UNUSE" /end COMPU_VTAB
/begin COMPU_METHOD u_t_dir "" TAB_VERB "%6.3" "" COMPU_TAB_REF u_t_dir /end COMPU_METHOD
/begin COMPU_VTAB u_t_dir "" TAB_VERB 2 0 "Decrease" 1 "Increase" /end COMPU_VTAB
/begin COMPU_METHOD u_t_cmp_snsr "" TAB_VERB "%6.3" "" COMPU_TAB_REF u_t_cmp_snsr /end COMPU_METHOD
/begin COMPU_VTAB u_t_cmp_snsr "" TAB_VERB 4 0 "IAT" 1 "BOOST_T" 2 "UNUSE" 3 "ECT" /end COMPU_VTAB
/begin COMPU_VTAB u_t_cmp_snsr "" TAB_VERB 3 0 "IAT" 1 "UNUSE" 2 "ECT" /end COMPU_VTAB
/begin COMPU_METHOD u_est_cfg "" TAB_VERB "%10.4" "" COMPU_TAB_REF u_est_cfg /end COMPU_METHOD
/begin COMPU_VTAB u_est_cfg "" TAB_VERB 2 0 "EST" 1 "IGBT" /end COMPU_VTAB
/begin COMPU_METHOD u_ecsd_lo_en_st "" TAB_VERB "%10.4" "" COMPU_TAB_REF u_ecsd_lo_en_st /end COMPU_METHOD
/begin COMPU_VTAB u_ecsd_lo_en_st "" TAB_VERB 11 0 "DIAG_BYPASS" 1 "INITIAL" 2 "TEST_FINISH" 3 "FAIL_ACTV" 4 "IAT_HIGH" 7 "RUN_TIME" 8 "OFF_TIME" 9 "ECT_OUT" 10 "AIRFLOW" 11 "STALL" 12 "ENABLE" /end COMPU_VTAB
/begin COMPU_METHOD u_iat_cfg "" TAB_VERB "%6.3" "" COMPU_TAB_REF u_iat_cfg /end COMPU_METHOD
/begin COMPU_VTAB u_iat_cfg "" TAB_VERB 2 0 "PressureRatio" 1 "IMEP_MBT" /end COMPU_VTAB
/begin COMPU_METHOD p_t_GPF_DP_N128_128 "Ax + B" RAT_FUNC "%4.4" "KPa" COEFFS 0.0 1.0 0.000000 0.0 0.0 0.003906250000 /end COMPU_METHOD
/begin COMPU_METHOD p_t_GPF_COUNT_0_65535 "Ax + B" RAT_FUNC "%4.0" "count" COEFFS 0.0 1.0 0.000000 0.0 0.0 1.000000000000 /end COMPU_METHOD
/begin COMPU_METHOD p_t_GPF_TEMP_N2048_2048 "" RAT_FUNC "%7.3" "degC" COEFFS 0.0 1.0 0.0 0.0 0.0 0.0625 /end COMPU_METHOD
/begin COMPU_METHOD p_t_GPF_TEMPK_0_2048 "" RAT_FUNC "%4.2" "K" COEFFS 0.0 1.0 0.0 0.0 0.0 0.03125 /end COMPU_METHOD
/begin COMPU_METHOD p_t_GPF_SM_0_128 "" RAT_FUNC "%7.4" "g" COEFFS 0.0 1.0 0.0 0.0 0.0 0.001953125 /end COMPU_METHOD
/begin COMPU_METHOD p_t_GPF_VSPD_0_512 "" RAT_FUNC "%7.4" "km/h" COEFFS 0.0 1.0 0.0 0.0 0.0 0.0078125 /end COMPU_METHOD
/begin COMPU_METHOD p_t_GPF_DENS_0_16 "" RAT_FUNC "%7.5" "N/A" COEFFS 0.0 1.0 0.0 0.0 0.0 0.000244140625 /end COMPU_METHOD
/begin COMPU_METHOD p_t_GPF_VISC_0_0P00005 "" RAT_FUNC "%12.11" "Pa.s" COEFFS 0.0 1.0 0.0 0.0 0.0 0.00000000093132257461548 /end COMPU_METHOD
/begin COMPU_METHOD p_t_GPF_INMD_N2048_2048_LONG "Ax + B" RAT_FUNC "%10.6" "g.K/L" COEFFS 0.0 1.0 0.000000 0.0 0.0 0.000000953674 /end COMPU_METHOD
/begin COMPU_METHOD p_t_GPF_LMBD_0_32 "" RAT_FUNC "%7.5" "lambda" COEFFS 0.0 1.0 0.0 0.0 0.0 0.00048828125 /end COMPU_METHOD
/begin COMPU_METHOD p_t_GPF_FUEL_FLW_0_512 "" RAT_FUNC "%7.4" "mg/str" COEFFS 0.0 1.0 0.0 0.0 0.0 0.0078125 /end COMPU_METHOD
/begin COMPU_METHOD p_t_GPF_RATIO_0_16 "" RAT_FUNC "%7.5" "ratio" COEFFS 0.0 1.0 0.0 0.0 0.0 0.000244140625 /end COMPU_METHOD
/begin COMPU_METHOD p_t_GPF_RATIO_0_2 "" RAT_FUNC "%7.6" "ratio" COEFFS 0.0 1.0 0.0 0.0 0.0 0.000030517578125 /end COMPU_METHOD
/begin COMPU_METHOD p_t_GPF_LMBD_N16_16 "Ax + B" RAT_FUNC "%10.6" "ratio" COEFFS 0.0 1.0 0.000000 0.0 0.0 0.000488281250 /end COMPU_METHOD
/begin COMPU_METHOD p_t_GPF_FUEL_MAS_FLW_0_64 "Ax + B" RAT_FUNC "%10.6" "g/s" COEFFS 0.0 1.0 0.000000 0.0 0.0 0.000976562500 /end COMPU_METHOD
/begin COMPU_METHOD p_t_GPF_TRQ_0_255 "" RAT_FUNC "%4.1" "Nm" COEFFS 0.0 1.0 0.0 0.0 0.0 0.00390625 /end COMPU_METHOD
/begin COMPU_METHOD p_t_GPF_SL_PCT_0_128 "" RAT_FUNC "%7.4" "g" COEFFS 0.0 1.0 0.0 0.0 0.0 0.001953125 /end COMPU_METHOD
/begin COMPU_METHOD p_t_GPF_MAS_FLW_0_512 "" RAT_FUNC "%7.4" "g/sec" COEFFS 0.0 1.0 0.0 0.0 0.0 0.0078125 /end COMPU_METHOD
/begin FUNCTION gpf_regen "gpf regeneration"
 /begin DEF_CHARACTERISTIC GPF_X_REGEN_MIN_RT GPF_C_REGEN_MIN_RT GPF_V_OPER_CONDS_OVERRIDE GPF_V_STAT_CONDS_OVERRIDE GPF_V_REGEN_EN_IMEP_MIN GPF_V_REGEN_EN_IMEP_HYST GPF_V_REGEN_EN_BAT_MIN GPF_V_REGEN_EN_BAT_HYST GPF_V_REGEN_EN_TANK_LVL_MIN GPF_V_REGEN_EN_TANK_LVL_HYST GPF_V_REGEN_EN_IAT_MIN GPF_V_REGEN_EN_IAT_HYST GPF_V_REGEN_EN_VSPD_MIN GPF_V_REGEN_EN_VSPD_HYST GPF_V_REGEN_EN_RPM_MIN GPF_V_REGEN_EN_RPM_HYST GPF_V_REGEN_ECT_MIN GPF_V_REGEN_ECT_MAX GPF_V_REGEN_EN_INLET_TEMP_MIN GPF_V_REGEN_EN_INLET_TEMP_MAX GPF_V_REGEN_EN_OIL_TEMP_MIN GPF_V_REGEN_EN_OIL_TEMP_MAX GPF_V_REGEN_EN_TURBO_TEMP_MIN GPF_V_REGEN_EN_TURBO_TEMP_MAX GPF_V_REGEN_EN_TWC_TEMP_MIN GPF_V_REGEN_EN_TWC_TEMP_MAX GPF_V_REGEN_ACT_TM_MAX GPF_V_SOOT_LD_PCT GPF_V_FORC_EO_SOOT GPF_V_REGEN_REQ_HI GPF_V_REGEN_REQ_HYS GPF_V_CRTIC_SOOT_THR GPF_V_LOW_TEMP_THR GPF_V_LOW_TEMP_TM_MAX GPF_V_HT_MOD_INLET_TEMP_HYST GPF_V_HT_MOD_INLET_TEMP_MIN GPF_X_HI_O2_TMP_SOOT_LOAD GPF_C_HI_O2_TMP_THR GPF_V_HT_O2_TEMP_THR_HYST GPF_V_HI_SOOT_LO_ESPD GPF_V_HI_SOOT_HI_ESPD GPF_V_HI_SOOT_LO_IMEP GPF_V_HI_SOOT_HI_IMEP GPF_V_HI_SOOT_LO_TEMP GPF_V_HI_SOOT_HI_TEMP GPF_V_HI_SOOT_PEDPOS_MAX GPF_V_HI_SOOT_THR GPF_V_HI_SOOT_DLY_UP GPF_V_HI_SOOT_DLY_DWN GPF_V_TRGT_DFT_AFR GPF_V_TRGT_DFT_TEMP GPF_V_TRGT_HT_AFR GPF_V_TRGT_HT_TEMP GPF_V_TRGT_O2_AFR GPF_V_TRGT_O2_TEMP GPF_V_TRGT_HI_SOOT_AFR GPF_V_TRGT_HI_SOOT_TEMP GPF_X_ACT_RGN_TRQ_RPM GPF_X_ACT_RGN_TRQ_DLT_TEMP GPF_M_ACT_RGN_TRQ GPF_X_RST_TM_SOOT_LD GPF_X_RST_TM_TEMP GPF_M_RST_TM /end DEF_CHARACTERISTIC
 /begin OUT_MEASUREMENT gpf_regen_stat_cond_st_eng_runtime gpf_regen_stat_cond_st_IMEP gpf_regen_stat_cond_st_BAT_volt gpf_regen_stat_cond_st_tank_level gpf_regen_stat_cond_st_IAT gpf_regen_stat_cond_st_MPH gpf_regen_stat_cond_st_RPM gpf_regen_stat_cond_st_BYPASS gpf_regen_oper_cond_st_CLNT gpf_regen_oper_cond_st_INLET gpf_regen_oper_cond_st_OIL gpf_regen_oper_cond_st_TURBO gpf_regen_oper_cond_st_TWC gpf_regen_oper_cond_st_BYPASS gpf_crtic_soot_req gpf_ht_regen_req gpf_hi_o2_regen_req gpf_hi_soot_regen_req gpf_low_temp_regen_req gpf_regen_rtm gpf_regen_conds_met gpf_regen_tm gpf_sel_accu_soot gpf_eo_accu_soot gpf_dp_accu_soot gpf_sel_soot_tot gpf_regen_req gpf_low_temp_regen_tm gpf_o2_temp_max_thresh gpf_hi_soot_regen_enbl_tm gpf_hi_soot_regen_dsbl_tm gpf_trgt_afr gpf_trgt_temp gpf_trgt_temp_diff gpf_add_tq gpf_afr gpf_ash_rst_tm_thresh /end OUT_MEASUREMENT
/end FUNCTION
/begin FUNCTION gpf_io "gpf input output"
 /begin DEF_CHARACTERISTIC GPF_V_DP_FAC GPF_V_DP_OFST GPF_V_DP_FILT GPF_V_IN_TEMP_INST GPF_C_IN_TEMP GPF_X_IN_TEMP GPF_V_IN_TEMP_FILT GPF_V_CFG GPF_M_TEMP_FAC GPF_X_TEMP_ESPD GPF_X_TEMP_FLW GPF_V_ASH_LRN_DSBL /end DEF_CHARACTERISTIC
 /begin OUT_MEASUREMENT gpf_dp_avg_flt gpf_temp_in_flt gpf_temp_in_flt_k gpf_dp_raw gpf_dp gpf_temp_in_raw gpf_temp_in_k gpf_puc_dsbl /end OUT_MEASUREMENT
/end FUNCTION
/*RECORD_LAYOUT keep no change*/
/begin RECORD_LAYOUT __UBYTE_Z FNC_VALUES 1 UBYTE ROW_DIR DIRECT /end RECORD_LAYOUT
/begin RECORD_LAYOUT __UWORD_Z FNC_VALUES 1 UWORD ROW_DIR DIRECT /end RECORD_LAYOUT
/begin RECORD_LAYOUT __ULONG_Z FNC_VALUES 1 ULONG ROW_DIR DIRECT /end RECORD_LAYOUT
/begin RECORD_LAYOUT __SBYTE_Z FNC_VALUES 1 SBYTE ROW_DIR DIRECT /end RECORD_LAYOUT
/begin RECORD_LAYOUT __SWORD_Z FNC_VALUES 1 SWORD ROW_DIR DIRECT /end RECORD_LAYOUT
/begin RECORD_LAYOUT __SLONG_Z FNC_VALUES 1 SLONG ROW_DIR DIRECT /end RECORD_LAYOUT
/begin RECORD_LAYOUT __FLOAT32_IEEE_Z FNC_VALUES 1 FLOAT32_IEEE ROW_DIR DIRECT /end RECORD_LAYOUT
/begin RECORD_LAYOUT __FLOAT64_IEEE_Z FNC_VALUES 1 FLOAT64_IEEE ROW_DIR DIRECT /end RECORD_LAYOUT
/begin RECORD_LAYOUT __UBYTE_S FNC_VALUES 1 UBYTE COLUMN_DIR DIRECT /end RECORD_LAYOUT
/begin RECORD_LAYOUT __UWORD_S FNC_VALUES 1 UWORD COLUMN_DIR DIRECT /end RECORD_LAYOUT
/begin RECORD_LAYOUT __SBYTE_S FNC_VALUES 1 SBYTE COLUMN_DIR DIRECT /end RECORD_LAYOUT
/begin RECORD_LAYOUT __SWORD_S FNC_VALUES 1 SWORD COLUMN_DIR DIRECT /end RECORD_LAYOUT
/begin RECORD_LAYOUT __FLOAT32_IEEE_S FNC_VALUES 1 FLOAT32_IEEE COLUMN_DIR DIRECT /end RECORD_LAYOUT
/begin RECORD_LAYOUT __FLOAT64_IEEE_S FNC_VALUES 1 FLOAT64_IEEE COLUMN_DIR DIRECT /end RECORD_LAYOUT
/begin RECORD_LAYOUT SSV__UBYTE_S AXIS_PTS_X 1 UBYTE INDEX_INCR DIRECT /end RECORD_LAYOUT
/begin RECORD_LAYOUT SSV__UWORD_S AXIS_PTS_X 1 UWORD INDEX_INCR DIRECT /end RECORD_LAYOUT
/begin RECORD_LAYOUT SSV__ULONG_S AXIS_PTS_X 1 ULONG INDEX_INCR DIRECT /end RECORD_LAYOUT
/begin RECORD_LAYOUT SSV__SBYTE_S AXIS_PTS_X 1 SBYTE INDEX_INCR DIRECT /end RECORD_LAYOUT
/begin RECORD_LAYOUT SSV__SWORD_S AXIS_PTS_X 1 SWORD INDEX_INCR DIRECT /end RECORD_LAYOUT
/begin RECORD_LAYOUT SSV__SLONG_S AXIS_PTS_X 1 SLONG INDEX_INCR DIRECT /end RECORD_LAYOUT
/begin RECORD_LAYOUT SSV__FLOAT32_IEEE_S AXIS_PTS_X 1 FLOAT32_IEEE INDEX_INCR DIRECT /end RECORD_LAYOUT
/begin RECORD_LAYOUT SSV__FLOAT64_IEEE_S AXIS_PTS_X 1 FLOAT64_IEEE INDEX_INCR DIRECT /end RECORD_LAYOUT
/begin RECORD_LAYOUT __A_UINT64_Z FNC_VALUES 1 A_UINT64 ROW_DIR DIRECT /end RECORD_LAYOUT
/begin RECORD_LAYOUT __A_INT64_Z FNC_VALUES 1 A_INT64 ROW_DIR DIRECT /end RECORD_LAYOUT
/begin RECORD_LAYOUT __A_UINT64_S FNC_VALUES 1 A_UINT64 COLUMN_DIR DIRECT /end RECORD_LAYOUT
/begin RECORD_LAYOUT __A_INT64_S FNC_VALUES 1 A_INT64 COLUMN_DIR DIRECT /end RECORD_LAYOUT
/begin RECORD_LAYOUT SSV__A_UINT64_S AXIS_PTS_X 1 A_UINT64 INDEX_INCR DIRECT /end RECORD_LAYOUT
/begin RECORD_LAYOUT SSV__A_INT64_S AXIS_PTS_X 1 A_INT64 INDEX_INCR DIRECT /end RECORD_LAYOUT
/end MODULE
/end PROJECT
