ASAP2_VERSION 1 60
/begin PROJECT FC33 ""
/begin HEADER "" VERSION "1.0" /end HEADER
/begin MODULE FC33 ""
/begin MOD_COMMON "" BYTE_ORDER MSB_FIRST ALIGNMENT_LONG 2 ALIGNMENT_WORD 1 /end MOD_COMMON
/begin CHARACTERISTIC ERRM_EGR_POS_HI_TYP "EGR position sensor short high type" VALUE 0x2886C __UWORD_S 0 u_diag_typ 0 8 FORMAT "%1.0" BIT_MASK 0xF000 SYMBOL_LINK "ERRM_CFG_ARRY" 372 /end CHARACTERISTIC
/begin CHARACTERISTIC ERRM_EGR_POS_HI_MIL_ON "EGR position sensor short high MIL on enable" VALUE 0x2886C __UWORD_S 0 b_true 0 1 FORMAT "%1.0" BIT_MASK 0x0800 SYMBOL_LINK "ERRM_CFG_ARRY" 372 /end CHARACTERISTIC
/begin CHARACTERISTIC ERRM_EGR_POS_HI_DEN_GRP "EGR position sensor short high denom group" VALUE 0x2886C __UWORD_S 0 u_den_grp 0 63 FORMAT "%1.0" BIT_MASK 0x003F SYMBOL_LINK "ERRM_CFG_ARRY" 372 /end CHARACTERISTIC
/begin CHARACTERISTIC ERRM_EGR_POS_HI_DTC "EGR position sensor short high DTC" VALUE 0x2886C __UWORD_S 0 u_cnts 0 65535 FORMAT "%5.0" SYMBOL_LINK "ERRM_CFG_ARRY" 374 /end CHARACTERISTIC
/begin CHARACTERISTIC ERRM_EGR_POS_LO_TYP "EGR position sensor short low type" VALUE 0x2886C __UWORD_S 0 u_diag_typ 0 8 FORMAT "%1.0" BIT_MASK 0xF000 SYMBOL_LINK "ERRM_CFG_ARRY" 378 /end CHARACTERISTIC
/begin CHARACTERISTIC ERRM_EGR_POS_LO_MIL_ON "EGR position sensor short low MIL on enable" VALUE 0x2886C __UWORD_S 0 b_true 0 1 FORMAT "%1.0" BIT_MASK 0x0800 SYMBOL_LINK "ERRM_CFG_ARRY" 378 /end CHARACTERISTIC
/begin CHARACTERISTIC ERRM_EGR_POS_LO_DEN_GRP "EGR position sensor short low denom group" VALUE 0x2886C __UWORD_S 0 u_den_grp 0 63 FORMAT "%1.0" BIT_MASK 0x003F SYMBOL_LINK "ERRM_CFG_ARRY" 378 /end CHARACTERISTIC
/begin CHARACTERISTIC ERRM_EGR_POS_LO_DTC "EGR position sensor short low DTC" VALUE 0x2886C __UWORD_S 0 u_cnts 0 65535 FORMAT "%5.0" SYMBOL_LINK "ERRM_CFG_ARRY" 380 /end CHARACTERISTIC
/begin CHARACTERISTIC ERRM_EGR_ZERO_INIT_TYP "EGR position sensor initial zero type" VALUE 0x2886C __UWORD_S 0 u_diag_typ 0 8 FORMAT "%1.0" BIT_MASK 0xF000 SYMBOL_LINK "ERRM_CFG_ARRY" 384 /end CHARACTERISTIC
/begin CHARACTERISTIC ERRM_EGR_ZERO_INIT_MIL_ON "EGR position sensor initial zero MIL on enable" VALUE 0x2886C __UWORD_S 0 b_true 0 1 FORMAT "%1.0" BIT_MASK 0x0800 SYMBOL_LINK "ERRM_CFG_ARRY" 384 /end CHARACTERISTIC
/begin CHARACTERISTIC ERRM_EGR_ZERO_INIT_DEN_GRP "EGR position sensor initial zero denom group" VALUE 0x2886C __UWORD_S 0 u_den_grp 0 63 FORMAT "%1.0" BIT_MASK 0x003F SYMBOL_LINK "ERRM_CFG_ARRY" 384 /end CHARACTERISTIC
/begin CHARACTERISTIC ERRM_EGR_ZERO_INIT_DTC "EGR position sensor initial zero DTC" VALUE 0x2886C __UWORD_S 0 u_cnts 0 65535 FORMAT "%5.0" SYMBOL_LINK "ERRM_CFG_ARRY" 386 /end CHARACTERISTIC
/begin CHARACTERISTIC ERRM_EGR_ZERO_CHG_TYP "EGR position sensor zero change type" VALUE 0x2886C __UWORD_S 0 u_diag_typ 0 8 FORMAT "%1.0" BIT_MASK 0xF000 SYMBOL_LINK "ERRM_CFG_ARRY" 390 /end CHARACTERISTIC
/begin CHARACTERISTIC ERRM_EGR_ZERO_CHG_MIL_ON "EGR position sensor zero change MIL on enable" VALUE 0x2886C __UWORD_S 0 b_true 0 1 FORMAT "%1.0" BIT_MASK 0x0800 SYMBOL_LINK "ERRM_CFG_ARRY" 390 /end CHARACTERISTIC
/begin CHARACTERISTIC ERRM_EGR_ZERO_CHG_DEN_GRP "EGR position sensor zero change denom group" VALUE 0x2886C __UWORD_S 0 u_den_grp 0 63 FORMAT "%1.0" BIT_MASK 0x003F SYMBOL_LINK "ERRM_CFG_ARRY" 390 /end CHARACTERISTIC
/begin CHARACTERISTIC ERRM_EGR_ZERO_CHG_DTC "EGR position sensor zero change DTC" VALUE 0x2886C __UWORD_S 0 u_cnts 0 65535 FORMAT "%5.0" SYMBOL_LINK "ERRM_CFG_ARRY" 392 /end CHARACTERISTIC
/begin CHARACTERISTIC ERRM_EGR_FLW_TYP "EGR flow type" VALUE 0x2886C __UWORD_S 0 u_diag_typ 0 8 FORMAT "%1.0" BIT_MASK 0xF000 SYMBOL_LINK "ERRM_CFG_ARRY" 396 /end CHARACTERISTIC
/begin CHARACTERISTIC ERRM_EGR_FLW_MIL_ON "EGR flow MIL on enable" VALUE 0x2886C __UWORD_S 0 b_true 0 1 FORMAT "%1.0" BIT_MASK 0x0800 SYMBOL_LINK "ERRM_CFG_ARRY" 396 /end CHARACTERISTIC
/begin CHARACTERISTIC ERRM_EGR_FLW_DEN_GRP "EGR flow denom group" VALUE 0x2886C __UWORD_S 0 u_den_grp 0 63 FORMAT "%1.0" BIT_MASK 0x003F SYMBOL_LINK "ERRM_CFG_ARRY" 396 /end CHARACTERISTIC
/begin CHARACTERISTIC ERRM_EGR_FLW_DTC "EGR flow change DTC" VALUE 0x2886C __UWORD_S 0 u_cnts 0 65535 FORMAT "%5.0" SYMBOL_LINK "ERRM_CFG_ARRY" 398 /end CHARACTERISTIC
/begin CHARACTERISTIC ERRM_EGR_CLS_POS_TYP "EGR close position type" VALUE 0x2886C __UWORD_S 0 u_diag_typ 0 8 FORMAT "%1.0" BIT_MASK 0xF000 SYMBOL_LINK "ERRM_CFG_ARRY" 402 /end CHARACTERISTIC
/begin CHARACTERISTIC ERRM_EGR_CLS_POS_MIL_ON "EGR close position MIL on enable" VALUE 0x2886C __UWORD_S 0 b_true 0 1 FORMAT "%1.0" BIT_MASK 0x0800 SYMBOL_LINK "ERRM_CFG_ARRY" 402 /end CHARACTERISTIC
/begin CHARACTERISTIC ERRM_EGR_CLS_POS_DEN_GRP "EGR close position denom group" VALUE 0x2886C __UWORD_S 0 u_den_grp 0 63 FORMAT "%1.0" BIT_MASK 0x003F SYMBOL_LINK "ERRM_CFG_ARRY" 402 /end CHARACTERISTIC
/begin CHARACTERISTIC ERRM_EGR_CLS_POS_DTC "EGR close position change DTC" VALUE 0x2886C __UWORD_S 0 u_cnts 0 65535 FORMAT "%5.0" SYMBOL_LINK "ERRM_CFG_ARRY" 404 /end CHARACTERISTIC
/begin CHARACTERISTIC ERRM_EGR_STCK_TYP "EGR stuck type" VALUE 0x2886C __UWORD_S 0 u_diag_typ 0 8 FORMAT "%1.0" BIT_MASK 0xF000 SYMBOL_LINK "ERRM_CFG_ARRY" 408 /end CHARACTERISTIC
/begin CHARACTERISTIC ERRM_EGR_STCK_MIL_ON "EGR stuck MIL on enable" VALUE 0x2886C __UWORD_S 0 b_true 0 1 FORMAT "%1.0" BIT_MASK 0x0800 SYMBOL_LINK "ERRM_CFG_ARRY" 408 /end CHARACTERISTIC
/begin CHARACTERISTIC ERRM_EGR_STCK_DEN_GRP "EGR stuck denom group" VALUE 0x2886C __UWORD_S 0 u_den_grp 0 63 FORMAT "%1.0" BIT_MASK 0x003F SYMBOL_LINK "ERRM_CFG_ARRY" 408 /end CHARACTERISTIC
/begin CHARACTERISTIC ERRM_EGR_STCK_DTC "EGR stuck change DTC" VALUE 0x2886C __UWORD_S 0 u_cnts 0 65535 FORMAT "%5.0" SYMBOL_LINK "ERRM_CFG_ARRY" 410 /end CHARACTERISTIC
/begin CHARACTERISTIC ERRM_EGR_POS_ERR_TYP "EGR position close conrol error type" VALUE 0x2886C __UWORD_S 0 u_diag_typ 0 8 FORMAT "%1.0" BIT_MASK 0xF000 SYMBOL_LINK "ERRM_CFG_ARRY" 414 /end CHARACTERISTIC
/begin CHARACTERISTIC ERRM_EGR_POS_ERR_MIL_ON "EGR position close conrol error MIL on enable" VALUE 0x2886C __UWORD_S 0 b_true 0 1 FORMAT "%1.0" BIT_MASK 0x0800 SYMBOL_LINK "ERRM_CFG_ARRY" 414 /end CHARACTERISTIC
/begin CHARACTERISTIC ERRM_EGR_POS_ERR_DEN_GRP "EGR position close conrol error denom group" VALUE 0x2886C __UWORD_S 0 u_den_grp 0 63 FORMAT "%1.0" BIT_MASK 0x003F SYMBOL_LINK "ERRM_CFG_ARRY" 414 /end CHARACTERISTIC
/begin CHARACTERISTIC ERRM_EGR_POS_ERR_DTC "EGR position close conrol error change DTC" VALUE 0x2886C __UWORD_S 0 u_cnts 0 65535 FORMAT "%5.0" SYMBOL_LINK "ERRM_CFG_ARRY" 416 /end CHARACTERISTIC
/begin CHARACTERISTIC ERRM_BST_T_LO_TYP "boost temp short low type" VALUE 0x2886C __UWORD_S 0 u_diag_typ 0 8 FORMAT "%1.0" BIT_MASK 0xF000 SYMBOL_LINK "ERRM_CFG_ARRY" 690 /end CHARACTERISTIC
/begin CHARACTERISTIC ERRM_BST_T_LO_MIL_ON "boost temp short low MIL on enable" VALUE 0x2886C __UWORD_S 0 b_true 0 1 FORMAT "%1.0" BIT_MASK 0x0800 SYMBOL_LINK "ERRM_CFG_ARRY" 690 /end CHARACTERISTIC
/begin CHARACTERISTIC ERRM_BST_T_LO_DEN_GRP "boost temp short low denom group" VALUE 0x2886C __UWORD_S 0 u_den_grp 0 63 FORMAT "%1.0" BIT_MASK 0x003F SYMBOL_LINK "ERRM_CFG_ARRY" 690 /end CHARACTERISTIC
/begin CHARACTERISTIC ERRM_BST_T_LO_DTC "boost temp short low DTC" VALUE 0x2886C __UWORD_S 0 u_cnts 0 65535 FORMAT "%5.0" SYMBOL_LINK "ERRM_CFG_ARRY" 692 /end CHARACTERISTIC
/begin CHARACTERISTIC ERRM_BST_T_HI_TYP "boost temp short high type" VALUE 0x2886C __UWORD_S 0 u_diag_typ 0 8 FORMAT "%1.0" BIT_MASK 0xF000 SYMBOL_LINK "ERRM_CFG_ARRY" 708 /end CHARACTERISTIC
/begin CHARACTERISTIC ERRM_BST_T_HI_MIL_ON "boost temp short high MIL on enable" VALUE 0x2886C __UWORD_S 0 b_true 0 1 FORMAT "%1.0" BIT_MASK 0x0800 SYMBOL_LINK "ERRM_CFG_ARRY" 708 /end CHARACTERISTIC
/begin CHARACTERISTIC ERRM_BST_T_HI_DEN_GRP "boost temp short high denom group" VALUE 0x2886C __UWORD_S 0 u_den_grp 0 63 FORMAT "%1.0" BIT_MASK 0x003F SYMBOL_LINK "ERRM_CFG_ARRY" 708 /end CHARACTERISTIC
/begin CHARACTERISTIC ERRM_BST_T_HI_DTC "boost temp short high DTC" VALUE 0x2886C __UWORD_S 0 u_cnts 0 65535 FORMAT "%5.0" SYMBOL_LINK "ERRM_CFG_ARRY" 710 /end CHARACTERISTIC
/begin CHARACTERISTIC ERRM_BST_T_HI_RAT_TYP "boost temp short high rationality type" VALUE 0x2886C __UWORD_S 0 u_diag_typ 0 8 FORMAT "%1.0" BIT_MASK 0xF000 SYMBOL_LINK "ERRM_CFG_ARRY" 762 /end CHARACTERISTIC
/begin CHARACTERISTIC ERRM_BST_T_HI_RAT_MIL_ON "boost temp short high rationality MIL on enable" VALUE 0x2886C __UWORD_S 0 b_true 0 1 FORMAT "%1.0" BIT_MASK 0x0800 SYMBOL_LINK "ERRM_CFG_ARRY" 762 /end CHARACTERISTIC
/begin CHARACTERISTIC ERRM_BST_T_HI_RAT_DEN_GRP "boost temp short high rationality denom group" VALUE 0x2886C __UWORD_S 0 u_den_grp 0 63 FORMAT "%1.0" BIT_MASK 0x003F SYMBOL_LINK "ERRM_CFG_ARRY" 762 /end CHARACTERISTIC
/begin CHARACTERISTIC ERRM_BST_T_HI_RAT_DTC "boost temp short high rationality DTC" VALUE 0x2886C __UWORD_S 0 u_cnts 0 65535 FORMAT "%5.0" SYMBOL_LINK "ERRM_CFG_ARRY" 764 /end CHARACTERISTIC
/begin CHARACTERISTIC ERRM_BST_T_LO_RAT_TYP "boost temp short low rationality type" VALUE 0x2886C __UWORD_S 0 u_diag_typ 0 8 FORMAT "%1.0" BIT_MASK 0xF000 SYMBOL_LINK "ERRM_CFG_ARRY" 780 /end CHARACTERISTIC
/begin CHARACTERISTIC ERRM_BST_T_LO_RAT_MIL_ON "boost temp short low rationality MIL on enable" VALUE 0x2886C __UWORD_S 0 b_true 0 1 FORMAT "%1.0" BIT_MASK 0x0800 SYMBOL_LINK "ERRM_CFG_ARRY" 780 /end CHARACTERISTIC
/begin CHARACTERISTIC ERRM_BST_T_LO_RAT_DEN_GRP "boost temp short low rationality denom group" VALUE 0x2886C __UWORD_S 0 u_den_grp 0 63 FORMAT "%1.0" BIT_MASK 0x003F SYMBOL_LINK "ERRM_CFG_ARRY" 780 /end CHARACTERISTIC
/begin CHARACTERISTIC ERRM_BST_T_LO_RAT_DTC "boost temp short low rationality DTC" VALUE 0x2886C __UWORD_S 0 u_cnts 0 65535 FORMAT "%5.0" SYMBOL_LINK "ERRM_CFG_ARRY" 782 /end CHARACTERISTIC
/begin CHARACTERISTIC ERRM_MISFIRE_TYP "misfire type" VALUE 0x2886C __UWORD_S 0 u_diag_typ 0 8 FORMAT "%1.0" BIT_MASK 0xF000 SYMBOL_LINK "ERRM_CFG_ARRY" 918 SYMBOL_LINK "ERRM_CFG_ARRY" 870 /end CHARACTERISTIC
/begin CHARACTERISTIC ERRM_MISFIRE_MIL_ON "misfire MIL on enable" VALUE 0x2886C __UWORD_S 0 b_true 0 1 FORMAT "%1.0" BIT_MASK 0x0800 SYMBOL_LINK "ERRM_CFG_ARRY" 918 SYMBOL_LINK "ERRM_CFG_ARRY" 870 /end CHARACTERISTIC
/begin CHARACTERISTIC ERRM_MISFIRE_DEN_GRP "misfire denom group" VALUE 0x2886C __UWORD_S 0 u_den_grp 0 63 FORMAT "%1.0" BIT_MASK 0x003F SYMBOL_LINK "ERRM_CFG_ARRY" 918 SYMBOL_LINK "ERRM_CFG_ARRY" 870 /end CHARACTERISTIC
/begin CHARACTERISTIC ERRM_MISFIRE_DTC "misfire DTC" VALUE 0x2886C __UWORD_S 0 u_cnts 0 65535 FORMAT "%5.0" SYMBOL_LINK "ERRM_CFG_ARRY" 920 SYMBOL_LINK "ERRM_CFG_ARRY" 872 /end CHARACTERISTIC
/begin CHARACTERISTIC ERRM_VOLT_HI_TYP "ignition voltage high type" VALUE 0x2886C __UWORD_S 0 u_diag_typ 0 8 FORMAT "%1.0" BIT_MASK 0xF000 SYMBOL_LINK "ERRM_CFG_ARRY" 1014 SYMBOL_LINK "ERRM_CFG_ARRY" 966 /end CHARACTERISTIC
/begin CHARACTERISTIC ERRM_VOLT_HI_MIL_ON "ignition voltage high MIL on enable" VALUE 0x2886C __UWORD_S 0 b_true 0 1 FORMAT "%1.0" BIT_MASK 0x0800 SYMBOL_LINK "ERRM_CFG_ARRY" 1014 SYMBOL_LINK "ERRM_CFG_ARRY" 966 /end CHARACTERISTIC
/begin CHARACTERISTIC ERRM_VOLT_HI_DEN_GRP "ignition voltage high denom group" VALUE 0x2886C __UWORD_S 0 u_den_grp 0 63 FORMAT "%1.0" BIT_MASK 0x003F SYMBOL_LINK "ERRM_CFG_ARRY" 1014 SYMBOL_LINK "ERRM_CFG_ARRY" 966 /end CHARACTERISTIC
/begin CHARACTERISTIC ERRM_VOLT_HI_DTC "ignition voltage high DTC" VALUE 0x2886C __UWORD_S 0 u_cnts 0 65535 FORMAT "%5.0" SYMBOL_LINK "ERRM_CFG_ARRY" 1016 SYMBOL_LINK "ERRM_CFG_ARRY" 968 /end CHARACTERISTIC
/begin CHARACTERISTIC ERRM_VOLT_LO_TYP "ignition voltage low type" VALUE 0x2886C __UWORD_S 0 u_diag_typ 0 8 FORMAT "%1.0" BIT_MASK 0xF000 SYMBOL_LINK "ERRM_CFG_ARRY" 1020 SYMBOL_LINK "ERRM_CFG_ARRY" 972 /end CHARACTERISTIC
/begin CHARACTERISTIC ERRM_VOLT_LO_MIL_ON "ignition voltage low MIL on enable" VALUE 0x2886C __UWORD_S 0 b_true 0 1 FORMAT "%1.0" BIT_MASK 0x0800 SYMBOL_LINK "ERRM_CFG_ARRY" 1020 SYMBOL_LINK "ERRM_CFG_ARRY" 972 /end CHARACTERISTIC
/begin CHARACTERISTIC ERRM_VOLT_LO_DEN_GRP "ignition voltage low denom group" VALUE 0x2886C __UWORD_S 0 u_den_grp 0 63 FORMAT "%1.0" BIT_MASK 0x003F SYMBOL_LINK "ERRM_CFG_ARRY" 1020 SYMBOL_LINK "ERRM_CFG_ARRY" 972 /end CHARACTERISTIC
/begin CHARACTERISTIC ERRM_VOLT_LO_DTC "ignition voltage low DTC" VALUE 0x2886C __UWORD_S 0 u_cnts 0 65535 FORMAT "%5.0" SYMBOL_LINK "ERRM_CFG_ARRY" 1022 SYMBOL_LINK "ERRM_CFG_ARRY" 974 /end CHARACTERISTIC
/begin CHARACTERISTIC ERRM_TANK_P_HI_TYP "tank press short high type" VALUE 0x2886C __UWORD_S 0 u_diag_typ 0 8 FORMAT "%1.0" BIT_MASK 0xF000 SYMBOL_LINK "ERRM_CFG_ARRY" 1026 SYMBOL_LINK "ERRM_CFG_ARRY" 978 /end CHARACTERISTIC
/begin CHARACTERISTIC ERRM_TANK_P_HI_MIL_ON "tank press short high MIL on enable" VALUE 0x2886C __UWORD_S 0 b_true 0 1 FORMAT "%1.0" BIT_MASK 0x0800 SYMBOL_LINK "ERRM_CFG_ARRY" 1026 SYMBOL_LINK "ERRM_CFG_ARRY" 978 /end CHARACTERISTIC
/begin CHARACTERISTIC ERRM_TANK_P_HI_DEN_GRP "tank press short high denom group" VALUE 0x2886C __UWORD_S 0 u_den_grp 0 63 FORMAT "%1.0" BIT_MASK 0x003F SYMBOL_LINK "ERRM_CFG_ARRY" 1026 SYMBOL_LINK "ERRM_CFG_ARRY" 978 /end CHARACTERISTIC
/begin CHARACTERISTIC ERRM_TANK_P_HI_DTC "tank press short high DTC" VALUE 0x2886C __UWORD_S 0 u_cnts 0 65535 FORMAT "%5.0" SYMBOL_LINK "ERRM_CFG_ARRY" 1028 SYMBOL_LINK "ERRM_CFG_ARRY" 980 /end CHARACTERISTIC
/begin CHARACTERISTIC ERRM_TANK_P_LO_TYP "tank press short low type" VALUE 0x2886C __UWORD_S 0 u_diag_typ 0 8 FORMAT "%1.0" BIT_MASK 0xF000 SYMBOL_LINK "ERRM_CFG_ARRY" 1032 SYMBOL_LINK "ERRM_CFG_ARRY" 984 /end CHARACTERISTIC
/begin CHARACTERISTIC ERRM_TANK_P_LO_MIL_ON "tank press short low MIL on enable" VALUE 0x2886C __UWORD_S 0 b_true 0 1 FORMAT "%1.0" BIT_MASK 0x0800 SYMBOL_LINK "ERRM_CFG_ARRY" 1032 SYMBOL_LINK "ERRM_CFG_ARRY" 984 /end CHARACTERISTIC
/begin CHARACTERISTIC ERRM_TANK_P_LO_DEN_GRP "tank press short low denom group" VALUE 0x2886C __UWORD_S 0 u_den_grp 0 63 FORMAT "%1.0" BIT_MASK 0x003F SYMBOL_LINK "ERRM_CFG_ARRY" 1032 SYMBOL_LINK "ERRM_CFG_ARRY" 984 /end CHARACTERISTIC
/begin CHARACTERISTIC ERRM_TANK_P_LO_DTC "tank press short low DTC" VALUE 0x2886C __UWORD_S 0 u_cnts 0 65535 FORMAT "%5.0" SYMBOL_LINK "ERRM_CFG_ARRY" 1034 SYMBOL_LINK "ERRM_CFG_ARRY" 986 /end CHARACTERISTIC
/begin CHARACTERISTIC ERRM_TANK_P_STCK_TYP "tank press stuck type" VALUE 0x2886C __UWORD_S 0 u_diag_typ 0 8 FORMAT "%1.0" BIT_MASK 0xF000 SYMBOL_LINK "ERRM_CFG_ARRY" 1038 SYMBOL_LINK "ERRM_CFG_ARRY" 990 /end CHARACTERISTIC
/begin CHARACTERISTIC ERRM_TANK_P_STCK_MIL_ON "tank press stuck MIL on enable" VALUE 0x2886C __UWORD_S 0 b_true 0 1 FORMAT "%1.0" BIT_MASK 0x0800 SYMBOL_LINK "ERRM_CFG_ARRY" 1038 SYMBOL_LINK "ERRM_CFG_ARRY" 990 /end CHARACTERISTIC
/begin CHARACTERISTIC ERRM_TANK_P_STCK_DEN_GRP "tank press stuck denom group" VALUE 0x2886C __UWORD_S 0 u_den_grp 0 63 FORMAT "%1.0" BIT_MASK 0x003F SYMBOL_LINK "ERRM_CFG_ARRY" 1038 SYMBOL_LINK "ERRM_CFG_ARRY" 990 /end CHARACTERISTIC
/begin CHARACTERISTIC ERRM_TANK_P_STCK_DTC "tank press stuck low DTC" VALUE 0x2886C __UWORD_S 0 u_cnts 0 65535 FORMAT "%5.0" SYMBOL_LINK "ERRM_CFG_ARRY" 1040 SYMBOL_LINK "ERRM_CFG_ARRY" 992 /end CHARACTERISTIC
/begin CHARACTERISTIC ERRM_TANK_P_NOISE_TYP "tank press noise type" VALUE 0x2886C __UWORD_S 0 u_diag_typ 0 8 FORMAT "%1.0" BIT_MASK 0xF000 SYMBOL_LINK "ERRM_CFG_ARRY" 1044 SYMBOL_LINK "ERRM_CFG_ARRY" 996 /end CHARACTERISTIC
/begin CHARACTERISTIC ERRM_TANK_P_NOISE_MIL_ON "tank press noise MIL on enable" VALUE 0x2886C __UWORD_S 0 b_true 0 1 FORMAT "%1.0" BIT_MASK 0x0800 SYMBOL_LINK "ERRM_CFG_ARRY" 1044 SYMBOL_LINK "ERRM_CFG_ARRY" 996 /end CHARACTERISTIC
/begin CHARACTERISTIC ERRM_TANK_P_NOISE_DEN_GRP "tank press noise denom group" VALUE 0x2886C __UWORD_S 0 u_den_grp 0 63 FORMAT "%1.0" BIT_MASK 0x003F SYMBOL_LINK "ERRM_CFG_ARRY" 1044 SYMBOL_LINK "ERRM_CFG_ARRY" 996 /end CHARACTERISTIC
/begin CHARACTERISTIC ERRM_TANK_P_NOISE_DTC "tank press noise low DTC" VALUE 0x2886C __UWORD_S 0 u_cnts 0 65535 FORMAT "%5.0" SYMBOL_LINK "ERRM_CFG_ARRY" 1046 SYMBOL_LINK "ERRM_CFG_ARRY" 998 /end CHARACTERISTIC
/begin CHARACTERISTIC ERRM_CRK_LRN_TYP "crankshaft tooth learn type" VALUE 0x2886C __UWORD_S 0 u_diag_typ 0 8 FORMAT "%1.0" BIT_MASK 0xF000 SYMBOL_LINK "ERRM_CFG_ARRY" 1086 SYMBOL_LINK "ERRM_CFG_ARRY" 1038 /end CHARACTERISTIC
/begin CHARACTERISTIC ERRM_CRK_LRN_MIL_ON "crankshaft tooth learn MIL on enable" VALUE 0x2886C __UWORD_S 0 b_true 0 1 FORMAT "%1.0" BIT_MASK 0x0800 SYMBOL_LINK "ERRM_CFG_ARRY" 1086 SYMBOL_LINK "ERRM_CFG_ARRY" 1038 /end CHARACTERISTIC
/begin CHARACTERISTIC ERRM_CRK_LRN_DEN_GRP "crankshaft tooth learn denom group" VALUE 0x2886C __UWORD_S 0 u_den_grp 0 63 FORMAT "%1.0" BIT_MASK 0x003F SYMBOL_LINK "ERRM_CFG_ARRY" 1086 SYMBOL_LINK "ERRM_CFG_ARRY" 1038 /end CHARACTERISTIC
/begin CHARACTERISTIC ERRM_CRK_LRN_DTC "crankshaft tooth learn low DTC" VALUE 0x2886C __UWORD_S 0 u_cnts 0 65535 FORMAT "%5.0" SYMBOL_LINK "ERRM_CFG_ARRY" 1088 SYMBOL_LINK "ERRM_CFG_ARRY" 1040 /end CHARACTERISTIC
/begin CHARACTERISTIC ERRM_VSPD_OPN_TYP "vehicle speed sensor type" VALUE 0x2886C __UWORD_S 0 u_diag_typ 0 8 FORMAT "%1.0" BIT_MASK 0xF000 SYMBOL_LINK "ERRM_CFG_ARRY" 1140 SYMBOL_LINK "ERRM_CFG_ARRY" 1092 /end CHARACTERISTIC
/begin CHARACTERISTIC ERRM_VSPD_OPN_MIL_ON "vehicle speed sensor MIL on enable" VALUE 0x2886C __UWORD_S 0 b_true 0 1 FORMAT "%1.0" BIT_MASK 0x0800 SYMBOL_LINK "ERRM_CFG_ARRY" 1140 SYMBOL_LINK "ERRM_CFG_ARRY" 1092 /end CHARACTERISTIC
/begin CHARACTERISTIC ERRM_VSPD_OPN_DEN_GRP "vehicle speed sensor denom group" VALUE 0x2886C __UWORD_S 0 u_den_grp 0 63 FORMAT "%1.0" BIT_MASK 0x003F SYMBOL_LINK "ERRM_CFG_ARRY" 1140 SYMBOL_LINK "ERRM_CFG_ARRY" 1092 /end CHARACTERISTIC
/begin CHARACTERISTIC ERRM_VSPD_OPN_DTC "vehicle speed sensor low DTC" VALUE 0x2886C __UWORD_S 0 u_cnts 0 65535 FORMAT "%5.0" SYMBOL_LINK "ERRM_CFG_ARRY" 1142 SYMBOL_LINK "ERRM_CFG_ARRY" 1094 /end CHARACTERISTIC
/begin CHARACTERISTIC ERRM_B1_EXH_CAM_TH_TYP "bank1 exhaust cam tooth number type" VALUE 0x2886C __UWORD_S 0 u_diag_typ 0 8 FORMAT "%1.0" BIT_MASK 0xF000 SYMBOL_LINK "ERRM_CFG_ARRY" 1146 SYMBOL_LINK "ERRM_CFG_ARRY" 1098 /end CHARACTERISTIC
/begin CHARACTERISTIC ERRM_B1_EXH_CAM_TH_MIL_ON "bank1 exhaust cam tooth number MIL on enable" VALUE 0x2886C __UWORD_S 0 b_true 0 1 FORMAT "%1.0" BIT_MASK 0x0800 SYMBOL_LINK "ERRM_CFG_ARRY" 1146 SYMBOL_LINK "ERRM_CFG_ARRY" 1098 /end CHARACTERISTIC
/begin CHARACTERISTIC ERRM_B1_EXH_CAM_TH_DEN_GRP "bank1 exhaust cam tooth number denom group" VALUE 0x2886C __UWORD_S 0 u_den_grp 0 63 FORMAT "%1.0" BIT_MASK 0x003F SYMBOL_LINK "ERRM_CFG_ARRY" 1146 SYMBOL_LINK "ERRM_CFG_ARRY" 1098 /end CHARACTERISTIC
/begin CHARACTERISTIC ERRM_B1_EXH_CAM_TH_DTC "bank1 exhaust cam tooth number DTC" VALUE 0x2886C __UWORD_S 0 u_cnts 0 65535 FORMAT "%5.0" SYMBOL_LINK "ERRM_CFG_ARRY" 1148 SYMBOL_LINK "ERRM_CFG_ARRY" 1100 /end CHARACTERISTIC
/begin CHARACTERISTIC ERRM_B1_EXH_CAM_COR_TYP "bank1 exhaust cam tooth learn type" VALUE 0x2886C __UWORD_S 0 u_diag_typ 0 8 FORMAT "%1.0" BIT_MASK 0xF000 SYMBOL_LINK "ERRM_CFG_ARRY" 1152 SYMBOL_LINK "ERRM_CFG_ARRY" 1104 /end CHARACTERISTIC
/begin CHARACTERISTIC ERRM_B1_EXH_CAM_COR_MIL_ON "bank1 exhaust cam tooth learn MIL on enable" VALUE 0x2886C __UWORD_S 0 b_true 0 1 FORMAT "%1.0" BIT_MASK 0x0800 SYMBOL_LINK "ERRM_CFG_ARRY" 1152 SYMBOL_LINK "ERRM_CFG_ARRY" 1104 /end CHARACTERISTIC
/begin CHARACTERISTIC ERRM_B1_EXH_CAM_COR_DEN_GRP "bank1 exhaust cam tooth learn denom group" VALUE 0x2886C __UWORD_S 0 u_den_grp 0 63 FORMAT "%1.0" BIT_MASK 0x003F SYMBOL_LINK "ERRM_CFG_ARRY" 1152 SYMBOL_LINK "ERRM_CFG_ARRY" 1104 /end CHARACTERISTIC
/begin CHARACTERISTIC ERRM_B1_EXH_CAM_COR_DTC "bank1 exhaust cam tooth learn DTC" VALUE 0x2886C __UWORD_S 0 u_cnts 0 65535 FORMAT "%5.0" SYMBOL_LINK "ERRM_CFG_ARRY" 1154 SYMBOL_LINK "ERRM_CFG_ARRY" 1106 /end CHARACTERISTIC
/begin CHARACTERISTIC ERRM_B1_EXH_VVT_STCK_TYP "bank1 exhaust vvt stuck type" VALUE 0x2886C __UWORD_S 0 u_diag_typ 0 8 FORMAT "%1.0" BIT_MASK 0xF000 SYMBOL_LINK "ERRM_CFG_ARRY" 1158 SYMBOL_LINK "ERRM_CFG_ARRY" 1110 /end CHARACTERISTIC
/begin CHARACTERISTIC ERRM_B1_EXH_VVT_STCK_MIL_ON "bank1 exhaust vvt stuck MIL on enable" VALUE 0x2886C __UWORD_S 0 b_true 0 1 FORMAT "%1.0" BIT_MASK 0x0800 SYMBOL_LINK "ERRM_CFG_ARRY" 1158 SYMBOL_LINK "ERRM_CFG_ARRY" 1110 /end CHARACTERISTIC
/begin CHARACTERISTIC ERRM_B1_EXH_VVT_STCK_DEN_GRP "bank1 exhaust vvt stuck denom group" VALUE 0x2886C __UWORD_S 0 u_den_grp 0 63 FORMAT "%1.0" BIT_MASK 0x003F SYMBOL_LINK "ERRM_CFG_ARRY" 1158 SYMBOL_LINK "ERRM_CFG_ARRY" 1110 /end CHARACTERISTIC
/begin CHARACTERISTIC ERRM_B1_EXH_VVT_STCK_DTC "bank1 exhaust vvt stuck DTC" VALUE 0x2886C __UWORD_S 0 u_cnts 0 65535 FORMAT "%5.0" SYMBOL_LINK "ERRM_CFG_ARRY" 1160 SYMBOL_LINK "ERRM_CFG_ARRY" 1112 /end CHARACTERISTIC
/begin CHARACTERISTIC ERRM_B1_EXH_CAM_SLW_TYP "bank1 exhaust vvt stuck type" VALUE 0x2886C __UWORD_S 0 u_diag_typ 0 8 FORMAT "%1.0" BIT_MASK 0xF000 SYMBOL_LINK "ERRM_CFG_ARRY" 1164 SYMBOL_LINK "ERRM_CFG_ARRY" 1116 /end CHARACTERISTIC
/begin CHARACTERISTIC ERRM_B1_EXH_CAM_SLW_MIL_ON "bank1 exhaust vvt stuck MIL on enable" VALUE 0x2886C __UWORD_S 0 b_true 0 1 FORMAT "%1.0" BIT_MASK 0x0800 SYMBOL_LINK "ERRM_CFG_ARRY" 1164 SYMBOL_LINK "ERRM_CFG_ARRY" 1116 /end CHARACTERISTIC
/begin CHARACTERISTIC ERRM_B1_EXH_CAM_SLW_DEN_GRP "bank1 exhaust vvt stuck denom group" VALUE 0x2886C __UWORD_S 0 u_den_grp 0 63 FORMAT "%1.0" BIT_MASK 0x003F SYMBOL_LINK "ERRM_CFG_ARRY" 1164 SYMBOL_LINK "ERRM_CFG_ARRY" 1116 /end CHARACTERISTIC
/begin CHARACTERISTIC ERRM_B1_EXH_CAM_SLW_DTC "bank1 exhaust vvt stuck DTC" VALUE 0x2886C __UWORD_S 0 u_cnts 0 65535 FORMAT "%5.0" SYMBOL_LINK "ERRM_CFG_ARRY" 1166 SYMBOL_LINK "ERRM_CFG_ARRY" 1118 /end CHARACTERISTIC
/begin CHARACTERISTIC ERRM_B1_EXH_VVT_PERF_TYP "bank1 exhaust vvt performance type" VALUE 0x2886C __UWORD_S 0 u_diag_typ 0 8 FORMAT "%1.0" BIT_MASK 0xF000 SYMBOL_LINK "ERRM_CFG_ARRY" 1170 SYMBOL_LINK "ERRM_CFG_ARRY" 1122 /end CHARACTERISTIC
/begin CHARACTERISTIC ERRM_B1_EXH_VVT_PERF_MIL_ON "bank1 exhaust vvt performance MIL on enable" VALUE 0x2886C __UWORD_S 0 b_true 0 1 FORMAT "%1.0" BIT_MASK 0x0800 SYMBOL_LINK "ERRM_CFG_ARRY" 1170 SYMBOL_LINK "ERRM_CFG_ARRY" 1122 /end CHARACTERISTIC
/begin CHARACTERISTIC ERRM_B1_EXH_VVT_PERF_DEN_GRP "bank1 exhaust vvt performance denom group" VALUE 0x2886C __UWORD_S 0 u_den_grp 0 63 FORMAT "%1.0" BIT_MASK 0x003F SYMBOL_LINK "ERRM_CFG_ARRY" 1170 SYMBOL_LINK "ERRM_CFG_ARRY" 1122 /end CHARACTERISTIC
/begin CHARACTERISTIC ERRM_B1_EXH_VVT_PERF_DTC "bank1 exhaust vvt performance DTC" VALUE 0x2886C __UWORD_S 0 u_cnts 0 65535 FORMAT "%5.0" SYMBOL_LINK "ERRM_CFG_ARRY" 1172 SYMBOL_LINK "ERRM_CFG_ARRY" 1124 /end CHARACTERISTIC
/begin CHARACTERISTIC ERRM_B1_INTK_CAM_TH_TYP "bank1 intake cam tooth number type" VALUE 0x2886C __UWORD_S 0 u_diag_typ 0 8 FORMAT "%1.0" BIT_MASK 0xF000 SYMBOL_LINK "ERRM_CFG_ARRY" 1176 SYMBOL_LINK "ERRM_CFG_ARRY" 1128 /end CHARACTERISTIC
/begin CHARACTERISTIC ERRM_B1_INTK_CAM_TH_MIL_ON "bank1 intake cam tooth number MIL on enable" VALUE 0x2886C __UWORD_S 0 b_true 0 1 FORMAT "%1.0" BIT_MASK 0x0800 SYMBOL_LINK "ERRM_CFG_ARRY" 1176 SYMBOL_LINK "ERRM_CFG_ARRY" 1128 /end CHARACTERISTIC
/begin CHARACTERISTIC ERRM_B1_INTK_CAM_TH_DEN_GRP "bank1 intake cam tooth number denom group" VALUE 0x2886C __UWORD_S 0 u_den_grp 0 63 FORMAT "%1.0" BIT_MASK 0x003F SYMBOL_LINK "ERRM_CFG_ARRY" 1176 SYMBOL_LINK "ERRM_CFG_ARRY" 1128 /end CHARACTERISTIC
/begin CHARACTERISTIC ERRM_B1_INTK_CAM_TH_DTC "bank1 intake cam tooth number DTC" VALUE 0x2886C __UWORD_S 0 u_cnts 0 65535 FORMAT "%5.0" SYMBOL_LINK "ERRM_CFG_ARRY" 1178 SYMBOL_LINK "ERRM_CFG_ARRY" 1130 /end CHARACTERISTIC
/begin CHARACTERISTIC ERRM_B1_INTK_CAM_COR_TYP "bank1 intake cam tooth learn type" VALUE 0x2886C __UWORD_S 0 u_diag_typ 0 8 FORMAT "%1.0" BIT_MASK 0xF000 SYMBOL_LINK "ERRM_CFG_ARRY" 1182 SYMBOL_LINK "ERRM_CFG_ARRY" 1134 /end CHARACTERISTIC
/begin CHARACTERISTIC ERRM_B1_INTK_CAM_COR_MIL_ON "bank1 intake cam tooth learn MIL on enable" VALUE 0x2886C __UWORD_S 0 b_true 0 1 FORMAT "%1.0" BIT_MASK 0x0800 SYMBOL_LINK "ERRM_CFG_ARRY" 1182 SYMBOL_LINK "ERRM_CFG_ARRY" 1134 /end CHARACTERISTIC
/begin CHARACTERISTIC ERRM_B1_INTK_CAM_COR_DEN_GRP "bank1 intake cam tooth learn denom group" VALUE 0x2886C __UWORD_S 0 u_den_grp 0 63 FORMAT "%1.0" BIT_MASK 0x003F SYMBOL_LINK "ERRM_CFG_ARRY" 1182 SYMBOL_LINK "ERRM_CFG_ARRY" 1134 /end CHARACTERISTIC
/begin CHARACTERISTIC ERRM_B1_INTK_CAM_COR_DTC "bank1 intake cam tooth learn DTC" VALUE 0x2886C __UWORD_S 0 u_cnts 0 65535 FORMAT "%5.0" SYMBOL_LINK "ERRM_CFG_ARRY" 1184 SYMBOL_LINK "ERRM_CFG_ARRY" 1136 /end CHARACTERISTIC
/begin CHARACTERISTIC ERRM_B1_INTK_VVT_STCK_TYP "bank1 intake vvt stuck type" VALUE 0x2886C __UWORD_S 0 u_diag_typ 0 8 FORMAT "%1.0" BIT_MASK 0xF000 SYMBOL_LINK "ERRM_CFG_ARRY" 1188 SYMBOL_LINK "ERRM_CFG_ARRY" 1140 /end CHARACTERISTIC
/begin CHARACTERISTIC ERRM_B1_INTK_VVT_STCK_MIL_ON "bank1 intake vvt stuck MIL on enable" VALUE 0x2886C __UWORD_S 0 b_true 0 1 FORMAT "%1.0" BIT_MASK 0x0800 SYMBOL_LINK "ERRM_CFG_ARRY" 1188 SYMBOL_LINK "ERRM_CFG_ARRY" 1140 /end CHARACTERISTIC
/begin CHARACTERISTIC ERRM_B1_INTK_VVT_STCK_DEN_GRP "bank1 intake vvt stuck denom group" VALUE 0x2886C __UWORD_S 0 u_den_grp 0 63 FORMAT "%1.0" BIT_MASK 0x003F SYMBOL_LINK "ERRM_CFG_ARRY" 1188 SYMBOL_LINK "ERRM_CFG_ARRY" 1140 /end CHARACTERISTIC
/begin CHARACTERISTIC ERRM_B1_INTK_VVT_STCK_DTC "bank1 intake vvt stuck DTC" VALUE 0x2886C __UWORD_S 0 u_cnts 0 65535 FORMAT "%5.0" SYMBOL_LINK "ERRM_CFG_ARRY" 1190 SYMBOL_LINK "ERRM_CFG_ARRY" 1142 /end CHARACTERISTIC
/begin CHARACTERISTIC ERRM_B1_INTK_CAM_SLW_TYP "bank1 intake vvt stuck type" VALUE 0x2886C __UWORD_S 0 u_diag_typ 0 8 FORMAT "%1.0" BIT_MASK 0xF000 SYMBOL_LINK "ERRM_CFG_ARRY" 1194 SYMBOL_LINK "ERRM_CFG_ARRY" 1146 /end CHARACTERISTIC
/begin CHARACTERISTIC ERRM_B1_INTK_CAM_SLW_MIL_ON "bank1 intake vvt stuck MIL on enable" VALUE 0x2886C __UWORD_S 0 b_true 0 1 FORMAT "%1.0" BIT_MASK 0x0800 SYMBOL_LINK "ERRM_CFG_ARRY" 1194 SYMBOL_LINK "ERRM_CFG_ARRY" 1146 /end CHARACTERISTIC
/begin CHARACTERISTIC ERRM_B1_INTK_CAM_SLW_DEN_GRP "bank1 intake vvt stuck denom group" VALUE 0x2886C __UWORD_S 0 u_den_grp 0 63 FORMAT "%1.0" BIT_MASK 0x003F SYMBOL_LINK "ERRM_CFG_ARRY" 1194 SYMBOL_LINK "ERRM_CFG_ARRY" 1146 /end CHARACTERISTIC
/begin CHARACTERISTIC ERRM_B1_INTK_CAM_SLW_DTC "bank1 intake vvt stuck DTC" VALUE 0x2886C __UWORD_S 0 u_cnts 0 65535 FORMAT "%5.0" SYMBOL_LINK "ERRM_CFG_ARRY" 1196 SYMBOL_LINK "ERRM_CFG_ARRY" 1148 /end CHARACTERISTIC
/begin CHARACTERISTIC ERRM_B1_INTK_VVT_PERF_TYP "bank1 intake vvt performance type" VALUE 0x2886C __UWORD_S 0 u_diag_typ 0 8 FORMAT "%1.0" BIT_MASK 0xF000 SYMBOL_LINK "ERRM_CFG_ARRY" 1200 SYMBOL_LINK "ERRM_CFG_ARRY" 1152 /end CHARACTERISTIC
/begin CHARACTERISTIC ERRM_B1_INTK_VVT_PERF_MIL_ON "bank1 intake vvt performance MIL on enable" VALUE 0x2886C __UWORD_S 0 b_true 0 1 FORMAT "%1.0" BIT_MASK 0x0800 SYMBOL_LINK "ERRM_CFG_ARRY" 1200 SYMBOL_LINK "ERRM_CFG_ARRY" 1152 /end CHARACTERISTIC
/begin CHARACTERISTIC ERRM_B1_INTK_VVT_PERF_DEN_GRP "bank1 intake vvt performance denom group" VALUE 0x2886C __UWORD_S 0 u_den_grp 0 63 FORMAT "%1.0" BIT_MASK 0x003F SYMBOL_LINK "ERRM_CFG_ARRY" 1200 SYMBOL_LINK "ERRM_CFG_ARRY" 1152 /end CHARACTERISTIC
/begin CHARACTERISTIC ERRM_B1_INTK_VVT_PERF_DTC "bank1 intake vvt performance DTC" VALUE 0x2886C __UWORD_S 0 u_cnts 0 65535 FORMAT "%5.0" SYMBOL_LINK "ERRM_CFG_ARRY" 1202 SYMBOL_LINK "ERRM_CFG_ARRY" 1154 /end CHARACTERISTIC
/begin CHARACTERISTIC ERRM_FAN1_CIRCUIT_TYP "fan1 circuit type" VALUE 0x2886C __UWORD_S 0 u_diag_typ 0 8 FORMAT "%1.0" BIT_MASK 0xF000 SYMBOL_LINK "ERRM_CFG_ARRY" 1212 SYMBOL_LINK "ERRM_CFG_ARRY" 1164 /end CHARACTERISTIC
/begin CHARACTERISTIC ERRM_FAN1_CIRCUIT_MIL_ON "fan1 circuit MIL on enable" VALUE 0x2886C __UWORD_S 0 b_true 0 1 FORMAT "%1.0" BIT_MASK 0x0800 SYMBOL_LINK "ERRM_CFG_ARRY" 1212 SYMBOL_LINK "ERRM_CFG_ARRY" 1164 /end CHARACTERISTIC
/begin CHARACTERISTIC ERRM_FAN1_CIRCUIT_DEN_GRP "fan1 circuit denom group" VALUE 0x2886C __UWORD_S 0 u_den_grp 0 63 FORMAT "%1.0" BIT_MASK 0x003F SYMBOL_LINK "ERRM_CFG_ARRY" 1212 SYMBOL_LINK "ERRM_CFG_ARRY" 1164 /end CHARACTERISTIC
/begin CHARACTERISTIC ERRM_FAN1_CIRCUIT_DTC "fan1 circuit DTC" VALUE 0x2886C __UWORD_S 0 u_cnts 0 65535 FORMAT "%5.0" SYMBOL_LINK "ERRM_CFG_ARRY" 1214 SYMBOL_LINK "ERRM_CFG_ARRY" 1166 /end CHARACTERISTIC
/begin CHARACTERISTIC ERRM_FAN2_CIRCUIT_TYP "fan2 circuit type" VALUE 0x2886C __UWORD_S 0 u_diag_typ 0 8 FORMAT "%1.0" BIT_MASK 0xF000 SYMBOL_LINK "ERRM_CFG_ARRY" 1218 SYMBOL_LINK "ERRM_CFG_ARRY" 1170 /end CHARACTERISTIC
/begin CHARACTERISTIC ERRM_FAN2_CIRCUIT_MIL_ON "fan2 circuit MIL on enable" VALUE 0x2886C __UWORD_S 0 b_true 0 1 FORMAT "%1.0" BIT_MASK 0x0800 SYMBOL_LINK "ERRM_CFG_ARRY" 1218 SYMBOL_LINK "ERRM_CFG_ARRY" 1170 /end CHARACTERISTIC
/begin CHARACTERISTIC ERRM_FAN2_CIRCUIT_DEN_GRP "fan2 circuit denom group" VALUE 0x2886C __UWORD_S 0 u_den_grp 0 63 FORMAT "%1.0" BIT_MASK 0x003F SYMBOL_LINK "ERRM_CFG_ARRY" 1218 SYMBOL_LINK "ERRM_CFG_ARRY" 1170 /end CHARACTERISTIC
/begin CHARACTERISTIC ERRM_FAN2_CIRCUIT_DTC "fan2 circuit DTC" VALUE 0x2886C __UWORD_S 0 u_cnts 0 65535 FORMAT "%5.0" SYMBOL_LINK "ERRM_CFG_ARRY" 1216 SYMBOL_LINK "ERRM_CFG_ARRY" 1172 /end CHARACTERISTIC
/begin CHARACTERISTIC ERRM_PWM_FAN_TYP "pwm fan circuit type" VALUE 0x2886C __UWORD_S 0 u_diag_typ 0 8 FORMAT "%1.0" BIT_MASK 0xF000 SYMBOL_LINK "ERRM_CFG_ARRY" 1224 SYMBOL_LINK "ERRM_CFG_ARRY" 1176 /end CHARACTERISTIC
/begin CHARACTERISTIC ERRM_PWM_FAN_MIL_ON "pwm fan circuit MIL on enable" VALUE 0x2886C __UWORD_S 0 b_true 0 1 FORMAT "%1.0" BIT_MASK 0x0800 SYMBOL_LINK "ERRM_CFG_ARRY" 1224 SYMBOL_LINK "ERRM_CFG_ARRY" 1176 /end CHARACTERISTIC
/begin CHARACTERISTIC ERRM_PWM_FAN_DEN_GRP "pwm fan circuit denom group" VALUE 0x2886C __UWORD_S 0 u_den_grp 0 63 FORMAT "%1.0" BIT_MASK 0x003F SYMBOL_LINK "ERRM_CFG_ARRY" 1224 SYMBOL_LINK "ERRM_CFG_ARRY" 1176 /end CHARACTERISTIC
/begin CHARACTERISTIC ERRM_PWM_FAN_DTC "pwm fan circuit DTC" VALUE 0x2886C __UWORD_S 0 u_cnts 0 65535 FORMAT "%5.0" SYMBOL_LINK "ERRM_CFG_ARRY" 1226 SYMBOL_LINK "ERRM_CFG_ARRY" 1178 /end CHARACTERISTIC
/begin CHARACTERISTIC ERRM_ECM_COP_TYP "ECM cop type" VALUE 0x2886C __UWORD_S 0 u_diag_typ 0 8 FORMAT "%1.0" BIT_MASK 0xF000 SYMBOL_LINK "ERRM_CFG_ARRY" 1230 SYMBOL_LINK "ERRM_CFG_ARRY" 1182 /end CHARACTERISTIC
/begin CHARACTERISTIC ERRM_ECM_COP_MIL_ON "ECM cop MIL on enable" VALUE 0x2886C __UWORD_S 0 b_true 0 1 FORMAT "%1.0" BIT_MASK 0x0800 SYMBOL_LINK "ERRM_CFG_ARRY" 1230 SYMBOL_LINK "ERRM_CFG_ARRY" 1182 /end CHARACTERISTIC
/begin CHARACTERISTIC ERRM_ECM_COP_DEN_GRP "ECM cop denom group" VALUE 0x2886C __UWORD_S 0 u_den_grp 0 63 FORMAT "%1.0" BIT_MASK 0x003F SYMBOL_LINK "ERRM_CFG_ARRY" 1230 SYMBOL_LINK "ERRM_CFG_ARRY" 1182 /end CHARACTERISTIC
/begin CHARACTERISTIC ERRM_ECM_COP_DTC "ECM cop DTC" VALUE 0x2886C __UWORD_S 0 u_cnts 0 65535 FORMAT "%5.0" SYMBOL_LINK "ERRM_CFG_ARRY" 1232 SYMBOL_LINK "ERRM_CFG_ARRY" 1184 /end CHARACTERISTIC
/begin CHARACTERISTIC ERRM_MPR_CIRCUIT_TYP "main power relay circuit type" VALUE 0x2886C __UWORD_S 0 u_diag_typ 0 8 FORMAT "%1.0" BIT_MASK 0xF000 SYMBOL_LINK "ERRM_CFG_ARRY" 1236 SYMBOL_LINK "ERRM_CFG_ARRY" 1188 /end CHARACTERISTIC
/begin CHARACTERISTIC ERRM_MPR_CIRCUIT_MIL_ON "main power relay circuit MIL on enable" VALUE 0x2886C __UWORD_S 0 b_true 0 1 FORMAT "%1.0" BIT_MASK 0x0800 SYMBOL_LINK "ERRM_CFG_ARRY" 1236 SYMBOL_LINK "ERRM_CFG_ARRY" 1188 /end CHARACTERISTIC
/begin CHARACTERISTIC ERRM_MPR_CIRCUIT_DEN_GRP "main power relay circuit denom group" VALUE 0x2886C __UWORD_S 0 u_den_grp 0 63 FORMAT "%1.0" BIT_MASK 0x003F SYMBOL_LINK "ERRM_CFG_ARRY" 1236 SYMBOL_LINK "ERRM_CFG_ARRY" 1188 /end CHARACTERISTIC
/begin CHARACTERISTIC ERRM_MPR_CIRCUIT_DTC "main power relay circuit DTC" VALUE 0x2886C __UWORD_S 0 u_cnts 0 65535 FORMAT "%5.0" SYMBOL_LINK "ERRM_CFG_ARRY" 1238 SYMBOL_LINK "ERRM_CFG_ARRY" 1190 /end CHARACTERISTIC
/begin CHARACTERISTIC ERRM_CP_LO_TYP "cainster purge short low type" VALUE 0x2886C __UWORD_S 0 u_diag_typ 0 8 FORMAT "%1.0" BIT_MASK 0xF000 SYMBOL_LINK "ERRM_CFG_ARRY" 1242 SYMBOL_LINK "ERRM_CFG_ARRY" 1194 /end CHARACTERISTIC
/begin CHARACTERISTIC ERRM_CP_LO_MIL_ON "cainster purge short low MIL on enable" VALUE 0x2886C __UWORD_S 0 b_true 0 1 FORMAT "%1.0" BIT_MASK 0x0800 SYMBOL_LINK "ERRM_CFG_ARRY" 1242 SYMBOL_LINK "ERRM_CFG_ARRY" 1194 /end CHARACTERISTIC
/begin CHARACTERISTIC ERRM_CP_LO_DEN_GRP "cainster purge short low denom group" VALUE 0x2886C __UWORD_S 0 u_den_grp 0 63 FORMAT "%1.0" BIT_MASK 0x003F SYMBOL_LINK "ERRM_CFG_ARRY" 1242 SYMBOL_LINK "ERRM_CFG_ARRY" 1194 /end CHARACTERISTIC
/begin CHARACTERISTIC ERRM_CP_LO_DTC "cainster purge short low DTC" VALUE 0x2886C __UWORD_S 0 u_cnts 0 65535 FORMAT "%5.0" SYMBOL_LINK "ERRM_CFG_ARRY" 1244 SYMBOL_LINK "ERRM_CFG_ARRY" 1196 /end CHARACTERISTIC
/begin CHARACTERISTIC ERRM_CP_HI_TYP "cainster purge short high type" VALUE 0x2886C __UWORD_S 0 u_diag_typ 0 8 FORMAT "%1.0" BIT_MASK 0xF000 SYMBOL_LINK "ERRM_CFG_ARRY" 1248 SYMBOL_LINK "ERRM_CFG_ARRY" 1200 /end CHARACTERISTIC
/begin CHARACTERISTIC ERRM_CP_HI_MIL_ON "cainster purge short high MIL on enable" VALUE 0x2886C __UWORD_S 0 b_true 0 1 FORMAT "%1.0" BIT_MASK 0x0800 SYMBOL_LINK "ERRM_CFG_ARRY" 1248 SYMBOL_LINK "ERRM_CFG_ARRY" 1200 /end CHARACTERISTIC
/begin CHARACTERISTIC ERRM_CP_HI_DEN_GRP "cainster purge short high denom group" VALUE 0x2886C __UWORD_S 0 u_den_grp 0 63 FORMAT "%1.0" BIT_MASK 0x003F SYMBOL_LINK "ERRM_CFG_ARRY" 1248 SYMBOL_LINK "ERRM_CFG_ARRY" 1200 /end CHARACTERISTIC
/begin CHARACTERISTIC ERRM_CP_HI_DTC "cainster purge short high DTC" VALUE 0x2886C __UWORD_S 0 u_cnts 0 65535 FORMAT "%5.0" SYMBOL_LINK "ERRM_CFG_ARRY" 1250 SYMBOL_LINK "ERRM_CFG_ARRY" 1202 /end CHARACTERISTIC
/begin CHARACTERISTIC ERRM_B1S1_HT_LO_TYP "bank1 up o2 heater short low type" VALUE 0x2886C __UWORD_S 0 u_diag_typ 0 8 FORMAT "%1.0" BIT_MASK 0xF000 SYMBOL_LINK "ERRM_CFG_ARRY" 1254 SYMBOL_LINK "ERRM_CFG_ARRY" 1206 /end CHARACTERISTIC
/begin CHARACTERISTIC ERRM_B1S1_HT_LO_MIL_ON "bank1 up o2 heater short low MIL on enable" VALUE 0x2886C __UWORD_S 0 b_true 0 1 FORMAT "%1.0" BIT_MASK 0x0800 SYMBOL_LINK "ERRM_CFG_ARRY" 1254 SYMBOL_LINK "ERRM_CFG_ARRY" 1206 /end CHARACTERISTIC
/begin CHARACTERISTIC ERRM_B1S1_HT_LO_DEN_GRP "bank1 up o2 heater short low denom group" VALUE 0x2886C __UWORD_S 0 u_den_grp 0 63 FORMAT "%1.0" BIT_MASK 0x003F SYMBOL_LINK "ERRM_CFG_ARRY" 1254 SYMBOL_LINK "ERRM_CFG_ARRY" 1206 /end CHARACTERISTIC
/begin CHARACTERISTIC ERRM_B1S1_HT_LO_DTC "bank1 up o2 heater short low DTC" VALUE 0x2886C __UWORD_S 0 u_cnts 0 65535 FORMAT "%5.0" SYMBOL_LINK "ERRM_CFG_ARRY" 1256 SYMBOL_LINK "ERRM_CFG_ARRY" 1208 /end CHARACTERISTIC
/begin CHARACTERISTIC ERRM_B1S1_HT_HI_TYP "bank1 up o2 heater short high type" VALUE 0x2886C __UWORD_S 0 u_diag_typ 0 8 FORMAT "%1.0" BIT_MASK 0xF000 SYMBOL_LINK "ERRM_CFG_ARRY" 1260 SYMBOL_LINK "ERRM_CFG_ARRY" 1212 /end CHARACTERISTIC
/begin CHARACTERISTIC ERRM_B1S1_HT_HI_MIL_ON "bank1 up o2 heater short high MIL on enable" VALUE 0x2886C __UWORD_S 0 b_true 0 1 FORMAT "%1.0" BIT_MASK 0x0800 SYMBOL_LINK "ERRM_CFG_ARRY" 1260 SYMBOL_LINK "ERRM_CFG_ARRY" 1212 /end CHARACTERISTIC
/begin CHARACTERISTIC ERRM_B1S1_HT_HI_DEN_GRP "bank1 up o2 heater short high denom group" VALUE 0x2886C __UWORD_S 0 u_den_grp 0 63 FORMAT "%1.0" BIT_MASK 0x003F SYMBOL_LINK "ERRM_CFG_ARRY" 1260 SYMBOL_LINK "ERRM_CFG_ARRY" 1212 /end CHARACTERISTIC
/begin CHARACTERISTIC ERRM_B1S1_HT_HI_DTC "bank1 up o2 heater short high DTC" VALUE 0x2886C __UWORD_S 0 u_cnts 0 65535 FORMAT "%5.0" SYMBOL_LINK "ERRM_CFG_ARRY" 1262 SYMBOL_LINK "ERRM_CFG_ARRY" 1214 /end CHARACTERISTIC
/begin CHARACTERISTIC ERRM_B1S2_HT_LO_TYP "bank1 down o2 heater short low type" VALUE 0x2886C __UWORD_S 0 u_diag_typ 0 8 FORMAT "%1.0" BIT_MASK 0xF000 SYMBOL_LINK "ERRM_CFG_ARRY" 1266 SYMBOL_LINK "ERRM_CFG_ARRY" 1218 /end CHARACTERISTIC
/begin CHARACTERISTIC ERRM_B1S2_HT_LO_MIL_ON "bank1 down o2 heater short low MIL on enable" VALUE 0x2886C __UWORD_S 0 b_true 0 1 FORMAT "%1.0" BIT_MASK 0x0800 SYMBOL_LINK "ERRM_CFG_ARRY" 1266 SYMBOL_LINK "ERRM_CFG_ARRY" 1218 /end CHARACTERISTIC
/begin CHARACTERISTIC ERRM_B1S2_HT_LO_DEN_GRP "bank1 down o2 heater short low denom group" VALUE 0x2886C __UWORD_S 0 u_den_grp 0 63 FORMAT "%1.0" BIT_MASK 0x003F SYMBOL_LINK "ERRM_CFG_ARRY" 1266 SYMBOL_LINK "ERRM_CFG_ARRY" 1218 /end CHARACTERISTIC
/begin CHARACTERISTIC ERRM_B1S2_HT_LO_DTC "bank1 down o2 heater short low DTC" VALUE 0x2886C __UWORD_S 0 u_cnts 0 65535 FORMAT "%5.0" SYMBOL_LINK "ERRM_CFG_ARRY" 1268 SYMBOL_LINK "ERRM_CFG_ARRY" 1220 /end CHARACTERISTIC
/begin CHARACTERISTIC ERRM_B1S2_HT_HI_TYP "bank1 down o2 heater short high type" VALUE 0x2886C __UWORD_S 0 u_diag_typ 0 8 FORMAT "%1.0" BIT_MASK 0xF000 SYMBOL_LINK "ERRM_CFG_ARRY" 1272 SYMBOL_LINK "ERRM_CFG_ARRY" 1224 /end CHARACTERISTIC
/begin CHARACTERISTIC ERRM_B1S2_HT_HI_MIL_ON "bank1 down o2 heater short high MIL on enable" VALUE 0x2886C __UWORD_S 0 b_true 0 1 FORMAT "%1.0" BIT_MASK 0x0800 SYMBOL_LINK "ERRM_CFG_ARRY" 1272 SYMBOL_LINK "ERRM_CFG_ARRY" 1224 /end CHARACTERISTIC
/begin CHARACTERISTIC ERRM_B1S2_HT_HI_DEN_GRP "bank1 down o2 heater short high denom group" VALUE 0x2886C __UWORD_S 0 u_den_grp 0 63 FORMAT "%1.0" BIT_MASK 0x003F SYMBOL_LINK "ERRM_CFG_ARRY" 1272 SYMBOL_LINK "ERRM_CFG_ARRY" 1224 /end CHARACTERISTIC
/begin CHARACTERISTIC ERRM_B1S2_HT_HI_DTC "bank1 down o2 heater short high DTC" VALUE 0x2886C __UWORD_S 0 u_cnts 0 65535 FORMAT "%5.0" SYMBOL_LINK "ERRM_CFG_ARRY" 1274 SYMBOL_LINK "ERRM_CFG_ARRY" 1226 /end CHARACTERISTIC
/begin CHARACTERISTIC ERRM_INJ1_LO_TYP "injector1 short low type" VALUE 0x2886C __UWORD_S 0 u_diag_typ 0 8 FORMAT "%1.0" BIT_MASK 0xF000 SYMBOL_LINK "ERRM_CFG_ARRY" 1278 SYMBOL_LINK "ERRM_CFG_ARRY" 1230 /end CHARACTERISTIC
/begin CHARACTERISTIC ERRM_INJ1_LO_MIL_ON "injector1 short low MIL on enable" VALUE 0x2886C __UWORD_S 0 b_true 0 1 FORMAT "%1.0" BIT_MASK 0x0800 SYMBOL_LINK "ERRM_CFG_ARRY" 1278 SYMBOL_LINK "ERRM_CFG_ARRY" 1230 /end CHARACTERISTIC
/begin CHARACTERISTIC ERRM_INJ1_LO_DEN_GRP "injector1 short low denom group" VALUE 0x2886C __UWORD_S 0 u_den_grp 0 63 FORMAT "%1.0" BIT_MASK 0x003F SYMBOL_LINK "ERRM_CFG_ARRY" 1278 SYMBOL_LINK "ERRM_CFG_ARRY" 1230 /end CHARACTERISTIC
/begin CHARACTERISTIC ERRM_INJ1_LO_DTC "injector1 short low DTC" VALUE 0x2886C __UWORD_S 0 u_cnts 0 65535 FORMAT "%5.0" SYMBOL_LINK "ERRM_CFG_ARRY" 1280 SYMBOL_LINK "ERRM_CFG_ARRY" 1232 /end CHARACTERISTIC
/begin CHARACTERISTIC ERRM_INJ1_HI_TYP "injector1 short high type" VALUE 0x2886C __UWORD_S 0 u_diag_typ 0 8 FORMAT "%1.0" BIT_MASK 0xF000 SYMBOL_LINK "ERRM_CFG_ARRY" 1284 SYMBOL_LINK "ERRM_CFG_ARRY" 1236 /end CHARACTERISTIC
/begin CHARACTERISTIC ERRM_INJ1_HI_MIL_ON "injector1 short high MIL on enable" VALUE 0x2886C __UWORD_S 0 b_true 0 1 FORMAT "%1.0" BIT_MASK 0x0800 SYMBOL_LINK "ERRM_CFG_ARRY" 1284 SYMBOL_LINK "ERRM_CFG_ARRY" 1236 /end CHARACTERISTIC
/begin CHARACTERISTIC ERRM_INJ1_HI_DEN_GRP "injector1 short high denom group" VALUE 0x2886C __UWORD_S 0 u_den_grp 0 63 FORMAT "%1.0" BIT_MASK 0x003F SYMBOL_LINK "ERRM_CFG_ARRY" 1284 SYMBOL_LINK "ERRM_CFG_ARRY" 1236 /end CHARACTERISTIC
/begin CHARACTERISTIC ERRM_INJ1_HI_DTC "injector1 short high DTC" VALUE 0x2886C __UWORD_S 0 u_cnts 0 65535 FORMAT "%5.0" SYMBOL_LINK "ERRM_CFG_ARRY" 1286 SYMBOL_LINK "ERRM_CFG_ARRY" 1238 /end CHARACTERISTIC
/begin CHARACTERISTIC ERRM_INJ2_LO_TYP "injector2 short low type" VALUE 0x2886C __UWORD_S 0 u_diag_typ 0 8 FORMAT "%1.0" BIT_MASK 0xF000 SYMBOL_LINK "ERRM_CFG_ARRY" 1290 SYMBOL_LINK "ERRM_CFG_ARRY" 1242 /end CHARACTERISTIC
/begin CHARACTERISTIC ERRM_INJ2_LO_MIL_ON "injector2 short low MIL on enable" VALUE 0x2886C __UWORD_S 0 b_true 0 1 FORMAT "%1.0" BIT_MASK 0x0800 SYMBOL_LINK "ERRM_CFG_ARRY" 1290 SYMBOL_LINK "ERRM_CFG_ARRY" 1242 /end CHARACTERISTIC
/begin CHARACTERISTIC ERRM_INJ2_LO_DEN_GRP "injector2 short low denom group" VALUE 0x2886C __UWORD_S 0 u_den_grp 0 63 FORMAT "%1.0" BIT_MASK 0x003F SYMBOL_LINK "ERRM_CFG_ARRY" 1290 SYMBOL_LINK "ERRM_CFG_ARRY" 1242 /end CHARACTERISTIC
/begin CHARACTERISTIC ERRM_INJ2_LO_DTC "injector2 short low DTC" VALUE 0x2886C __UWORD_S 0 u_cnts 0 65535 FORMAT "%5.0" SYMBOL_LINK "ERRM_CFG_ARRY" 1292 SYMBOL_LINK "ERRM_CFG_ARRY" 1244 /end CHARACTERISTIC
/begin CHARACTERISTIC ERRM_INJ2_HI_TYP "injector2 short high type" VALUE 0x2886C __UWORD_S 0 u_diag_typ 0 8 FORMAT "%1.0" BIT_MASK 0xF000 SYMBOL_LINK "ERRM_CFG_ARRY" 1296 SYMBOL_LINK "ERRM_CFG_ARRY" 1248 /end CHARACTERISTIC
/begin CHARACTERISTIC ERRM_INJ2_HI_MIL_ON "injector2 short high MIL on enable" VALUE 0x2886C __UWORD_S 0 b_true 0 1 FORMAT "%1.0" BIT_MASK 0x0800 SYMBOL_LINK "ERRM_CFG_ARRY" 1296 SYMBOL_LINK "ERRM_CFG_ARRY" 1248 /end CHARACTERISTIC
/begin CHARACTERISTIC ERRM_INJ2_HI_DEN_GRP "injector2 short high denom group" VALUE 0x2886C __UWORD_S 0 u_den_grp 0 63 FORMAT "%1.0" BIT_MASK 0x003F SYMBOL_LINK "ERRM_CFG_ARRY" 1296 SYMBOL_LINK "ERRM_CFG_ARRY" 1248 /end CHARACTERISTIC
/begin CHARACTERISTIC ERRM_INJ2_HI_DTC "injector2 short high DTC" VALUE 0x2886C __UWORD_S 0 u_cnts 0 65535 FORMAT "%5.0" SYMBOL_LINK "ERRM_CFG_ARRY" 1298 SYMBOL_LINK "ERRM_CFG_ARRY" 1250 /end CHARACTERISTIC
/begin CHARACTERISTIC ERRM_INJ3_LO_TYP "injector3 short low type" VALUE 0x2886C __UWORD_S 0 u_diag_typ 0 8 FORMAT "%1.0" BIT_MASK 0xF000 SYMBOL_LINK "ERRM_CFG_ARRY" 1302 SYMBOL_LINK "ERRM_CFG_ARRY" 1254 /end CHARACTERISTIC
/begin CHARACTERISTIC ERRM_INJ3_LO_MIL_ON "injector3 short low MIL on enable" VALUE 0x2886C __UWORD_S 0 b_true 0 1 FORMAT "%1.0" BIT_MASK 0x0800 SYMBOL_LINK "ERRM_CFG_ARRY" 1302 SYMBOL_LINK "ERRM_CFG_ARRY" 1254 /end CHARACTERISTIC
/begin CHARACTERISTIC ERRM_INJ3_LO_DEN_GRP "injector3 short low denom group" VALUE 0x2886C __UWORD_S 0 u_den_grp 0 63 FORMAT "%1.0" BIT_MASK 0x003F SYMBOL_LINK "ERRM_CFG_ARRY" 1302 SYMBOL_LINK "ERRM_CFG_ARRY" 1254 /end CHARACTERISTIC
/begin CHARACTERISTIC ERRM_INJ3_LO_DTC "injector3 short low DTC" VALUE 0x2886C __UWORD_S 0 u_cnts 0 65535 FORMAT "%5.0" SYMBOL_LINK "ERRM_CFG_ARRY" 1304 SYMBOL_LINK "ERRM_CFG_ARRY" 1256 /end CHARACTERISTIC
/begin CHARACTERISTIC ERRM_INJ3_HI_TYP "injector3 short high type" VALUE 0x2886C __UWORD_S 0 u_diag_typ 0 8 FORMAT "%1.0" BIT_MASK 0xF000 SYMBOL_LINK "ERRM_CFG_ARRY" 1308 SYMBOL_LINK "ERRM_CFG_ARRY" 1260 /end CHARACTERISTIC
/begin CHARACTERISTIC ERRM_INJ3_HI_MIL_ON "injector3 short high MIL on enable" VALUE 0x2886C __UWORD_S 0 b_true 0 1 FORMAT "%1.0" BIT_MASK 0x0800 SYMBOL_LINK "ERRM_CFG_ARRY" 1308 SYMBOL_LINK "ERRM_CFG_ARRY" 1260 /end CHARACTERISTIC
/begin CHARACTERISTIC ERRM_INJ3_HI_DEN_GRP "injector3 short high denom group" VALUE 0x2886C __UWORD_S 0 u_den_grp 0 63 FORMAT "%1.0" BIT_MASK 0x003F SYMBOL_LINK "ERRM_CFG_ARRY" 1308 SYMBOL_LINK "ERRM_CFG_ARRY" 1260 /end CHARACTERISTIC
/begin CHARACTERISTIC ERRM_INJ3_HI_DTC "injector3 short high DTC" VALUE 0x2886C __UWORD_S 0 u_cnts 0 65535 FORMAT "%5.0" SYMBOL_LINK "ERRM_CFG_ARRY" 1310 SYMBOL_LINK "ERRM_CFG_ARRY" 1262 /end CHARACTERISTIC
/begin CHARACTERISTIC ERRM_INJ4_LO_TYP "injector4 short low type" VALUE 0x2886C __UWORD_S 0 u_diag_typ 0 8 FORMAT "%1.0" BIT_MASK 0xF000 SYMBOL_LINK "ERRM_CFG_ARRY" 1314 SYMBOL_LINK "ERRM_CFG_ARRY" 1266 /end CHARACTERISTIC
/begin CHARACTERISTIC ERRM_INJ4_LO_MIL_ON "injector4 short low MIL on enable" VALUE 0x2886C __UWORD_S 0 b_true 0 1 FORMAT "%1.0" BIT_MASK 0x0800 SYMBOL_LINK "ERRM_CFG_ARRY" 1314 SYMBOL_LINK "ERRM_CFG_ARRY" 1266 /end CHARACTERISTIC
/begin CHARACTERISTIC ERRM_INJ4_LO_DEN_GRP "injector4 short low denom group" VALUE 0x2886C __UWORD_S 0 u_den_grp 0 63 FORMAT "%1.0" BIT_MASK 0x003F SYMBOL_LINK "ERRM_CFG_ARRY" 1314 SYMBOL_LINK "ERRM_CFG_ARRY" 1266 /end CHARACTERISTIC
/begin CHARACTERISTIC ERRM_INJ4_LO_DTC "injector4 short low DTC" VALUE 0x2886C __UWORD_S 0 u_cnts 0 65535 FORMAT "%5.0" SYMBOL_LINK "ERRM_CFG_ARRY" 1316 SYMBOL_LINK "ERRM_CFG_ARRY" 1268 /end CHARACTERISTIC
/begin CHARACTERISTIC ERRM_INJ4_HI_TYP "injector4 short high type" VALUE 0x2886C __UWORD_S 0 u_diag_typ 0 8 FORMAT "%1.0" BIT_MASK 0xF000 SYMBOL_LINK "ERRM_CFG_ARRY" 1320 SYMBOL_LINK "ERRM_CFG_ARRY" 1272 /end CHARACTERISTIC
/begin CHARACTERISTIC ERRM_INJ4_HI_MIL_ON "injector4 short high MIL on enable" VALUE 0x2886C __UWORD_S 0 b_true 0 1 FORMAT "%1.0" BIT_MASK 0x0800 SYMBOL_LINK "ERRM_CFG_ARRY" 1320 SYMBOL_LINK "ERRM_CFG_ARRY" 1272 /end CHARACTERISTIC
/begin CHARACTERISTIC ERRM_INJ4_HI_DEN_GRP "injector4 short high denom group" VALUE 0x2886C __UWORD_S 0 u_den_grp 0 63 FORMAT "%1.0" BIT_MASK 0x003F SYMBOL_LINK "ERRM_CFG_ARRY" 1320 SYMBOL_LINK "ERRM_CFG_ARRY" 1272 /end CHARACTERISTIC
/begin CHARACTERISTIC ERRM_INJ4_HI_DTC "injector4 short high DTC" VALUE 0x2886C __UWORD_S 0 u_cnts 0 65535 FORMAT "%5.0" SYMBOL_LINK "ERRM_CFG_ARRY" 1322 SYMBOL_LINK "ERRM_CFG_ARRY" 1274 /end CHARACTERISTIC
/begin CHARACTERISTIC ERRM_FPR_CIRCUIT_TYP "fuel pump relay circuit type" VALUE 0x2886C __UWORD_S 0 u_diag_typ 0 8 FORMAT "%1.0" BIT_MASK 0xF000 SYMBOL_LINK "ERRM_CFG_ARRY" 1326 SYMBOL_LINK "ERRM_CFG_ARRY" 1278 /end CHARACTERISTIC
/begin CHARACTERISTIC ERRM_FPR_CIRCUIT_MIL_ON "fuel pump relay circuit MIL on enable" VALUE 0x2886C __UWORD_S 0 b_true 0 1 FORMAT "%1.0" BIT_MASK 0x0800 SYMBOL_LINK "ERRM_CFG_ARRY" 1326 SYMBOL_LINK "ERRM_CFG_ARRY" 1278 /end CHARACTERISTIC
/begin CHARACTERISTIC ERRM_FPR_CIRCUIT_DEN_GRP "fuel pump relay circuit denom group" VALUE 0x2886C __UWORD_S 0 u_den_grp 0 63 FORMAT "%1.0" BIT_MASK 0x003F SYMBOL_LINK "ERRM_CFG_ARRY" 1326 SYMBOL_LINK "ERRM_CFG_ARRY" 1278 /end CHARACTERISTIC
/begin CHARACTERISTIC ERRM_FPR_CIRCUIT_DTC "fuel pump relay circuit DTC" VALUE 0x2886C __UWORD_S 0 u_cnts 0 65535 FORMAT "%5.0" SYMBOL_LINK "ERRM_CFG_ARRY" 1328 SYMBOL_LINK "ERRM_CFG_ARRY" 1280 /end CHARACTERISTIC
/begin CHARACTERISTIC ERRM_B1_INTK_VVT_HI_TYP "bank1 intake vvt short high type" VALUE 0x2886C __UWORD_S 0 u_diag_typ 0 8 FORMAT "%1.0" BIT_MASK 0xF000 SYMBOL_LINK "ERRM_CFG_ARRY" 1332 SYMBOL_LINK "ERRM_CFG_ARRY" 1284 /end CHARACTERISTIC
/begin CHARACTERISTIC ERRM_B1_INTK_VVT_HI_MIL_ON "bank1 intake vvt short high MIL on enable" VALUE 0x2886C __UWORD_S 0 b_true 0 1 FORMAT "%1.0" BIT_MASK 0x0800 SYMBOL_LINK "ERRM_CFG_ARRY" 1332 SYMBOL_LINK "ERRM_CFG_ARRY" 1284 /end CHARACTERISTIC
/begin CHARACTERISTIC ERRM_B1_INTK_VVT_HI_DEN_GRP "bank1 intake vvt short high denom group" VALUE 0x2886C __UWORD_S 0 u_den_grp 0 63 FORMAT "%1.0" BIT_MASK 0x003F SYMBOL_LINK "ERRM_CFG_ARRY" 1332 SYMBOL_LINK "ERRM_CFG_ARRY" 1284 /end CHARACTERISTIC
/begin CHARACTERISTIC ERRM_B1_INTK_VVT_HI_DTC "bank1 intake vvt short high DTC" VALUE 0x2886C __UWORD_S 0 u_cnts 0 65535 FORMAT "%5.0" SYMBOL_LINK "ERRM_CFG_ARRY" 1334 SYMBOL_LINK "ERRM_CFG_ARRY" 1286 /end CHARACTERISTIC
/begin CHARACTERISTIC ERRM_B1_INTK_VVT_LO_TYP "bank1 intake vvt short low type" VALUE 0x2886C __UWORD_S 0 u_diag_typ 0 8 FORMAT "%1.0" BIT_MASK 0xF000 SYMBOL_LINK "ERRM_CFG_ARRY" 1338 SYMBOL_LINK "ERRM_CFG_ARRY" 1290 /end CHARACTERISTIC
/begin CHARACTERISTIC ERRM_B1_INTK_VVT_LO_MIL_ON "bank1 intake vvt short low MIL on enable" VALUE 0x2886C __UWORD_S 0 b_true 0 1 FORMAT "%1.0" BIT_MASK 0x0800 SYMBOL_LINK "ERRM_CFG_ARRY" 1338 SYMBOL_LINK "ERRM_CFG_ARRY" 1290 /end CHARACTERISTIC
/begin CHARACTERISTIC ERRM_B1_INTK_VVT_LO_DEN_GRP "bank1 intake vvt short low denom group" VALUE 0x2886C __UWORD_S 0 u_den_grp 0 63 FORMAT "%1.0" BIT_MASK 0x003F SYMBOL_LINK "ERRM_CFG_ARRY" 1338 SYMBOL_LINK "ERRM_CFG_ARRY" 1290 /end CHARACTERISTIC
/begin CHARACTERISTIC ERRM_B1_INTK_VVT_LO_DTC "bank1 intake vvt short low DTC" VALUE 0x2886C __UWORD_S 0 u_cnts 0 65535 FORMAT "%5.0" SYMBOL_LINK "ERRM_CFG_ARRY" 1340 SYMBOL_LINK "ERRM_CFG_ARRY" 1292 /end CHARACTERISTIC
/begin CHARACTERISTIC ERRM_B1_INTK_VVT_OPN_TYP "bank1 intake vvt open type" VALUE 0x2886C __UWORD_S 0 u_diag_typ 0 8 FORMAT "%1.0" BIT_MASK 0xF000 SYMBOL_LINK "ERRM_CFG_ARRY" 1344 SYMBOL_LINK "ERRM_CFG_ARRY" 1296 /end CHARACTERISTIC
/begin CHARACTERISTIC ERRM_B1_INTK_VVT_OPN_MIL_ON "bank1 intake vvt open MIL on enable" VALUE 0x2886C __UWORD_S 0 b_true 0 1 FORMAT "%1.0" BIT_MASK 0x0800 SYMBOL_LINK "ERRM_CFG_ARRY" 1344 SYMBOL_LINK "ERRM_CFG_ARRY" 1296 /end CHARACTERISTIC
/begin CHARACTERISTIC ERRM_B1_INTK_VVT_OPN_DEN_GRP "bank1 intake vvt open denom group" VALUE 0x2886C __UWORD_S 0 u_den_grp 0 63 FORMAT "%1.0" BIT_MASK 0x003F SYMBOL_LINK "ERRM_CFG_ARRY" 1344 SYMBOL_LINK "ERRM_CFG_ARRY" 1296 /end CHARACTERISTIC
/begin CHARACTERISTIC ERRM_B1_INTK_VVT_OPN_DTC "bank1 intake vvt open DTC" VALUE 0x2886C __UWORD_S 0 u_cnts 0 65535 FORMAT "%5.0" SYMBOL_LINK "ERRM_CFG_ARRY" 1346 SYMBOL_LINK "ERRM_CFG_ARRY" 1298 /end CHARACTERISTIC
/begin CHARACTERISTIC ERRM_B1_EXH_VVT_HI_TYP "bank1 exhaust vvt short high type" VALUE 0x2886C __UWORD_S 0 u_diag_typ 0 8 FORMAT "%1.0" BIT_MASK 0xF000 SYMBOL_LINK "ERRM_CFG_ARRY" 1350 SYMBOL_LINK "ERRM_CFG_ARRY" 1302 /end CHARACTERISTIC
/begin CHARACTERISTIC ERRM_B1_EXH_VVT_HI_MIL_ON "bank1 exhaust vvt short high MIL on enable" VALUE 0x2886C __UWORD_S 0 b_true 0 1 FORMAT "%1.0" BIT_MASK 0x0800 SYMBOL_LINK "ERRM_CFG_ARRY" 1350 SYMBOL_LINK "ERRM_CFG_ARRY" 1302 /end CHARACTERISTIC
/begin CHARACTERISTIC ERRM_B1_EXH_VVT_HI_DEN_GRP "bank1 exhaust vvt short high denom group" VALUE 0x2886C __UWORD_S 0 u_den_grp 0 63 FORMAT "%1.0" BIT_MASK 0x003F SYMBOL_LINK "ERRM_CFG_ARRY" 1350 SYMBOL_LINK "ERRM_CFG_ARRY" 1302 /end CHARACTERISTIC
/begin CHARACTERISTIC ERRM_B1_EXH_VVT_HI_DTC "bank1 exhaust vvt short high DTC" VALUE 0x2886C __UWORD_S 0 u_cnts 0 65535 FORMAT "%5.0" SYMBOL_LINK "ERRM_CFG_ARRY" 1352 SYMBOL_LINK "ERRM_CFG_ARRY" 1304 /end CHARACTERISTIC
/begin CHARACTERISTIC ERRM_B1_EXH_VVT_LO_TYP "bank1 exhaust vvt short low type" VALUE 0x2886C __UWORD_S 0 u_diag_typ 0 8 FORMAT "%1.0" BIT_MASK 0xF000 SYMBOL_LINK "ERRM_CFG_ARRY" 1356 SYMBOL_LINK "ERRM_CFG_ARRY" 1308 /end CHARACTERISTIC
/begin CHARACTERISTIC ERRM_B1_EXH_VVT_LO_MIL_ON "bank1 exhaust vvt short low MIL on enable" VALUE 0x2886C __UWORD_S 0 b_true 0 1 FORMAT "%1.0" BIT_MASK 0x0800 SYMBOL_LINK "ERRM_CFG_ARRY" 1356 SYMBOL_LINK "ERRM_CFG_ARRY" 1308 /end CHARACTERISTIC
/begin CHARACTERISTIC ERRM_B1_EXH_VVT_LO_DEN_GRP "bank1 exhaust vvt short low denom group" VALUE 0x2886C __UWORD_S 0 u_den_grp 0 63 FORMAT "%1.0" BIT_MASK 0x003F SYMBOL_LINK "ERRM_CFG_ARRY" 1356 SYMBOL_LINK "ERRM_CFG_ARRY" 1308 /end CHARACTERISTIC
/begin CHARACTERISTIC ERRM_B1_EXH_VVT_LO_DTC "bank1 exhaust vvt short low DTC" VALUE 0x2886C __UWORD_S 0 u_cnts 0 65535 FORMAT "%5.0" SYMBOL_LINK "ERRM_CFG_ARRY" 1358 SYMBOL_LINK "ERRM_CFG_ARRY" 1310 /end CHARACTERISTIC
/begin CHARACTERISTIC ERRM_B1_EXH_VVT_OPN_TYP "bank1 exhaust vvt open type" VALUE 0x2886C __UWORD_S 0 u_diag_typ 0 8 FORMAT "%1.0" BIT_MASK 0xF000 SYMBOL_LINK "ERRM_CFG_ARRY" 1362 SYMBOL_LINK "ERRM_CFG_ARRY" 1314 /end CHARACTERISTIC
/begin CHARACTERISTIC ERRM_B1_EXH_VVT_OPN_MIL_ON "bank1 exhaust vvt open MIL on enable" VALUE 0x2886C __UWORD_S 0 b_true 0 1 FORMAT "%1.0" BIT_MASK 0x0800 SYMBOL_LINK "ERRM_CFG_ARRY" 1362 SYMBOL_LINK "ERRM_CFG_ARRY" 1314 /end CHARACTERISTIC
/begin CHARACTERISTIC ERRM_B1_EXH_VVT_OPN_DEN_GRP "bank1 exhaust vvt open denom group" VALUE 0x2886C __UWORD_S 0 u_den_grp 0 63 FORMAT "%1.0" BIT_MASK 0x003F SYMBOL_LINK "ERRM_CFG_ARRY" 1362 SYMBOL_LINK "ERRM_CFG_ARRY" 1314 /end CHARACTERISTIC
/begin CHARACTERISTIC ERRM_B1_EXH_VVT_OPN_DTC "bank1 exhaust vvt open DTC" VALUE 0x2886C __UWORD_S 0 u_cnts 0 65535 FORMAT "%5.0" SYMBOL_LINK "ERRM_CFG_ARRY" 1364 SYMBOL_LINK "ERRM_CFG_ARRY" 1316 /end CHARACTERISTIC
/begin CHARACTERISTIC ERRM_ESTA_LO_TYP "ESTA short low type" VALUE 0x2886C __UWORD_S 0 u_diag_typ 0 8 FORMAT "%1.0" BIT_MASK 0xF000 SYMBOL_LINK "ERRM_CFG_ARRY" 1368 SYMBOL_LINK "ERRM_CFG_ARRY" 1320 /end CHARACTERISTIC
/begin CHARACTERISTIC ERRM_ESTA_LO_MIL_ON "ESTA short low MIL on enable" VALUE 0x2886C __UWORD_S 0 b_true 0 1 FORMAT "%1.0" BIT_MASK 0x0800 SYMBOL_LINK "ERRM_CFG_ARRY" 1368 SYMBOL_LINK "ERRM_CFG_ARRY" 1320 /end CHARACTERISTIC
/begin CHARACTERISTIC ERRM_ESTA_LO_DEN_GRP "ESTA short low denom group" VALUE 0x2886C __UWORD_S 0 u_den_grp 0 63 FORMAT "%1.0" BIT_MASK 0x003F SYMBOL_LINK "ERRM_CFG_ARRY" 1368 SYMBOL_LINK "ERRM_CFG_ARRY" 1320 /end CHARACTERISTIC
/begin CHARACTERISTIC ERRM_ESTA_LO_DTC "ESTA short low DTC" VALUE 0x2886C __UWORD_S 0 u_cnts 0 65535 FORMAT "%5.0" SYMBOL_LINK "ERRM_CFG_ARRY" 1370 SYMBOL_LINK "ERRM_CFG_ARRY" 1322 /end CHARACTERISTIC
/begin CHARACTERISTIC ERRM_ESTA_HI_TYP "ESTA short high type" VALUE 0x2886C __UWORD_S 0 u_diag_typ 0 8 FORMAT "%1.0" BIT_MASK 0xF000 SYMBOL_LINK "ERRM_CFG_ARRY" 1374 SYMBOL_LINK "ERRM_CFG_ARRY" 1326 /end CHARACTERISTIC
/begin CHARACTERISTIC ERRM_ESTA_HI_MIL_ON "ESTA short high MIL on enable" VALUE 0x2886C __UWORD_S 0 b_true 0 1 FORMAT "%1.0" BIT_MASK 0x0800 SYMBOL_LINK "ERRM_CFG_ARRY" 1374 SYMBOL_LINK "ERRM_CFG_ARRY" 1326 /end CHARACTERISTIC
/begin CHARACTERISTIC ERRM_ESTA_HI_DEN_GRP "ESTA short high denom group" VALUE 0x2886C __UWORD_S 0 u_den_grp 0 63 FORMAT "%1.0" BIT_MASK 0x003F SYMBOL_LINK "ERRM_CFG_ARRY" 1374 SYMBOL_LINK "ERRM_CFG_ARRY" 1326 /end CHARACTERISTIC
/begin CHARACTERISTIC ERRM_ESTA_HI_DTC "ESTA short high DTC" VALUE 0x2886C __UWORD_S 0 u_cnts 0 65535 FORMAT "%5.0" SYMBOL_LINK "ERRM_CFG_ARRY" 1376 SYMBOL_LINK "ERRM_CFG_ARRY" 1328 /end CHARACTERISTIC
/begin CHARACTERISTIC ERRM_ESTA_OPN_TYP "ESTA open type" VALUE 0x2886C __UWORD_S 0 u_diag_typ 0 8 FORMAT "%1.0" BIT_MASK 0xF000 SYMBOL_LINK "ERRM_CFG_ARRY" 1380 SYMBOL_LINK "ERRM_CFG_ARRY" 1332 /end CHARACTERISTIC
/begin CHARACTERISTIC ERRM_ESTA_OPN_MIL_ON "ESTA open MIL on enable" VALUE 0x2886C __UWORD_S 0 b_true 0 1 FORMAT "%1.0" BIT_MASK 0x0800 SYMBOL_LINK "ERRM_CFG_ARRY" 1380 SYMBOL_LINK "ERRM_CFG_ARRY" 1332 /end CHARACTERISTIC
/begin CHARACTERISTIC ERRM_ESTA_OPN_DEN_GRP "ESTA open denom group" VALUE 0x2886C __UWORD_S 0 u_den_grp 0 63 FORMAT "%1.0" BIT_MASK 0x003F SYMBOL_LINK "ERRM_CFG_ARRY" 1380 SYMBOL_LINK "ERRM_CFG_ARRY" 1332 /end CHARACTERISTIC
/begin CHARACTERISTIC ERRM_ESTA_OPN_DTC "ESTA open DTC" VALUE 0x2886C __UWORD_S 0 u_cnts 0 65535 FORMAT "%5.0" SYMBOL_LINK "ERRM_CFG_ARRY" 1382 SYMBOL_LINK "ERRM_CFG_ARRY" 1334 /end CHARACTERISTIC
/begin CHARACTERISTIC ERRM_ESTB_LO_TYP "ESTB short low type" VALUE 0x2886C __UWORD_S 0 u_diag_typ 0 8 FORMAT "%1.0" BIT_MASK 0xF000 SYMBOL_LINK "ERRM_CFG_ARRY" 1386 SYMBOL_LINK "ERRM_CFG_ARRY" 1338 /end CHARACTERISTIC
/begin CHARACTERISTIC ERRM_ESTB_LO_MIL_ON "ESTB short low MIL on enable" VALUE 0x2886C __UWORD_S 0 b_true 0 1 FORMAT "%1.0" BIT_MASK 0x0800 SYMBOL_LINK "ERRM_CFG_ARRY" 1386 SYMBOL_LINK "ERRM_CFG_ARRY" 1338 /end CHARACTERISTIC
/begin CHARACTERISTIC ERRM_ESTB_LO_DEN_GRP "ESTB short low denom group" VALUE 0x2886C __UWORD_S 0 u_den_grp 0 63 FORMAT "%1.0" BIT_MASK 0x003F SYMBOL_LINK "ERRM_CFG_ARRY" 1386 SYMBOL_LINK "ERRM_CFG_ARRY" 1338 /end CHARACTERISTIC
/begin CHARACTERISTIC ERRM_ESTB_LO_DTC "ESTB short low DTC" VALUE 0x2886C __UWORD_S 0 u_cnts 0 65535 FORMAT "%5.0" SYMBOL_LINK "ERRM_CFG_ARRY" 1388 SYMBOL_LINK "ERRM_CFG_ARRY" 1340 /end CHARACTERISTIC
/begin CHARACTERISTIC ERRM_ESTB_HI_TYP "ESTB short high type" VALUE 0x2886C __UWORD_S 0 u_diag_typ 0 8 FORMAT "%1.0" BIT_MASK 0xF000 SYMBOL_LINK "ERRM_CFG_ARRY" 1392 SYMBOL_LINK "ERRM_CFG_ARRY" 1344 /end CHARACTERISTIC
/begin CHARACTERISTIC ERRM_ESTB_HI_MIL_ON "ESTB short high MIL on enable" VALUE 0x2886C __UWORD_S 0 b_true 0 1 FORMAT "%1.0" BIT_MASK 0x0800 SYMBOL_LINK "ERRM_CFG_ARRY" 1392 SYMBOL_LINK "ERRM_CFG_ARRY" 1344 /end CHARACTERISTIC
/begin CHARACTERISTIC ERRM_ESTB_HI_DEN_GRP "ESTB short high denom group" VALUE 0x2886C __UWORD_S 0 u_den_grp 0 63 FORMAT "%1.0" BIT_MASK 0x003F SYMBOL_LINK "ERRM_CFG_ARRY" 1392 SYMBOL_LINK "ERRM_CFG_ARRY" 1344 /end CHARACTERISTIC
/begin CHARACTERISTIC ERRM_ESTB_HI_DTC "ESTB short high DTC" VALUE 0x2886C __UWORD_S 0 u_cnts 0 65535 FORMAT "%5.0" SYMBOL_LINK "ERRM_CFG_ARRY" 1394 SYMBOL_LINK "ERRM_CFG_ARRY" 1346 /end CHARACTERISTIC
/begin CHARACTERISTIC ERRM_ESTB_OPN_TYP "ESTB open type" VALUE 0x2886C __UWORD_S 0 u_diag_typ 0 8 FORMAT "%1.0" BIT_MASK 0xF000 SYMBOL_LINK "ERRM_CFG_ARRY" 1398 SYMBOL_LINK "ERRM_CFG_ARRY" 1350 /end CHARACTERISTIC
/begin CHARACTERISTIC ERRM_ESTB_OPN_MIL_ON "ESTB open MIL on enable" VALUE 0x2886C __UWORD_S 0 b_true 0 1 FORMAT "%1.0" BIT_MASK 0x0800 SYMBOL_LINK "ERRM_CFG_ARRY" 1398 SYMBOL_LINK "ERRM_CFG_ARRY" 1350 /end CHARACTERISTIC
/begin CHARACTERISTIC ERRM_ESTB_OPN_DEN_GRP "ESTB open denom group" VALUE 0x2886C __UWORD_S 0 u_den_grp 0 63 FORMAT "%1.0" BIT_MASK 0x003F SYMBOL_LINK "ERRM_CFG_ARRY" 1398 SYMBOL_LINK "ERRM_CFG_ARRY" 1350 /end CHARACTERISTIC
/begin CHARACTERISTIC ERRM_ESTB_OPN_DTC "ESTB open DTC" VALUE 0x2886C __UWORD_S 0 u_cnts 0 65535 FORMAT "%5.0" SYMBOL_LINK "ERRM_CFG_ARRY" 1400 SYMBOL_LINK "ERRM_CFG_ARRY" 1352 /end CHARACTERISTIC
/begin CHARACTERISTIC ERRM_ESTC_LO_TYP "ESTC short low type" VALUE 0x2886C __UWORD_S 0 u_diag_typ 0 8 FORMAT "%1.0" BIT_MASK 0xF000 SYMBOL_LINK "ERRM_CFG_ARRY" 1404 SYMBOL_LINK "ERRM_CFG_ARRY" 1356 /end CHARACTERISTIC
/begin CHARACTERISTIC ERRM_ESTC_LO_MIL_ON "ESTC short low MIL on enable" VALUE 0x2886C __UWORD_S 0 b_true 0 1 FORMAT "%1.0" BIT_MASK 0x0800 SYMBOL_LINK "ERRM_CFG_ARRY" 1404 SYMBOL_LINK "ERRM_CFG_ARRY" 1356 /end CHARACTERISTIC
/begin CHARACTERISTIC ERRM_ESTC_LO_DEN_GRP "ESTC short low denom group" VALUE 0x2886C __UWORD_S 0 u_den_grp 0 63 FORMAT "%1.0" BIT_MASK 0x003F SYMBOL_LINK "ERRM_CFG_ARRY" 1404 SYMBOL_LINK "ERRM_CFG_ARRY" 1356 /end CHARACTERISTIC
/begin CHARACTERISTIC ERRM_ESTC_LO_DTC "ESTC short low DTC" VALUE 0x2886C __UWORD_S 0 u_cnts 0 65535 FORMAT "%5.0" SYMBOL_LINK "ERRM_CFG_ARRY" 1406 SYMBOL_LINK "ERRM_CFG_ARRY" 1358 /end CHARACTERISTIC
/begin CHARACTERISTIC ERRM_ESTC_HI_TYP "ESTC short high type" VALUE 0x2886C __UWORD_S 0 u_diag_typ 0 8 FORMAT "%1.0" BIT_MASK 0xF000 SYMBOL_LINK "ERRM_CFG_ARRY" 1410 SYMBOL_LINK "ERRM_CFG_ARRY" 1362 /end CHARACTERISTIC
/begin CHARACTERISTIC ERRM_ESTC_HI_MIL_ON "ESTC short high MIL on enable" VALUE 0x2886C __UWORD_S 0 b_true 0 1 FORMAT "%1.0" BIT_MASK 0x0800 SYMBOL_LINK "ERRM_CFG_ARRY" 1410 SYMBOL_LINK "ERRM_CFG_ARRY" 1362 /end CHARACTERISTIC
/begin CHARACTERISTIC ERRM_ESTC_HI_DEN_GRP "ESTC short high denom group" VALUE 0x2886C __UWORD_S 0 u_den_grp 0 63 FORMAT "%1.0" BIT_MASK 0x003F SYMBOL_LINK "ERRM_CFG_ARRY" 1410 SYMBOL_LINK "ERRM_CFG_ARRY" 1362 /end CHARACTERISTIC
/begin CHARACTERISTIC ERRM_ESTC_HI_DTC "ESTC short high DTC" VALUE 0x2886C __UWORD_S 0 u_cnts 0 65535 FORMAT "%5.0" SYMBOL_LINK "ERRM_CFG_ARRY" 1412 SYMBOL_LINK "ERRM_CFG_ARRY" 1364 /end CHARACTERISTIC
/begin CHARACTERISTIC ERRM_ESTC_OPN_TYP "ESTC open type" VALUE 0x2886C __UWORD_S 0 u_diag_typ 0 8 FORMAT "%1.0" BIT_MASK 0xF000 SYMBOL_LINK "ERRM_CFG_ARRY" 1416 SYMBOL_LINK "ERRM_CFG_ARRY" 1368 /end CHARACTERISTIC
/begin CHARACTERISTIC ERRM_ESTC_OPN_MIL_ON "ESTC open MIL on enable" VALUE 0x2886C __UWORD_S 0 b_true 0 1 FORMAT "%1.0" BIT_MASK 0x0800 SYMBOL_LINK "ERRM_CFG_ARRY" 1416 SYMBOL_LINK "ERRM_CFG_ARRY" 1368 /end CHARACTERISTIC
/begin CHARACTERISTIC ERRM_ESTC_OPN_DEN_GRP "ESTC open denom group" VALUE 0x2886C __UWORD_S 0 u_den_grp 0 63 FORMAT "%1.0" BIT_MASK 0x003F SYMBOL_LINK "ERRM_CFG_ARRY" 1416 SYMBOL_LINK "ERRM_CFG_ARRY" 1368 /end CHARACTERISTIC
/begin CHARACTERISTIC ERRM_ESTC_OPN_DTC "ESTC open DTC" VALUE 0x2886C __UWORD_S 0 u_cnts 0 65535 FORMAT "%5.0" SYMBOL_LINK "ERRM_CFG_ARRY" 1418 SYMBOL_LINK "ERRM_CFG_ARRY" 1370 /end CHARACTERISTIC
/begin CHARACTERISTIC ERRM_ESTD_LO_TYP "ESTD short low type" VALUE 0x2886C __UWORD_S 0 u_diag_typ 0 8 FORMAT "%1.0" BIT_MASK 0xF000 SYMBOL_LINK "ERRM_CFG_ARRY" 1422 SYMBOL_LINK "ERRM_CFG_ARRY" 1374 /end CHARACTERISTIC
/begin CHARACTERISTIC ERRM_ESTD_LO_MIL_ON "ESTD short low MIL on enable" VALUE 0x2886C __UWORD_S 0 b_true 0 1 FORMAT "%1.0" BIT_MASK 0x0800 SYMBOL_LINK "ERRM_CFG_ARRY" 1422 SYMBOL_LINK "ERRM_CFG_ARRY" 1374 /end CHARACTERISTIC
/begin CHARACTERISTIC ERRM_ESTD_LO_DEN_GRP "ESTD short low denom group" VALUE 0x2886C __UWORD_S 0 u_den_grp 0 63 FORMAT "%1.0" BIT_MASK 0x003F SYMBOL_LINK "ERRM_CFG_ARRY" 1422 SYMBOL_LINK "ERRM_CFG_ARRY" 1374 /end CHARACTERISTIC
/begin CHARACTERISTIC ERRM_ESTD_LO_DTC "ESTD short low DTC" VALUE 0x2886C __UWORD_S 0 u_cnts 0 65535 FORMAT "%5.0" SYMBOL_LINK "ERRM_CFG_ARRY" 1424 SYMBOL_LINK "ERRM_CFG_ARRY" 1376 /end CHARACTERISTIC
/begin CHARACTERISTIC ERRM_ESTD_HI_TYP "ESTD short high type" VALUE 0x2886C __UWORD_S 0 u_diag_typ 0 8 FORMAT "%1.0" BIT_MASK 0xF000 SYMBOL_LINK "ERRM_CFG_ARRY" 1428 SYMBOL_LINK "ERRM_CFG_ARRY" 1380 /end CHARACTERISTIC
/begin CHARACTERISTIC ERRM_ESTD_HI_MIL_ON "ESTD short high MIL on enable" VALUE 0x2886C __UWORD_S 0 b_true 0 1 FORMAT "%1.0" BIT_MASK 0x0800 SYMBOL_LINK "ERRM_CFG_ARRY" 1428 SYMBOL_LINK "ERRM_CFG_ARRY" 1380 /end CHARACTERISTIC
/begin CHARACTERISTIC ERRM_ESTD_HI_DEN_GRP "ESTD short high denom group" VALUE 0x2886C __UWORD_S 0 u_den_grp 0 63 FORMAT "%1.0" BIT_MASK 0x003F SYMBOL_LINK "ERRM_CFG_ARRY" 1428 SYMBOL_LINK "ERRM_CFG_ARRY" 1380 /end CHARACTERISTIC
/begin CHARACTERISTIC ERRM_ESTD_HI_DTC "ESTD short high DTC" VALUE 0x2886C __UWORD_S 0 u_cnts 0 65535 FORMAT "%5.0" SYMBOL_LINK "ERRM_CFG_ARRY" 1430 SYMBOL_LINK "ERRM_CFG_ARRY" 1382 /end CHARACTERISTIC
/begin CHARACTERISTIC ERRM_ESTD_OPN_TYP "ESTD open type" VALUE 0x2886C __UWORD_S 0 u_diag_typ 0 8 FORMAT "%1.0" BIT_MASK 0xF000 SYMBOL_LINK "ERRM_CFG_ARRY" 1434 SYMBOL_LINK "ERRM_CFG_ARRY" 1386 /end CHARACTERISTIC
/begin CHARACTERISTIC ERRM_ESTD_OPN_MIL_ON "ESTD open MIL on enable" VALUE 0x2886C __UWORD_S 0 b_true 0 1 FORMAT "%1.0" BIT_MASK 0x0800 SYMBOL_LINK "ERRM_CFG_ARRY" 1434 SYMBOL_LINK "ERRM_CFG_ARRY" 1386 /end CHARACTERISTIC
/begin CHARACTERISTIC ERRM_ESTD_OPN_DEN_GRP "ESTD open denom group" VALUE 0x2886C __UWORD_S 0 u_den_grp 0 63 FORMAT "%1.0" BIT_MASK 0x003F SYMBOL_LINK "ERRM_CFG_ARRY" 1434 SYMBOL_LINK "ERRM_CFG_ARRY" 1386 /end CHARACTERISTIC
/begin CHARACTERISTIC ERRM_ESTD_OPN_DTC "ESTD open DTC" VALUE 0x2886C __UWORD_S 0 u_cnts 0 65535 FORMAT "%5.0" SYMBOL_LINK "ERRM_CFG_ARRY" 1436 SYMBOL_LINK "ERRM_CFG_ARRY" 1388 /end CHARACTERISTIC
/begin CHARACTERISTIC ERRM_VENT_LO_TYP "vent valve short low type" VALUE 0x2886C __UWORD_S 0 u_diag_typ 0 8 FORMAT "%1.0" BIT_MASK 0xF000 SYMBOL_LINK "ERRM_CFG_ARRY" 1524 SYMBOL_LINK "ERRM_CFG_ARRY" 1476 /end CHARACTERISTIC
/begin CHARACTERISTIC ERRM_VENT_LO_MIL_ON "vent valve short low MIL on enable" VALUE 0x2886C __UWORD_S 0 b_true 0 1 FORMAT "%1.0" BIT_MASK 0x0800 SYMBOL_LINK "ERRM_CFG_ARRY" 1524 SYMBOL_LINK "ERRM_CFG_ARRY" 1476 /end CHARACTERISTIC
/begin CHARACTERISTIC ERRM_VENT_LO_DEN_GRP "vent valve short low denom group" VALUE 0x2886C __UWORD_S 0 u_den_grp 0 63 FORMAT "%1.0" BIT_MASK 0x003F SYMBOL_LINK "ERRM_CFG_ARRY" 1524 SYMBOL_LINK "ERRM_CFG_ARRY" 1476 /end CHARACTERISTIC
/begin CHARACTERISTIC ERRM_VENT_LO_DTC "vent valve short low DTC" VALUE 0x2886C __UWORD_S 0 u_cnts 0 65535 FORMAT "%5.0" SYMBOL_LINK "ERRM_CFG_ARRY" 1526 SYMBOL_LINK "ERRM_CFG_ARRY" 1478 /end CHARACTERISTIC
/begin CHARACTERISTIC ERRM_VENT_HI_TYP "vent valve short high type" VALUE 0x2886C __UWORD_S 0 u_diag_typ 0 8 FORMAT "%1.0" BIT_MASK 0xF000 SYMBOL_LINK "ERRM_CFG_ARRY" 1530 SYMBOL_LINK "ERRM_CFG_ARRY" 1482 /end CHARACTERISTIC
/begin CHARACTERISTIC ERRM_VENT_HI_MIL_ON "vent valve short high MIL on enable" VALUE 0x2886C __UWORD_S 0 b_true 0 1 FORMAT "%1.0" BIT_MASK 0x0800 SYMBOL_LINK "ERRM_CFG_ARRY" 1530 SYMBOL_LINK "ERRM_CFG_ARRY" 1482 /end CHARACTERISTIC
/begin CHARACTERISTIC ERRM_VENT_HI_DEN_GRP "vent valve short high denom group" VALUE 0x2886C __UWORD_S 0 u_den_grp 0 63 FORMAT "%1.0" BIT_MASK 0x003F SYMBOL_LINK "ERRM_CFG_ARRY" 1530 SYMBOL_LINK "ERRM_CFG_ARRY" 1482 /end CHARACTERISTIC
/begin CHARACTERISTIC ERRM_VENT_HI_DTC "vent valve short high DTC" VALUE 0x2886C __UWORD_S 0 u_cnts 0 65535 FORMAT "%5.0" SYMBOL_LINK "ERRM_CFG_ARRY" 1532 SYMBOL_LINK "ERRM_CFG_ARRY" 1484 /end CHARACTERISTIC
/begin CHARACTERISTIC ERRM_ECM_AD_TYP "ECM AD response type" VALUE 0x2886C __UWORD_S 0 u_diag_typ 0 8 FORMAT "%1.0" BIT_MASK 0xF000 SYMBOL_LINK "ERRM_CFG_ARRY" 1560 SYMBOL_LINK "ERRM_CFG_ARRY" 1512 /end CHARACTERISTIC
/begin CHARACTERISTIC ERRM_ECM_AD_MIL_ON "ECM AD response MIL on enable" VALUE 0x2886C __UWORD_S 0 b_true 0 1 FORMAT "%1.0" BIT_MASK 0x0800 SYMBOL_LINK "ERRM_CFG_ARRY" 1560 SYMBOL_LINK "ERRM_CFG_ARRY" 1512 /end CHARACTERISTIC
/begin CHARACTERISTIC ERRM_ECM_AD_DEN_GRP "ECM AD response denom group" VALUE 0x2886C __UWORD_S 0 u_den_grp 0 63 FORMAT "%1.0" BIT_MASK 0x003F SYMBOL_LINK "ERRM_CFG_ARRY" 1560 SYMBOL_LINK "ERRM_CFG_ARRY" 1512 /end CHARACTERISTIC
/begin CHARACTERISTIC ERRM_ECM_AD_DTC "ECM AD response DTC" VALUE 0x2886C __UWORD_S 0 u_cnts 0 65535 FORMAT "%5.0" SYMBOL_LINK "ERRM_CFG_ARRY" 1562 SYMBOL_LINK "ERRM_CFG_ARRY" 1514 /end CHARACTERISTIC
/begin CHARACTERISTIC ERRM_ECM_SW_VER_TYP "ECM software version type" VALUE 0x2886C __UWORD_S 0 u_diag_typ 0 8 FORMAT "%1.0" BIT_MASK 0xF000 SYMBOL_LINK "ERRM_CFG_ARRY" 1566 SYMBOL_LINK "ERRM_CFG_ARRY" 1518 /end CHARACTERISTIC
/begin CHARACTERISTIC ERRM_ECM_SW_VER_MIL_ON "ECM software version MIL on enable" VALUE 0x2886C __UWORD_S 0 b_true 0 1 FORMAT "%1.0" BIT_MASK 0x0800 SYMBOL_LINK "ERRM_CFG_ARRY" 1566 SYMBOL_LINK "ERRM_CFG_ARRY" 1518 /end CHARACTERISTIC
/begin CHARACTERISTIC ERRM_ECM_SW_VER_DEN_GRP "ECM software version denom group" VALUE 0x2886C __UWORD_S 0 u_den_grp 0 63 FORMAT "%1.0" BIT_MASK 0x003F SYMBOL_LINK "ERRM_CFG_ARRY" 1566 SYMBOL_LINK "ERRM_CFG_ARRY" 1518 /end CHARACTERISTIC
/begin CHARACTERISTIC ERRM_ECM_SW_VER_DTC "ECM software version DTC" VALUE 0x2886C __UWORD_S 0 u_cnts 0 65535 FORMAT "%5.0" SYMBOL_LINK "ERRM_CFG_ARRY" 1568 SYMBOL_LINK "ERRM_CFG_ARRY" 1520 /end CHARACTERISTIC
/begin CHARACTERISTIC ERRM_PS_P_LO_TYP "power steer pressure short low type" VALUE 0x2886C __UWORD_S 0 u_diag_typ 0 8 FORMAT "%1.0" BIT_MASK 0xF000 SYMBOL_LINK "ERRM_CFG_ARRY" 1572 SYMBOL_LINK "ERRM_CFG_ARRY" 1524 /end CHARACTERISTIC
/begin CHARACTERISTIC ERRM_PS_P_LO_MIL_ON "power steer pressure short low MIL on enable" VALUE 0x2886C __UWORD_S 0 b_true 0 1 FORMAT "%1.0" BIT_MASK 0x0800 SYMBOL_LINK "ERRM_CFG_ARRY" 1572 SYMBOL_LINK "ERRM_CFG_ARRY" 1524 /end CHARACTERISTIC
/begin CHARACTERISTIC ERRM_PS_P_LO_DEN_GRP "power steer pressure short low denom group" VALUE 0x2886C __UWORD_S 0 u_den_grp 0 63 FORMAT "%1.0" BIT_MASK 0x003F SYMBOL_LINK "ERRM_CFG_ARRY" 1572 SYMBOL_LINK "ERRM_CFG_ARRY" 1524 /end CHARACTERISTIC
/begin CHARACTERISTIC ERRM_PS_P_LO_DTC "power steer pressure short low DTC" VALUE 0x2886C __UWORD_S 0 u_cnts 0 65535 FORMAT "%5.0" SYMBOL_LINK "ERRM_CFG_ARRY" 1574 SYMBOL_LINK "ERRM_CFG_ARRY" 1526 /end CHARACTERISTIC
/begin CHARACTERISTIC ERRM_PS_P_HI_TYP "power steer pressure short high type" VALUE 0x2886C __UWORD_S 0 u_diag_typ 0 8 FORMAT "%1.0" BIT_MASK 0xF000 SYMBOL_LINK "ERRM_CFG_ARRY" 1578 SYMBOL_LINK "ERRM_CFG_ARRY" 1530 /end CHARACTERISTIC
/begin CHARACTERISTIC ERRM_PS_P_HI_MIL_ON "power steer pressure short high MIL on enable" VALUE 0x2886C __UWORD_S 0 b_true 0 1 FORMAT "%1.0" BIT_MASK 0x0800 SYMBOL_LINK "ERRM_CFG_ARRY" 1578 SYMBOL_LINK "ERRM_CFG_ARRY" 1530 /end CHARACTERISTIC
/begin CHARACTERISTIC ERRM_PS_P_HI_DEN_GRP "power steer pressure short high denom group" VALUE 0x2886C __UWORD_S 0 u_den_grp 0 63 FORMAT "%1.0" BIT_MASK 0x003F SYMBOL_LINK "ERRM_CFG_ARRY" 1578 SYMBOL_LINK "ERRM_CFG_ARRY" 1530 /end CHARACTERISTIC
/begin CHARACTERISTIC ERRM_PS_P_HI_DTC "power steer pressure short high DTC" VALUE 0x2886C __UWORD_S 0 u_cnts 0 65535 FORMAT "%5.0" SYMBOL_LINK "ERRM_CFG_ARRY" 1580 SYMBOL_LINK "ERRM_CFG_ARRY" 1532 /end CHARACTERISTIC
/begin CHARACTERISTIC ERRM_CRUZ_AN_TYP "cruise analog input type" VALUE 0x2886C __UWORD_S 0 u_diag_typ 0 8 FORMAT "%1.0" BIT_MASK 0xF000 SYMBOL_LINK "ERRM_CFG_ARRY" 1590 SYMBOL_LINK "ERRM_CFG_ARRY" 1542 /end CHARACTERISTIC
/begin CHARACTERISTIC ERRM_CRUZ_AN_MIL_ON "cruise analog input MIL on enable" VALUE 0x2886C __UWORD_S 0 b_true 0 1 FORMAT "%1.0" BIT_MASK 0x0800 SYMBOL_LINK "ERRM_CFG_ARRY" 1590 SYMBOL_LINK "ERRM_CFG_ARRY" 1542 /end CHARACTERISTIC
/begin CHARACTERISTIC ERRM_CRUZ_AN_DEN_GRP "cruise analog input denom group" VALUE 0x2886C __UWORD_S 0 u_den_grp 0 63 FORMAT "%1.0" BIT_MASK 0x003F SYMBOL_LINK "ERRM_CFG_ARRY" 1590 SYMBOL_LINK "ERRM_CFG_ARRY" 1542 /end CHARACTERISTIC
/begin CHARACTERISTIC ERRM_CRUZ_AN_DTC "cruise analog input DTC" VALUE 0x2886C __UWORD_S 0 u_cnts 0 65535 FORMAT "%5.0" SYMBOL_LINK "ERRM_CFG_ARRY" 1592 SYMBOL_LINK "ERRM_CFG_ARRY" 1544 /end CHARACTERISTIC
/begin CHARACTERISTIC ERRM_CRUZ_ON_TYP "cruise on noise type" VALUE 0x2886C __UWORD_S 0 u_diag_typ 0 8 FORMAT "%1.0" BIT_MASK 0xF000 SYMBOL_LINK "ERRM_CFG_ARRY" 1596 SYMBOL_LINK "ERRM_CFG_ARRY" 1548 /end CHARACTERISTIC
/begin CHARACTERISTIC ERRM_CRUZ_ON_MIL_ON "cruise on noise MIL on enable" VALUE 0x2886C __UWORD_S 0 b_true 0 1 FORMAT "%1.0" BIT_MASK 0x0800 SYMBOL_LINK "ERRM_CFG_ARRY" 1596 SYMBOL_LINK "ERRM_CFG_ARRY" 1548 /end CHARACTERISTIC
/begin CHARACTERISTIC ERRM_CRUZ_ON_DEN_GRP "cruise on noise denom group" VALUE 0x2886C __UWORD_S 0 u_den_grp 0 63 FORMAT "%1.0" BIT_MASK 0x003F SYMBOL_LINK "ERRM_CFG_ARRY" 1596 SYMBOL_LINK "ERRM_CFG_ARRY" 1548 /end CHARACTERISTIC
/begin CHARACTERISTIC ERRM_CRUZ_ON_DTC "cruise on noise DTC" VALUE 0x2886C __UWORD_S 0 u_cnts 0 65535 FORMAT "%5.0" SYMBOL_LINK "ERRM_CFG_ARRY" 1598 SYMBOL_LINK "ERRM_CFG_ARRY" 1550 /end CHARACTERISTIC
/begin CHARACTERISTIC ERRM_CRUZ_CANCEL_TYP "cruise cancel noise type" VALUE 0x2886C __UWORD_S 0 u_diag_typ 0 8 FORMAT "%1.0" BIT_MASK 0xF000 SYMBOL_LINK "ERRM_CFG_ARRY" 1602 SYMBOL_LINK "ERRM_CFG_ARRY" 1554 /end CHARACTERISTIC
/begin CHARACTERISTIC ERRM_CRUZ_CANCEL_MIL_ON "cruise cancel noise MIL on enable" VALUE 0x2886C __UWORD_S 0 b_true 0 1 FORMAT "%1.0" BIT_MASK 0x0800 SYMBOL_LINK "ERRM_CFG_ARRY" 1602 SYMBOL_LINK "ERRM_CFG_ARRY" 1554 /end CHARACTERISTIC
/begin CHARACTERISTIC ERRM_CRUZ_CANCEL_DEN_GRP "cruise cancel noise denom group" VALUE 0x2886C __UWORD_S 0 u_den_grp 0 63 FORMAT "%1.0" BIT_MASK 0x003F SYMBOL_LINK "ERRM_CFG_ARRY" 1602 SYMBOL_LINK "ERRM_CFG_ARRY" 1554 /end CHARACTERISTIC
/begin CHARACTERISTIC ERRM_CRUZ_CANCEL_DTC "cruise cancel noise DTC" VALUE 0x2886C __UWORD_S 0 u_cnts 0 65535 FORMAT "%5.0" SYMBOL_LINK "ERRM_CFG_ARRY" 1604 SYMBOL_LINK "ERRM_CFG_ARRY" 1556 /end CHARACTERISTIC
/begin CHARACTERISTIC ERRM_CRUZ_RES_TYP "cruise resume noise type" VALUE 0x2886C __UWORD_S 0 u_diag_typ 0 8 FORMAT "%1.0" BIT_MASK 0xF000 SYMBOL_LINK "ERRM_CFG_ARRY" 1608 SYMBOL_LINK "ERRM_CFG_ARRY" 1560 /end CHARACTERISTIC
/begin CHARACTERISTIC ERRM_CRUZ_RES_MIL_ON "cruise resume noise MIL on enable" VALUE 0x2886C __UWORD_S 0 b_true 0 1 FORMAT "%1.0" BIT_MASK 0x0800 SYMBOL_LINK "ERRM_CFG_ARRY" 1608 SYMBOL_LINK "ERRM_CFG_ARRY" 1560 /end CHARACTERISTIC
/begin CHARACTERISTIC ERRM_CRUZ_RES_DEN_GRP "cruise resume noise denom group" VALUE 0x2886C __UWORD_S 0 u_den_grp 0 63 FORMAT "%1.0" BIT_MASK 0x003F SYMBOL_LINK "ERRM_CFG_ARRY" 1608 SYMBOL_LINK "ERRM_CFG_ARRY" 1560 /end CHARACTERISTIC
/begin CHARACTERISTIC ERRM_CRUZ_RES_DTC "cruise resume noise DTC" VALUE 0x2886C __UWORD_S 0 u_cnts 0 65535 FORMAT "%5.0" SYMBOL_LINK "ERRM_CFG_ARRY" 1610 SYMBOL_LINK "ERRM_CFG_ARRY" 1562 /end CHARACTERISTIC
/begin CHARACTERISTIC ERRM_CRUZ_SET_TYP "cruise set noise type" VALUE 0x2886C __UWORD_S 0 u_diag_typ 0 8 FORMAT "%1.0" BIT_MASK 0xF000 SYMBOL_LINK "ERRM_CFG_ARRY" 1614 SYMBOL_LINK "ERRM_CFG_ARRY" 1566 /end CHARACTERISTIC
/begin CHARACTERISTIC ERRM_CRUZ_SET_MIL_ON "cruise set noise MIL on enable" VALUE 0x2886C __UWORD_S 0 b_true 0 1 FORMAT "%1.0" BIT_MASK 0x0800 SYMBOL_LINK "ERRM_CFG_ARRY" 1614 SYMBOL_LINK "ERRM_CFG_ARRY" 1566 /end CHARACTERISTIC
/begin CHARACTERISTIC ERRM_CRUZ_SET_DEN_GRP "cruise set noise denom group" VALUE 0x2886C __UWORD_S 0 u_den_grp 0 63 FORMAT "%1.0" BIT_MASK 0x003F SYMBOL_LINK "ERRM_CFG_ARRY" 1614 SYMBOL_LINK "ERRM_CFG_ARRY" 1566 /end CHARACTERISTIC
/begin CHARACTERISTIC ERRM_CRUZ_SET_DTC "cruise set noise DTC" VALUE 0x2886C __UWORD_S 0 u_cnts 0 65535 FORMAT "%5.0" SYMBOL_LINK "ERRM_CFG_ARRY" 1616 SYMBOL_LINK "ERRM_CFG_ARRY" 1568 /end CHARACTERISTIC
/begin CHARACTERISTIC ERRM_CRUZ_DIST_TYP "cruise distance noise type" VALUE 0x2886C __UWORD_S 0 u_diag_typ 0 8 FORMAT "%1.0" BIT_MASK 0xF000 SYMBOL_LINK "ERRM_CFG_ARRY" 1620 SYMBOL_LINK "ERRM_CFG_ARRY" 1572 /end CHARACTERISTIC
/begin CHARACTERISTIC ERRM_CRUZ_DIST_MIL_ON "cruise distance noise MIL on enable" VALUE 0x2886C __UWORD_S 0 b_true 0 1 FORMAT "%1.0" BIT_MASK 0x0800 SYMBOL_LINK "ERRM_CFG_ARRY" 1620 SYMBOL_LINK "ERRM_CFG_ARRY" 1572 /end CHARACTERISTIC
/begin CHARACTERISTIC ERRM_CRUZ_DIST_DEN_GRP "cruise distance noise denom group" VALUE 0x2886C __UWORD_S 0 u_den_grp 0 63 FORMAT "%1.0" BIT_MASK 0x003F SYMBOL_LINK "ERRM_CFG_ARRY" 1620 SYMBOL_LINK "ERRM_CFG_ARRY" 1572 /end CHARACTERISTIC
/begin CHARACTERISTIC ERRM_CRUZ_DIST_DTC "cruise distance noise DTC" VALUE 0x2886C __UWORD_S 0 u_cnts 0 65535 FORMAT "%5.0" SYMBOL_LINK "ERRM_CFG_ARRY" 1622 SYMBOL_LINK "ERRM_CFG_ARRY" 1574 /end CHARACTERISTIC
/begin CHARACTERISTIC ERRM_CRUZ_LMT_TYP "cruise speed limit noise type" VALUE 0x2886C __UWORD_S 0 u_diag_typ 0 8 FORMAT "%1.0" BIT_MASK 0xF000 SYMBOL_LINK "ERRM_CFG_ARRY" 1626 SYMBOL_LINK "ERRM_CFG_ARRY" 1578 /end CHARACTERISTIC
/begin CHARACTERISTIC ERRM_CRUZ_LMT_MIL_ON "cruise speed limit noise MIL on enable" VALUE 0x2886C __UWORD_S 0 b_true 0 1 FORMAT "%1.0" BIT_MASK 0x0800 SYMBOL_LINK "ERRM_CFG_ARRY" 1626 SYMBOL_LINK "ERRM_CFG_ARRY" 1578 /end CHARACTERISTIC
/begin CHARACTERISTIC ERRM_CRUZ_LMT_DEN_GRP "cruise speed limit noise denom group" VALUE 0x2886C __UWORD_S 0 u_den_grp 0 63 FORMAT "%1.0" BIT_MASK 0x003F SYMBOL_LINK "ERRM_CFG_ARRY" 1626 SYMBOL_LINK "ERRM_CFG_ARRY" 1578 /end CHARACTERISTIC
/begin CHARACTERISTIC ERRM_CRUZ_LMT_DTC "cruise speed limit noise DTC" VALUE 0x2886C __UWORD_S 0 u_cnts 0 65535 FORMAT "%5.0" SYMBOL_LINK "ERRM_CFG_ARRY" 1628 SYMBOL_LINK "ERRM_CFG_ARRY" 1580 /end CHARACTERISTIC
/begin CHARACTERISTIC ERRM_CRUZ_ON_STCK_TYP "cruise on stuck type" VALUE 0x2886C __UWORD_S 0 u_diag_typ 0 8 FORMAT "%1.0" BIT_MASK 0xF000 SYMBOL_LINK "ERRM_CFG_ARRY" 1632 SYMBOL_LINK "ERRM_CFG_ARRY" 1584 /end CHARACTERISTIC
/begin CHARACTERISTIC ERRM_CRUZ_ON_STCK_MIL_ON "cruise on stuck MIL on enable" VALUE 0x2886C __UWORD_S 0 b_true 0 1 FORMAT "%1.0" BIT_MASK 0x0800 SYMBOL_LINK "ERRM_CFG_ARRY" 1632 SYMBOL_LINK "ERRM_CFG_ARRY" 1584 /end CHARACTERISTIC
/begin CHARACTERISTIC ERRM_CRUZ_ON_STCK_DEN_GRP "cruise on stuck denom group" VALUE 0x2886C __UWORD_S 0 u_den_grp 0 63 FORMAT "%1.0" BIT_MASK 0x003F SYMBOL_LINK "ERRM_CFG_ARRY" 1632 SYMBOL_LINK "ERRM_CFG_ARRY" 1584 /end CHARACTERISTIC
/begin CHARACTERISTIC ERRM_CRUZ_ON_STCK_DTC "cruise on stuck DTC" VALUE 0x2886C __UWORD_S 0 u_cnts 0 65535 FORMAT "%5.0" SYMBOL_LINK "ERRM_CFG_ARRY" 1634 SYMBOL_LINK "ERRM_CFG_ARRY" 1586 /end CHARACTERISTIC
/begin CHARACTERISTIC ERRM_CRUZ_CANCEL_STCK_TYP "cruise cancel stuck type" VALUE 0x2886C __UWORD_S 0 u_diag_typ 0 8 FORMAT "%1.0" BIT_MASK 0xF000 SYMBOL_LINK "ERRM_CFG_ARRY" 1638 SYMBOL_LINK "ERRM_CFG_ARRY" 1590 /end CHARACTERISTIC
/begin CHARACTERISTIC ERRM_CRUZ_CANCEL_STCK_MIL_ON "cruise cancel stuck MIL on enable" VALUE 0x2886C __UWORD_S 0 b_true 0 1 FORMAT "%1.0" BIT_MASK 0x0800 SYMBOL_LINK "ERRM_CFG_ARRY" 1638 SYMBOL_LINK "ERRM_CFG_ARRY" 1590 /end CHARACTERISTIC
/begin CHARACTERISTIC ERRM_CRUZ_CANCEL_STCK_DEN_GRP "cruise cancel stuck denom group" VALUE 0x2886C __UWORD_S 0 u_den_grp 0 63 FORMAT "%1.0" BIT_MASK 0x003F SYMBOL_LINK "ERRM_CFG_ARRY" 1638 SYMBOL_LINK "ERRM_CFG_ARRY" 1590 /end CHARACTERISTIC
/begin CHARACTERISTIC ERRM_CRUZ_CANCEL_STCK_DTC "cruise cancel stuck DTC" VALUE 0x2886C __UWORD_S 0 u_cnts 0 65535 FORMAT "%5.0" SYMBOL_LINK "ERRM_CFG_ARRY" 1640 SYMBOL_LINK "ERRM_CFG_ARRY" 1592 /end CHARACTERISTIC
/begin CHARACTERISTIC ERRM_CRUZ_RES_STCK_TYP "cruise resume stuck type" VALUE 0x2886C __UWORD_S 0 u_diag_typ 0 8 FORMAT "%1.0" BIT_MASK 0xF000 SYMBOL_LINK "ERRM_CFG_ARRY" 1644 SYMBOL_LINK "ERRM_CFG_ARRY" 1596 /end CHARACTERISTIC
/begin CHARACTERISTIC ERRM_CRUZ_RES_STCK_MIL_ON "cruise resume stuck MIL on enable" VALUE 0x2886C __UWORD_S 0 b_true 0 1 FORMAT "%1.0" BIT_MASK 0x0800 SYMBOL_LINK "ERRM_CFG_ARRY" 1644 SYMBOL_LINK "ERRM_CFG_ARRY" 1596 /end CHARACTERISTIC
/begin CHARACTERISTIC ERRM_CRUZ_RES_STCK_DEN_GRP "cruise resume stuck denom group" VALUE 0x2886C __UWORD_S 0 u_den_grp 0 63 FORMAT "%1.0" BIT_MASK 0x003F SYMBOL_LINK "ERRM_CFG_ARRY" 1644 SYMBOL_LINK "ERRM_CFG_ARRY" 1596 /end CHARACTERISTIC
/begin CHARACTERISTIC ERRM_CRUZ_RES_STCK_DTC "cruise resume stuck DTC" VALUE 0x2886C __UWORD_S 0 u_cnts 0 65535 FORMAT "%5.0" SYMBOL_LINK "ERRM_CFG_ARRY" 1646 SYMBOL_LINK "ERRM_CFG_ARRY" 1598 /end CHARACTERISTIC
/begin CHARACTERISTIC ERRM_CRUZ_SET_STCK_TYP "cruise set stuck type" VALUE 0x2886C __UWORD_S 0 u_diag_typ 0 8 FORMAT "%1.0" BIT_MASK 0xF000 SYMBOL_LINK "ERRM_CFG_ARRY" 1650 SYMBOL_LINK "ERRM_CFG_ARRY" 1602 /end CHARACTERISTIC
/begin CHARACTERISTIC ERRM_CRUZ_SET_STCK_MIL_ON "cruise set stuck MIL on enable" VALUE 0x2886C __UWORD_S 0 b_true 0 1 FORMAT "%1.0" BIT_MASK 0x0800 SYMBOL_LINK "ERRM_CFG_ARRY" 1650 SYMBOL_LINK "ERRM_CFG_ARRY" 1602 /end CHARACTERISTIC
/begin CHARACTERISTIC ERRM_CRUZ_SET_STCK_DEN_GRP "cruise set stuck denom group" VALUE 0x2886C __UWORD_S 0 u_den_grp 0 63 FORMAT "%1.0" BIT_MASK 0x003F SYMBOL_LINK "ERRM_CFG_ARRY" 1650 SYMBOL_LINK "ERRM_CFG_ARRY" 1602 /end CHARACTERISTIC
/begin CHARACTERISTIC ERRM_CRUZ_SET_STCK_DTC "cruise set stuck DTC" VALUE 0x2886C __UWORD_S 0 u_cnts 0 65535 FORMAT "%5.0" SYMBOL_LINK "ERRM_CFG_ARRY" 1652 SYMBOL_LINK "ERRM_CFG_ARRY" 1604 /end CHARACTERISTIC
/begin CHARACTERISTIC ERRM_CRUZ_DIST_STCK_TYP "cruise distance stuck type" VALUE 0x2886C __UWORD_S 0 u_diag_typ 0 8 FORMAT "%1.0" BIT_MASK 0xF000 SYMBOL_LINK "ERRM_CFG_ARRY" 1656 SYMBOL_LINK "ERRM_CFG_ARRY" 1608 /end CHARACTERISTIC
/begin CHARACTERISTIC ERRM_CRUZ_DIST_STCK_MIL_ON "cruise distance stuck MIL on enable" VALUE 0x2886C __UWORD_S 0 b_true 0 1 FORMAT "%1.0" BIT_MASK 0x0800 SYMBOL_LINK "ERRM_CFG_ARRY" 1656 SYMBOL_LINK "ERRM_CFG_ARRY" 1608 /end CHARACTERISTIC
/begin CHARACTERISTIC ERRM_CRUZ_DIST_STCK_DEN_GRP "cruise distance stuck denom group" VALUE 0x2886C __UWORD_S 0 u_den_grp 0 63 FORMAT "%1.0" BIT_MASK 0x003F SYMBOL_LINK "ERRM_CFG_ARRY" 1656 SYMBOL_LINK "ERRM_CFG_ARRY" 1608 /end CHARACTERISTIC
/begin CHARACTERISTIC ERRM_CRUZ_DIST_STCK_DTC "cruise distance stuck DTC" VALUE 0x2886C __UWORD_S 0 u_cnts 0 65535 FORMAT "%5.0" SYMBOL_LINK "ERRM_CFG_ARRY" 1658 SYMBOL_LINK "ERRM_CFG_ARRY" 1610 /end CHARACTERISTIC
/begin CHARACTERISTIC ERRM_CRUZ_LMT_STCK_TYP "cruise speed limit stuck type" VALUE 0x2886C __UWORD_S 0 u_diag_typ 0 8 FORMAT "%1.0" BIT_MASK 0xF000 SYMBOL_LINK "ERRM_CFG_ARRY" 1662 SYMBOL_LINK "ERRM_CFG_ARRY" 1614 /end CHARACTERISTIC
/begin CHARACTERISTIC ERRM_CRUZ_LMT_STCK_MIL_ON "cruise speed limit stuck MIL on enable" VALUE 0x2886C __UWORD_S 0 b_true 0 1 FORMAT "%1.0" BIT_MASK 0x0800 SYMBOL_LINK "ERRM_CFG_ARRY" 1662 SYMBOL_LINK "ERRM_CFG_ARRY" 1614 /end CHARACTERISTIC
/begin CHARACTERISTIC ERRM_CRUZ_LMT_STCK_DEN_GRP "cruise speed limit stuck denom group" VALUE 0x2886C __UWORD_S 0 u_den_grp 0 63 FORMAT "%1.0" BIT_MASK 0x003F SYMBOL_LINK "ERRM_CFG_ARRY" 1662 SYMBOL_LINK "ERRM_CFG_ARRY" 1614 /end CHARACTERISTIC
/begin CHARACTERISTIC ERRM_CRUZ_LMT_STCK_DTC "cruise speed limit stuck DTC" VALUE 0x2886C __UWORD_S 0 u_cnts 0 65535 FORMAT "%5.0" SYMBOL_LINK "ERRM_CFG_ARRY" 1664 SYMBOL_LINK "ERRM_CFG_ARRY" 1616 /end CHARACTERISTIC
/begin CHARACTERISTIC ERRM_ECM_AD0_TYP "ECM AD0 hardware type" VALUE 0x2886C __UWORD_S 0 u_diag_typ 0 8 FORMAT "%1.0" BIT_MASK 0xF000 SYMBOL_LINK "ERRM_CFG_ARRY" 1668 SYMBOL_LINK "ERRM_CFG_ARRY" 1620 /end CHARACTERISTIC
/begin CHARACTERISTIC ERRM_ECM_AD0_MIL_ON "ECM AD0 hardware MIL on enable" VALUE 0x2886C __UWORD_S 0 b_true 0 1 FORMAT "%1.0" BIT_MASK 0x0800 SYMBOL_LINK "ERRM_CFG_ARRY" 1668 SYMBOL_LINK "ERRM_CFG_ARRY" 1620 /end CHARACTERISTIC
/begin CHARACTERISTIC ERRM_ECM_AD0_DEN_GRP "ECM AD0 hardware denom group" VALUE 0x2886C __UWORD_S 0 u_den_grp 0 63 FORMAT "%1.0" BIT_MASK 0x003F SYMBOL_LINK "ERRM_CFG_ARRY" 1668 SYMBOL_LINK "ERRM_CFG_ARRY" 1620 /end CHARACTERISTIC
/begin CHARACTERISTIC ERRM_ECM_AD0_DTC "ECM AD0 hardware DTC" VALUE 0x2886C __UWORD_S 0 u_cnts 0 65535 FORMAT "%5.0" SYMBOL_LINK "ERRM_CFG_ARRY" 1670 SYMBOL_LINK "ERRM_CFG_ARRY" 1622 /end CHARACTERISTIC
/begin CHARACTERISTIC ERRM_ECM_AD1_TYP "ECM AD1 hardware type" VALUE 0x2886C __UWORD_S 0 u_diag_typ 0 8 FORMAT "%1.0" BIT_MASK 0xF000 SYMBOL_LINK "ERRM_CFG_ARRY" 1674 SYMBOL_LINK "ERRM_CFG_ARRY" 1626 /end CHARACTERISTIC
/begin CHARACTERISTIC ERRM_ECM_AD1_MIL_ON "ECM AD1 hardware MIL on enable" VALUE 0x2886C __UWORD_S 0 b_true 0 1 FORMAT "%1.0" BIT_MASK 0x0800 SYMBOL_LINK "ERRM_CFG_ARRY" 1674 SYMBOL_LINK "ERRM_CFG_ARRY" 1626 /end CHARACTERISTIC
/begin CHARACTERISTIC ERRM_ECM_AD1_DEN_GRP "ECM AD1 hardware denom group" VALUE 0x2886C __UWORD_S 0 u_den_grp 0 63 FORMAT "%1.0" BIT_MASK 0x003F SYMBOL_LINK "ERRM_CFG_ARRY" 1674 SYMBOL_LINK "ERRM_CFG_ARRY" 1626 /end CHARACTERISTIC
/begin CHARACTERISTIC ERRM_ECM_AD1_DTC "ECM AD1 hardware DTC" VALUE 0x2886C __UWORD_S 0 u_cnts 0 65535 FORMAT "%5.0" SYMBOL_LINK "ERRM_CFG_ARRY" 1676 SYMBOL_LINK "ERRM_CFG_ARRY" 1628 /end CHARACTERISTIC
/begin CHARACTERISTIC ERRM_ECM_GPR_TYP "ECM general purpose register hardware type" VALUE 0x2886C __UWORD_S 0 u_diag_typ 0 8 FORMAT "%1.0" BIT_MASK 0xF000 SYMBOL_LINK "ERRM_CFG_ARRY" 1680 SYMBOL_LINK "ERRM_CFG_ARRY" 1632 /end CHARACTERISTIC
/begin CHARACTERISTIC ERRM_ECM_GPR_MIL_ON "ECM general purpose register MIL on enable" VALUE 0x2886C __UWORD_S 0 b_true 0 1 FORMAT "%1.0" BIT_MASK 0x0800 SYMBOL_LINK "ERRM_CFG_ARRY" 1680 SYMBOL_LINK "ERRM_CFG_ARRY" 1632 /end CHARACTERISTIC
/begin CHARACTERISTIC ERRM_ECM_GPR_DEN_GRP "ECM general purpose register denom group" VALUE 0x2886C __UWORD_S 0 u_den_grp 0 63 FORMAT "%1.0" BIT_MASK 0x003F SYMBOL_LINK "ERRM_CFG_ARRY" 1680 SYMBOL_LINK "ERRM_CFG_ARRY" 1632 /end CHARACTERISTIC
/begin CHARACTERISTIC ERRM_ECM_GPR_DTC "ECM general purpose register DTC" VALUE 0x2886C __UWORD_S 0 u_cnts 0 65535 FORMAT "%5.0" SYMBOL_LINK "ERRM_CFG_ARRY" 1682 SYMBOL_LINK "ERRM_CFG_ARRY" 1634 /end CHARACTERISTIC
/begin CHARACTERISTIC ERRM_WSS_OPN_TYP "wheel speed sensor open type" VALUE 0x2886C __UWORD_S 0 u_diag_typ 0 8 FORMAT "%1.0" BIT_MASK 0xF000 SYMBOL_LINK "ERRM_CFG_ARRY" 1686 SYMBOL_LINK "ERRM_CFG_ARRY" 1638 /end CHARACTERISTIC
/begin CHARACTERISTIC ERRM_WSS_OPN_MIL_ON "wheel speed sensor open MIL on enable" VALUE 0x2886C __UWORD_S 0 b_true 0 1 FORMAT "%1.0" BIT_MASK 0x0800 SYMBOL_LINK "ERRM_CFG_ARRY" 1686 SYMBOL_LINK "ERRM_CFG_ARRY" 1638 /end CHARACTERISTIC
/begin CHARACTERISTIC ERRM_WSS_OPN_DEN_GRP "wheel speed sensor open denom group" VALUE 0x2886C __UWORD_S 0 u_den_grp 0 63 FORMAT "%1.0" BIT_MASK 0x003F SYMBOL_LINK "ERRM_CFG_ARRY" 1686 SYMBOL_LINK "ERRM_CFG_ARRY" 1638 /end CHARACTERISTIC
/begin CHARACTERISTIC ERRM_WSS_OPN_DTC "wheel speed sensor open DTC" VALUE 0x2886C __UWORD_S 0 u_cnts 0 65535 FORMAT "%5.0" SYMBOL_LINK "ERRM_CFG_ARRY" 1688 SYMBOL_LINK "ERRM_CFG_ARRY" 1640 /end CHARACTERISTIC
/begin CHARACTERISTIC ERRM_EGR_VLV_TYP "EGR valve type" VALUE 0x2886C __UWORD_S 0 u_diag_typ 0 8 FORMAT "%1.0" BIT_MASK 0xF000 SYMBOL_LINK "ERRM_CFG_ARRY" 1686 /end CHARACTERISTIC
/begin CHARACTERISTIC ERRM_EGR_VLV_MIL_ON "EGR valve MIL on enable" VALUE 0x2886C __UWORD_S 0 b_true 0 1 FORMAT "%1.0" BIT_MASK 0x0800 SYMBOL_LINK "ERRM_CFG_ARRY" 1686 /end CHARACTERISTIC
/begin CHARACTERISTIC ERRM_EGR_VLV_DEN_GRP "EGR valve denom group" VALUE 0x2886C __UWORD_S 0 u_den_grp 0 63 FORMAT "%1.0" BIT_MASK 0x003F SYMBOL_LINK "ERRM_CFG_ARRY" 1686 /end CHARACTERISTIC
/begin CHARACTERISTIC ERRM_EGR_VLV_DTC "EGR valve DTC" VALUE 0x2886C __UWORD_S 0 u_cnts 0 65535 FORMAT "%5.0" SYMBOL_LINK "ERRM_CFG_ARRY" 1688 /end CHARACTERISTIC
/begin CHARACTERISTIC ERRM_MPR_OUT_TYP "main power relay contactor type" VALUE 0x2886C __UWORD_S 0 u_diag_typ 0 8 FORMAT "%1.0" BIT_MASK 0xF000 SYMBOL_LINK "ERRM_CFG_ARRY" 1740 SYMBOL_LINK "ERRM_CFG_ARRY" 1698 /end CHARACTERISTIC
/begin CHARACTERISTIC ERRM_MPR_OUT_MIL_ON "main power relay contactor MIL on enable" VALUE 0x2886C __UWORD_S 0 b_true 0 1 FORMAT "%1.0" BIT_MASK 0x0800 SYMBOL_LINK "ERRM_CFG_ARRY" 1740 SYMBOL_LINK "ERRM_CFG_ARRY" 1698 /end CHARACTERISTIC
/begin CHARACTERISTIC ERRM_MPR_OUT_DEN_GRP "main power relay contactor denom group" VALUE 0x2886C __UWORD_S 0 u_den_grp 0 63 FORMAT "%1.0" BIT_MASK 0x003F SYMBOL_LINK "ERRM_CFG_ARRY" 1740 SYMBOL_LINK "ERRM_CFG_ARRY" 1698 /end CHARACTERISTIC
/begin CHARACTERISTIC ERRM_MPR_OUT_DTC "main power relay contactor abnormal DTC" VALUE 0x2886C __UWORD_S 0 u_cnts 0 65535 FORMAT "%5.0" SYMBOL_LINK "ERRM_CFG_ARRY" 1742 SYMBOL_LINK "ERRM_CFG_ARRY" 1700 /end CHARACTERISTIC
/begin CHARACTERISTIC ERRM_B1S2_PUC_RSP_TYP "bank1 downstream PUC response type" VALUE 0x2886C __UWORD_S 0 u_diag_typ 0 8 FORMAT "%1.0" BIT_MASK 0xF000 SYMBOL_LINK "ERRM_CFG_ARRY" 1746 SYMBOL_LINK "ERRM_CFG_ARRY" 1704 /end CHARACTERISTIC
/begin CHARACTERISTIC ERRM_B1S2_PUC_RSP_MIL_ON "bank1 downstream PUC response MIL on enable" VALUE 0x2886C __UWORD_S 0 b_true 0 1 FORMAT "%1.0" BIT_MASK 0x0800 SYMBOL_LINK "ERRM_CFG_ARRY" 1746 SYMBOL_LINK "ERRM_CFG_ARRY" 1704 /end CHARACTERISTIC
/begin CHARACTERISTIC ERRM_B1S2_PUC_RSP_DEN_GRP "bank1 downstream PUC response denom group" VALUE 0x2886C __UWORD_S 0 u_den_grp 0 63 FORMAT "%1.0" BIT_MASK 0x003F SYMBOL_LINK "ERRM_CFG_ARRY" 1746 SYMBOL_LINK "ERRM_CFG_ARRY" 1704 /end CHARACTERISTIC
/begin CHARACTERISTIC ERRM_B1S2_PUC_RSP_DTC "bank1 downstream PUC response DTC" VALUE 0x2886C __UWORD_S 0 u_cnts 0 65535 FORMAT "%5.0" SYMBOL_LINK "ERRM_CFG_ARRY" 1748 SYMBOL_LINK "ERRM_CFG_ARRY" 1706 /end CHARACTERISTIC
/begin CHARACTERISTIC ERRM_MISFIRE_CYL1_TYP "misfire cylinder1 type" VALUE 0x2886C __UWORD_S 0 u_diag_typ 0 8 FORMAT "%1.0" BIT_MASK 0xF000 SYMBOL_LINK "ERRM_CFG_ARRY" 1752 SYMBOL_LINK "ERRM_CFG_ARRY" 1710 /end CHARACTERISTIC
/begin CHARACTERISTIC ERRM_MISFIRE_CYL1_MIL_ON "misfire cylinder1 MIL on enable" VALUE 0x2886C __UWORD_S 0 b_true 0 1 FORMAT "%1.0" BIT_MASK 0x0800 SYMBOL_LINK "ERRM_CFG_ARRY" 1752 SYMBOL_LINK "ERRM_CFG_ARRY" 1710 /end CHARACTERISTIC
/begin CHARACTERISTIC ERRM_MISFIRE_CYL1_DEN_GRP "misfire cylinder1 denom group" VALUE 0x2886C __UWORD_S 0 u_den_grp 0 63 FORMAT "%1.0" BIT_MASK 0x003F SYMBOL_LINK "ERRM_CFG_ARRY" 1752 SYMBOL_LINK "ERRM_CFG_ARRY" 1710 /end CHARACTERISTIC
/begin CHARACTERISTIC ERRM_MISFIRE_CYL1_DTC "misfire cylinder1 DTC" VALUE 0x2886C __UWORD_S 0 u_cnts 0 65535 FORMAT "%5.0" SYMBOL_LINK "ERRM_CFG_ARRY" 1754 SYMBOL_LINK "ERRM_CFG_ARRY" 1712 /end CHARACTERISTIC
/begin CHARACTERISTIC ERRM_MISFIRE_CYL2_TYP "misfire cylinder2 type" VALUE 0x2886C __UWORD_S 0 u_diag_typ 0 8 FORMAT "%1.0" BIT_MASK 0xF000 SYMBOL_LINK "ERRM_CFG_ARRY" 1758 SYMBOL_LINK "ERRM_CFG_ARRY" 1716 /end CHARACTERISTIC
/begin CHARACTERISTIC ERRM_MISFIRE_CYL2_MIL_ON "misfire cylinder2 MIL on enable" VALUE 0x2886C __UWORD_S 0 b_true 0 1 FORMAT "%1.0" BIT_MASK 0x0800 SYMBOL_LINK "ERRM_CFG_ARRY" 1758 SYMBOL_LINK "ERRM_CFG_ARRY" 1716 /end CHARACTERISTIC
/begin CHARACTERISTIC ERRM_MISFIRE_CYL2_DEN_GRP "misfire cylinder2 denom group" VALUE 0x2886C __UWORD_S 0 u_den_grp 0 63 FORMAT "%1.0" BIT_MASK 0x003F SYMBOL_LINK "ERRM_CFG_ARRY" 1758 SYMBOL_LINK "ERRM_CFG_ARRY" 1716 /end CHARACTERISTIC
/begin CHARACTERISTIC ERRM_MISFIRE_CYL2_DTC "misfire cylinder2 DTC" VALUE 0x2886C __UWORD_S 0 u_cnts 0 65535 FORMAT "%5.0" SYMBOL_LINK "ERRM_CFG_ARRY" 1760 SYMBOL_LINK "ERRM_CFG_ARRY" 1718 /end CHARACTERISTIC
/begin CHARACTERISTIC ERRM_MISFIRE_CYL3_TYP "misfire cylinder3 type" VALUE 0x2886C __UWORD_S 0 u_diag_typ 0 8 FORMAT "%1.0" BIT_MASK 0xF000 SYMBOL_LINK "ERRM_CFG_ARRY" 1764 SYMBOL_LINK "ERRM_CFG_ARRY" 1722 /end CHARACTERISTIC
/begin CHARACTERISTIC ERRM_MISFIRE_CYL3_MIL_ON "misfire cylinder3 MIL on enable" VALUE 0x2886C __UWORD_S 0 b_true 0 1 FORMAT "%1.0" BIT_MASK 0x0800 SYMBOL_LINK "ERRM_CFG_ARRY" 1764 SYMBOL_LINK "ERRM_CFG_ARRY" 1722 /end CHARACTERISTIC
/begin CHARACTERISTIC ERRM_MISFIRE_CYL3_DEN_GRP "misfire cylinder3 denom group" VALUE 0x2886C __UWORD_S 0 u_den_grp 0 63 FORMAT "%1.0" BIT_MASK 0x003F SYMBOL_LINK "ERRM_CFG_ARRY" 1764 SYMBOL_LINK "ERRM_CFG_ARRY" 1722 /end CHARACTERISTIC
/begin CHARACTERISTIC ERRM_MISFIRE_CYL3_DTC "misfire cylinder3 DTC" VALUE 0x2886C __UWORD_S 0 u_cnts 0 65535 FORMAT "%5.0" SYMBOL_LINK "ERRM_CFG_ARRY" 1766 SYMBOL_LINK "ERRM_CFG_ARRY" 1724 /end CHARACTERISTIC
/begin CHARACTERISTIC ERRM_MISFIRE_CYL4_TYP "misfire cylinder4 type" VALUE 0x2886C __UWORD_S 0 u_diag_typ 0 8 FORMAT "%1.0" BIT_MASK 0xF000 SYMBOL_LINK "ERRM_CFG_ARRY" 1770 SYMBOL_LINK "ERRM_CFG_ARRY" 1728 /end CHARACTERISTIC
/begin CHARACTERISTIC ERRM_MISFIRE_CYL4_MIL_ON "misfire cylinder4 MIL on enable" VALUE 0x2886C __UWORD_S 0 b_true 0 1 FORMAT "%1.0" BIT_MASK 0x0800 SYMBOL_LINK "ERRM_CFG_ARRY" 1770 SYMBOL_LINK "ERRM_CFG_ARRY" 1728 /end CHARACTERISTIC
/begin CHARACTERISTIC ERRM_MISFIRE_CYL4_DEN_GRP "misfire cylinder4 denom group" VALUE 0x2886C __UWORD_S 0 u_den_grp 0 63 FORMAT "%1.0" BIT_MASK 0x003F SYMBOL_LINK "ERRM_CFG_ARRY" 1770 SYMBOL_LINK "ERRM_CFG_ARRY" 1728 /end CHARACTERISTIC
/begin CHARACTERISTIC ERRM_MISFIRE_CYL4_DTC "misfire cylinder4 DTC" VALUE 0x2886C __UWORD_S 0 u_cnts 0 65535 FORMAT "%5.0" SYMBOL_LINK "ERRM_CFG_ARRY" 1772 SYMBOL_LINK "ERRM_CFG_ARRY" 1730 /end CHARACTERISTIC
/begin CHARACTERISTIC ERRM_IG_ADV_TYP "ignition advance timing error type" VALUE 0x2886C __UWORD_S 0 u_diag_typ 0 8 FORMAT "%1.0" BIT_MASK 0xF000 SYMBOL_LINK "ERRM_CFG_ARRY" 1782 SYMBOL_LINK "ERRM_CFG_ARRY" 1740 /end CHARACTERISTIC
/begin CHARACTERISTIC ERRM_IG_ADV_MIL_ON "ignition advance timing error MIL on enable" VALUE 0x2886C __UWORD_S 0 b_true 0 1 FORMAT "%1.0" BIT_MASK 0x0800 SYMBOL_LINK "ERRM_CFG_ARRY" 1782 SYMBOL_LINK "ERRM_CFG_ARRY" 1740 /end CHARACTERISTIC
/begin CHARACTERISTIC ERRM_IG_ADV_DEN_GRP "ignition advance timing error denom group" VALUE 0x2886C __UWORD_S 0 u_den_grp 0 63 FORMAT "%1.0" BIT_MASK 0x003F SYMBOL_LINK "ERRM_CFG_ARRY" 1782 SYMBOL_LINK "ERRM_CFG_ARRY" 1740 /end CHARACTERISTIC
/begin CHARACTERISTIC ERRM_IG_ADV_DTC "ignition advance timing error DTC" VALUE 0x2886C __UWORD_S 0 u_cnts 0 65535 FORMAT "%5.0" SYMBOL_LINK "ERRM_CFG_ARRY" 1784 SYMBOL_LINK "ERRM_CFG_ARRY" 1742 /end CHARACTERISTIC
/begin CHARACTERISTIC ERRM_E_THERM_HI_TYP "electronic thermostat type" VALUE 0x2886C __UWORD_S 0 u_diag_typ 0 8 FORMAT "%1.0" BIT_MASK 0xF000 SYMBOL_LINK "ERRM_CFG_ARRY" 1788 SYMBOL_LINK "ERRM_CFG_ARRY" 1746 /end CHARACTERISTIC
/begin CHARACTERISTIC ERRM_E_THERM_HI_MIL_ON "electronic thermostat MIL on enable" VALUE 0x2886C __UWORD_S 0 b_true 0 1 FORMAT "%1.0" BIT_MASK 0x0800 SYMBOL_LINK "ERRM_CFG_ARRY" 1788 SYMBOL_LINK "ERRM_CFG_ARRY" 1746 /end CHARACTERISTIC
/begin CHARACTERISTIC ERRM_E_THERM_HI_DEN_GRP "electronic thermostat denom group" VALUE 0x2886C __UWORD_S 0 u_den_grp 0 63 FORMAT "%1.0" BIT_MASK 0x003F SYMBOL_LINK "ERRM_CFG_ARRY" 1788 SYMBOL_LINK "ERRM_CFG_ARRY" 1746 /end CHARACTERISTIC
/begin CHARACTERISTIC ERRM_E_THERM_HI_DTC "electronic thermostat DTC" VALUE 0x2886C __UWORD_S 0 u_cnts 0 65535 FORMAT "%5.0" SYMBOL_LINK "ERRM_CFG_ARRY" 1790 SYMBOL_LINK "ERRM_CFG_ARRY" 1748 /end CHARACTERISTIC
/begin CHARACTERISTIC ERRM_E_THERM_LO_TYP "electronic thermostat type" VALUE 0x2886C __UWORD_S 0 u_diag_typ 0 8 FORMAT "%1.0" BIT_MASK 0xF000 SYMBOL_LINK "ERRM_CFG_ARRY" 1794 SYMBOL_LINK "ERRM_CFG_ARRY" 1752 /end CHARACTERISTIC
/begin CHARACTERISTIC ERRM_E_THERM_LO_MIL_ON "electronic thermostat MIL on enable" VALUE 0x2886C __UWORD_S 0 b_true 0 1 FORMAT "%1.0" BIT_MASK 0x0800 SYMBOL_LINK "ERRM_CFG_ARRY" 1794 SYMBOL_LINK "ERRM_CFG_ARRY" 1752 /end CHARACTERISTIC
/begin CHARACTERISTIC ERRM_E_THERM_LO_DEN_GRP "electronic thermostat denom group" VALUE 0x2886C __UWORD_S 0 u_den_grp 0 63 FORMAT "%1.0" BIT_MASK 0x003F SYMBOL_LINK "ERRM_CFG_ARRY" 1794 SYMBOL_LINK "ERRM_CFG_ARRY" 1752 /end CHARACTERISTIC
/begin CHARACTERISTIC ERRM_E_THERM_LO_DTC "electronic thermostat DTC" VALUE 0x2886C __UWORD_S 0 u_cnts 0 65535 FORMAT "%5.0" SYMBOL_LINK "ERRM_CFG_ARRY" 1796 SYMBOL_LINK "ERRM_CFG_ARRY" 1754 /end CHARACTERISTIC
/begin CHARACTERISTIC ERRM_TURB_OVR_BST_TYP "turbocharger overboost type" VALUE 0x2886C __UWORD_S 0 u_diag_typ 0 8 FORMAT "%1.0" BIT_MASK 0xF000 SYMBOL_LINK "ERRM_CFG_ARRY" 1800 /end CHARACTERISTIC
/begin CHARACTERISTIC ERRM_TURB_OVR_BST_MIL_ON "turbocharger overboost MIL on enable" VALUE 0x2886C __UWORD_S 0 b_true 0 1 FORMAT "%1.0" BIT_MASK 0x0800 SYMBOL_LINK "ERRM_CFG_ARRY" 1800 /end CHARACTERISTIC
/begin CHARACTERISTIC ERRM_TURB_OVR_BST_DEN_GRP "turbocharger overboost denom group" VALUE 0x2886C __UWORD_S 0 u_den_grp 0 63 FORMAT "%1.0" BIT_MASK 0x003F SYMBOL_LINK "ERRM_CFG_ARRY" 1800 /end CHARACTERISTIC
/begin CHARACTERISTIC ERRM_TURB_OVR_BST_DTC "turbocharger overboost DTC" VALUE 0x2886C __UWORD_S 0 u_cnts 0 65535 FORMAT "%5.0" SYMBOL_LINK "ERRM_CFG_ARRY" 1802 /end CHARACTERISTIC
/begin CHARACTERISTIC ERRM_TURB_UNDER_BST_TYP "turbocharger underboost type" VALUE 0x2886C __UWORD_S 0 u_diag_typ 0 8 FORMAT "%1.0" BIT_MASK 0xF000 SYMBOL_LINK "ERRM_CFG_ARRY" 1806 /end CHARACTERISTIC
/begin CHARACTERISTIC ERRM_TURB_UNDER_BST_MIL_ON "turbocharger underboost MIL on enable" VALUE 0x2886C __UWORD_S 0 b_true 0 1 FORMAT "%1.0" BIT_MASK 0x0800 SYMBOL_LINK "ERRM_CFG_ARRY" 1806 /end CHARACTERISTIC
/begin CHARACTERISTIC ERRM_TURB_UNDER_BST_DEN_GRP "turbocharger underboost denom group" VALUE 0x2886C __UWORD_S 0 u_den_grp 0 63 FORMAT "%1.0" BIT_MASK 0x003F SYMBOL_LINK "ERRM_CFG_ARRY" 1806 /end CHARACTERISTIC
/begin CHARACTERISTIC ERRM_TURB_UNDER_BST_DTC "turbocharger underboost DTC" VALUE 0x2886C __UWORD_S 0 u_cnts 0 65535 FORMAT "%5.0" SYMBOL_LINK "ERRM_CFG_ARRY" 1808 /end CHARACTERISTIC
/begin CHARACTERISTIC ERRM_WGV_LO_TYP "turbocharger waste gate valve short low type" VALUE 0x2886C __UWORD_S 0 u_diag_typ 0 8 FORMAT "%1.0" BIT_MASK 0xF000 SYMBOL_LINK "ERRM_CFG_ARRY" 1812 /end CHARACTERISTIC
/begin CHARACTERISTIC ERRM_WGV_LO_MIL_ON "turbocharger waste gate valve short low MIL on enable" VALUE 0x2886C __UWORD_S 0 b_true 0 1 FORMAT "%1.0" BIT_MASK 0x0800 SYMBOL_LINK "ERRM_CFG_ARRY" 1812 /end CHARACTERISTIC
/begin CHARACTERISTIC ERRM_WGV_LO_DEN_GRP "turbocharger waste gate valve short low denom group" VALUE 0x2886C __UWORD_S 0 u_den_grp 0 63 FORMAT "%1.0" BIT_MASK 0x003F SYMBOL_LINK "ERRM_CFG_ARRY" 1812 /end CHARACTERISTIC
/begin CHARACTERISTIC ERRM_WGV_LO_DTC "turbocharger waste gate valve short low DTC" VALUE 0x2886C __UWORD_S 0 u_cnts 0 65535 FORMAT "%5.0" SYMBOL_LINK "ERRM_CFG_ARRY" 1814 /end CHARACTERISTIC
/begin CHARACTERISTIC ERRM_WGV_HI_TYP "turbocharger waste gate valve short high type" VALUE 0x2886C __UWORD_S 0 u_diag_typ 0 8 FORMAT "%1.0" BIT_MASK 0xF000 SYMBOL_LINK "ERRM_CFG_ARRY" 1818 /end CHARACTERISTIC
/begin CHARACTERISTIC ERRM_WGV_HI_MIL_ON "turbocharger waste gate valve short high MIL on enable" VALUE 0x2886C __UWORD_S 0 b_true 0 1 FORMAT "%1.0" BIT_MASK 0x0800 SYMBOL_LINK "ERRM_CFG_ARRY" 1818 /end CHARACTERISTIC
/begin CHARACTERISTIC ERRM_WGV_HI_DEN_GRP "turbocharger waste gate valve short high denom group" VALUE 0x2886C __UWORD_S 0 u_den_grp 0 63 FORMAT "%1.0" BIT_MASK 0x003F SYMBOL_LINK "ERRM_CFG_ARRY" 1818 /end CHARACTERISTIC
/begin CHARACTERISTIC ERRM_WGV_HI_DTC "turbocharger waste gate valve short high DTC" VALUE 0x2886C __UWORD_S 0 u_cnts 0 65535 FORMAT "%5.0" SYMBOL_LINK "ERRM_CFG_ARRY" 1820 /end CHARACTERISTIC
/begin CHARACTERISTIC ERRM_WGV_OPN_TYP "turbocharger waste gate valve open type" VALUE 0x2886C __UWORD_S 0 u_diag_typ 0 8 FORMAT "%1.0" BIT_MASK 0xF000 SYMBOL_LINK "ERRM_CFG_ARRY" 1824 /end CHARACTERISTIC
/begin CHARACTERISTIC ERRM_WGV_OPN_MIL_ON "turbocharger waste gate valve open MIL on enable" VALUE 0x2886C __UWORD_S 0 b_true 0 1 FORMAT "%1.0" BIT_MASK 0x0800 SYMBOL_LINK "ERRM_CFG_ARRY" 1824 /end CHARACTERISTIC
/begin CHARACTERISTIC ERRM_WGV_OPN_DEN_GRP "turbocharger waste gate valve open denom group" VALUE 0x2886C __UWORD_S 0 u_den_grp 0 63 FORMAT "%1.0" BIT_MASK 0x003F SYMBOL_LINK "ERRM_CFG_ARRY" 1824 /end CHARACTERISTIC
/begin CHARACTERISTIC ERRM_WGV_OPN_DTC "turbocharger waste gate valve open DTC" VALUE 0x2886C __UWORD_S 0 u_cnts 0 65535 FORMAT "%5.0" SYMBOL_LINK "ERRM_CFG_ARRY" 1826 /end CHARACTERISTIC
/begin CHARACTERISTIC ERRM_BYPASS_VLV_LO_TYP "turbocharger bypass valve short low type" VALUE 0x2886C __UWORD_S 0 u_diag_typ 0 8 FORMAT "%1.0" BIT_MASK 0xF000 SYMBOL_LINK "ERRM_CFG_ARRY" 1848 /end CHARACTERISTIC
/begin CHARACTERISTIC ERRM_BYPASS_VLV_LO_MIL_ON "turbocharger bypass valve short low MIL on enable" VALUE 0x2886C __UWORD_S 0 b_true 0 1 FORMAT "%1.0" BIT_MASK 0x0800 SYMBOL_LINK "ERRM_CFG_ARRY" 1848 /end CHARACTERISTIC
/begin CHARACTERISTIC ERRM_BYPASS_VLV_LO_DEN_GRP "turbocharger bypass valve short low denom group" VALUE 0x2886C __UWORD_S 0 u_den_grp 0 63 FORMAT "%1.0" BIT_MASK 0x003F SYMBOL_LINK "ERRM_CFG_ARRY" 1848 /end CHARACTERISTIC
/begin CHARACTERISTIC ERRM_BYPASS_VLV_LO_DTC "turbocharger bypass valve short low DTC" VALUE 0x2886C __UWORD_S 0 u_cnts 0 65535 FORMAT "%5.0" SYMBOL_LINK "ERRM_CFG_ARRY" 1850 /end CHARACTERISTIC
/begin CHARACTERISTIC ERRM_BYPASS_VLV_HI_TYP "turbocharger bypass valve short high type" VALUE 0x2886C __UWORD_S 0 u_diag_typ 0 8 FORMAT "%1.0" BIT_MASK 0xF000 SYMBOL_LINK "ERRM_CFG_ARRY" 1854 /end CHARACTERISTIC
/begin CHARACTERISTIC ERRM_BYPASS_VLV_HI_MIL_ON "turbocharger bypass valve short high MIL on enable" VALUE 0x2886C __UWORD_S 0 b_true 0 1 FORMAT "%1.0" BIT_MASK 0x0800 SYMBOL_LINK "ERRM_CFG_ARRY" 1854 /end CHARACTERISTIC
/begin CHARACTERISTIC ERRM_BYPASS_VLV_HI_DEN_GRP "turbocharger bypass valve short high denom group" VALUE 0x2886C __UWORD_S 0 u_den_grp 0 63 FORMAT "%1.0" BIT_MASK 0x003F SYMBOL_LINK "ERRM_CFG_ARRY" 1854 /end CHARACTERISTIC
/begin CHARACTERISTIC ERRM_BYPASS_VLV_HI_DTC "turbocharger bypass valve short high DTC" VALUE 0x2886C __UWORD_S 0 u_cnts 0 65535 FORMAT "%5.0" SYMBOL_LINK "ERRM_CFG_ARRY" 1856 /end CHARACTERISTIC
/begin CHARACTERISTIC ERRM_BYPASS_VLV_OPN_TYP "turbocharger bypass valve open type" VALUE 0x2886C __UWORD_S 0 u_diag_typ 0 8 FORMAT "%1.0" BIT_MASK 0xF000 SYMBOL_LINK "ERRM_CFG_ARRY" 1860 /end CHARACTERISTIC
/begin CHARACTERISTIC ERRM_BYPASS_VLV_OPN_MIL_ON "turbocharger bypass valve open MIL on enable" VALUE 0x2886C __UWORD_S 0 b_true 0 1 FORMAT "%1.0" BIT_MASK 0x0800 SYMBOL_LINK "ERRM_CFG_ARRY" 1860 /end CHARACTERISTIC
/begin CHARACTERISTIC ERRM_BYPASS_VLV_OPN_DEN_GRP "turbocharger bypass valve open denom group" VALUE 0x2886C __UWORD_S 0 u_den_grp 0 63 FORMAT "%1.0" BIT_MASK 0x003F SYMBOL_LINK "ERRM_CFG_ARRY" 1860 /end CHARACTERISTIC
/begin CHARACTERISTIC ERRM_BYPASS_VLV_OPN_DTC "turbocharger bypass valve open DTC" VALUE 0x2886C __UWORD_S 0 u_cnts 0 65535 FORMAT "%5.0" SYMBOL_LINK "ERRM_CFG_ARRY" 1862 /end CHARACTERISTIC
/begin CHARACTERISTIC ERRM_INTR_FAN_LO_TYP "turbocharger intercoolant fan short low type" VALUE 0x2886C __UWORD_S 0 u_diag_typ 0 8 FORMAT "%1.0" BIT_MASK 0xF000 SYMBOL_LINK "ERRM_CFG_ARRY" 1884 /end CHARACTERISTIC
/begin CHARACTERISTIC ERRM_INTR_FAN_LO_MIL_ON "turbocharger intercoolant fan short low MIL on enable" VALUE 0x2886C __UWORD_S 0 b_true 0 1 FORMAT "%1.0" BIT_MASK 0x0800 SYMBOL_LINK "ERRM_CFG_ARRY" 1884 /end CHARACTERISTIC
/begin CHARACTERISTIC ERRM_INTR_FAN_LO_DEN_GRP "turbocharger intercoolant fan short low denom group" VALUE 0x2886C __UWORD_S 0 u_den_grp 0 63 FORMAT "%1.0" BIT_MASK 0x003F SYMBOL_LINK "ERRM_CFG_ARRY" 1884 /end CHARACTERISTIC
/begin CHARACTERISTIC ERRM_INTR_FAN_LO_DTC "turbocharger intercoolant fan short low DTC" VALUE 0x2886C __UWORD_S 0 u_cnts 0 65535 FORMAT "%5.0" SYMBOL_LINK "ERRM_CFG_ARRY" 1886 /end CHARACTERISTIC
/begin CHARACTERISTIC ERRM_INTR_FAN_HI_TYP "turbocharger intercoolant fan short high type" VALUE 0x2886C __UWORD_S 0 u_diag_typ 0 8 FORMAT "%1.0" BIT_MASK 0xF000 SYMBOL_LINK "ERRM_CFG_ARRY" 1890 /end CHARACTERISTIC
/begin CHARACTERISTIC ERRM_INTR_FAN_HI_MIL_ON "turbocharger intercoolant fan short high MIL on enable" VALUE 0x2886C __UWORD_S 0 b_true 0 1 FORMAT "%1.0" BIT_MASK 0x0800 SYMBOL_LINK "ERRM_CFG_ARRY" 1890 /end CHARACTERISTIC
/begin CHARACTERISTIC ERRM_INTR_FAN_HI_DEN_GRP "turbocharger intercoolant fan short high denom group" VALUE 0x2886C __UWORD_S 0 u_den_grp 0 63 FORMAT "%1.0" BIT_MASK 0x003F SYMBOL_LINK "ERRM_CFG_ARRY" 1890 /end CHARACTERISTIC
/begin CHARACTERISTIC ERRM_INTR_FAN_HI_DTC "turbocharger intercoolant fan short high DTC" VALUE 0x2886C __UWORD_S 0 u_cnts 0 65535 FORMAT "%5.0" SYMBOL_LINK "ERRM_CFG_ARRY" 1892 /end CHARACTERISTIC
/begin CHARACTERISTIC ERRM_INTR_FAN_OPN_TYP "turbocharger intercoolant fan open type" VALUE 0x2886C __UWORD_S 0 u_diag_typ 0 8 FORMAT "%1.0" BIT_MASK 0xF000 SYMBOL_LINK "ERRM_CFG_ARRY" 1896 /end CHARACTERISTIC
/begin CHARACTERISTIC ERRM_INTR_FAN_OPN_MIL_ON "turbocharger intercoolant fan open MIL on enable" VALUE 0x2886C __UWORD_S 0 b_true 0 1 FORMAT "%1.0" BIT_MASK 0x0800 SYMBOL_LINK "ERRM_CFG_ARRY" 1896 /end CHARACTERISTIC
/begin CHARACTERISTIC ERRM_INTR_FAN_OPN_DEN_GRP "turbocharger intercoolant fan open denom group" VALUE 0x2886C __UWORD_S 0 u_den_grp 0 63 FORMAT "%1.0" BIT_MASK 0x003F SYMBOL_LINK "ERRM_CFG_ARRY" 1896 /end CHARACTERISTIC
/begin CHARACTERISTIC ERRM_INTR_FAN_OPN_DTC "turbocharger intercoolant fan open DTC" VALUE 0x2886C __UWORD_S 0 u_cnts 0 65535 FORMAT "%5.0" SYMBOL_LINK "ERRM_CFG_ARRY" 1898 /end CHARACTERISTIC
/begin CHARACTERISTIC ERRM_INTR_PMP_LO_TYP "turbocharger intercoolant pump short low type" VALUE 0x2886C __UWORD_S 0 u_diag_typ 0 8 FORMAT "%1.0" BIT_MASK 0xF000 SYMBOL_LINK "ERRM_CFG_ARRY" 1920 /end CHARACTERISTIC
/begin CHARACTERISTIC ERRM_INTR_PMP_LO_MIL_ON "turbocharger intercoolant fan short low MIL on enable" VALUE 0x2886C __UWORD_S 0 b_true 0 1 FORMAT "%1.0" BIT_MASK 0x0800 SYMBOL_LINK "ERRM_CFG_ARRY" 1920 /end CHARACTERISTIC
/begin CHARACTERISTIC ERRM_INTR_PMP_LO_DEN_GRP "turbocharger intercoolant pump short low denom group" VALUE 0x2886C __UWORD_S 0 u_den_grp 0 63 FORMAT "%1.0" BIT_MASK 0x003F SYMBOL_LINK "ERRM_CFG_ARRY" 1920 /end CHARACTERISTIC
/begin CHARACTERISTIC ERRM_INTR_PMP_LO_DTC "turbocharger intercoolant pump short low DTC" VALUE 0x2886C __UWORD_S 0 u_cnts 0 65535 FORMAT "%5.0" SYMBOL_LINK "ERRM_CFG_ARRY" 1922 /end CHARACTERISTIC
/begin CHARACTERISTIC ERRM_INTR_PMP_HI_TYP "turbocharger intercoolant pump short high type" VALUE 0x2886C __UWORD_S 0 u_diag_typ 0 8 FORMAT "%1.0" BIT_MASK 0xF000 SYMBOL_LINK "ERRM_CFG_ARRY" 1926 /end CHARACTERISTIC
/begin CHARACTERISTIC ERRM_INTR_PMP_HI_MIL_ON "turbocharger intercoolant pump short high MIL on enable" VALUE 0x2886C __UWORD_S 0 b_true 0 1 FORMAT "%1.0" BIT_MASK 0x0800 SYMBOL_LINK "ERRM_CFG_ARRY" 1926 /end CHARACTERISTIC
/begin CHARACTERISTIC ERRM_INTR_PMP_HI_DEN_GRP "turbocharger intercoolant pump short high denom group" VALUE 0x2886C __UWORD_S 0 u_den_grp 0 63 FORMAT "%1.0" BIT_MASK 0x003F SYMBOL_LINK "ERRM_CFG_ARRY" 1926 /end CHARACTERISTIC
/begin CHARACTERISTIC ERRM_INTR_PMP_HI_DTC "turbocharger intercoolant pump short high DTC" VALUE 0x2886C __UWORD_S 0 u_cnts 0 65535 FORMAT "%5.0" SYMBOL_LINK "ERRM_CFG_ARRY" 1928 /end CHARACTERISTIC
/begin CHARACTERISTIC ERRM_INTR_PMP_OPN_TYP "turbocharger intercoolant pump open type" VALUE 0x2886C __UWORD_S 0 u_diag_typ 0 8 FORMAT "%1.0" BIT_MASK 0xF000 SYMBOL_LINK "ERRM_CFG_ARRY" 1932 /end CHARACTERISTIC
/begin CHARACTERISTIC ERRM_INTR_PMP_OPN_MIL_ON "turbocharger intercoolant pump open MIL on enable" VALUE 0x2886C __UWORD_S 0 b_true 0 1 FORMAT "%1.0" BIT_MASK 0x0800 SYMBOL_LINK "ERRM_CFG_ARRY" 1932 /end CHARACTERISTIC
/begin CHARACTERISTIC ERRM_INTR_PMP_OPN_DEN_GRP "turbocharger intercoolant pump open denom group" VALUE 0x2886C __UWORD_S 0 u_den_grp 0 63 FORMAT "%1.0" BIT_MASK 0x003F SYMBOL_LINK "ERRM_CFG_ARRY" 1932 /end CHARACTERISTIC
/begin CHARACTERISTIC ERRM_INTR_PMP_OPN_DTC "turbocharger intercoolant pump open DTC" VALUE 0x2886C __UWORD_S 0 u_cnts 0 65535 FORMAT "%5.0" SYMBOL_LINK "ERRM_CFG_ARRY" 1934 /end CHARACTERISTIC
/begin CHARACTERISTIC ERRM_B1S2_POW_RSP_TYP "bank1 down o2 sensor power response type" VALUE 0x2886C __UWORD_S 0 u_diag_typ 0 8 FORMAT "%1.0" BIT_MASK 0xF000 SYMBOL_LINK "ERRM_CFG_ARRY" 2010 SYMBOL_LINK "ERRM_CFG_ARRY" 1758 /end CHARACTERISTIC
/begin CHARACTERISTIC ERRM_B1S2_POW_RSP_MIL_ON "bank1 down o2 sensor power response MIL on enable" VALUE 0x2886C __UWORD_S 0 b_true 0 1 FORMAT "%1.0" BIT_MASK 0x0800 SYMBOL_LINK "ERRM_CFG_ARRY" 2010 SYMBOL_LINK "ERRM_CFG_ARRY" 1758 /end CHARACTERISTIC
/begin CHARACTERISTIC ERRM_B1S2_POW_RSP_DEN_GRP "bank1 down o2 sensor power response denom group" VALUE 0x2886C __UWORD_S 0 u_den_grp 0 63 FORMAT "%1.0" BIT_MASK 0x003F SYMBOL_LINK "ERRM_CFG_ARRY" 2010 SYMBOL_LINK "ERRM_CFG_ARRY" 1758 /end CHARACTERISTIC
/begin CHARACTERISTIC ERRM_B1S2_POW_RSP_DTC "bank1 down o2 sensor power response DTC" VALUE 0x2886C __UWORD_S 0 u_cnts 0 65535 FORMAT "%5.0" SYMBOL_LINK "ERRM_CFG_ARRY" 2012 SYMBOL_LINK "ERRM_CFG_ARRY" 1760 /end CHARACTERISTIC
/begin CHARACTERISTIC ERRM_BAT_TEMP_HI_TYP "battery temp high type" VALUE 0x2886C __UWORD_S 0 u_diag_typ 0 8 FORMAT "%1.0" BIT_MASK 0xF000 SYMBOL_LINK "ERRM_CFG_ARRY" 2016 SYMBOL_LINK "ERRM_CFG_ARRY" 1764 /end CHARACTERISTIC
/begin CHARACTERISTIC ERRM_BAT_TEMP_HI_MIL_ON "battery temp high MIL on enable" VALUE 0x2886C __UWORD_S 0 b_true 0 1 FORMAT "%1.0" BIT_MASK 0x0800 SYMBOL_LINK "ERRM_CFG_ARRY" 2016 SYMBOL_LINK "ERRM_CFG_ARRY" 1764 /end CHARACTERISTIC
/begin CHARACTERISTIC ERRM_BAT_TEMP_HI_DEN_GRP "battery temp high denom group" VALUE 0x2886C __UWORD_S 0 u_den_grp 0 63 FORMAT "%1.0" BIT_MASK 0x003F SYMBOL_LINK "ERRM_CFG_ARRY" 2016 SYMBOL_LINK "ERRM_CFG_ARRY" 1764 /end CHARACTERISTIC
/begin CHARACTERISTIC ERRM_BAT_TEMP_HI_DTC "battery temp high DTC" VALUE 0x2886C __UWORD_S 0 u_cnts 0 65535 FORMAT "%5.0" SYMBOL_LINK "ERRM_CFG_ARRY" 2018 SYMBOL_LINK "ERRM_CFG_ARRY" 1766 /end CHARACTERISTIC
/begin CHARACTERISTIC ERRM_BAT_NO_CHRG_TYP "battery no charge type" VALUE 0x2886C __UWORD_S 0 u_diag_typ 0 8 FORMAT "%1.0" BIT_MASK 0xF000 SYMBOL_LINK "ERRM_CFG_ARRY" 2022 SYMBOL_LINK "ERRM_CFG_ARRY" 1770 /end CHARACTERISTIC
/begin CHARACTERISTIC ERRM_BAT_NO_CHRG_MIL_ON "battery no charge MIL on enable" VALUE 0x2886C __UWORD_S 0 b_true 0 1 FORMAT "%1.0" BIT_MASK 0x0800 SYMBOL_LINK "ERRM_CFG_ARRY" 2022 SYMBOL_LINK "ERRM_CFG_ARRY" 1770 /end CHARACTERISTIC
/begin CHARACTERISTIC ERRM_BAT_NO_CHRG_DEN_GRP "battery no charge denom group" VALUE 0x2886C __UWORD_S 0 u_den_grp 0 63 FORMAT "%1.0" BIT_MASK 0x003F SYMBOL_LINK "ERRM_CFG_ARRY" 2022 SYMBOL_LINK "ERRM_CFG_ARRY" 1770 /end CHARACTERISTIC
/begin CHARACTERISTIC ERRM_BAT_NO_CHRG_DTC "battery no charge DTC" VALUE 0x2886C __UWORD_S 0 u_cnts 0 65535 FORMAT "%5.0" SYMBOL_LINK "ERRM_CFG_ARRY" 2024 SYMBOL_LINK "ERRM_CFG_ARRY" 1772 /end CHARACTERISTIC
/begin CHARACTERISTIC ERRM_BAT_LO_SOC_TYP "battery SOC low type" VALUE 0x2886C __UWORD_S 0 u_diag_typ 0 8 FORMAT "%1.0" BIT_MASK 0xF000 SYMBOL_LINK "ERRM_CFG_ARRY" 2028 SYMBOL_LINK "ERRM_CFG_ARRY" 1776 /end CHARACTERISTIC
/begin CHARACTERISTIC ERRM_BAT_LO_SOC_MIL_ON "battery SOC low MIL on enable" VALUE 0x2886C __UWORD_S 0 b_true 0 1 FORMAT "%1.0" BIT_MASK 0x0800 SYMBOL_LINK "ERRM_CFG_ARRY" 2028 SYMBOL_LINK "ERRM_CFG_ARRY" 1776 /end CHARACTERISTIC
/begin CHARACTERISTIC ERRM_BAT_LO_SOC_DEN_GRP "battery SOC low denom group" VALUE 0x2886C __UWORD_S 0 u_den_grp 0 63 FORMAT "%1.0" BIT_MASK 0x003F SYMBOL_LINK "ERRM_CFG_ARRY" 2028 SYMBOL_LINK "ERRM_CFG_ARRY" 1776 /end CHARACTERISTIC
/begin CHARACTERISTIC ERRM_BAT_LO_SOC_DTC "battery SOC low DTC" VALUE 0x2886C __UWORD_S 0 u_cnts 0 65535 FORMAT "%5.0" SYMBOL_LINK "ERRM_CFG_ARRY" 2030 SYMBOL_LINK "ERRM_CFG_ARRY" 1778 /end CHARACTERISTIC
/begin CHARACTERISTIC ERRM_SYS_VLT_LO_TYP "system voltage low type" VALUE 0x2886C __UWORD_S 0 u_diag_typ 0 8 FORMAT "%1.0" BIT_MASK 0xF000 SYMBOL_LINK "ERRM_CFG_ARRY" 2034 SYMBOL_LINK "ERRM_CFG_ARRY" 1782 /end CHARACTERISTIC
/begin CHARACTERISTIC ERRM_SYS_VLT_LO_MIL_ON "system voltage low MIL on enable" VALUE 0x2886C __UWORD_S 0 b_true 0 1 FORMAT "%1.0" BIT_MASK 0x0800 SYMBOL_LINK "ERRM_CFG_ARRY" 2034 SYMBOL_LINK "ERRM_CFG_ARRY" 1782 /end CHARACTERISTIC
/begin CHARACTERISTIC ERRM_SYS_VLT_LO_DEN_GRP "system voltage low denom group" VALUE 0x2886C __UWORD_S 0 u_den_grp 0 63 FORMAT "%1.0" BIT_MASK 0x003F SYMBOL_LINK "ERRM_CFG_ARRY" 2034 SYMBOL_LINK "ERRM_CFG_ARRY" 1782 /end CHARACTERISTIC
/begin CHARACTERISTIC ERRM_SYS_VLT_LO_DTC "system voltage low DTC" VALUE 0x2886C __UWORD_S 0 u_cnts 0 65535 FORMAT "%5.0" SYMBOL_LINK "ERRM_CFG_ARRY" 2036 SYMBOL_LINK "ERRM_CFG_ARRY" 1784 /end CHARACTERISTIC
/begin CHARACTERISTIC ERRM_SYS_VLT_RAT_TYP "system voltage rationality type" VALUE 0x2886C __UWORD_S 0 u_diag_typ 0 8 FORMAT "%1.0" BIT_MASK 0xF000 SYMBOL_LINK "ERRM_CFG_ARRY" 2040 SYMBOL_LINK "ERRM_CFG_ARRY" 1788 /end CHARACTERISTIC
/begin CHARACTERISTIC ERRM_SYS_VLT_RAT_MIL_ON "system voltage rationality MIL on enable" VALUE 0x2886C __UWORD_S 0 b_true 0 1 FORMAT "%1.0" BIT_MASK 0x0800 SYMBOL_LINK "ERRM_CFG_ARRY" 2040 SYMBOL_LINK "ERRM_CFG_ARRY" 1788 /end CHARACTERISTIC
/begin CHARACTERISTIC ERRM_SYS_VLT_RAT_DEN_GRP "system voltage rationality denom group" VALUE 0x2886C __UWORD_S 0 u_den_grp 0 63 FORMAT "%1.0" BIT_MASK 0x003F SYMBOL_LINK "ERRM_CFG_ARRY" 2040 SYMBOL_LINK "ERRM_CFG_ARRY" 1788 /end CHARACTERISTIC
/begin CHARACTERISTIC ERRM_SYS_VLT_RAT_DTC "system voltage rationality DTC" VALUE 0x2886C __UWORD_S 0 u_cnts 0 65535 FORMAT "%5.0" SYMBOL_LINK "ERRM_CFG_ARRY" 2042 SYMBOL_LINK "ERRM_CFG_ARRY" 1790 /end CHARACTERISTIC
/begin CHARACTERISTIC ERRM_BAT_SOC_RAT_TYP "SOC rationality type" VALUE 0x2886C __UWORD_S 0 u_diag_typ 0 8 FORMAT "%1.0" BIT_MASK 0xF000 SYMBOL_LINK "ERRM_CFG_ARRY" 2046 SYMBOL_LINK "ERRM_CFG_ARRY" 1794 /end CHARACTERISTIC
/begin CHARACTERISTIC ERRM_BAT_SOC_RAT_MIL_ON "SOC rationality MIL on enable" VALUE 0x2886C __UWORD_S 0 b_true 0 1 FORMAT "%1.0" BIT_MASK 0x0800 SYMBOL_LINK "ERRM_CFG_ARRY" 2046 SYMBOL_LINK "ERRM_CFG_ARRY" 1794 /end CHARACTERISTIC
/begin CHARACTERISTIC ERRM_BAT_SOC_RAT_DEN_GRP "SOC rationality denom group" VALUE 0x2886C __UWORD_S 0 u_den_grp 0 63 FORMAT "%1.0" BIT_MASK 0x003F SYMBOL_LINK "ERRM_CFG_ARRY" 2046 SYMBOL_LINK "ERRM_CFG_ARRY" 1794 /end CHARACTERISTIC
/begin CHARACTERISTIC ERRM_BAT_SOC_RAT_DTC "SOC rationality DTC" VALUE 0x2886C __UWORD_S 0 u_cnts 0 65535 FORMAT "%5.0" SYMBOL_LINK "ERRM_CFG_ARRY" 2048 SYMBOL_LINK "ERRM_CFG_ARRY" 1796 /end CHARACTERISTIC
/begin CHARACTERISTIC ERRM_ALT_TEMP_HI_TYP "alternator temp high type" VALUE 0x2886C __UWORD_S 0 u_diag_typ 0 8 FORMAT "%1.0" BIT_MASK 0xF000 SYMBOL_LINK "ERRM_CFG_ARRY" 2052 SYMBOL_LINK "ERRM_CFG_ARRY" 1800 /end CHARACTERISTIC
/begin CHARACTERISTIC ERRM_ALT_TEMP_HI_MIL_ON "alternator temp high MIL on enable" VALUE 0x2886C __UWORD_S 0 b_true 0 1 FORMAT "%1.0" BIT_MASK 0x0800 SYMBOL_LINK "ERRM_CFG_ARRY" 2052 SYMBOL_LINK "ERRM_CFG_ARRY" 1800 /end CHARACTERISTIC
/begin CHARACTERISTIC ERRM_ALT_TEMP_HI_DEN_GRP "alternator temp high denom group" VALUE 0x2886C __UWORD_S 0 u_den_grp 0 63 FORMAT "%1.0" BIT_MASK 0x003F SYMBOL_LINK "ERRM_CFG_ARRY" 2052 SYMBOL_LINK "ERRM_CFG_ARRY" 1800 /end CHARACTERISTIC
/begin CHARACTERISTIC ERRM_ALT_TEMP_HI_DTC "alternator temp high DTC" VALUE 0x2886C __UWORD_S 0 u_cnts 0 65535 FORMAT "%5.0" SYMBOL_LINK "ERRM_CFG_ARRY" 2054 SYMBOL_LINK "ERRM_CFG_ARRY" 1802 /end CHARACTERISTIC
/begin CHARACTERISTIC ERRM_ALT_MECH_TYP "alternator mech high type" VALUE 0x2886C __UWORD_S 0 u_diag_typ 0 8 FORMAT "%1.0" BIT_MASK 0xF000 SYMBOL_LINK "ERRM_CFG_ARRY" 2058 SYMBOL_LINK "ERRM_CFG_ARRY" 1806 /end CHARACTERISTIC
/begin CHARACTERISTIC ERRM_ALT_MECH_MIL_ON "alternator mech MIL on enable" VALUE 0x2886C __UWORD_S 0 b_true 0 1 FORMAT "%1.0" BIT_MASK 0x0800 SYMBOL_LINK "ERRM_CFG_ARRY" 2058 SYMBOL_LINK "ERRM_CFG_ARRY" 1806 /end CHARACTERISTIC
/begin CHARACTERISTIC ERRM_ALT_MECH_DEN_GRP "alternator mech denom group" VALUE 0x2886C __UWORD_S 0 u_den_grp 0 63 FORMAT "%1.0" BIT_MASK 0x003F SYMBOL_LINK "ERRM_CFG_ARRY" 2058 SYMBOL_LINK "ERRM_CFG_ARRY" 1806 /end CHARACTERISTIC
/begin CHARACTERISTIC ERRM_ALT_MECH_DTC "alternator mech DTC" VALUE 0x2886C __UWORD_S 0 u_cnts 0 65535 FORMAT "%5.0" SYMBOL_LINK "ERRM_CFG_ARRY" 2060 SYMBOL_LINK "ERRM_CFG_ARRY" 1808 /end CHARACTERISTIC
/begin CHARACTERISTIC ERRM_ALT_ELEC_TYP "alternator electonic type" VALUE 0x2886C __UWORD_S 0 u_diag_typ 0 8 FORMAT "%1.0" BIT_MASK 0xF000 SYMBOL_LINK "ERRM_CFG_ARRY" 2064 SYMBOL_LINK "ERRM_CFG_ARRY" 1812 /end CHARACTERISTIC
/begin CHARACTERISTIC ERRM_ALT_ELEC_MIL_ON "alternator electonic MIL on enable" VALUE 0x2886C __UWORD_S 0 b_true 0 1 FORMAT "%1.0" BIT_MASK 0x0800 SYMBOL_LINK "ERRM_CFG_ARRY" 2064 SYMBOL_LINK "ERRM_CFG_ARRY" 1812 /end CHARACTERISTIC
/begin CHARACTERISTIC ERRM_ALT_ELEC_DEN_GRP "alternator electonic denom group" VALUE 0x2886C __UWORD_S 0 u_den_grp 0 63 FORMAT "%1.0" BIT_MASK 0x003F SYMBOL_LINK "ERRM_CFG_ARRY" 2064 SYMBOL_LINK "ERRM_CFG_ARRY" 1812 /end CHARACTERISTIC
/begin CHARACTERISTIC ERRM_ALT_ELEC_DTC "alternator electonic DTC" VALUE 0x2886C __UWORD_S 0 u_cnts 0 65535 FORMAT "%5.0" SYMBOL_LINK "ERRM_CFG_ARRY" 2066 SYMBOL_LINK "ERRM_CFG_ARRY" 1814 /end CHARACTERISTIC
/begin CHARACTERISTIC ERRM_STRT_RLYA_HI_TYP "starter relayA high type" VALUE 0x2886C __UWORD_S 0 u_diag_typ 0 8 FORMAT "%1.0" BIT_MASK 0xF000 SYMBOL_LINK "ERRM_CFG_ARRY" 2070 SYMBOL_LINK "ERRM_CFG_ARRY" 1818 /end CHARACTERISTIC
/begin CHARACTERISTIC ERRM_STRT_RLYA_HI_MIL_ON "starter relayA high MIL on enable" VALUE 0x2886C __UWORD_S 0 b_true 0 1 FORMAT "%1.0" BIT_MASK 0x0800 SYMBOL_LINK "ERRM_CFG_ARRY" 2070 SYMBOL_LINK "ERRM_CFG_ARRY" 1818 /end CHARACTERISTIC
/begin CHARACTERISTIC ERRM_STRT_RLYA_HI_DEN_GRP "starter relayA high denom group" VALUE 0x2886C __UWORD_S 0 u_den_grp 0 63 FORMAT "%1.0" BIT_MASK 0x003F SYMBOL_LINK "ERRM_CFG_ARRY" 2070 SYMBOL_LINK "ERRM_CFG_ARRY" 1818 /end CHARACTERISTIC
/begin CHARACTERISTIC ERRM_STRT_RLYA_HI_DTC "starter relayA high DTC" VALUE 0x2886C __UWORD_S 0 u_cnts 0 65535 FORMAT "%5.0" SYMBOL_LINK "ERRM_CFG_ARRY" 2072 SYMBOL_LINK "ERRM_CFG_ARRY" 1820 /end CHARACTERISTIC
/begin CHARACTERISTIC ERRM_STRT_RLYA_LO_TYP "starter relayA low type" VALUE 0x2886C __UWORD_S 0 u_diag_typ 0 8 FORMAT "%1.0" BIT_MASK 0xF000 SYMBOL_LINK "ERRM_CFG_ARRY" 2076 SYMBOL_LINK "ERRM_CFG_ARRY" 1824 /end CHARACTERISTIC
/begin CHARACTERISTIC ERRM_STRT_RLYA_LO_MIL_ON "starter relayA low MIL on enable" VALUE 0x2886C __UWORD_S 0 b_true 0 1 FORMAT "%1.0" BIT_MASK 0x0800 SYMBOL_LINK "ERRM_CFG_ARRY" 2076 SYMBOL_LINK "ERRM_CFG_ARRY" 1824 /end CHARACTERISTIC
/begin CHARACTERISTIC ERRM_STRT_RLYA_LO_DEN_GRP "starter relayA low denom group" VALUE 0x2886C __UWORD_S 0 u_den_grp 0 63 FORMAT "%1.0" BIT_MASK 0x003F SYMBOL_LINK "ERRM_CFG_ARRY" 2076 SYMBOL_LINK "ERRM_CFG_ARRY" 1824 /end CHARACTERISTIC
/begin CHARACTERISTIC ERRM_STRT_RLYA_LO_DTC "starter relayA low DTC" VALUE 0x2886C __UWORD_S 0 u_cnts 0 65535 FORMAT "%5.0" SYMBOL_LINK "ERRM_CFG_ARRY" 2078 SYMBOL_LINK "ERRM_CFG_ARRY" 1826 /end CHARACTERISTIC
/begin CHARACTERISTIC ERRM_STRT_RLYB_HI_TYP "starter relayB high type" VALUE 0x2886C __UWORD_S 0 u_diag_typ 0 8 FORMAT "%1.0" BIT_MASK 0xF000 SYMBOL_LINK "ERRM_CFG_ARRY" 2082 SYMBOL_LINK "ERRM_CFG_ARRY" 1830 /end CHARACTERISTIC
/begin CHARACTERISTIC ERRM_STRT_RLYB_HI_MIL_ON "starter relayB high MIL on enable" VALUE 0x2886C __UWORD_S 0 b_true 0 1 FORMAT "%1.0" BIT_MASK 0x0800 SYMBOL_LINK "ERRM_CFG_ARRY" 2082 SYMBOL_LINK "ERRM_CFG_ARRY" 1830 /end CHARACTERISTIC
/begin CHARACTERISTIC ERRM_STRT_RLYB_HI_DEN_GRP "starter relayB high denom group" VALUE 0x2886C __UWORD_S 0 u_den_grp 0 63 FORMAT "%1.0" BIT_MASK 0x003F SYMBOL_LINK "ERRM_CFG_ARRY" 2082 SYMBOL_LINK "ERRM_CFG_ARRY" 1830 /end CHARACTERISTIC
/begin CHARACTERISTIC ERRM_STRT_RLYB_HI_DTC "starter relayB high DTC" VALUE 0x2886C __UWORD_S 0 u_cnts 0 65535 FORMAT "%5.0" SYMBOL_LINK "ERRM_CFG_ARRY" 2084 SYMBOL_LINK "ERRM_CFG_ARRY" 1832 /end CHARACTERISTIC
/begin CHARACTERISTIC ERRM_STRT_RLYB_LO_TYP "starter relayB low type" VALUE 0x2886C __UWORD_S 0 u_diag_typ 0 8 FORMAT "%1.0" BIT_MASK 0xF000 SYMBOL_LINK "ERRM_CFG_ARRY" 2088 SYMBOL_LINK "ERRM_CFG_ARRY" 1836 /end CHARACTERISTIC
/begin CHARACTERISTIC ERRM_STRT_RLYB_LO_MIL_ON "starter relayB low MIL on enable" VALUE 0x2886C __UWORD_S 0 b_true 0 1 FORMAT "%1.0" BIT_MASK 0x0800 SYMBOL_LINK "ERRM_CFG_ARRY" 2088 SYMBOL_LINK "ERRM_CFG_ARRY" 1836 /end CHARACTERISTIC
/begin CHARACTERISTIC ERRM_STRT_RLYB_LO_DEN_GRP "starter relayB low denom group" VALUE 0x2886C __UWORD_S 0 u_den_grp 0 63 FORMAT "%1.0" BIT_MASK 0x003F SYMBOL_LINK "ERRM_CFG_ARRY" 2088 SYMBOL_LINK "ERRM_CFG_ARRY" 1836 /end CHARACTERISTIC
/begin CHARACTERISTIC ERRM_STRT_RLYB_LO_DTC "starter relayB low DTC" VALUE 0x2886C __UWORD_S 0 u_cnts 0 65535 FORMAT "%5.0" SYMBOL_LINK "ERRM_CFG_ARRY" 2090 SYMBOL_LINK "ERRM_CFG_ARRY" 1838 /end CHARACTERISTIC
/begin CHARACTERISTIC ERRM_TCM_FAIL_TYP "TCM report fail type" VALUE 0x2886C __UWORD_S 0 u_diag_typ 0 8 FORMAT "%1.0" BIT_MASK 0xF000 SYMBOL_LINK "ERRM_CFG_ARRY" 2142 SYMBOL_LINK "ERRM_CFG_ARRY" 1890 /end CHARACTERISTIC
/begin CHARACTERISTIC ERRM_TCM_FAIL_MIL_ON "TCM report fail MIL on enable" VALUE 0x2886C __UWORD_S 0 b_true 0 1 FORMAT "%1.0" BIT_MASK 0x0800 SYMBOL_LINK "ERRM_CFG_ARRY" 2142 SYMBOL_LINK "ERRM_CFG_ARRY" 1890 /end CHARACTERISTIC
/begin CHARACTERISTIC ERRM_TCM_FAIL_DEN_GRP "TCM report fail denom group" VALUE 0x2886C __UWORD_S 0 u_den_grp 0 63 FORMAT "%1.0" BIT_MASK 0x003F SYMBOL_LINK "ERRM_CFG_ARRY" 2142 SYMBOL_LINK "ERRM_CFG_ARRY" 1890 /end CHARACTERISTIC
/begin CHARACTERISTIC ERRM_TCM_FAIL_DTC "TCM report fail DTC" VALUE 0x2886C __UWORD_S 0 u_cnts 0 65535 FORMAT "%5.0" SYMBOL_LINK "ERRM_CFG_ARRY" 2144 SYMBOL_LINK "ERRM_CFG_ARRY" 1892 /end CHARACTERISTIC
/begin CHARACTERISTIC ERRM_LIN_ERR_TYP "LIN error type" VALUE 0x2886C __UWORD_S 0 u_diag_typ 0 8 FORMAT "%1.0" BIT_MASK 0xF000 SYMBOL_LINK "ERRM_CFG_ARRY" 2196 SYMBOL_LINK "ERRM_CFG_ARRY" 1926 /end CHARACTERISTIC
/begin CHARACTERISTIC ERRM_LIN_ERR_MIL_ON "LIN error MIL on enable" VALUE 0x2886C __UWORD_S 0 b_true 0 1 FORMAT "%1.0" BIT_MASK 0x0800 SYMBOL_LINK "ERRM_CFG_ARRY" 2196 SYMBOL_LINK "ERRM_CFG_ARRY" 1926 /end CHARACTERISTIC
/begin CHARACTERISTIC ERRM_LIN_ERR_DEN_GRP "LIN error denom group" VALUE 0x2886C __UWORD_S 0 u_den_grp 0 63 FORMAT "%1.0" BIT_MASK 0x003F SYMBOL_LINK "ERRM_CFG_ARRY" 2196 SYMBOL_LINK "ERRM_CFG_ARRY" 1926 /end CHARACTERISTIC
/begin CHARACTERISTIC ERRM_LIN_ERR_DTC "LIN error DTC" VALUE 0x2886C __UWORD_S 0 u_cnts 0 65535 FORMAT "%5.0" SYMBOL_LINK "ERRM_CFG_ARRY" 2198 SYMBOL_LINK "ERRM_CFG_ARRY" 1928 /end CHARACTERISTIC
/begin CHARACTERISTIC ERRM_BAT_SNSR_TYP "battery sensor fail type" VALUE 0x2886C __UWORD_S 0 u_diag_typ 0 8 FORMAT "%1.0" BIT_MASK 0xF000 SYMBOL_LINK "ERRM_CFG_ARRY" 2220 SYMBOL_LINK "ERRM_CFG_ARRY" 1950 /end CHARACTERISTIC
/begin CHARACTERISTIC ERRM_BAT_SNSR_MIL_ON "battery sensor fail MIL on enable" VALUE 0x2886C __UWORD_S 0 b_true 0 1 FORMAT "%1.0" BIT_MASK 0x0800 SYMBOL_LINK "ERRM_CFG_ARRY" 2220 SYMBOL_LINK "ERRM_CFG_ARRY" 1950 /end CHARACTERISTIC
/begin CHARACTERISTIC ERRM_BAT_SNSR_DEN_GRP "battery sensor fail denom group" VALUE 0x2886C __UWORD_S 0 u_den_grp 0 63 FORMAT "%1.0" BIT_MASK 0x003F SYMBOL_LINK "ERRM_CFG_ARRY" 2220 SYMBOL_LINK "ERRM_CFG_ARRY" 1950 /end CHARACTERISTIC
/begin CHARACTERISTIC ERRM_BAT_SNSR_DTC "battery sensor fail DTC" VALUE 0x2886C __UWORD_S 0 u_cnts 0 65535 FORMAT "%5.0" SYMBOL_LINK "ERRM_CFG_ARRY" 2222 SYMBOL_LINK "ERRM_CFG_ARRY" 1950 /end CHARACTERISTIC
/begin CHARACTERISTIC ERRM_BAT_SNSR_COM_TYP "battery sensor comm type" VALUE 0x2886C __UWORD_S 0 u_diag_typ 0 8 FORMAT "%1.0" BIT_MASK 0xF000 SYMBOL_LINK "ERRM_CFG_ARRY" 2226 SYMBOL_LINK "ERRM_CFG_ARRY" 1956 /end CHARACTERISTIC
/begin CHARACTERISTIC ERRM_BAT_SNSR_COM_MIL_ON "battery sensor comm MIL on enable" VALUE 0x2886C __UWORD_S 0 b_true 0 1 FORMAT "%1.0" BIT_MASK 0x0800 SYMBOL_LINK "ERRM_CFG_ARRY" 2226 SYMBOL_LINK "ERRM_CFG_ARRY" 1956 /end CHARACTERISTIC
/begin CHARACTERISTIC ERRM_BAT_SNSR_COM_DEN_GRP "battery sensor comm denom group" VALUE 0x2886C __UWORD_S 0 u_den_grp 0 63 FORMAT "%1.0" BIT_MASK 0x003F SYMBOL_LINK "ERRM_CFG_ARRY" 2226 SYMBOL_LINK "ERRM_CFG_ARRY" 1956 /end CHARACTERISTIC
/begin CHARACTERISTIC ERRM_BAT_SNSR_COM_DTC "battery sensor comm DTC" VALUE 0x2886C __UWORD_S 0 u_cnts 0 65535 FORMAT "%5.0" SYMBOL_LINK "ERRM_CFG_ARRY" 2228 SYMBOL_LINK "ERRM_CFG_ARRY" 1958 /end CHARACTERISTIC
/begin CHARACTERISTIC ERRM_ALT_COM_TYP "alternator comm type" VALUE 0x2886C __UWORD_S 0 u_diag_typ 0 8 FORMAT "%1.0" BIT_MASK 0xF000 SYMBOL_LINK "ERRM_CFG_ARRY" 2232 SYMBOL_LINK "ERRM_CFG_ARRY" 1962 /end CHARACTERISTIC
/begin CHARACTERISTIC ERRM_ALT_COM_MIL_ON "alternator comm MIL on enable" VALUE 0x2886C __UWORD_S 0 b_true 0 1 FORMAT "%1.0" BIT_MASK 0x0800 SYMBOL_LINK "ERRM_CFG_ARRY" 2232 SYMBOL_LINK "ERRM_CFG_ARRY" 1962 /end CHARACTERISTIC
/begin CHARACTERISTIC ERRM_ALT_COM_DEN_GRP "alternator comm denom group" VALUE 0x2886C __UWORD_S 0 u_den_grp 0 63 FORMAT "%1.0" BIT_MASK 0x003F SYMBOL_LINK "ERRM_CFG_ARRY" 2232 SYMBOL_LINK "ERRM_CFG_ARRY" 1962 /end CHARACTERISTIC
/begin CHARACTERISTIC ERRM_ALT_COM_DTC "alternator comm DTC" VALUE 0x2886C __UWORD_S 0 u_cnts 0 65535 FORMAT "%5.0" SYMBOL_LINK "ERRM_CFG_ARRY" 2234 SYMBOL_LINK "ERRM_CFG_ARRY" 1964 /end CHARACTERISTIC
/begin CHARACTERISTIC ERRM_AC_T_LO_TYP "AC evap temp short low type" VALUE 0x2886C __UWORD_S 0 u_diag_typ 0 8 FORMAT "%1.0" BIT_MASK 0xF000 SYMBOL_LINK "ERRM_CFG_ARRY" 2250 SYMBOL_LINK "ERRM_CFG_ARRY" 1980 /end CHARACTERISTIC
/begin CHARACTERISTIC ERRM_AC_T_LO_MIL_ON "AC evap temp short low MIL on enable" VALUE 0x2886C __UWORD_S 0 b_true 0 1 FORMAT "%1.0" BIT_MASK 0x0800 SYMBOL_LINK "ERRM_CFG_ARRY" 2250 SYMBOL_LINK "ERRM_CFG_ARRY" 1980 /end CHARACTERISTIC
/begin CHARACTERISTIC ERRM_AC_T_LO_DEN_GRP "AC evap temp short low denom group" VALUE 0x2886C __UWORD_S 0 u_den_grp 0 63 FORMAT "%1.0" BIT_MASK 0x003F SYMBOL_LINK "ERRM_CFG_ARRY" 2250 SYMBOL_LINK "ERRM_CFG_ARRY" 1980 /end CHARACTERISTIC
/begin CHARACTERISTIC ERRM_AC_T_LO_DTC "AC evap temp short low DTC" VALUE 0x2886C __UWORD_S 0 u_cnts 0 65535 FORMAT "%5.0" SYMBOL_LINK "ERRM_CFG_ARRY" 2252 SYMBOL_LINK "ERRM_CFG_ARRY" 1982 /end CHARACTERISTIC
/begin CHARACTERISTIC ERRM_AC_T_HI_TYP "AC evap temp short high type" VALUE 0x2886C __UWORD_S 0 u_diag_typ 0 8 FORMAT "%1.0" BIT_MASK 0xF000 SYMBOL_LINK "ERRM_CFG_ARRY" 2256 SYMBOL_LINK "ERRM_CFG_ARRY" 1986 /end CHARACTERISTIC
/begin CHARACTERISTIC ERRM_AC_T_HI_MIL_ON "AC evap temp short high MIL on enable" VALUE 0x2886C __UWORD_S 0 b_true 0 1 FORMAT "%1.0" BIT_MASK 0x0800 SYMBOL_LINK "ERRM_CFG_ARRY" 2256 SYMBOL_LINK "ERRM_CFG_ARRY" 1986 /end CHARACTERISTIC
/begin CHARACTERISTIC ERRM_AC_T_HI_DEN_GRP "AC evap temp short high denom group" VALUE 0x2886C __UWORD_S 0 u_den_grp 0 63 FORMAT "%1.0" BIT_MASK 0x003F SYMBOL_LINK "ERRM_CFG_ARRY" 2256 SYMBOL_LINK "ERRM_CFG_ARRY" 1986 /end CHARACTERISTIC
/begin CHARACTERISTIC ERRM_AC_T_HI_DTC "AC evap temp short high DTC" VALUE 0x2886C __UWORD_S 0 u_cnts 0 65535 FORMAT "%5.0" SYMBOL_LINK "ERRM_CFG_ARRY" 2258 SYMBOL_LINK "ERRM_CFG_ARRY" 1988 /end CHARACTERISTIC
/begin CHARACTERISTIC ERRM_CLTCH_TOP_RLS_TYP "clutch top switch release position short type" VALUE 0x2886C __UWORD_S 0 u_diag_typ 0 8 FORMAT "%1.0" BIT_MASK 0xF000 SYMBOL_LINK "ERRM_CFG_ARRY" 2280 SYMBOL_LINK "ERRM_CFG_ARRY" 2010 /end CHARACTERISTIC
/begin CHARACTERISTIC ERRM_CLTCH_TOP_RLS_MIL_ON "clutch top switch release position short MIL on enable" VALUE 0x2886C __UWORD_S 0 b_true 0 1 FORMAT "%1.0" BIT_MASK 0x0800 SYMBOL_LINK "ERRM_CFG_ARRY" 2280 SYMBOL_LINK "ERRM_CFG_ARRY" 2010 /end CHARACTERISTIC
/begin CHARACTERISTIC ERRM_CLTCH_TOP_RLS_DEN_GRP "clutch top switch release position short denom group" VALUE 0x2886C __UWORD_S 0 u_den_grp 0 63 FORMAT "%1.0" BIT_MASK 0x003F SYMBOL_LINK "ERRM_CFG_ARRY" 2280 SYMBOL_LINK "ERRM_CFG_ARRY" 2010 /end CHARACTERISTIC
/begin CHARACTERISTIC ERRM_CLTCH_TOP_RLS_DTC "clutch top switch release position short DTC" VALUE 0x2886C __UWORD_S 0 u_cnts 0 65535 FORMAT "%5.0" SYMBOL_LINK "ERRM_CFG_ARRY" 2282 SYMBOL_LINK "ERRM_CFG_ARRY" 2012 /end CHARACTERISTIC
/begin CHARACTERISTIC ERRM_CLTCH_TOP_DPRS_TYP "clutch top switch depress position short type" VALUE 0x2886C __UWORD_S 0 u_diag_typ 0 8 FORMAT "%1.0" BIT_MASK 0xF000 SYMBOL_LINK "ERRM_CFG_ARRY" 2286 SYMBOL_LINK "ERRM_CFG_ARRY" 2016 /end CHARACTERISTIC
/begin CHARACTERISTIC ERRM_CLTCH_TOP_DPRS_MIL_ON "clutch top switch depress position short MIL on enable" VALUE 0x2886C __UWORD_S 0 b_true 0 1 FORMAT "%1.0" BIT_MASK 0x0800 SYMBOL_LINK "ERRM_CFG_ARRY" 2286 SYMBOL_LINK "ERRM_CFG_ARRY" 2016 /end CHARACTERISTIC
/begin CHARACTERISTIC ERRM_CLTCH_TOP_DPRS_DEN_GRP "clutch top switch depress position short denom group" VALUE 0x2886C __UWORD_S 0 u_den_grp 0 63 FORMAT "%1.0" BIT_MASK 0x003F SYMBOL_LINK "ERRM_CFG_ARRY" 2286 SYMBOL_LINK "ERRM_CFG_ARRY" 2016 /end CHARACTERISTIC
/begin CHARACTERISTIC ERRM_CLTCH_TOP_DPRS_DTC "clutch top switch depress position short DTC" VALUE 0x2886C __UWORD_S 0 u_cnts 0 65535 FORMAT "%5.0" SYMBOL_LINK "ERRM_CFG_ARRY" 2288 SYMBOL_LINK "ERRM_CFG_ARRY" 2018 /end CHARACTERISTIC
/begin CHARACTERISTIC ERRM_CLTCH_BOT_RLS_TYP "clutch bottom switch release position short type" VALUE 0x2886C __UWORD_S 0 u_diag_typ 0 8 FORMAT "%1.0" BIT_MASK 0xF000 SYMBOL_LINK "ERRM_CFG_ARRY" 2292 SYMBOL_LINK "ERRM_CFG_ARRY" 2022 /end CHARACTERISTIC
/begin CHARACTERISTIC ERRM_CLTCH_BOT_RLS_MIL_ON "clutch bottom switch release position short MIL on enable" VALUE 0x2886C __UWORD_S 0 b_true 0 1 FORMAT "%1.0" BIT_MASK 0x0800 SYMBOL_LINK "ERRM_CFG_ARRY" 2292 SYMBOL_LINK "ERRM_CFG_ARRY" 2022 /end CHARACTERISTIC
/begin CHARACTERISTIC ERRM_CLTCH_BOT_RLS_DEN_GRP "clutch bottom switch release position short denom group" VALUE 0x2886C __UWORD_S 0 u_den_grp 0 63 FORMAT "%1.0" BIT_MASK 0x003F SYMBOL_LINK "ERRM_CFG_ARRY" 2292 SYMBOL_LINK "ERRM_CFG_ARRY" 2022 /end CHARACTERISTIC
/begin CHARACTERISTIC ERRM_CLTCH_BOT_RLS_DTC "clutch bottom switch release position short DTC" VALUE 0x2886C __UWORD_S 0 u_cnts 0 65535 FORMAT "%5.0" SYMBOL_LINK "ERRM_CFG_ARRY" 2294 SYMBOL_LINK "ERRM_CFG_ARRY" 2024 /end CHARACTERISTIC
/begin CHARACTERISTIC ERRM_CLTCH_BOT_DPRS_TYP "clutch bottom switch depress position short type" VALUE 0x2886C __UWORD_S 0 u_diag_typ 0 8 FORMAT "%1.0" BIT_MASK 0xF000 SYMBOL_LINK "ERRM_CFG_ARRY" 2298 SYMBOL_LINK "ERRM_CFG_ARRY" 2028 /end CHARACTERISTIC
/begin CHARACTERISTIC ERRM_CLTCH_BOT_DPRS_MIL_ON "clutch bottom switch depress position short MIL on enable" VALUE 0x2886C __UWORD_S 0 b_true 0 1 FORMAT "%1.0" BIT_MASK 0x0800 SYMBOL_LINK "ERRM_CFG_ARRY" 2298 SYMBOL_LINK "ERRM_CFG_ARRY" 2028 /end CHARACTERISTIC
/begin CHARACTERISTIC ERRM_CLTCH_BOT_DPRS_DEN_GRP "clutch bottom switch depress position short denom group" VALUE 0x2886C __UWORD_S 0 u_den_grp 0 63 FORMAT "%1.0" BIT_MASK 0x003F SYMBOL_LINK "ERRM_CFG_ARRY" 2298 SYMBOL_LINK "ERRM_CFG_ARRY" 2028 /end CHARACTERISTIC
/begin CHARACTERISTIC ERRM_CLTCH_BOT_DPRS_DTC "clutch bottom switch depress position short DTC" VALUE 0x2886C __UWORD_S 0 u_cnts 0 65535 FORMAT "%5.0" SYMBOL_LINK "ERRM_CFG_ARRY" 2300 SYMBOL_LINK "ERRM_CFG_ARRY" 2030 /end CHARACTERISTIC
/begin CHARACTERISTIC ERRM_N_STCK_N_TYP "neutral switch stuck at neutral type" VALUE 0x2886C __UWORD_S 0 u_diag_typ 0 8 FORMAT "%1.0" BIT_MASK 0xF000 SYMBOL_LINK "ERRM_CFG_ARRY" 2316 SYMBOL_LINK "ERRM_CFG_ARRY" 2046 /end CHARACTERISTIC
/begin CHARACTERISTIC ERRM_N_STCK_N_MIL_ON "neutral switch stuck at neutral MIL on enable" VALUE 0x2886C __UWORD_S 0 b_true 0 1 FORMAT "%1.0" BIT_MASK 0x0800 SYMBOL_LINK "ERRM_CFG_ARRY" 2316 SYMBOL_LINK "ERRM_CFG_ARRY" 2046 /end CHARACTERISTIC
/begin CHARACTERISTIC ERRM_N_STCK_N_DEN_GRP "neutral switch stuck at neutral denom group" VALUE 0x2886C __UWORD_S 0 u_den_grp 0 63 FORMAT "%1.0" BIT_MASK 0x003F SYMBOL_LINK "ERRM_CFG_ARRY" 2316 SYMBOL_LINK "ERRM_CFG_ARRY" 2046 /end CHARACTERISTIC
/begin CHARACTERISTIC ERRM_N_STCK_N_DTC "neutral switch stuck at neutral DTC" VALUE 0x2886C __UWORD_S 0 u_cnts 0 65535 FORMAT "%5.0" SYMBOL_LINK "ERRM_CFG_ARRY" 2318 SYMBOL_LINK "ERRM_CFG_ARRY" 2048 /end CHARACTERISTIC
/begin CHARACTERISTIC ERRM_N_STCK_NON_TYP "neutral switch stuck at non-neutral type" VALUE 0x2886C __UWORD_S 0 u_diag_typ 0 8 FORMAT "%1.0" BIT_MASK 0xF000 SYMBOL_LINK "ERRM_CFG_ARRY" 2322 SYMBOL_LINK "ERRM_CFG_ARRY" 2052 /end CHARACTERISTIC
/begin CHARACTERISTIC ERRM_N_STCK_NON_MIL_ON "neutral switch stuck at non-neutral MIL on enable" VALUE 0x2886C __UWORD_S 0 b_true 0 1 FORMAT "%1.0" BIT_MASK 0x0800 SYMBOL_LINK "ERRM_CFG_ARRY" 2322 SYMBOL_LINK "ERRM_CFG_ARRY" 2052 /end CHARACTERISTIC
/begin CHARACTERISTIC ERRM_N_STCK_NON_DEN_GRP "neutral switch stuck at non-neutral denom group" VALUE 0x2886C __UWORD_S 0 u_den_grp 0 63 FORMAT "%1.0" BIT_MASK 0x003F SYMBOL_LINK "ERRM_CFG_ARRY" 2322 SYMBOL_LINK "ERRM_CFG_ARRY" 2052 /end CHARACTERISTIC
/begin CHARACTERISTIC ERRM_N_STCK_NON_DTC "neutral switch stuck at non-neutral DTC" VALUE 0x2886C __UWORD_S 0 u_cnts 0 65535 FORMAT "%5.0" SYMBOL_LINK "ERRM_CFG_ARRY" 2324 SYMBOL_LINK "ERRM_CFG_ARRY" 2054 /end CHARACTERISTIC
/begin CHARACTERISTIC ERRM_AMP_HI_TYP "amp sensor short high type" VALUE 0x2886C __UWORD_S 0 u_diag_typ 0 8 FORMAT "%1.0" BIT_MASK 0xF000 SYMBOL_LINK "ERRM_CFG_ARRY" 2334 SYMBOL_LINK "ERRM_CFG_ARRY" 2064 /end CHARACTERISTIC
/begin CHARACTERISTIC ERRM_AMP_HI_MIL_ON "amp sensor short high MIL on enable" VALUE 0x2886C __UWORD_S 0 b_true 0 1 FORMAT "%1.0" BIT_MASK 0x0800 SYMBOL_LINK "ERRM_CFG_ARRY" 2334 SYMBOL_LINK "ERRM_CFG_ARRY" 2064 /end CHARACTERISTIC
/begin CHARACTERISTIC ERRM_AMP_HI_DEN_GRP "amp sensor short high denom group" VALUE 0x2886C __UWORD_S 0 u_den_grp 0 63 FORMAT "%1.0" BIT_MASK 0x003F SYMBOL_LINK "ERRM_CFG_ARRY" 2334 SYMBOL_LINK "ERRM_CFG_ARRY" 2064 /end CHARACTERISTIC
/begin CHARACTERISTIC ERRM_AMP_HI_DTC "amp sensor short high DTC" VALUE 0x2886C __UWORD_S 0 u_cnts 0 65535 FORMAT "%5.0" SYMBOL_LINK "ERRM_CFG_ARRY" 2336 SYMBOL_LINK "ERRM_CFG_ARRY" 2066 /end CHARACTERISTIC
/begin CHARACTERISTIC ERRM_MAP_HI_TYP "map sensor short high type" VALUE 0x2886C __UWORD_S 0 u_diag_typ 0 8 FORMAT "%1.0" BIT_MASK 0xF000 SYMBOL_LINK "ERRM_CFG_ARRY" 2346 SYMBOL_LINK "ERRM_CFG_ARRY" 2070 /end CHARACTERISTIC
/begin CHARACTERISTIC ERRM_MAP_HI_MIL_ON "map sensor short high MIL on enable" VALUE 0x2886C __UWORD_S 0 b_true 0 1 FORMAT "%1.0" BIT_MASK 0x0800 SYMBOL_LINK "ERRM_CFG_ARRY" 2346 SYMBOL_LINK "ERRM_CFG_ARRY" 2070 /end CHARACTERISTIC
/begin CHARACTERISTIC ERRM_MAP_HI_DEN_GRP "map sensor short high denom group" VALUE 0x2886C __UWORD_S 0 u_den_grp 0 63 FORMAT "%1.0" BIT_MASK 0x003F SYMBOL_LINK "ERRM_CFG_ARRY" 2346 SYMBOL_LINK "ERRM_CFG_ARRY" 2070 /end CHARACTERISTIC
/begin CHARACTERISTIC ERRM_MAP_HI_DTC "map sensor short high DTC" VALUE 0x2886C __UWORD_S 0 u_cnts 0 65535 FORMAT "%5.0" SYMBOL_LINK "ERRM_CFG_ARRY" 2348 SYMBOL_LINK "ERRM_CFG_ARRY" 2072 /end CHARACTERISTIC
/begin CHARACTERISTIC ERRM_AMP_LO_TYP "amp sensor short low type" VALUE 0x2886C __UWORD_S 0 u_diag_typ 0 8 FORMAT "%1.0" BIT_MASK 0xF000 SYMBOL_LINK "ERRM_CFG_ARRY" 2352 SYMBOL_LINK "ERRM_CFG_ARRY" 2076 /end CHARACTERISTIC
/begin CHARACTERISTIC ERRM_AMP_LO_MIL_ON "amp sensor short low MIL on enable" VALUE 0x2886C __UWORD_S 0 b_true 0 1 FORMAT "%1.0" BIT_MASK 0x0800 SYMBOL_LINK "ERRM_CFG_ARRY" 2352 SYMBOL_LINK "ERRM_CFG_ARRY" 2076 /end CHARACTERISTIC
/begin CHARACTERISTIC ERRM_AMP_LO_DEN_GRP "amp sensor short low denom group" VALUE 0x2886C __UWORD_S 0 u_den_grp 0 63 FORMAT "%1.0" BIT_MASK 0x003F SYMBOL_LINK "ERRM_CFG_ARRY" 2352 SYMBOL_LINK "ERRM_CFG_ARRY" 2076 /end CHARACTERISTIC
/begin CHARACTERISTIC ERRM_AMP_LO_DTC "amp sensor short low DTC" VALUE 0x2886C __UWORD_S 0 u_cnts 0 65535 FORMAT "%5.0" SYMBOL_LINK "ERRM_CFG_ARRY" 2354 SYMBOL_LINK "ERRM_CFG_ARRY" 2078 /end CHARACTERISTIC
/begin CHARACTERISTIC ERRM_MAP_LO_TYP "map sensor short low type" VALUE 0x2886C __UWORD_S 0 u_diag_typ 0 8 FORMAT "%1.0" BIT_MASK 0xF000 SYMBOL_LINK "ERRM_CFG_ARRY" 2364 SYMBOL_LINK "ERRM_CFG_ARRY" 2082 /end CHARACTERISTIC
/begin CHARACTERISTIC ERRM_MAP_LO_MIL_ON "map sensor short low MIL on enable" VALUE 0x2886C __UWORD_S 0 b_true 0 1 FORMAT "%1.0" BIT_MASK 0x0800 SYMBOL_LINK "ERRM_CFG_ARRY" 2364 SYMBOL_LINK "ERRM_CFG_ARRY" 2082 /end CHARACTERISTIC
/begin CHARACTERISTIC ERRM_MAP_LO_DEN_GRP "map sensor short low denom group" VALUE 0x2886C __UWORD_S 0 u_den_grp 0 63 FORMAT "%1.0" BIT_MASK 0x003F SYMBOL_LINK "ERRM_CFG_ARRY" 2364 SYMBOL_LINK "ERRM_CFG_ARRY" 2082 /end CHARACTERISTIC
/begin CHARACTERISTIC ERRM_MAP_LO_DTC "map sensor short low DTC" VALUE 0x2886C __UWORD_S 0 u_cnts 0 65535 FORMAT "%5.0" SYMBOL_LINK "ERRM_CFG_ARRY" 2366 SYMBOL_LINK "ERRM_CFG_ARRY" 2084 /end CHARACTERISTIC
/begin CHARACTERISTIC ERRM_AMP_STRT_COR_TYP "start up amp correlation type" VALUE 0x2886C __UWORD_S 0 u_diag_typ 0 8 FORMAT "%1.0" BIT_MASK 0xF000 SYMBOL_LINK "ERRM_CFG_ARRY" 2406 SYMBOL_LINK "ERRM_CFG_ARRY" 2112 /end CHARACTERISTIC
/begin CHARACTERISTIC ERRM_AMP_STRT_COR_MIL_ON "start up amp correlation MIL on enable" VALUE 0x2886C __UWORD_S 0 b_true 0 1 FORMAT "%1.0" BIT_MASK 0x0800 SYMBOL_LINK "ERRM_CFG_ARRY" 2406 SYMBOL_LINK "ERRM_CFG_ARRY" 2112 /end CHARACTERISTIC
/begin CHARACTERISTIC ERRM_AMP_STRT_COR_DEN_GRP "start up amp correlation denom group" VALUE 0x2886C __UWORD_S 0 u_den_grp 0 63 FORMAT "%1.0" BIT_MASK 0x003F SYMBOL_LINK "ERRM_CFG_ARRY" 2406 SYMBOL_LINK "ERRM_CFG_ARRY" 2112 /end CHARACTERISTIC
/begin CHARACTERISTIC ERRM_AMP_STRT_COR_DTC "start up amp correlation DTC" VALUE 0x2886C __UWORD_S 0 u_cnts 0 65535 FORMAT "%5.0" SYMBOL_LINK "ERRM_CFG_ARRY" 2408 SYMBOL_LINK "ERRM_CFG_ARRY" 2114 /end CHARACTERISTIC
/begin CHARACTERISTIC ERRM_MAP_STRT_COR_TYP "start up map correlation type" VALUE 0x2886C __UWORD_S 0 u_diag_typ 0 8 FORMAT "%1.0" BIT_MASK 0xF000 SYMBOL_LINK "ERRM_CFG_ARRY" 2418 SYMBOL_LINK "ERRM_CFG_ARRY" 2118 /end CHARACTERISTIC
/begin CHARACTERISTIC ERRM_MAP_STRT_COR_MIL_ON "start up map correlation MIL on enable" VALUE 0x2886C __UWORD_S 0 b_true 0 1 FORMAT "%1.0" BIT_MASK 0x0800 SYMBOL_LINK "ERRM_CFG_ARRY" 2418 SYMBOL_LINK "ERRM_CFG_ARRY" 2118 /end CHARACTERISTIC
/begin CHARACTERISTIC ERRM_MAP_STRT_COR_DEN_GRP "start up map correlation denom group" VALUE 0x2886C __UWORD_S 0 u_den_grp 0 63 FORMAT "%1.0" BIT_MASK 0x003F SYMBOL_LINK "ERRM_CFG_ARRY" 2418 SYMBOL_LINK "ERRM_CFG_ARRY" 2118 /end CHARACTERISTIC
/begin CHARACTERISTIC ERRM_MAP_STRT_COR_DTC "start up map correlation DTC" VALUE 0x2886C __UWORD_S 0 u_cnts 0 65535 FORMAT "%5.0" SYMBOL_LINK "ERRM_CFG_ARRY" 2420 SYMBOL_LINK "ERRM_CFG_ARRY" 2120 /end CHARACTERISTIC
/begin CHARACTERISTIC ERRM_BST_P_HI_TYP "boost press sensor short high type" VALUE 0x2886C __UWORD_S 0 u_diag_typ 0 8 FORMAT "%1.0" BIT_MASK 0xF000 SYMBOL_LINK "ERRM_CFG_ARRY" 2340 /end CHARACTERISTIC
/begin CHARACTERISTIC ERRM_BST_P_HI_MIL_ON "boost press short high MIL on enable" VALUE 0x2886C __UWORD_S 0 b_true 0 1 FORMAT "%1.0" BIT_MASK 0x0800 SYMBOL_LINK "ERRM_CFG_ARRY" 2340 /end CHARACTERISTIC
/begin CHARACTERISTIC ERRM_BST_P_HI_DEN_GRP "boost press short high denom group" VALUE 0x2886C __UWORD_S 0 u_den_grp 0 63 FORMAT "%1.0" BIT_MASK 0x003F SYMBOL_LINK "ERRM_CFG_ARRY" 2340 /end CHARACTERISTIC
/begin CHARACTERISTIC ERRM_BST_P_HI_DTC "boost press short high DTC" VALUE 0x2886C __UWORD_S 0 u_cnts 0 65535 FORMAT "%5.0" SYMBOL_LINK "ERRM_CFG_ARRY" 2342 /end CHARACTERISTIC
/begin CHARACTERISTIC ERRM_BST_P_LO_TYP "boost press sensor short low type" VALUE 0x2886C __UWORD_S 0 u_diag_typ 0 8 FORMAT "%1.0" BIT_MASK 0xF000 SYMBOL_LINK "ERRM_CFG_ARRY" 2358 /end CHARACTERISTIC
/begin CHARACTERISTIC ERRM_BST_P_LO_MIL_ON "boost press short low MIL on enable" VALUE 0x2886C __UWORD_S 0 b_true 0 1 FORMAT "%1.0" BIT_MASK 0x0800 SYMBOL_LINK "ERRM_CFG_ARRY" 2358 /end CHARACTERISTIC
/begin CHARACTERISTIC ERRM_BST_P_LO_DEN_GRP "boost press short low denom group" VALUE 0x2886C __UWORD_S 0 u_den_grp 0 63 FORMAT "%1.0" BIT_MASK 0x003F SYMBOL_LINK "ERRM_CFG_ARRY" 2358 /end CHARACTERISTIC
/begin CHARACTERISTIC ERRM_BST_P_LO_DTC "boost press short low DTC" VALUE 0x2886C __UWORD_S 0 u_cnts 0 65535 FORMAT "%5.0" SYMBOL_LINK "ERRM_CFG_ARRY" 2360 /end CHARACTERISTIC
/begin CHARACTERISTIC ERRM_BSTP_STRT_COR_TYP "start up boost press correlation type" VALUE 0x2886C __UWORD_S 0 u_diag_typ 0 8 FORMAT "%1.0" BIT_MASK 0xF000 SYMBOL_LINK "ERRM_CFG_ARRY" 2412 /end CHARACTERISTIC
/begin CHARACTERISTIC ERRM_BSTP_STRT_COR_MIL_ON "start up boost press correlation MIL on enable" VALUE 0x2886C __UWORD_S 0 b_true 0 1 FORMAT "%1.0" BIT_MASK 0x0800 SYMBOL_LINK "ERRM_CFG_ARRY" 2412 /end CHARACTERISTIC
/begin CHARACTERISTIC ERRM_BSTP_STRT_COR_DEN_GRP "start up boost press correlation denom group" VALUE 0x2886C __UWORD_S 0 u_den_grp 0 63 FORMAT "%1.0" BIT_MASK 0x003F SYMBOL_LINK "ERRM_CFG_ARRY" 2412 /end CHARACTERISTIC
/begin CHARACTERISTIC ERRM_BSTP_STRT_COR_DTC "start up boost press correlation DTC" VALUE 0x2886C __UWORD_S 0 u_cnts 0 65535 FORMAT "%5.0" SYMBOL_LINK "ERRM_CFG_ARRY" 2414 /end CHARACTERISTIC
/begin CHARACTERISTIC ERRM_B1S1_O2_OPN_TYP "bank1 up o2 sensor open type" VALUE 0x2886C __UWORD_S 0 u_diag_typ 0 8 FORMAT "%1.0" BIT_MASK 0xF000 SYMBOL_LINK "ERRM_CFG_ARRY" 2628 SYMBOL_LINK "ERRM_CFG_ARRY" 2310 /end CHARACTERISTIC
/begin CHARACTERISTIC ERRM_B1S1_O2_OPN_MIL_ON "bank1 up o2 sensor open MIL on enable" VALUE 0x2886C __UWORD_S 0 b_true 0 1 FORMAT "%1.0" BIT_MASK 0x0800 SYMBOL_LINK "ERRM_CFG_ARRY" 2628 SYMBOL_LINK "ERRM_CFG_ARRY" 2310 /end CHARACTERISTIC
/begin CHARACTERISTIC ERRM_B1S1_O2_OPN_DEN_GRP "bank1 up o2 sensor open denom group" VALUE 0x2886C __UWORD_S 0 u_den_grp 0 63 FORMAT "%1.0" BIT_MASK 0x003F SYMBOL_LINK "ERRM_CFG_ARRY" 2628 SYMBOL_LINK "ERRM_CFG_ARRY" 2310 /end CHARACTERISTIC
/begin CHARACTERISTIC ERRM_B1S1_O2_OPN_DTC "bank1 up o2 sensor open DTC" VALUE 0x2886C __UWORD_S 0 u_cnts 0 65535 FORMAT "%5.0" SYMBOL_LINK "ERRM_CFG_ARRY" 2630 SYMBOL_LINK "ERRM_CFG_ARRY" 2312 /end CHARACTERISTIC
/begin CHARACTERISTIC ERRM_B1S1_O2_LO_TYP "bank1 up o2 sensor short low type" VALUE 0x2886C __UWORD_S 0 u_diag_typ 0 8 FORMAT "%1.0" BIT_MASK 0xF000 SYMBOL_LINK "ERRM_CFG_ARRY" 2634 SYMBOL_LINK "ERRM_CFG_ARRY" 2316 /end CHARACTERISTIC
/begin CHARACTERISTIC ERRM_B1S1_O2_LO_MIL_ON "bank1 up o2 sensor short low MIL on enable" VALUE 0x2886C __UWORD_S 0 b_true 0 1 FORMAT "%1.0" BIT_MASK 0x0800 SYMBOL_LINK "ERRM_CFG_ARRY" 2634 SYMBOL_LINK "ERRM_CFG_ARRY" 2316 /end CHARACTERISTIC
/begin CHARACTERISTIC ERRM_B1S1_O2_LO_DEN_GRP "bank1 up o2 sensor short low denom group" VALUE 0x2886C __UWORD_S 0 u_den_grp 0 63 FORMAT "%1.0" BIT_MASK 0x003F SYMBOL_LINK "ERRM_CFG_ARRY" 2634 SYMBOL_LINK "ERRM_CFG_ARRY" 2316 /end CHARACTERISTIC
/begin CHARACTERISTIC ERRM_B1S1_O2_LO_DTC "bank1 up o2 sensor short low DTC" VALUE 0x2886C __UWORD_S 0 u_cnts 0 65535 FORMAT "%5.0" SYMBOL_LINK "ERRM_CFG_ARRY" 2636 SYMBOL_LINK "ERRM_CFG_ARRY" 2318 /end CHARACTERISTIC
/begin CHARACTERISTIC ERRM_B1S1_O2_HI_TYP "bank1 up o2 sensor short high type" VALUE 0x2886C __UWORD_S 0 u_diag_typ 0 8 FORMAT "%1.0" BIT_MASK 0xF000 SYMBOL_LINK "ERRM_CFG_ARRY" 2640 SYMBOL_LINK "ERRM_CFG_ARRY" 2322 /end CHARACTERISTIC
/begin CHARACTERISTIC ERRM_B1S1_O2_HI_MIL_ON "bank1 up o2 sensor short high MIL on enable" VALUE 0x2886C __UWORD_S 0 b_true 0 1 FORMAT "%1.0" BIT_MASK 0x0800 SYMBOL_LINK "ERRM_CFG_ARRY" 2640 SYMBOL_LINK "ERRM_CFG_ARRY" 2322 /end CHARACTERISTIC
/begin CHARACTERISTIC ERRM_B1S1_O2_HI_DEN_GRP "bank1 up o2 sensor short high denom group" VALUE 0x2886C __UWORD_S 0 u_den_grp 0 63 FORMAT "%1.0" BIT_MASK 0x003F SYMBOL_LINK "ERRM_CFG_ARRY" 2640 SYMBOL_LINK "ERRM_CFG_ARRY" 2322 /end CHARACTERISTIC
/begin CHARACTERISTIC ERRM_B1S1_O2_HI_DTC "bank1 up o2 sensor short high DTC" VALUE 0x2886C __UWORD_S 0 u_cnts 0 65535 FORMAT "%5.0" SYMBOL_LINK "ERRM_CFG_ARRY" 2642 SYMBOL_LINK "ERRM_CFG_ARRY" 2324 /end CHARACTERISTIC
/begin CHARACTERISTIC ERRM_B1S1_POW_LEAN_TYP "bank1 up o2 sensor power lean type" VALUE 0x2886C __UWORD_S 0 u_diag_typ 0 8 FORMAT "%1.0" BIT_MASK 0xF000 SYMBOL_LINK "ERRM_CFG_ARRY" 2646 SYMBOL_LINK "ERRM_CFG_ARRY" 2328 /end CHARACTERISTIC
/begin CHARACTERISTIC ERRM_B1S1_POW_LEAN_MIL_ON "bank1 up o2 sensor power lean MIL on enable" VALUE 0x2886C __UWORD_S 0 b_true 0 1 FORMAT "%1.0" BIT_MASK 0x0800 SYMBOL_LINK "ERRM_CFG_ARRY" 2646 SYMBOL_LINK "ERRM_CFG_ARRY" 2328 /end CHARACTERISTIC
/begin CHARACTERISTIC ERRM_B1S1_POW_LEAN_DEN_GRP "bank1 up o2 sensor power lean denom group" VALUE 0x2886C __UWORD_S 0 u_den_grp 0 63 FORMAT "%1.0" BIT_MASK 0x003F SYMBOL_LINK "ERRM_CFG_ARRY" 2646 SYMBOL_LINK "ERRM_CFG_ARRY" 2328 /end CHARACTERISTIC
/begin CHARACTERISTIC ERRM_B1S1_POW_LEAN_DTC "bank1 up o2 sensor power lean DTC" VALUE 0x2886C __UWORD_S 0 u_cnts 0 65535 FORMAT "%5.0" SYMBOL_LINK "ERRM_CFG_ARRY" 2648 SYMBOL_LINK "ERRM_CFG_ARRY" 2330 /end CHARACTERISTIC
/begin CHARACTERISTIC ERRM_B1S1_PUC_RICH_TYP "bank1 up o2 sensor puc rich type" VALUE 0x2886C __UWORD_S 0 u_diag_typ 0 8 FORMAT "%1.0" BIT_MASK 0xF000 SYMBOL_LINK "ERRM_CFG_ARRY" 2652 SYMBOL_LINK "ERRM_CFG_ARRY" 2334 /end CHARACTERISTIC
/begin CHARACTERISTIC ERRM_B1S1_PUC_RICH_MIL_ON "bank1 up o2 sensor puc rich MIL on enable" VALUE 0x2886C __UWORD_S 0 b_true 0 1 FORMAT "%1.0" BIT_MASK 0x0800 SYMBOL_LINK "ERRM_CFG_ARRY" 2652 SYMBOL_LINK "ERRM_CFG_ARRY" 2334 /end CHARACTERISTIC
/begin CHARACTERISTIC ERRM_B1S1_PUC_RICH_DEN_GRP "bank1 up o2 sensor puc rich denom group" VALUE 0x2886C __UWORD_S 0 u_den_grp 0 63 FORMAT "%1.0" BIT_MASK 0x003F SYMBOL_LINK "ERRM_CFG_ARRY" 2652 SYMBOL_LINK "ERRM_CFG_ARRY" 2334 /end CHARACTERISTIC
/begin CHARACTERISTIC ERRM_B1S1_PUC_RICH_DTC "bank1 up o2 sensor puc rich DTC" VALUE 0x2886C __UWORD_S 0 u_cnts 0 65535 FORMAT "%5.0" SYMBOL_LINK "ERRM_CFG_ARRY" 2654 SYMBOL_LINK "ERRM_CFG_ARRY" 2336 /end CHARACTERISTIC
/begin CHARACTERISTIC ERRM_B1S2_O2_OPN_TYP "bank1 down o2 sensor open type" VALUE 0x2886C __UWORD_S 0 u_diag_typ 0 8 FORMAT "%1.0" BIT_MASK 0xF000 SYMBOL_LINK "ERRM_CFG_ARRY" 2658 SYMBOL_LINK "ERRM_CFG_ARRY" 2340 /end CHARACTERISTIC
/begin CHARACTERISTIC ERRM_B1S2_O2_OPN_MIL_ON "bank1 down o2 sensor open MIL on enable" VALUE 0x2886C __UWORD_S 0 b_true 0 1 FORMAT "%1.0" BIT_MASK 0x0800 SYMBOL_LINK "ERRM_CFG_ARRY" 2658 SYMBOL_LINK "ERRM_CFG_ARRY" 2340 /end CHARACTERISTIC
/begin CHARACTERISTIC ERRM_B1S2_O2_OPN_DEN_GRP "bank1 down o2 sensor open denom group" VALUE 0x2886C __UWORD_S 0 u_den_grp 0 63 FORMAT "%1.0" BIT_MASK 0x003F SYMBOL_LINK "ERRM_CFG_ARRY" 2658 SYMBOL_LINK "ERRM_CFG_ARRY" 2340 /end CHARACTERISTIC
/begin CHARACTERISTIC ERRM_B1S2_O2_OPN_DTC "bank1 down o2 sensor open DTC" VALUE 0x2886C __UWORD_S 0 u_cnts 0 65535 FORMAT "%5.0" SYMBOL_LINK "ERRM_CFG_ARRY" 2660 SYMBOL_LINK "ERRM_CFG_ARRY" 2342 /end CHARACTERISTIC
/begin CHARACTERISTIC ERRM_B1S2_O2_LO_TYP "bank1 down o2 sensor short low type" VALUE 0x2886C __UWORD_S 0 u_diag_typ 0 8 FORMAT "%1.0" BIT_MASK 0xF000 SYMBOL_LINK "ERRM_CFG_ARRY" 2664 SYMBOL_LINK "ERRM_CFG_ARRY" 2346 /end CHARACTERISTIC
/begin CHARACTERISTIC ERRM_B1S2_O2_LO_MIL_ON "bank1 down o2 sensor short low MIL on enable" VALUE 0x2886C __UWORD_S 0 b_true 0 1 FORMAT "%1.0" BIT_MASK 0x0800 SYMBOL_LINK "ERRM_CFG_ARRY" 2664 SYMBOL_LINK "ERRM_CFG_ARRY" 2346 /end CHARACTERISTIC
/begin CHARACTERISTIC ERRM_B1S2_O2_LO_DEN_GRP "bank1 down o2 sensor short low denom group" VALUE 0x2886C __UWORD_S 0 u_den_grp 0 63 FORMAT "%1.0" BIT_MASK 0x003F SYMBOL_LINK "ERRM_CFG_ARRY" 2664 SYMBOL_LINK "ERRM_CFG_ARRY" 2346 /end CHARACTERISTIC
/begin CHARACTERISTIC ERRM_B1S2_O2_LO_DTC "bank1 down o2 sensor short low DTC" VALUE 0x2886C __UWORD_S 0 u_cnts 0 65535 FORMAT "%5.0" SYMBOL_LINK "ERRM_CFG_ARRY" 2666 SYMBOL_LINK "ERRM_CFG_ARRY" 2348 /end CHARACTERISTIC
/begin CHARACTERISTIC ERRM_B1S2_O2_HI_TYP "bank1 down o2 sensor short high type" VALUE 0x2886C __UWORD_S 0 u_diag_typ 0 8 FORMAT "%1.0" BIT_MASK 0xF000 SYMBOL_LINK "ERRM_CFG_ARRY" 2670 SYMBOL_LINK "ERRM_CFG_ARRY" 2352 /end CHARACTERISTIC
/begin CHARACTERISTIC ERRM_B1S2_O2_HI_MIL_ON "bank1 down o2 sensor short high MIL on enable" VALUE 0x2886C __UWORD_S 0 b_true 0 1 FORMAT "%1.0" BIT_MASK 0x0800 SYMBOL_LINK "ERRM_CFG_ARRY" 2670 SYMBOL_LINK "ERRM_CFG_ARRY" 2352 /end CHARACTERISTIC
/begin CHARACTERISTIC ERRM_B1S2_O2_HI_DEN_GRP "bank1 down o2 sensor short high denom group" VALUE 0x2886C __UWORD_S 0 u_den_grp 0 63 FORMAT "%1.0" BIT_MASK 0x003F SYMBOL_LINK "ERRM_CFG_ARRY" 2670 SYMBOL_LINK "ERRM_CFG_ARRY" 2352 /end CHARACTERISTIC
/begin CHARACTERISTIC ERRM_B1S2_O2_HI_DTC "bank1 down o2 sensor short high DTC" VALUE 0x2886C __UWORD_S 0 u_cnts 0 65535 FORMAT "%5.0" SYMBOL_LINK "ERRM_CFG_ARRY" 2672 SYMBOL_LINK "ERRM_CFG_ARRY" 2354 /end CHARACTERISTIC
/begin CHARACTERISTIC ERRM_B1S2_POW_LEAN_TYP "bank1 down o2 sensor power lean type" VALUE 0x2886C __UWORD_S 0 u_diag_typ 0 8 FORMAT "%1.0" BIT_MASK 0xF000 SYMBOL_LINK "ERRM_CFG_ARRY" 2676 SYMBOL_LINK "ERRM_CFG_ARRY" 2358 /end CHARACTERISTIC
/begin CHARACTERISTIC ERRM_B1S2_POW_LEAN_MIL_ON "bank1 down o2 sensor power lean MIL on enable" VALUE 0x2886C __UWORD_S 0 b_true 0 1 FORMAT "%1.0" BIT_MASK 0x0800 SYMBOL_LINK "ERRM_CFG_ARRY" 2676 SYMBOL_LINK "ERRM_CFG_ARRY" 2358 /end CHARACTERISTIC
/begin CHARACTERISTIC ERRM_B1S2_POW_LEAN_DEN_GRP "bank1 down o2 sensor power lean denom group" VALUE 0x2886C __UWORD_S 0 u_den_grp 0 63 FORMAT "%1.0" BIT_MASK 0x003F SYMBOL_LINK "ERRM_CFG_ARRY" 2676 SYMBOL_LINK "ERRM_CFG_ARRY" 2358 /end CHARACTERISTIC
/begin CHARACTERISTIC ERRM_B1S2_POW_LEAN_DTC "bank1 down o2 sensor power lean DTC" VALUE 0x2886C __UWORD_S 0 u_cnts 0 65535 FORMAT "%5.0" SYMBOL_LINK "ERRM_CFG_ARRY" 2678 SYMBOL_LINK "ERRM_CFG_ARRY" 2360 /end CHARACTERISTIC
/begin CHARACTERISTIC ERRM_B1S2_PUC_RICH_TYP "bank1 down o2 sensor puc rich type" VALUE 0x2886C __UWORD_S 0 u_diag_typ 0 8 FORMAT "%1.0" BIT_MASK 0xF000 SYMBOL_LINK "ERRM_CFG_ARRY" 2682 SYMBOL_LINK "ERRM_CFG_ARRY" 2364 /end CHARACTERISTIC
/begin CHARACTERISTIC ERRM_B1S2_PUC_RICH_MIL_ON "bank1 down o2 sensor puc rich MIL on enable" VALUE 0x2886C __UWORD_S 0 b_true 0 1 FORMAT "%1.0" BIT_MASK 0x0800 SYMBOL_LINK "ERRM_CFG_ARRY" 2682 SYMBOL_LINK "ERRM_CFG_ARRY" 2364 /end CHARACTERISTIC
/begin CHARACTERISTIC ERRM_B1S2_PUC_RICH_DEN_GRP "bank1 down o2 sensor puc rich denom group" VALUE 0x2886C __UWORD_S 0 u_den_grp 0 63 FORMAT "%1.0" BIT_MASK 0x003F SYMBOL_LINK "ERRM_CFG_ARRY" 2682 SYMBOL_LINK "ERRM_CFG_ARRY" 2364 /end CHARACTERISTIC
/begin CHARACTERISTIC ERRM_B1S2_PUC_RICH_DTC "bank1 down o2 sensor puc rich DTC" VALUE 0x2886C __UWORD_S 0 u_cnts 0 65535 FORMAT "%5.0" SYMBOL_LINK "ERRM_CFG_ARRY" 2684 SYMBOL_LINK "ERRM_CFG_ARRY" 2366 /end CHARACTERISTIC
/begin CHARACTERISTIC ERRM_B1S1_SW_CNTS_TYP "bank1 up o2 switch counts type" VALUE 0x2886C __UWORD_S 0 u_diag_typ 0 8 FORMAT "%1.0" BIT_MASK 0xF000 SYMBOL_LINK "ERRM_CFG_ARRY" 2688 SYMBOL_LINK "ERRM_CFG_ARRY" 2370 /end CHARACTERISTIC
/begin CHARACTERISTIC ERRM_B1S1_SW_CNTS_MIL_ON "bank1 up o2 switch counts MIL on enable" VALUE 0x2886C __UWORD_S 0 b_true 0 1 FORMAT "%1.0" BIT_MASK 0x0800 SYMBOL_LINK "ERRM_CFG_ARRY" 2688 SYMBOL_LINK "ERRM_CFG_ARRY" 2370 /end CHARACTERISTIC
/begin CHARACTERISTIC ERRM_B1S1_SW_CNTS_DEN_GRP "bank1 up o2 switch counts denom group" VALUE 0x2886C __UWORD_S 0 u_den_grp 0 63 FORMAT "%1.0" BIT_MASK 0x003F SYMBOL_LINK "ERRM_CFG_ARRY" 2688 SYMBOL_LINK "ERRM_CFG_ARRY" 2370 /end CHARACTERISTIC
/begin CHARACTERISTIC ERRM_B1S1_SW_CNTS_DTC "bank1 up o2 switch counts DTC" VALUE 0x2886C __UWORD_S 0 u_cnts 0 65535 FORMAT "%5.0" SYMBOL_LINK "ERRM_CFG_ARRY" 2690 SYMBOL_LINK "ERRM_CFG_ARRY" 2372 /end CHARACTERISTIC
/begin CHARACTERISTIC ERRM_B1S1_RL_AVG_TYP "bank1 up o2 rich to lean time average type" VALUE 0x2886C __UWORD_S 0 u_diag_typ 0 8 FORMAT "%1.0" BIT_MASK 0xF000 SYMBOL_LINK "ERRM_CFG_ARRY" 2694 SYMBOL_LINK "ERRM_CFG_ARRY" 2376 /end CHARACTERISTIC
/begin CHARACTERISTIC ERRM_B1S1_RL_AVG_MIL_ON "bank1 up o2 rich to lean time average MIL on enable" VALUE 0x2886C __UWORD_S 0 b_true 0 1 FORMAT "%1.0" BIT_MASK 0x0800 SYMBOL_LINK "ERRM_CFG_ARRY" 2694 SYMBOL_LINK "ERRM_CFG_ARRY" 2376 /end CHARACTERISTIC
/begin CHARACTERISTIC ERRM_B1S1_RL_AVG_DEN_GRP "bank1 up o2 rich to lean time average denom group" VALUE 0x2886C __UWORD_S 0 u_den_grp 0 63 FORMAT "%1.0" BIT_MASK 0x003F SYMBOL_LINK "ERRM_CFG_ARRY" 2694 SYMBOL_LINK "ERRM_CFG_ARRY" 2376 /end CHARACTERISTIC
/begin CHARACTERISTIC ERRM_B1S1_RL_AVG_DTC "bank1 up o2 rich to lean time average DTC" VALUE 0x2886C __UWORD_S 0 u_cnts 0 65535 FORMAT "%5.0" SYMBOL_LINK "ERRM_CFG_ARRY" 2696 SYMBOL_LINK "ERRM_CFG_ARRY" 2378 /end CHARACTERISTIC
/begin CHARACTERISTIC ERRM_B1S1_LR_AVG_TYP "bank1 up o2 lean to rich time average type" VALUE 0x2886C __UWORD_S 0 u_diag_typ 0 8 FORMAT "%1.0" BIT_MASK 0xF000 SYMBOL_LINK "ERRM_CFG_ARRY" 2700 SYMBOL_LINK "ERRM_CFG_ARRY" 2382 /end CHARACTERISTIC
/begin CHARACTERISTIC ERRM_B1S1_LR_AVG_MIL_ON "bank1 up o2 lean to rich time average MIL on enable" VALUE 0x2886C __UWORD_S 0 b_true 0 1 FORMAT "%1.0" BIT_MASK 0x0800 SYMBOL_LINK "ERRM_CFG_ARRY" 2700 SYMBOL_LINK "ERRM_CFG_ARRY" 2382 /end CHARACTERISTIC
/begin CHARACTERISTIC ERRM_B1S1_LR_AVG_DEN_GRP "bank1 up o2 lean to rich time average denom group" VALUE 0x2886C __UWORD_S 0 u_den_grp 0 63 FORMAT "%1.0" BIT_MASK 0x003F SYMBOL_LINK "ERRM_CFG_ARRY" 2700 SYMBOL_LINK "ERRM_CFG_ARRY" 2382 /end CHARACTERISTIC
/begin CHARACTERISTIC ERRM_B1S1_LR_AVG_DTC "bank1 up o2 lean to rich time average DTC" VALUE 0x2886C __UWORD_S 0 u_cnts 0 65535 FORMAT "%5.0" SYMBOL_LINK "ERRM_CFG_ARRY" 2702 SYMBOL_LINK "ERRM_CFG_ARRY" 2384 /end CHARACTERISTIC
/begin CHARACTERISTIC ERRM_B1S1_RAT_TYP "bank1 up o2 time ratio type" VALUE 0x2886C __UWORD_S 0 u_diag_typ 0 8 FORMAT "%1.0" BIT_MASK 0xF000 SYMBOL_LINK "ERRM_CFG_ARRY" 2706 SYMBOL_LINK "ERRM_CFG_ARRY" 2388 /end CHARACTERISTIC
/begin CHARACTERISTIC ERRM_B1S1_RAT_MIL_ON "bank1 up o2 time ratio MIL on enable" VALUE 0x2886C __UWORD_S 0 b_true 0 1 FORMAT "%1.0" BIT_MASK 0x0800 SYMBOL_LINK "ERRM_CFG_ARRY" 2706 SYMBOL_LINK "ERRM_CFG_ARRY" 2388 /end CHARACTERISTIC
/begin CHARACTERISTIC ERRM_B1S1_RAT_DEN_GRP "bank1 up o2 time ratio denom group" VALUE 0x2886C __UWORD_S 0 u_den_grp 0 63 FORMAT "%1.0" BIT_MASK 0x003F SYMBOL_LINK "ERRM_CFG_ARRY" 2706 SYMBOL_LINK "ERRM_CFG_ARRY" 2388 /end CHARACTERISTIC
/begin CHARACTERISTIC ERRM_B1S1_RAT_DTC "bank1 up o2 time ratio DTC" VALUE 0x2886C __UWORD_S 0 u_cnts 0 65535 FORMAT "%5.0" SYMBOL_LINK "ERRM_CFG_ARRY" 2708 SYMBOL_LINK "ERRM_CFG_ARRY" 2390 /end CHARACTERISTIC
/begin CHARACTERISTIC ERRM_B1S1_UNDER_HT_TYP "bank1 up o2 under heater type" VALUE 0x2886C __UWORD_S 0 u_diag_typ 0 8 FORMAT "%1.0" BIT_MASK 0xF000 SYMBOL_LINK "ERRM_CFG_ARRY" 2730 SYMBOL_LINK "ERRM_CFG_ARRY" 2412 /end CHARACTERISTIC
/begin CHARACTERISTIC ERRM_B1S1_UNDER_HT_MIL_ON "bank1 up o2 under heater MIL on enable" VALUE 0x2886C __UWORD_S 0 b_true 0 1 FORMAT "%1.0" BIT_MASK 0x0800 SYMBOL_LINK "ERRM_CFG_ARRY" 2730 SYMBOL_LINK "ERRM_CFG_ARRY" 2412 /end CHARACTERISTIC
/begin CHARACTERISTIC ERRM_B1S1_UNDER_HT_DEN_GRP "bank1 up o2 under heater denom group" VALUE 0x2886C __UWORD_S 0 u_den_grp 0 63 FORMAT "%1.0" BIT_MASK 0x003F SYMBOL_LINK "ERRM_CFG_ARRY" 2730 SYMBOL_LINK "ERRM_CFG_ARRY" 2412 /end CHARACTERISTIC
/begin CHARACTERISTIC ERRM_B1S1_UNDER_HT_DTC "bank1 up o2 under heater DTC" VALUE 0x2886C __UWORD_S 0 u_cnts 0 65535 FORMAT "%5.0" SYMBOL_LINK "ERRM_CFG_ARRY" 2732 SYMBOL_LINK "ERRM_CFG_ARRY" 2414 /end CHARACTERISTIC
/begin CHARACTERISTIC ERRM_B1S2_UNDER_HT_TYP "bank1 down o2 under heater type" VALUE 0x2886C __UWORD_S 0 u_diag_typ 0 8 FORMAT "%1.0" BIT_MASK 0xF000 SYMBOL_LINK "ERRM_CFG_ARRY" 2736 SYMBOL_LINK "ERRM_CFG_ARRY" 2418 /end CHARACTERISTIC
/begin CHARACTERISTIC ERRM_B1S2_UNDER_HT_MIL_ON "bank1 down o2 under heater MIL on enable" VALUE 0x2886C __UWORD_S 0 b_true 0 1 FORMAT "%1.0" BIT_MASK 0x0800 SYMBOL_LINK "ERRM_CFG_ARRY" 2736 SYMBOL_LINK "ERRM_CFG_ARRY" 2418 /end CHARACTERISTIC
/begin CHARACTERISTIC ERRM_B1S2_UNDER_HT_DEN_GRP "bank1 down o2 under heater denom group" VALUE 0x2886C __UWORD_S 0 u_den_grp 0 63 FORMAT "%1.0" BIT_MASK 0x003F SYMBOL_LINK "ERRM_CFG_ARRY" 2736 SYMBOL_LINK "ERRM_CFG_ARRY" 2418 /end CHARACTERISTIC
/begin CHARACTERISTIC ERRM_B1S2_UNDER_HT_DTC "bank1 down o2 under heater DTC" VALUE 0x2886C __UWORD_S 0 u_cnts 0 65535 FORMAT "%5.0" SYMBOL_LINK "ERRM_CFG_ARRY" 2738 SYMBOL_LINK "ERRM_CFG_ARRY" 2420 /end CHARACTERISTIC
/begin CHARACTERISTIC ERRM_B1S1_OVER_HT_TYP "bank1 up o2 over heater type" VALUE 0x2886C __UWORD_S 0 u_diag_typ 0 8 FORMAT "%1.0" BIT_MASK 0xF000 SYMBOL_LINK "ERRM_CFG_ARRY" 2742 SYMBOL_LINK "ERRM_CFG_ARRY" 2424 /end CHARACTERISTIC
/begin CHARACTERISTIC ERRM_B1S1_OVER_HT_MIL_ON "bank1 up o2 over heater MIL on enable" VALUE 0x2886C __UWORD_S 0 b_true 0 1 FORMAT "%1.0" BIT_MASK 0x0800 SYMBOL_LINK "ERRM_CFG_ARRY" 2742 SYMBOL_LINK "ERRM_CFG_ARRY" 2424 /end CHARACTERISTIC
/begin CHARACTERISTIC ERRM_B1S1_OVER_HT_DEN_GRP "bank1 up o2 over heater denom group" VALUE 0x2886C __UWORD_S 0 u_den_grp 0 63 FORMAT "%1.0" BIT_MASK 0x003F SYMBOL_LINK "ERRM_CFG_ARRY" 2742 SYMBOL_LINK "ERRM_CFG_ARRY" 2424 /end CHARACTERISTIC
/begin CHARACTERISTIC ERRM_B1S1_OVER_HT_DTC "bank1 up o2 over heater DTC" VALUE 0x2886C __UWORD_S 0 u_cnts 0 65535 FORMAT "%5.0" SYMBOL_LINK "ERRM_CFG_ARRY" 2744 SYMBOL_LINK "ERRM_CFG_ARRY" 2426 /end CHARACTERISTIC
/begin CHARACTERISTIC ERRM_B1S2_OVER_HT_TYP "bank1 down o2 over heater type" VALUE 0x2886C __UWORD_S 0 u_diag_typ 0 8 FORMAT "%1.0" BIT_MASK 0xF000 SYMBOL_LINK "ERRM_CFG_ARRY" 2748 SYMBOL_LINK "ERRM_CFG_ARRY" 2430 /end CHARACTERISTIC
/begin CHARACTERISTIC ERRM_B1S2_OVER_HT_MIL_ON "bank1 down o2 over heater MIL on enable" VALUE 0x2886C __UWORD_S 0 b_true 0 1 FORMAT "%1.0" BIT_MASK 0x0800 SYMBOL_LINK "ERRM_CFG_ARRY" 2748 SYMBOL_LINK "ERRM_CFG_ARRY" 2430 /end CHARACTERISTIC
/begin CHARACTERISTIC ERRM_B1S2_OVER_HT_DEN_GRP "bank1 down o2 over heater denom group" VALUE 0x2886C __UWORD_S 0 u_den_grp 0 63 FORMAT "%1.0" BIT_MASK 0x003F SYMBOL_LINK "ERRM_CFG_ARRY" 2748 SYMBOL_LINK "ERRM_CFG_ARRY" 2430 /end CHARACTERISTIC
/begin CHARACTERISTIC ERRM_B1S2_OVER_HT_DTC "bank1 down o2 over heater DTC" VALUE 0x2886C __UWORD_S 0 u_cnts 0 65535 FORMAT "%5.0" SYMBOL_LINK "ERRM_CFG_ARRY" 2750 SYMBOL_LINK "ERRM_CFG_ARRY" 2432 /end CHARACTERISTIC
/begin CHARACTERISTIC ERRM_IMMO_AUTH_TYP "immo authentication type" VALUE 0x2886C __UWORD_S 0 u_diag_typ 0 8 FORMAT "%1.0" BIT_MASK 0xF000 SYMBOL_LINK "ERRM_CFG_ARRY" 2754 SYMBOL_LINK "ERRM_CFG_ARRY" 2436 /end CHARACTERISTIC
/begin CHARACTERISTIC ERRM_IMMO_AUTH_MIL_ON "immo authentication MIL on enable" VALUE 0x2886C __UWORD_S 0 b_true 0 1 FORMAT "%1.0" BIT_MASK 0x0800 SYMBOL_LINK "ERRM_CFG_ARRY" 2754 SYMBOL_LINK "ERRM_CFG_ARRY" 2436 /end CHARACTERISTIC
/begin CHARACTERISTIC ERRM_IMMO_AUTH_DEN_GRP "immo authentication denom group" VALUE 0x2886C __UWORD_S 0 u_den_grp 0 63 FORMAT "%1.0" BIT_MASK 0x003F SYMBOL_LINK "ERRM_CFG_ARRY" 2754 SYMBOL_LINK "ERRM_CFG_ARRY" 2436 /end CHARACTERISTIC
/begin CHARACTERISTIC ERRM_IMMO_AUTH_DTC "immo authentication DTC" VALUE 0x2886C __UWORD_S 0 u_cnts 0 65535 FORMAT "%5.0" SYMBOL_LINK "ERRM_CFG_ARRY" 2756 SYMBOL_LINK "ERRM_CFG_ARRY" 2438 /end CHARACTERISTIC
/begin CHARACTERISTIC ERRM_IMMO_RSP_TYP "immo reponse type" VALUE 0x2886C __UWORD_S 0 u_diag_typ 0 8 FORMAT "%1.0" BIT_MASK 0xF000 SYMBOL_LINK "ERRM_CFG_ARRY" 2760 SYMBOL_LINK "ERRM_CFG_ARRY" 2442 /end CHARACTERISTIC
/begin CHARACTERISTIC ERRM_IMMO_RSP_MIL_ON "immo reponse MIL on enable" VALUE 0x2886C __UWORD_S 0 b_true 0 1 FORMAT "%1.0" BIT_MASK 0x0800 SYMBOL_LINK "ERRM_CFG_ARRY" 2760 SYMBOL_LINK "ERRM_CFG_ARRY" 2442 /end CHARACTERISTIC
/begin CHARACTERISTIC ERRM_IMMO_RSP_DEN_GRP "immo reponse denom group" VALUE 0x2886C __UWORD_S 0 u_den_grp 0 63 FORMAT "%1.0" BIT_MASK 0x003F SYMBOL_LINK "ERRM_CFG_ARRY" 2760 SYMBOL_LINK "ERRM_CFG_ARRY" 2442 /end CHARACTERISTIC
/begin CHARACTERISTIC ERRM_IMMO_RSP_DTC "immo reponse DTC" VALUE 0x2886C __UWORD_S 0 u_cnts 0 65535 FORMAT "%5.0" SYMBOL_LINK "ERRM_CFG_ARRY" 2762 SYMBOL_LINK "ERRM_CFG_ARRY" 2444 /end CHARACTERISTIC
/begin CHARACTERISTIC ERRM_IMMO_ECM_LRN_TYP "immo key learned type" VALUE 0x2886C __UWORD_S 0 u_diag_typ 0 8 FORMAT "%1.0" BIT_MASK 0xF000 SYMBOL_LINK "ERRM_CFG_ARRY" 2766 SYMBOL_LINK "ERRM_CFG_ARRY" 2448 /end CHARACTERISTIC
/begin CHARACTERISTIC ERRM_IMMO_ECM_LRN_MIL_ON "immo key learned MIL on enable" VALUE 0x2886C __UWORD_S 0 b_true 0 1 FORMAT "%1.0" BIT_MASK 0x0800 SYMBOL_LINK "ERRM_CFG_ARRY" 2766 SYMBOL_LINK "ERRM_CFG_ARRY" 2448 /end CHARACTERISTIC
/begin CHARACTERISTIC ERRM_IMMO_ECM_LRN_DEN_GRP "immo key learned denom group" VALUE 0x2886C __UWORD_S 0 u_den_grp 0 63 FORMAT "%1.0" BIT_MASK 0x003F SYMBOL_LINK "ERRM_CFG_ARRY" 2766 SYMBOL_LINK "ERRM_CFG_ARRY" 2448 /end CHARACTERISTIC
/begin CHARACTERISTIC ERRM_IMMO_ECM_LRN_DTC "immo key learned DTC" VALUE 0x2886C __UWORD_S 0 u_cnts 0 65535 FORMAT "%5.0" SYMBOL_LINK "ERRM_CFG_ARRY" 2768 SYMBOL_LINK "ERRM_CFG_ARRY" 2450 /end CHARACTERISTIC
/begin CHARACTERISTIC ERRM_STRT_RLY_OPN_TYP "starter relay open type" VALUE 0x2886C __UWORD_S 0 u_diag_typ 0 8 FORMAT "%1.0" BIT_MASK 0xF000 SYMBOL_LINK "ERRM_CFG_ARRY" 2826 SYMBOL_LINK "ERRM_CFG_ARRY" 2508 /end CHARACTERISTIC
/begin CHARACTERISTIC ERRM_STRT_RLY_OPN_MIL_ON "starter relay open MIL on enable" VALUE 0x2886C __UWORD_S 0 b_true 0 1 FORMAT "%1.0" BIT_MASK 0x0800 SYMBOL_LINK "ERRM_CFG_ARRY" 2826 SYMBOL_LINK "ERRM_CFG_ARRY" 2508 /end CHARACTERISTIC
/begin CHARACTERISTIC ERRM_STRT_RLY_OPN_DEN_GRP "starter relay open denom group" VALUE 0x2886C __UWORD_S 0 u_den_grp 0 63 FORMAT "%1.0" BIT_MASK 0x003F SYMBOL_LINK "ERRM_CFG_ARRY" 2826 SYMBOL_LINK "ERRM_CFG_ARRY" 2508 /end CHARACTERISTIC
/begin CHARACTERISTIC ERRM_STRT_RLY_OPN_DTC "starter relay open DTC" VALUE 0x2886C __UWORD_S 0 u_cnts 0 65535 FORMAT "%5.0" SYMBOL_LINK "ERRM_CFG_ARRY" 2828 SYMBOL_LINK "ERRM_CFG_ARRY" 2510 /end CHARACTERISTIC
/begin CHARACTERISTIC ERRM_STRT_RLY_STCK_TYP "starter relay stuck type" VALUE 0x2886C __UWORD_S 0 u_diag_typ 0 8 FORMAT "%1.0" BIT_MASK 0xF000 SYMBOL_LINK "ERRM_CFG_ARRY" 2832 SYMBOL_LINK "ERRM_CFG_ARRY" 2514 /end CHARACTERISTIC
/begin CHARACTERISTIC ERRM_STRT_RLY_STCK_MIL_ON "starter relay stuck MIL on enable" VALUE 0x2886C __UWORD_S 0 b_true 0 1 FORMAT "%1.0" BIT_MASK 0x0800 SYMBOL_LINK "ERRM_CFG_ARRY" 2832 SYMBOL_LINK "ERRM_CFG_ARRY" 2514 /end CHARACTERISTIC
/begin CHARACTERISTIC ERRM_STRT_RLY_STCK_DEN_GRP "starter relay stuck denom group" VALUE 0x2886C __UWORD_S 0 u_den_grp 0 63 FORMAT "%1.0" BIT_MASK 0x003F SYMBOL_LINK "ERRM_CFG_ARRY" 2832 SYMBOL_LINK "ERRM_CFG_ARRY" 2514 /end CHARACTERISTIC
/begin CHARACTERISTIC ERRM_STRT_RLY_STCK_DTC "starter relay stuck DTC" VALUE 0x2886C __UWORD_S 0 u_cnts 0 65535 FORMAT "%5.0" SYMBOL_LINK "ERRM_CFG_ARRY" 2834 SYMBOL_LINK "ERRM_CFG_ARRY" 2516 /end CHARACTERISTIC
/begin CHARACTERISTIC ERRM_TRN_RLY_STCK_TYP "drive train relay stuck type" VALUE 0x2886C __UWORD_S 0 u_diag_typ 0 8 FORMAT "%1.0" BIT_MASK 0xF000 SYMBOL_LINK "ERRM_CFG_ARRY" 2838 SYMBOL_LINK "ERRM_CFG_ARRY" 2520 /end CHARACTERISTIC
/begin CHARACTERISTIC ERRM_TRN_RLY_STCK_MIL_ON "drive train relay stuck MIL on enable" VALUE 0x2886C __UWORD_S 0 b_true 0 1 FORMAT "%1.0" BIT_MASK 0x0800 SYMBOL_LINK "ERRM_CFG_ARRY" 2838 SYMBOL_LINK "ERRM_CFG_ARRY" 2520 /end CHARACTERISTIC
/begin CHARACTERISTIC ERRM_TRN_RLY_STCK_DEN_GRP "drive train relay stuck denom group" VALUE 0x2886C __UWORD_S 0 u_den_grp 0 63 FORMAT "%1.0" BIT_MASK 0x003F SYMBOL_LINK "ERRM_CFG_ARRY" 2838 SYMBOL_LINK "ERRM_CFG_ARRY" 2520 /end CHARACTERISTIC
/begin CHARACTERISTIC ERRM_TRN_RLY_STCK_DTC "drive train relay stuck DTC" VALUE 0x2886C __UWORD_S 0 u_cnts 0 65535 FORMAT "%5.0" SYMBOL_LINK "ERRM_CFG_ARRY" 2840 SYMBOL_LINK "ERRM_CFG_ARRY" 2522 /end CHARACTERISTIC
/begin CHARACTERISTIC ERRM_STRT_ST_OPN_TYP "starter state open type" VALUE 0x2886C __UWORD_S 0 u_diag_typ 0 8 FORMAT "%1.0" BIT_MASK 0xF000 SYMBOL_LINK "ERRM_CFG_ARRY" 2844 SYMBOL_LINK "ERRM_CFG_ARRY" 2526 /end CHARACTERISTIC
/begin CHARACTERISTIC ERRM_STRT_ST_OPN_MIL_ON "starter state open  MIL on enable" VALUE 0x2886C __UWORD_S 0 b_true 0 1 FORMAT "%1.0" BIT_MASK 0x0800 SYMBOL_LINK "ERRM_CFG_ARRY" 2844 SYMBOL_LINK "ERRM_CFG_ARRY" 2526 /end CHARACTERISTIC
/begin CHARACTERISTIC ERRM_STRT_ST_OPN_DEN_GRP "starter state open denom group" VALUE 0x2886C __UWORD_S 0 u_den_grp 0 63 FORMAT "%1.0" BIT_MASK 0x003F SYMBOL_LINK "ERRM_CFG_ARRY" 2844 SYMBOL_LINK "ERRM_CFG_ARRY" 2526 /end CHARACTERISTIC
/begin CHARACTERISTIC ERRM_STRT_ST_OPN_DTC "starter state open DTC" VALUE 0x2886C __UWORD_S 0 u_cnts 0 65535 FORMAT "%5.0" SYMBOL_LINK "ERRM_CFG_ARRY" 2846 SYMBOL_LINK "ERRM_CFG_ARRY" 2528 /end CHARACTERISTIC
/begin CHARACTERISTIC ERRM_STRT_DMG_TYP "starter damage type" VALUE 0x2886C __UWORD_S 0 u_diag_typ 0 8 FORMAT "%1.0" BIT_MASK 0xF000 SYMBOL_LINK "ERRM_CFG_ARRY" 2850 SYMBOL_LINK "ERRM_CFG_ARRY" 2532 /end CHARACTERISTIC
/begin CHARACTERISTIC ERRM_STRT_DMG_MIL_ON "starter damage MIL on enable" VALUE 0x2886C __UWORD_S 0 b_true 0 1 FORMAT "%1.0" BIT_MASK 0x0800 SYMBOL_LINK "ERRM_CFG_ARRY" 2850 SYMBOL_LINK "ERRM_CFG_ARRY" 2532 /end CHARACTERISTIC
/begin CHARACTERISTIC ERRM_STRT_DMG_DEN_GRP "starter damage denom group" VALUE 0x2886C __UWORD_S 0 u_den_grp 0 63 FORMAT "%1.0" BIT_MASK 0x003F SYMBOL_LINK "ERRM_CFG_ARRY" 2850 SYMBOL_LINK "ERRM_CFG_ARRY" 2532 /end CHARACTERISTIC
/begin CHARACTERISTIC ERRM_STRT_DMG_DTC "starter damage DTC" VALUE 0x2886C __UWORD_S 0 u_cnts 0 65535 FORMAT "%5.0" SYMBOL_LINK "ERRM_CFG_ARRY" 2852 SYMBOL_LINK "ERRM_CFG_ARRY" 2534 /end CHARACTERISTIC
/begin CHARACTERISTIC ERRM_DRV_TRN_LO_TYP "drive train short low type" VALUE 0x2886C __UWORD_S 0 u_diag_typ 0 8 FORMAT "%1.0" BIT_MASK 0xF000 SYMBOL_LINK "ERRM_CFG_ARRY" 2856 SYMBOL_LINK "ERRM_CFG_ARRY" 2538 /end CHARACTERISTIC
/begin CHARACTERISTIC ERRM_DRV_TRN_LO_MIL_ON "drive train short low MIL on enable" VALUE 0x2886C __UWORD_S 0 b_true 0 1 FORMAT "%1.0" BIT_MASK 0x0800 SYMBOL_LINK "ERRM_CFG_ARRY" 2856 SYMBOL_LINK "ERRM_CFG_ARRY" 2538 /end CHARACTERISTIC
/begin CHARACTERISTIC ERRM_DRV_TRN_LO_DEN_GRP "drive train short low denom group" VALUE 0x2886C __UWORD_S 0 u_den_grp 0 63 FORMAT "%1.0" BIT_MASK 0x003F SYMBOL_LINK "ERRM_CFG_ARRY" 2856 SYMBOL_LINK "ERRM_CFG_ARRY" 2538 /end CHARACTERISTIC
/begin CHARACTERISTIC ERRM_DRV_TRN_LO_DTC "drive train short low DTC" VALUE 0x2886C __UWORD_S 0 u_cnts 0 65535 FORMAT "%5.0" SYMBOL_LINK "ERRM_CFG_ARRY" 2858 SYMBOL_LINK "ERRM_CFG_ARRY" 2540 /end CHARACTERISTIC
/begin CHARACTERISTIC ERRM_DRV_TRN_HI_TYP "drive train short high type" VALUE 0x2886C __UWORD_S 0 u_diag_typ 0 8 FORMAT "%1.0" BIT_MASK 0xF000 SYMBOL_LINK "ERRM_CFG_ARRY" 2862 SYMBOL_LINK "ERRM_CFG_ARRY" 2544 /end CHARACTERISTIC
/begin CHARACTERISTIC ERRM_DRV_TRN_HI_MIL_ON "drive train short high MIL on enable" VALUE 0x2886C __UWORD_S 0 b_true 0 1 FORMAT "%1.0" BIT_MASK 0x0800 SYMBOL_LINK "ERRM_CFG_ARRY" 2862 SYMBOL_LINK "ERRM_CFG_ARRY" 2544 /end CHARACTERISTIC
/begin CHARACTERISTIC ERRM_DRV_TRN_HI_DEN_GRP "drive train short high denom group" VALUE 0x2886C __UWORD_S 0 u_den_grp 0 63 FORMAT "%1.0" BIT_MASK 0x003F SYMBOL_LINK "ERRM_CFG_ARRY" 2862 SYMBOL_LINK "ERRM_CFG_ARRY" 2544 /end CHARACTERISTIC
/begin CHARACTERISTIC ERRM_DRV_TRN_HI_DTC "drive train short high DTC" VALUE 0x2886C __UWORD_S 0 u_cnts 0 65535 FORMAT "%5.0" SYMBOL_LINK "ERRM_CFG_ARRY" 2864 SYMBOL_LINK "ERRM_CFG_ARRY" 2546 /end CHARACTERISTIC
/begin CHARACTERISTIC ERRM_DRV_TRN_STCKLO_TYP "drive train stuck low type" VALUE 0x2886C __UWORD_S 0 u_diag_typ 0 8 FORMAT "%1.0" BIT_MASK 0xF000 SYMBOL_LINK "ERRM_CFG_ARRY" 2868 SYMBOL_LINK "ERRM_CFG_ARRY" 2550 /end CHARACTERISTIC
/begin CHARACTERISTIC ERRM_DRV_TRN_STCKLO_MIL_ON "drive train stuck low MIL on enable" VALUE 0x2886C __UWORD_S 0 b_true 0 1 FORMAT "%1.0" BIT_MASK 0x0800 SYMBOL_LINK "ERRM_CFG_ARRY" 2868 SYMBOL_LINK "ERRM_CFG_ARRY" 2550 /end CHARACTERISTIC
/begin CHARACTERISTIC ERRM_DRV_TRN_STCKLO_DEN_GRP "drive train stuck low denom group" VALUE 0x2886C __UWORD_S 0 u_den_grp 0 63 FORMAT "%1.0" BIT_MASK 0x003F SYMBOL_LINK "ERRM_CFG_ARRY" 2868 SYMBOL_LINK "ERRM_CFG_ARRY" 2550 /end CHARACTERISTIC
/begin CHARACTERISTIC ERRM_DRV_TRN_STCKLO_DTC "drive train stuck low DTC" VALUE 0x2886C __UWORD_S 0 u_cnts 0 65535 FORMAT "%5.0" SYMBOL_LINK "ERRM_CFG_ARRY" 2870 SYMBOL_LINK "ERRM_CFG_ARRY" 2552 /end CHARACTERISTIC
/begin CHARACTERISTIC ERRM_DRV_TRN_STCKHI_TYP "drive train stuck high type" VALUE 0x2886C __UWORD_S 0 u_diag_typ 0 8 FORMAT "%1.0" BIT_MASK 0xF000 SYMBOL_LINK "ERRM_CFG_ARRY" 2874 SYMBOL_LINK "ERRM_CFG_ARRY" 2556 /end CHARACTERISTIC
/begin CHARACTERISTIC ERRM_DRV_TRN_STCKHI_MIL_ON "drive train stuck high MIL on enable" VALUE 0x2886C __UWORD_S 0 b_true 0 1 FORMAT "%1.0" BIT_MASK 0x0800 SYMBOL_LINK "ERRM_CFG_ARRY" 2874 SYMBOL_LINK "ERRM_CFG_ARRY" 2556 /end CHARACTERISTIC
/begin CHARACTERISTIC ERRM_DRV_TRN_STCKHI_DEN_GRP "drive train stuck high denom group" VALUE 0x2886C __UWORD_S 0 u_den_grp 0 63 FORMAT "%1.0" BIT_MASK 0x003F SYMBOL_LINK "ERRM_CFG_ARRY" 2874 SYMBOL_LINK "ERRM_CFG_ARRY" 2556 /end CHARACTERISTIC
/begin CHARACTERISTIC ERRM_DRV_TRN_STCKHI_DTC "drive train stuck high DTC" VALUE 0x2886C __UWORD_S 0 u_cnts 0 65535 FORMAT "%5.0" SYMBOL_LINK "ERRM_CFG_ARRY" 2876 SYMBOL_LINK "ERRM_CFG_ARRY" 2558 /end CHARACTERISTIC
/begin CHARACTERISTIC ERRM_PWM_PMP_HI_TYP "pwm warter pump short high type" VALUE 0x2886C __UWORD_S 0 u_diag_typ 0 8 FORMAT "%1.0" BIT_MASK 0xF000 SYMBOL_LINK "ERRM_CFG_ARRY" 2886 SYMBOL_LINK "ERRM_CFG_ARRY" 2568 /end CHARACTERISTIC
/begin CHARACTERISTIC ERRM_PWM_PMP_HI_MIL_ON "pwm warter pump short high MIL on enable" VALUE 0x2886C __UWORD_S 0 b_true 0 1 FORMAT "%1.0" BIT_MASK 0x0800 SYMBOL_LINK "ERRM_CFG_ARRY" 2886 SYMBOL_LINK "ERRM_CFG_ARRY" 2568 /end CHARACTERISTIC
/begin CHARACTERISTIC ERRM_PWM_PMP_HI_DEN_GRP "pwm warter pump short high denom group" VALUE 0x2886C __UWORD_S 0 u_den_grp 0 63 FORMAT "%1.0" BIT_MASK 0x003F SYMBOL_LINK "ERRM_CFG_ARRY" 2886 SYMBOL_LINK "ERRM_CFG_ARRY" 2568 /end CHARACTERISTIC
/begin CHARACTERISTIC ERRM_PWM_PMP_HI_DTC "pwm warter pump short high DTC" VALUE 0x2886C __UWORD_S 0 u_cnts 0 65535 FORMAT "%5.0" SYMBOL_LINK "ERRM_CFG_ARRY" 2888 SYMBOL_LINK "ERRM_CFG_ARRY" 2570 /end CHARACTERISTIC
/begin CHARACTERISTIC ERRM_PWM_PMP_LO_TYP "pwm warter pump short low type" VALUE 0x2886C __UWORD_S 0 u_diag_typ 0 8 FORMAT "%1.0" BIT_MASK 0xF000 SYMBOL_LINK "ERRM_CFG_ARRY" 2892 SYMBOL_LINK "ERRM_CFG_ARRY" 2574 /end CHARACTERISTIC
/begin CHARACTERISTIC ERRM_PWM_PMP_LO_MIL_ON "pwm warter pump short low MIL on enable" VALUE 0x2886C __UWORD_S 0 b_true 0 1 FORMAT "%1.0" BIT_MASK 0x0800 SYMBOL_LINK "ERRM_CFG_ARRY" 2892 SYMBOL_LINK "ERRM_CFG_ARRY" 2574 /end CHARACTERISTIC
/begin CHARACTERISTIC ERRM_PWM_PMP_LO_DEN_GRP "pwm warter pump short low denom group" VALUE 0x2886C __UWORD_S 0 u_den_grp 0 63 FORMAT "%1.0" BIT_MASK 0x003F SYMBOL_LINK "ERRM_CFG_ARRY" 2892 SYMBOL_LINK "ERRM_CFG_ARRY" 2574 /end CHARACTERISTIC
/begin CHARACTERISTIC ERRM_PWM_PMP_LO_DTC "pwm warter pump short low DTC" VALUE 0x2886C __UWORD_S 0 u_cnts 0 65535 FORMAT "%5.0" SYMBOL_LINK "ERRM_CFG_ARRY" 2894 SYMBOL_LINK "ERRM_CFG_ARRY" 2576 /end CHARACTERISTIC
/begin CHARACTERISTIC ERRM_PWM_PMP_OPN_TYP "pwm warter pump open type" VALUE 0x2886C __UWORD_S 0 u_diag_typ 0 8 FORMAT "%1.0" BIT_MASK 0xF000 SYMBOL_LINK "ERRM_CFG_ARRY" 2898 SYMBOL_LINK "ERRM_CFG_ARRY" 2580 /end CHARACTERISTIC
/begin CHARACTERISTIC ERRM_PWM_PMP_OPN_MIL_ON "pwm warter pump open MIL on enable" VALUE 0x2886C __UWORD_S 0 b_true 0 1 FORMAT "%1.0" BIT_MASK 0x0800 SYMBOL_LINK "ERRM_CFG_ARRY" 2898 SYMBOL_LINK "ERRM_CFG_ARRY" 2580 /end CHARACTERISTIC
/begin CHARACTERISTIC ERRM_PWM_PMP_OPN_DEN_GRP "pwm warter pump open denom group" VALUE 0x2886C __UWORD_S 0 u_den_grp 0 63 FORMAT "%1.0" BIT_MASK 0x003F SYMBOL_LINK "ERRM_CFG_ARRY" 2898 SYMBOL_LINK "ERRM_CFG_ARRY" 2580 /end CHARACTERISTIC
/begin CHARACTERISTIC ERRM_PWM_PMP_OPN_DTC "pwm warter pump open DTC" VALUE 0x2886C __UWORD_S 0 u_cnts 0 65535 FORMAT "%5.0" SYMBOL_LINK "ERRM_CFG_ARRY" 2900 SYMBOL_LINK "ERRM_CFG_ARRY" 2582 /end CHARACTERISTIC
/begin CHARACTERISTIC ERRM_FUEL_CAP_OPN_TYP "fuel cap open type" VALUE 0x2886C __UWORD_S 0 u_diag_typ 0 8 FORMAT "%1.0" BIT_MASK 0xF000 SYMBOL_LINK "ERRM_CFG_ARRY" 2478 SYMBOL_LINK "ERRM_CFG_ARRY" 2160 /end CHARACTERISTIC
/begin CHARACTERISTIC ERRM_FUEL_CAP_OPN_MIL_ON "fuel cap open MIL on enable" VALUE 0x2886C __UWORD_S 0 b_true 0 1 FORMAT "%1.0" BIT_MASK 0x0800 SYMBOL_LINK "ERRM_CFG_ARRY" 2478 SYMBOL_LINK "ERRM_CFG_ARRY" 2160 /end CHARACTERISTIC
/begin CHARACTERISTIC ERRM_FUEL_CAP_OPN_DEN_GRP "fuel cap open denom group" VALUE 0x2886C __UWORD_S 0 u_den_grp 0 63 FORMAT "%1.0" BIT_MASK 0x003F SYMBOL_LINK "ERRM_CFG_ARRY" 2478 SYMBOL_LINK "ERRM_CFG_ARRY" 2160 /end CHARACTERISTIC
/begin CHARACTERISTIC ERRM_FUEL_CAP_OPN_DTC "fuel cap open DTC" VALUE 0x2886C __UWORD_S 0 u_cnts 0 65535 FORMAT "%5.0" SYMBOL_LINK "ERRM_CFG_ARRY" 2480 SYMBOL_LINK "ERRM_CFG_ARRY" 2162 /end CHARACTERISTIC
/begin CHARACTERISTIC ERRM_V_MF_SML_ECT_LO "misfire similar conditions ECT low" VALUE 0x0002038C __SWORD_S 0 u_deg_C -256 255.9921875 /end CHARACTERISTIC
/begin CHARACTERISTIC ERRM_V_MF_SML_ECT_HI "misfire similar conditions ECT high" VALUE 0x0002038C __SWORD_S 0 u_deg_C -256 255.9921875 /end CHARACTERISTIC
/begin CHARACTERISTIC ERRM_V_WRM_ECT "warm up conditions ECT thr" VALUE 0x0002038C __SWORD_S 0 u_deg_C -256 255.9921875 /end CHARACTERISTIC
/begin CHARACTERISTIC ERRM_V_MF_MIL_FLSH_LD_THR "misfire mill flash load thr" VALUE 0x0002038C __UWORD_S 0 u_pct_1 0 99.9984741210937 /end CHARACTERISTIC
/begin CHARACTERISTIC ERRM_V_MF_MIL_FLSH_ESPD_THR "misfire mill flash load thr" VALUE 0x0002038C __UWORD_S 0 u_espd 0 8191.875 FORMAT "%5.1" /end CHARACTERISTIC
/begin CHARACTERISTIC ERRM_V_MF_SML_DUR "misfire similar conditions confirm duration min" VALUE 0x0002038C __UWORD_S 0 u_4x_tmr 0 2047.96875 FORMAT "%4.2" /end CHARACTERISTIC
/begin CHARACTERISTIC ERRM_V_EVAM_IUPR_INC_IAT_MAX "EVAM iupr den increase enable IAT max" VALUE 0x0002038C __SWORD_S 0 u_deg_C -256 255.9921875 /end CHARACTERISTIC
/begin CHARACTERISTIC ERRM_V_EVAM_IUPR_INC_IAT_MIN "EVAM iupr den increase enable IAT min" VALUE 0x0002038C __SWORD_S 0 u_deg_C -256 255.9921875 /end CHARACTERISTIC
/begin CHARACTERISTIC ERRM_V_EVAM_IUPR_INC_RUN_MIN "EVAM iupr den increase enable run min" VALUE 0x0002038C __UWORD_S 0 u_16x_tmr 0 8191.875 FORMAT "%6.2" /end CHARACTERISTIC
/begin CHARACTERISTIC ERRM_V_EVAM_IUPR_KEYON_ECT_MIN "EVAM iupr den increase enable keyon ect min" VALUE 0x0002038C __SWORD_S 0 u_deg_C -256 255.9921875 /end CHARACTERISTIC
/begin CHARACTERISTIC ERRM_V_EVAM_IUPR_KEYON_ECT_MAX "EVAM iupr den increase enable keyon ect max" VALUE 0x0002038C __SWORD_S 0 u_deg_C -256 255.9921875 /end CHARACTERISTIC
/begin CHARACTERISTIC ERRM_V_EVAM_IUPR_AMB_T_DLT "key on ECT and key on IAT delta to determine startup temp" VALUE 0x0002038C __SWORD_S 0 u_deg_C -256 255.9921875 /end CHARACTERISTIC
/begin CHARACTERISTIC ERRM_V_IUPR_AMP_MIN "iupr den inc enable amp min" VALUE 0x0002038C __UWORD_S 0 u_kPa_0_256 0 255.99609375 /end CHARACTERISTIC
/begin COMPU_METHOD u_kPa_0_256 "press" RAT_FUNC "%5.2" "kPa" COEFFS 0.0 1.0 0.000000 0.0 0.0 0.00390625 /end COMPU_METHOD
/begin COMPU_METHOD u_deg_C "degC" RAT_FUNC "%5.2" "¡æ" COEFFS 0.0 1.0 0.0 0.0 0.0 0.0078125 /end COMPU_METHOD
/begin COMPU_METHOD u_cnts "counts" RAT_FUNC "%3.0" "cnts" COEFFS 0.0 1.0 0.0 0.0 0.0 1.0 /end COMPU_METHOD
/begin COMPU_METHOD u_4x_tmr "31.2 timer" RAT_FUNC "%6.2" "s" COEFFS 0.0 1.0 0.0 0.0 0.0 0.03125 /end COMPU_METHOD
/begin COMPU_METHOD u_16x_tmr "125 timer" RAT_FUNC "%5.1" "s" COEFFS 0.0 1.0 0.0 0.0 0.0 0.125 /end COMPU_METHOD
/begin COMPU_METHOD b_true "" TAB_VERB "%6.3" "" COMPU_TAB_REF b_true /end COMPU_METHOD
/begin COMPU_VTAB b_true "" TAB_VERB 2 0 "FALSE" 1 "TRUE" /end COMPU_VTAB
/begin COMPU_METHOD u_espd "engine speed" RAT_FUNC "%5.2" "rpm" COEFFS 0.0 1.0 0.000000 0.0 0.0 0.125 /end COMPU_METHOD
/begin COMPU_METHOD u_pct_1 "percentage" RAT_FUNC "%5.2" "%" COEFFS 0.0 1.0 0.000000 0.0 0.0 0.00152587890625 /end COMPU_METHOD
/begin COMPU_METHOD u_diag_typ "" TAB_VERB "%5.0" "" COMPU_TAB_REF u_diag_typ /end COMPU_METHOD
/begin COMPU_VTAB u_diag_typ "" TAB_VERB 5 0 "BYPASS" 1 "LIGHT_SVS" 2 "LIGHT_3RD_TRIP" 4 "LIGHT_2ND_TRIP" 8 "LIGHT_1ST_TRIP" /end COMPU_VTAB
/begin COMPU_METHOD u_den_grp "" TAB_VERB "%5.0" "" COMPU_TAB_REF u_den_grp /end COMPU_METHOD
/begin COMPU_VTAB u_den_grp "" TAB_VERB 34 0 "INTERNAL_USE" 1 "GENERIC" 2 "B1_CFD" 3 "B2_CFD" 4 "EGR_FLW" 5 "B1_EXH_CAM_ST" 6 "B1_EXH_VVT_STUK" 7 "B1_EXH_VVT_POS" 8 "B1_EXH_VVT_RESP" 9 "B2_EXH_CAM_ST" 10 "B2_EXH_VVT_STUK" 11 "B2_EXH_VVT_POS" 12 "B2_EXH_VVT_RESP" 13 "B1_INTK_CAM_ST" 14 "B1_INTK_VVT_STUK" 15 "B1_INTK_VVT_POS" 16 "B1_INTK_VVT_RESP" 17 "B2_INTK_CAM_ST" 18 "B2_INTK_VVT_STUK" 19 "B2_INTK_VVT_POS" 20 "B2_INTK_VVT_RESP" 21 "EVAM_PURGE_FLOW" 22 "EVAM_SMALL_LEAK" 23 "B1S1_RSP_SW_TMS" 24 "B1S1_RSP_RCH_LEAN" 25 "B1S1_RSP_LEAN_RCH" 26 "B1S1_RSP_RATIO" 27 "" 28 "" 29 "" 30 "B1S2_PUC_RESP" 31 "B1S2_POW_RESP" 32 "B1_SECOND_AIR" 33 "B2_SECOND_AIR" /end COMPU_VTAB
/begin FUNCTION errm ""
 /begin DEF_CHARACTERISTIC ERRM_MISFIRE_TYP ERRM_MISFIRE_MIL_ON ERRM_MISFIRE_DEN_GRP ERRM_MISFIRE_DTC ERRM_VOLT_HI_TYP ERRM_VOLT_HI_MIL_ON ERRM_VOLT_HI_DEN_GRP ERRM_VOLT_HI_DTC ERRM_VOLT_LO_TYP ERRM_VOLT_LO_MIL_ON ERRM_VOLT_LO_DEN_GRP ERRM_VOLT_LO_DTC ERRM_TANK_P_HI_TYP ERRM_TANK_P_HI_MIL_ON ERRM_TANK_P_HI_DEN_GRP ERRM_TANK_P_HI_DTC ERRM_TANK_P_LO_TYP ERRM_TANK_P_LO_MIL_ON ERRM_TANK_P_LO_DEN_GRP ERRM_TANK_P_LO_DTC ERRM_TANK_P_STCK_TYP ERRM_TANK_P_STCK_MIL_ON ERRM_TANK_P_STCK_DEN_GRP ERRM_TANK_P_STCK_DTC ERRM_TANK_P_NOISE_TYP ERRM_TANK_P_NOISE_MIL_ON ERRM_TANK_P_NOISE_DEN_GRP ERRM_TANK_P_NOISE_DTC ERRM_CRK_LRN_TYP ERRM_CRK_LRN_MIL_ON ERRM_CRK_LRN_DEN_GRP ERRM_CRK_LRN_DTC ERRM_VSPD_OPN_TYP ERRM_VSPD_OPN_MIL_ON ERRM_VSPD_OPN_DEN_GRP ERRM_VSPD_OPN_DTC ERRM_B1_EXH_CAM_TH_TYP ERRM_B1_EXH_CAM_TH_MIL_ON ERRM_B1_EXH_CAM_TH_DEN_GRP ERRM_B1_EXH_CAM_TH_DTC ERRM_B1_EXH_CAM_COR_TYP ERRM_B1_EXH_CAM_COR_MIL_ON ERRM_B1_EXH_CAM_COR_DEN_GRP ERRM_B1_EXH_CAM_COR_DTC ERRM_B1_EXH_VVT_STCK_TYP ERRM_B1_EXH_VVT_STCK_MIL_ON ERRM_B1_EXH_VVT_STCK_DEN_GRP ERRM_B1_EXH_VVT_STCK_DTC ERRM_B1_EXH_CAM_SLW_TYP ERRM_B1_EXH_CAM_SLW_MIL_ON ERRM_B1_EXH_CAM_SLW_DEN_GRP ERRM_B1_EXH_CAM_SLW_DTC ERRM_B1_EXH_VVT_PERF_TYP ERRM_B1_EXH_VVT_PERF_MIL_ON ERRM_B1_EXH_VVT_PERF_DEN_GRP ERRM_B1_EXH_VVT_PERF_DTC ERRM_B1_INTK_CAM_TH_TYP ERRM_B1_INTK_CAM_TH_MIL_ON ERRM_B1_INTK_CAM_TH_DEN_GRP ERRM_B1_INTK_CAM_TH_DTC ERRM_B1_INTK_CAM_COR_TYP ERRM_B1_INTK_CAM_COR_MIL_ON ERRM_B1_INTK_CAM_COR_DEN_GRP ERRM_B1_INTK_CAM_COR_DTC ERRM_B1_INTK_VVT_STCK_TYP ERRM_B1_INTK_VVT_STCK_MIL_ON ERRM_B1_INTK_VVT_STCK_DEN_GRP ERRM_B1_INTK_VVT_STCK_DTC ERRM_B1_INTK_CAM_SLW_TYP ERRM_B1_INTK_CAM_SLW_MIL_ON ERRM_B1_INTK_CAM_SLW_DEN_GRP ERRM_B1_INTK_CAM_SLW_DTC ERRM_B1_INTK_VVT_PERF_TYP ERRM_B1_INTK_VVT_PERF_MIL_ON ERRM_B1_INTK_VVT_PERF_DEN_GRP ERRM_B1_INTK_VVT_PERF_DTC ERRM_FAN1_CIRCUIT_TYP ERRM_FAN1_CIRCUIT_MIL_ON ERRM_FAN1_CIRCUIT_DEN_GRP ERRM_FAN1_CIRCUIT_DTC ERRM_FAN2_CIRCUIT_TYP ERRM_FAN2_CIRCUIT_MIL_ON ERRM_FAN2_CIRCUIT_DEN_GRP ERRM_FAN2_CIRCUIT_DTC ERRM_PWM_FAN_TYP ERRM_PWM_FAN_MIL_ON ERRM_PWM_FAN_DEN_GRP ERRM_PWM_FAN_DTC ERRM_ECM_COP_TYP ERRM_ECM_COP_MIL_ON ERRM_ECM_COP_DEN_GRP ERRM_ECM_COP_DTC ERRM_MPR_CIRCUIT_TYP ERRM_MPR_CIRCUIT_MIL_ON ERRM_MPR_CIRCUIT_DEN_GRP ERRM_MPR_CIRCUIT_DTC ERRM_CP_LO_TYP ERRM_CP_LO_MIL_ON ERRM_CP_LO_DEN_GRP ERRM_CP_LO_DTC ERRM_CP_HI_TYP ERRM_CP_HI_MIL_ON ERRM_CP_HI_DEN_GRP ERRM_CP_HI_DTC ERRM_B1S1_HT_LO_TYP ERRM_B1S1_HT_LO_MIL_ON ERRM_B1S1_HT_LO_DEN_GRP ERRM_B1S1_HT_LO_DTC ERRM_B1S1_HT_HI_TYP ERRM_B1S1_HT_HI_MIL_ON ERRM_B1S1_HT_HI_DEN_GRP ERRM_B1S1_HT_HI_DTC ERRM_B1S2_HT_LO_TYP ERRM_B1S2_HT_LO_MIL_ON ERRM_B1S2_HT_LO_DEN_GRP ERRM_B1S2_HT_LO_DTC ERRM_B1S2_HT_HI_TYP ERRM_B1S2_HT_HI_MIL_ON ERRM_B1S2_HT_HI_DEN_GRP ERRM_B1S2_HT_HI_DTC ERRM_INJ1_LO_TYP ERRM_INJ1_LO_MIL_ON ERRM_INJ1_LO_DEN_GRP ERRM_INJ1_LO_DTC ERRM_INJ1_HI_TYP ERRM_INJ1_HI_MIL_ON ERRM_INJ1_HI_DEN_GRP ERRM_INJ1_HI_DTC ERRM_INJ2_LO_TYP ERRM_INJ2_LO_MIL_ON ERRM_INJ2_LO_DEN_GRP ERRM_INJ2_LO_DTC ERRM_INJ2_HI_TYP ERRM_INJ2_HI_MIL_ON ERRM_INJ2_HI_DEN_GRP ERRM_INJ2_HI_DTC ERRM_INJ3_LO_TYP ERRM_INJ3_LO_MIL_ON ERRM_INJ3_LO_DEN_GRP ERRM_INJ3_LO_DTC ERRM_INJ3_HI_TYP ERRM_INJ3_HI_MIL_ON ERRM_INJ3_HI_DEN_GRP ERRM_INJ3_HI_DTC ERRM_INJ4_LO_TYP ERRM_INJ4_LO_MIL_ON ERRM_INJ4_LO_DEN_GRP ERRM_INJ4_LO_DTC ERRM_INJ4_HI_TYP ERRM_INJ4_HI_MIL_ON ERRM_INJ4_HI_DEN_GRP ERRM_INJ4_HI_DTC ERRM_FPR_CIRCUIT_TYP ERRM_FPR_CIRCUIT_MIL_ON ERRM_FPR_CIRCUIT_DEN_GRP ERRM_FPR_CIRCUIT_DTC ERRM_B1_INTK_VVT_HI_TYP ERRM_B1_INTK_VVT_HI_MIL_ON ERRM_B1_INTK_VVT_HI_DEN_GRP ERRM_B1_INTK_VVT_HI_DTC ERRM_B1_INTK_VVT_LO_TYP ERRM_B1_INTK_VVT_LO_MIL_ON ERRM_B1_INTK_VVT_LO_DEN_GRP ERRM_B1_INTK_VVT_LO_DTC ERRM_B1_INTK_VVT_OPN_TYP ERRM_B1_INTK_VVT_OPN_MIL_ON ERRM_B1_INTK_VVT_OPN_DEN_GRP ERRM_B1_INTK_VVT_OPN_DTC ERRM_B1_EXH_VVT_HI_TYP ERRM_B1_EXH_VVT_HI_MIL_ON ERRM_B1_EXH_VVT_HI_DEN_GRP ERRM_B1_EXH_VVT_HI_DTC ERRM_B1_EXH_VVT_LO_TYP ERRM_B1_EXH_VVT_LO_MIL_ON ERRM_B1_EXH_VVT_LO_DEN_GRP ERRM_B1_EXH_VVT_LO_DTC ERRM_B1_EXH_VVT_OPN_TYP ERRM_B1_EXH_VVT_OPN_MIL_ON ERRM_B1_EXH_VVT_OPN_DEN_GRP ERRM_B1_EXH_VVT_OPN_DTC ERRM_ESTA_LO_TYP ERRM_ESTA_LO_MIL_ON ERRM_ESTA_LO_DEN_GRP ERRM_ESTA_LO_DTC ERRM_ESTA_HI_TYP ERRM_ESTA_HI_MIL_ON ERRM_ESTA_HI_DEN_GRP ERRM_ESTA_HI_DTC ERRM_ESTA_OPN_TYP ERRM_ESTA_OPN_MIL_ON ERRM_ESTA_OPN_DEN_GRP ERRM_ESTA_OPN_DTC ERRM_ESTB_LO_TYP ERRM_ESTB_LO_MIL_ON ERRM_ESTB_LO_DEN_GRP ERRM_ESTB_LO_DTC ERRM_ESTB_HI_TYP ERRM_ESTB_HI_MIL_ON ERRM_ESTB_HI_DEN_GRP ERRM_ESTB_HI_DTC ERRM_ESTB_OPN_TYP ERRM_ESTB_OPN_MIL_ON ERRM_ESTB_OPN_DEN_GRP ERRM_ESTB_OPN_DTC ERRM_ESTC_LO_TYP ERRM_ESTC_LO_MIL_ON ERRM_ESTC_LO_DEN_GRP ERRM_ESTC_LO_DTC ERRM_ESTC_HI_TYP ERRM_ESTC_HI_MIL_ON ERRM_ESTC_HI_DEN_GRP ERRM_ESTC_HI_DTC ERRM_ESTC_OPN_TYP ERRM_ESTC_OPN_MIL_ON ERRM_ESTC_OPN_DEN_GRP ERRM_ESTC_OPN_DTC ERRM_ESTD_LO_TYP ERRM_ESTD_LO_MIL_ON ERRM_ESTD_LO_DEN_GRP ERRM_ESTD_LO_DTC ERRM_ESTD_HI_TYP ERRM_ESTD_HI_MIL_ON ERRM_ESTD_HI_DEN_GRP ERRM_ESTD_HI_DTC ERRM_ESTD_OPN_TYP ERRM_ESTD_OPN_MIL_ON ERRM_ESTD_OPN_DEN_GRP ERRM_ESTD_OPN_DTC ERRM_VENT_LO_TYP ERRM_VENT_LO_MIL_ON ERRM_VENT_LO_DEN_GRP ERRM_VENT_LO_DTC ERRM_VENT_HI_TYP ERRM_VENT_HI_MIL_ON ERRM_VENT_HI_DEN_GRP ERRM_VENT_HI_DTC ERRM_ECM_AD_TYP ERRM_ECM_AD_MIL_ON ERRM_ECM_AD_DEN_GRP ERRM_ECM_AD_DTC ERRM_ECM_SW_VER_TYP ERRM_ECM_SW_VER_MIL_ON ERRM_ECM_SW_VER_DEN_GRP ERRM_ECM_SW_VER_DTC ERRM_PS_P_LO_TYP ERRM_PS_P_LO_MIL_ON ERRM_PS_P_LO_DEN_GRP ERRM_PS_P_LO_DTC ERRM_PS_P_HI_TYP ERRM_PS_P_HI_MIL_ON ERRM_PS_P_HI_DEN_GRP ERRM_PS_P_HI_DTC ERRM_CRUZ_AN_TYP ERRM_CRUZ_AN_MIL_ON ERRM_CRUZ_AN_DEN_GRP ERRM_CRUZ_AN_DTC ERRM_CRUZ_ON_TYP ERRM_CRUZ_ON_MIL_ON ERRM_CRUZ_ON_DEN_GRP ERRM_CRUZ_ON_DTC ERRM_CRUZ_CANCEL_TYP ERRM_CRUZ_CANCEL_MIL_ON ERRM_CRUZ_CANCEL_DEN_GRP ERRM_CRUZ_CANCEL_DTC ERRM_CRUZ_RES_TYP ERRM_CRUZ_RES_MIL_ON ERRM_CRUZ_RES_DEN_GRP ERRM_CRUZ_RES_DTC ERRM_CRUZ_SET_TYP ERRM_CRUZ_SET_MIL_ON ERRM_CRUZ_SET_DEN_GRP ERRM_CRUZ_SET_DTC ERRM_CRUZ_DIST_TYP ERRM_CRUZ_DIST_MIL_ON ERRM_CRUZ_DIST_DEN_GRP ERRM_CRUZ_DIST_DTC ERRM_CRUZ_LMT_TYP ERRM_CRUZ_LMT_MIL_ON ERRM_CRUZ_LMT_DEN_GRP ERRM_CRUZ_LMT_DTC ERRM_CRUZ_ON_STCK_TYP ERRM_CRUZ_ON_STCK_MIL_ON ERRM_CRUZ_ON_STCK_DEN_GRP ERRM_CRUZ_ON_STCK_DTC ERRM_CRUZ_CANCEL_STCK_TYP ERRM_CRUZ_CANCEL_STCK_MIL_ON ERRM_CRUZ_CANCEL_STCK_DEN_GRP ERRM_CRUZ_CANCEL_STCK_DTC ERRM_CRUZ_RES_STCK_TYP ERRM_CRUZ_RES_STCK_MIL_ON ERRM_CRUZ_RES_STCK_DEN_GRP ERRM_CRUZ_RES_STCK_DTC ERRM_CRUZ_SET_STCK_TYP ERRM_CRUZ_SET_STCK_MIL_ON ERRM_CRUZ_SET_STCK_DEN_GRP ERRM_CRUZ_SET_STCK_DTC ERRM_CRUZ_DIST_STCK_TYP ERRM_CRUZ_DIST_STCK_MIL_ON ERRM_CRUZ_DIST_STCK_DEN_GRP ERRM_CRUZ_DIST_STCK_DTC ERRM_CRUZ_LMT_STCK_TYP ERRM_CRUZ_LMT_STCK_MIL_ON ERRM_CRUZ_LMT_STCK_DEN_GRP ERRM_CRUZ_LMT_STCK_DTC ERRM_ECM_AD0_TYP ERRM_ECM_AD0_MIL_ON ERRM_ECM_AD0_DEN_GRP ERRM_ECM_AD0_DTC ERRM_ECM_AD1_TYP ERRM_ECM_AD1_MIL_ON ERRM_ECM_AD1_DEN_GRP ERRM_ECM_AD1_DTC ERRM_ECM_GPR_TYP ERRM_ECM_GPR_MIL_ON ERRM_ECM_GPR_DEN_GRP ERRM_ECM_GPR_DTC ERRM_WSS_OPN_TYP ERRM_WSS_OPN_MIL_ON ERRM_WSS_OPN_DEN_GRP ERRM_WSS_OPN_DTC ERRM_MPR_OUT_TYP ERRM_MPR_OUT_MIL_ON ERRM_MPR_OUT_DEN_GRP ERRM_MPR_OUT_DTC ERRM_B1S2_PUC_RSP_TYP ERRM_B1S2_PUC_RSP_MIL_ON ERRM_B1S2_PUC_RSP_DEN_GRP ERRM_B1S2_PUC_RSP_DTC ERRM_MISFIRE_CYL1_TYP ERRM_MISFIRE_CYL1_MIL_ON ERRM_MISFIRE_CYL1_DEN_GRP ERRM_MISFIRE_CYL1_DTC ERRM_MISFIRE_CYL2_TYP ERRM_MISFIRE_CYL2_MIL_ON ERRM_MISFIRE_CYL2_DEN_GRP ERRM_MISFIRE_CYL2_DTC ERRM_MISFIRE_CYL3_TYP ERRM_MISFIRE_CYL3_MIL_ON ERRM_MISFIRE_CYL3_DEN_GRP ERRM_MISFIRE_CYL3_DTC ERRM_MISFIRE_CYL4_TYP ERRM_MISFIRE_CYL4_MIL_ON ERRM_MISFIRE_CYL4_DEN_GRP ERRM_MISFIRE_CYL4_DTC ERRM_IG_ADV_TYP ERRM_IG_ADV_MIL_ON ERRM_IG_ADV_DEN_GRP ERRM_IG_ADV_DTC ERRM_E_THERM_HI_TYP ERRM_E_THERM_HI_MIL_ON ERRM_E_THERM_HI_DEN_GRP ERRM_E_THERM_HI_DTC ERRM_E_THERM_LO_TYP ERRM_E_THERM_LO_MIL_ON ERRM_E_THERM_LO_DEN_GRP ERRM_E_THERM_LO_DTC ERRM_B1S2_POW_RSP_TYP ERRM_B1S2_POW_RSP_MIL_ON ERRM_B1S2_POW_RSP_DEN_GRP ERRM_B1S2_POW_RSP_DTC ERRM_BAT_TEMP_HI_TYP ERRM_BAT_TEMP_HI_MIL_ON ERRM_BAT_TEMP_HI_DEN_GRP ERRM_BAT_TEMP_HI_DTC ERRM_BAT_NO_CHRG_TYP ERRM_BAT_NO_CHRG_MIL_ON ERRM_BAT_NO_CHRG_DEN_GRP ERRM_BAT_NO_CHRG_DTC ERRM_BAT_LO_SOC_TYP ERRM_BAT_LO_SOC_MIL_ON ERRM_BAT_LO_SOC_DEN_GRP ERRM_BAT_LO_SOC_DTC ERRM_SYS_VLT_LO_TYP ERRM_SYS_VLT_LO_MIL_ON ERRM_SYS_VLT_LO_DEN_GRP ERRM_SYS_VLT_LO_DTC ERRM_SYS_VLT_RAT_TYP ERRM_SYS_VLT_RAT_MIL_ON ERRM_SYS_VLT_RAT_DEN_GRP ERRM_SYS_VLT_RAT_DTC ERRM_BAT_SOC_RAT_TYP ERRM_BAT_SOC_RAT_MIL_ON ERRM_BAT_SOC_RAT_DEN_GRP ERRM_BAT_SOC_RAT_DTC ERRM_ALT_TEMP_HI_TYP ERRM_ALT_TEMP_HI_MIL_ON ERRM_ALT_TEMP_HI_DEN_GRP ERRM_ALT_TEMP_HI_DTC ERRM_ALT_MECH_TYP ERRM_ALT_MECH_MIL_ON ERRM_ALT_MECH_DEN_GRP ERRM_ALT_MECH_DTC ERRM_ALT_ELEC_TYP ERRM_ALT_ELEC_MIL_ON ERRM_ALT_ELEC_DEN_GRP ERRM_ALT_ELEC_DTC ERRM_STRT_RLYA_HI_TYP ERRM_STRT_RLYA_HI_MIL_ON ERRM_STRT_RLYA_HI_DEN_GRP ERRM_STRT_RLYA_HI_DTC ERRM_STRT_RLYA_LO_TYP ERRM_STRT_RLYA_LO_MIL_ON ERRM_STRT_RLYA_LO_DEN_GRP ERRM_STRT_RLYA_LO_DTC ERRM_STRT_RLYB_HI_TYP ERRM_STRT_RLYB_HI_MIL_ON ERRM_STRT_RLYB_HI_DEN_GRP ERRM_STRT_RLYB_HI_DTC ERRM_STRT_RLYB_LO_TYP ERRM_STRT_RLYB_LO_MIL_ON ERRM_STRT_RLYB_LO_DEN_GRP ERRM_STRT_RLYB_LO_DTC ERRM_TCM_FAIL_TYP ERRM_TCM_FAIL_MIL_ON ERRM_TCM_FAIL_DEN_GRP ERRM_TCM_FAIL_DTC ERRM_LIN_ERR_TYP ERRM_LIN_ERR_MIL_ON ERRM_LIN_ERR_DEN_GRP ERRM_LIN_ERR_DTC ERRM_BAT_SNSR_TYP ERRM_BAT_SNSR_MIL_ON ERRM_BAT_SNSR_DEN_GRP ERRM_BAT_SNSR_DTC ERRM_BAT_SNSR_COM_TYP ERRM_BAT_SNSR_COM_MIL_ON ERRM_BAT_SNSR_COM_DEN_GRP ERRM_BAT_SNSR_COM_DTC ERRM_ALT_COM_TYP ERRM_ALT_COM_MIL_ON ERRM_ALT_COM_DEN_GRP ERRM_ALT_COM_DTC ERRM_AC_T_LO_TYP ERRM_AC_T_LO_MIL_ON ERRM_AC_T_LO_DEN_GRP ERRM_AC_T_LO_DTC ERRM_AC_T_HI_TYP ERRM_AC_T_HI_MIL_ON ERRM_AC_T_HI_DEN_GRP ERRM_AC_T_HI_DTC ERRM_CLTCH_TOP_RLS_TYP ERRM_CLTCH_TOP_RLS_MIL_ON ERRM_CLTCH_TOP_RLS_DEN_GRP ERRM_CLTCH_TOP_RLS_DTC ERRM_CLTCH_TOP_DPRS_TYP ERRM_CLTCH_TOP_DPRS_MIL_ON ERRM_CLTCH_TOP_DPRS_DEN_GRP ERRM_CLTCH_TOP_DPRS_DTC ERRM_CLTCH_BOT_RLS_TYP ERRM_CLTCH_BOT_RLS_MIL_ON ERRM_CLTCH_BOT_RLS_DEN_GRP ERRM_CLTCH_BOT_RLS_DTC ERRM_CLTCH_BOT_DPRS_TYP ERRM_CLTCH_BOT_DPRS_MIL_ON ERRM_CLTCH_BOT_DPRS_DEN_GRP ERRM_CLTCH_BOT_DPRS_DTC ERRM_N_STCK_N_TYP ERRM_N_STCK_N_MIL_ON ERRM_N_STCK_N_DEN_GRP ERRM_N_STCK_N_DTC ERRM_N_STCK_NON_TYP ERRM_N_STCK_NON_MIL_ON ERRM_N_STCK_NON_DEN_GRP ERRM_N_STCK_NON_DTC ERRM_AMP_HI_TYP ERRM_AMP_HI_MIL_ON ERRM_AMP_HI_DEN_GRP ERRM_AMP_HI_DTC ERRM_MAP_HI_TYP ERRM_MAP_HI_MIL_ON ERRM_MAP_HI_DEN_GRP ERRM_MAP_HI_DTC ERRM_AMP_LO_TYP ERRM_AMP_LO_MIL_ON ERRM_AMP_LO_DEN_GRP ERRM_AMP_LO_DTC ERRM_MAP_LO_TYP ERRM_MAP_LO_MIL_ON ERRM_MAP_LO_DEN_GRP ERRM_MAP_LO_DTC ERRM_B1S1_O2_OPN_TYP ERRM_B1S1_O2_OPN_MIL_ON ERRM_B1S1_O2_OPN_DEN_GRP ERRM_B1S1_O2_OPN_DTC ERRM_B1S1_O2_LO_TYP ERRM_B1S1_O2_LO_MIL_ON ERRM_B1S1_O2_LO_DEN_GRP ERRM_B1S1_O2_LO_DTC ERRM_B1S1_O2_HI_TYP ERRM_B1S1_O2_HI_MIL_ON ERRM_B1S1_O2_HI_DEN_GRP ERRM_B1S1_O2_HI_DTC ERRM_B1S1_POW_LEAN_TYP ERRM_B1S1_POW_LEAN_MIL_ON ERRM_B1S1_POW_LEAN_DEN_GRP ERRM_B1S1_POW_LEAN_DTC ERRM_B1S1_PUC_RICH_TYP ERRM_B1S1_PUC_RICH_MIL_ON ERRM_B1S1_PUC_RICH_DEN_GRP ERRM_B1S1_PUC_RICH_DTC ERRM_B1S2_O2_OPN_TYP ERRM_B1S2_O2_OPN_MIL_ON ERRM_B1S2_O2_OPN_DEN_GRP ERRM_B1S2_O2_OPN_DTC ERRM_B1S2_O2_LO_TYP ERRM_B1S2_O2_LO_MIL_ON ERRM_B1S2_O2_LO_DEN_GRP ERRM_B1S2_O2_LO_DTC ERRM_B1S2_O2_HI_TYP ERRM_B1S2_O2_HI_MIL_ON ERRM_B1S2_O2_HI_DEN_GRP ERRM_B1S2_O2_HI_DTC ERRM_B1S2_POW_LEAN_TYP ERRM_B1S2_POW_LEAN_MIL_ON ERRM_B1S2_POW_LEAN_DEN_GRP ERRM_B1S2_POW_LEAN_DTC ERRM_B1S2_PUC_RICH_TYP ERRM_B1S2_PUC_RICH_MIL_ON ERRM_B1S2_PUC_RICH_DEN_GRP ERRM_B1S2_PUC_RICH_DTC ERRM_B1S1_SW_CNTS_TYP ERRM_B1S1_SW_CNTS_MIL_ON ERRM_B1S1_SW_CNTS_DEN_GRP ERRM_B1S1_SW_CNTS_DTC ERRM_B1S1_RL_AVG_TYP ERRM_B1S1_RL_AVG_MIL_ON ERRM_B1S1_RL_AVG_DEN_GRP ERRM_B1S1_RL_AVG_DTC ERRM_B1S1_LR_AVG_TYP ERRM_B1S1_LR_AVG_MIL_ON ERRM_B1S1_LR_AVG_DEN_GRP ERRM_B1S1_LR_AVG_DTC ERRM_B1S1_RAT_TYP ERRM_B1S1_RAT_MIL_ON ERRM_B1S1_RAT_DEN_GRP ERRM_B1S1_RAT_DTC ERRM_B1S1_UNDER_HT_TYP ERRM_B1S1_UNDER_HT_MIL_ON ERRM_B1S1_UNDER_HT_DEN_GRP ERRM_B1S1_UNDER_HT_DTC ERRM_B1S2_UNDER_HT_TYP ERRM_B1S2_UNDER_HT_MIL_ON ERRM_B1S2_UNDER_HT_DEN_GRP ERRM_B1S2_UNDER_HT_DTC ERRM_B1S1_OVER_HT_TYP ERRM_B1S1_OVER_HT_MIL_ON ERRM_B1S1_OVER_HT_DEN_GRP ERRM_B1S1_OVER_HT_DTC ERRM_B1S2_OVER_HT_TYP ERRM_B1S2_OVER_HT_MIL_ON ERRM_B1S2_OVER_HT_DEN_GRP ERRM_B1S2_OVER_HT_DTC ERRM_IMMO_AUTH_TYP ERRM_IMMO_AUTH_MIL_ON ERRM_IMMO_AUTH_DEN_GRP ERRM_IMMO_AUTH_DTC ERRM_IMMO_RSP_TYP ERRM_IMMO_RSP_MIL_ON ERRM_IMMO_RSP_DEN_GRP ERRM_IMMO_RSP_DTC ERRM_IMMO_ECM_LRN_TYP ERRM_IMMO_ECM_LRN_MIL_ON ERRM_IMMO_ECM_LRN_DEN_GRP ERRM_IMMO_ECM_LRN_DTC ERRM_STRT_RLY_OPN_TYP ERRM_STRT_RLY_OPN_MIL_ON ERRM_STRT_RLY_OPN_DEN_GRP ERRM_STRT_RLY_OPN_DTC ERRM_STRT_RLY_STCK_TYP ERRM_STRT_RLY_STCK_MIL_ON ERRM_STRT_RLY_STCK_DEN_GRP ERRM_STRT_RLY_STCK_DTC ERRM_TRN_RLY_STCK_TYP ERRM_TRN_RLY_STCK_MIL_ON ERRM_TRN_RLY_STCK_DEN_GRP ERRM_TRN_RLY_STCK_DTC ERRM_STRT_ST_OPN_TYP ERRM_STRT_ST_OPN_MIL_ON ERRM_STRT_ST_OPN_DEN_GRP ERRM_STRT_ST_OPN_DTC ERRM_STRT_DMG_TYP ERRM_STRT_DMG_MIL_ON ERRM_STRT_DMG_DEN_GRP ERRM_STRT_DMG_DTC ERRM_DRV_TRN_LO_TYP ERRM_DRV_TRN_LO_MIL_ON ERRM_DRV_TRN_LO_DEN_GRP ERRM_DRV_TRN_LO_DTC ERRM_DRV_TRN_HI_TYP ERRM_DRV_TRN_HI_MIL_ON ERRM_DRV_TRN_HI_DEN_GRP ERRM_DRV_TRN_HI_DTC ERRM_DRV_TRN_STCKLO_TYP ERRM_DRV_TRN_STCKLO_MIL_ON ERRM_DRV_TRN_STCKLO_DEN_GRP ERRM_DRV_TRN_STCKLO_DTC ERRM_DRV_TRN_STCKHI_TYP ERRM_DRV_TRN_STCKHI_MIL_ON ERRM_DRV_TRN_STCKHI_DEN_GRP ERRM_DRV_TRN_STCKHI_DTC ERRM_PWM_PMP_HI_TYP ERRM_PWM_PMP_HI_MIL_ON ERRM_PWM_PMP_HI_DEN_GRP ERRM_PWM_PMP_HI_DTC ERRM_PWM_PMP_LO_TYP ERRM_PWM_PMP_LO_MIL_ON ERRM_PWM_PMP_LO_DEN_GRP ERRM_PWM_PMP_LO_DTC ERRM_PWM_PMP_OPN_TYP ERRM_PWM_PMP_OPN_MIL_ON ERRM_PWM_PMP_OPN_DEN_GRP ERRM_PWM_PMP_OPN_DTC ERRM_FUEL_CAP_OPN_TYP ERRM_FUEL_CAP_OPN_MIL_ON ERRM_FUEL_CAP_OPN_DEN_GRP ERRM_FUEL_CAP_OPN_DTC ERRM_BST_T_LO_TYP ERRM_BST_T_LO_MIL_ON ERRM_BST_T_LO_DEN_GRP ERRM_BST_T_LO_DTC ERRM_BST_T_HI_TYP ERRM_BST_T_HI_MIL_ON ERRM_BST_T_HI_DEN_GRP ERRM_BST_T_HI_DTC ERRM_BST_T_HI_RAT_TYP ERRM_BST_T_HI_RAT_MIL_ON ERRM_BST_T_HI_RAT_DEN_GRP ERRM_BST_T_HI_RAT_DTC ERRM_BST_T_LO_RAT_TYP ERRM_BST_T_LO_RAT_MIL_ON ERRM_BST_T_LO_RAT_DEN_GRP ERRM_BST_T_LO_RAT_DTC ERRM_TURB_OVR_BST_TYP ERRM_TURB_OVR_BST_MIL_ON ERRM_TURB_OVR_BST_DEN_GRP ERRM_TURB_OVR_BST_DTC ERRM_TURB_UNDER_BST_TYP ERRM_TURB_UNDER_BST_MIL_ON ERRM_TURB_UNDER_BST_DEN_GRP ERRM_TURB_UNDER_BST_DTC ERRM_WGV_LO_TYP ERRM_WGV_LO_MIL_ON ERRM_WGV_LO_DEN_GRP ERRM_WGV_LO_DTC ERRM_WGV_HI_TYP ERRM_WGV_HI_MIL_ON ERRM_WGV_HI_DEN_GRP ERRM_WGV_HI_DTC ERRM_WGV_OPN_TYP ERRM_WGV_OPN_MIL_ON ERRM_WGV_OPN_DEN_GRP ERRM_WGV_OPN_DTC ERRM_BYPASS_VLV_LO_TYP ERRM_BYPASS_VLV_LO_MIL_ON ERRM_BYPASS_VLV_LO_DEN_GRP ERRM_BYPASS_VLV_LO_DTC ERRM_BYPASS_VLV_HI_TYP ERRM_BYPASS_VLV_HI_MIL_ON ERRM_BYPASS_VLV_HI_DEN_GRP ERRM_BYPASS_VLV_HI_DTC ERRM_BYPASS_VLV_OPN_TYP ERRM_BYPASS_VLV_OPN_MIL_ON ERRM_BYPASS_VLV_OPN_DEN_GRP ERRM_BYPASS_VLV_OPN_DTC ERRM_INTR_FAN_LO_TYP ERRM_INTR_FAN_LO_MIL_ON ERRM_INTR_FAN_LO_DEN_GRP ERRM_INTR_FAN_LO_DTC ERRM_INTR_FAN_HI_TYP ERRM_INTR_FAN_HI_MIL_ON ERRM_INTR_FAN_HI_DEN_GRP ERRM_INTR_FAN_HI_DTC ERRM_INTR_FAN_OPN_TYP ERRM_INTR_FAN_OPN_MIL_ON ERRM_INTR_FAN_OPN_DEN_GRP ERRM_INTR_FAN_OPN_DTC ERRM_INTR_PMP_LO_TYP ERRM_INTR_PMP_LO_MIL_ON ERRM_INTR_PMP_LO_DEN_GRP ERRM_INTR_PMP_LO_DTC ERRM_INTR_PMP_HI_TYP ERRM_INTR_PMP_HI_MIL_ON ERRM_INTR_PMP_HI_DEN_GRP ERRM_INTR_PMP_HI_DTC ERRM_INTR_PMP_OPN_TYP ERRM_INTR_PMP_OPN_MIL_ON ERRM_INTR_PMP_OPN_DEN_GRP ERRM_INTR_PMP_OPN_DTC ERRM_BST_P_HI_TYP ERRM_BST_P_HI_MIL_ON ERRM_BST_P_HI_DEN_GRP ERRM_BST_P_HI_DTC ERRM_BST_P_LO_TYP ERRM_BST_P_LO_MIL_ON ERRM_BST_P_LO_DEN_GRP ERRM_BST_P_LO_DTC ERRM_BSTP_STRT_COR_TYP ERRM_BSTP_STRT_COR_MIL_ON ERRM_BSTP_STRT_COR_DEN_GRP ERRM_BSTP_STRT_COR_DTC ERRM_EGR_POS_HI_TYP ERRM_EGR_POS_HI_MIL_ON ERRM_EGR_POS_HI_DEN_GRP ERRM_EGR_POS_HI_DTC ERRM_EGR_POS_LO_TYP ERRM_EGR_POS_LO_MIL_ON ERRM_EGR_POS_LO_DEN_GRP ERRM_EGR_POS_LO_DTC ERRM_EGR_ZERO_INIT_TYP ERRM_EGR_ZERO_INIT_MIL_ON ERRM_EGR_ZERO_INIT_DEN_GRP ERRM_EGR_ZERO_INIT_DTC ERRM_EGR_ZERO_CHG_TYP ERRM_EGR_ZERO_CHG_MIL_ON ERRM_EGR_ZERO_CHG_DEN_GRP ERRM_EGR_ZERO_CHG_DTC ERRM_EGR_FLW_TYP ERRM_EGR_FLW_MIL_ON ERRM_EGR_FLW_DEN_GRP ERRM_EGR_FLW_DTC ERRM_EGR_CLS_POS_TYP ERRM_EGR_CLS_POS_MIL_ON ERRM_EGR_CLS_POS_DEN_GRP ERRM_EGR_CLS_POS_DTC ERRM_EGR_STCK_TYP ERRM_EGR_STCK_MIL_ON ERRM_EGR_STCK_DEN_GRP ERRM_EGR_STCK_DTC ERRM_EGR_POS_ERR_TYP ERRM_EGR_POS_ERR_MIL_ON ERRM_EGR_POS_ERR_DEN_GRP ERRM_EGR_POS_ERR_DTC ERRM_EGR_VLV_TYP ERRM_EGR_VLV_MIL_ON ERRM_EGR_VLV_DEN_GRP ERRM_EGR_VLV_DTC ERRM_AMP_STRT_COR_TYP ERRM_AMP_STRT_COR_MIL_ON ERRM_AMP_STRT_COR_DEN_GRP ERRM_AMP_STRT_COR_DTC ERRM_MAP_STRT_COR_TYP ERRM_MAP_STRT_COR_MIL_ON ERRM_MAP_STRT_COR_DEN_GRP ERRM_MAP_STRT_COR_DTC ERRM_V_MF_SML_ECT_LO ERRM_V_MF_SML_ECT_HI ERRM_V_WRM_ECT ERRM_V_MF_MIL_FLSH_LD_THR ERRM_V_MF_MIL_FLSH_ESPD_THR ERRM_V_MF_SML_DUR ERRM_V_EVAM_IUPR_INC_IAT_MAX ERRM_V_EVAM_IUPR_INC_IAT_MIN ERRM_V_EVAM_IUPR_INC_RUN_MIN ERRM_V_EVAM_IUPR_KEYON_ECT_MIN ERRM_V_EVAM_IUPR_KEYON_ECT_MAX ERRM_V_EVAM_IUPR_AMB_T_DLT ERRM_V_IUPR_AMP_MIN /end DEF_CHARACTERISTIC
/end FUNCTION
/begin RECORD_LAYOUT __UWORD_S FNC_VALUES 1 UWORD COLUMN_DIR DIRECT /end RECORD_LAYOUT
/begin RECORD_LAYOUT __SWORD_S FNC_VALUES 1 SWORD COLUMN_DIR DIRECT /end RECORD_LAYOUT
/end MODULE
/end PROJECT
