ASAP2_VERSION 1 60
/begin PROJECT FC33 ""
/begin HEADER "" VERSION "1.0" /end HEADER
/begin MODULE FC33 ""
/begin MOD_COMMON "" BYTE_ORDER MSB_FIRST ALIGNMENT_LONG 2 ALIGNMENT_WORD 1 /end MOD_COMMON
/begin MEASUREMENT cpd_iat_hi_fl_cnt "iat sensor short high fail counts" UWORD u_cnts 0 0 0 65535 ECU_ADDRESS 0x40004EA0 FORMAT "%5.0" /end MEASUREMENT
/begin MEASUREMENT cpd_iat_hi_diag_cnt "iat sensor short high diag counts" UWORD u_cnts 0 0 0 65535 ECU_ADDRESS 0x40004EA0 FORMAT "%5.0" SYMBOL_LINK "cpd_iat_hi_diag_cnt" 2 /end MEASUREMENT
/begin MEASUREMENT cpd_iat_hi_diag_en "iat sensor short high diag enable conditions met" UBYTE b_true 0 0 0.00 1.00 BIT_MASK 0x20 ECU_ADDRESS 0x40004EA0 FORMAT "%5.0" SYMBOL_LINK "cpd_iat_hi_diag_en" 4 /end MEASUREMENT
/begin MEASUREMENT cpd_iat_hi_fl_met "iat sensor short high diag fail conditions met" UBYTE b_true 0 0 0.00 1.00 BIT_MASK 0x10 ECU_ADDRESS 0x40004EA0 FORMAT "%5.0" SYMBOL_LINK "cpd_iat_hi_fl_met" 4 /end MEASUREMENT
/begin MEASUREMENT cpd_iat_hi_fn "iat sensor short high diag finish" UBYTE b_true 0 0 0.00 1.00 BIT_MASK 0x08 ECU_ADDRESS 0x40004EA0 FORMAT "%5.0" SYMBOL_LINK "cpd_iat_hi_fn" 4 /end MEASUREMENT
/begin MEASUREMENT cpd_iat_hi_fl "iat sensor short high diag fail" UBYTE b_true 0 0 0.00 1.00 BIT_MASK 0x04 ECU_ADDRESS 0x40004EA0 FORMAT "%5.0" SYMBOL_LINK "cpd_iat_hi_fl" 4 /end MEASUREMENT
/begin MEASUREMENT cpd_iat_hi_rpt_st "iat sensor short high diag report state" UBYTE u_rpt_st 0 0 0.00 2.00 BIT_MASK 0x03 ECU_ADDRESS 0x40004EA0 SYMBOL_LINK "cpd_iat_hi_rpt_st" 4 /end MEASUREMENT
/begin MEASUREMENT cpd_iat_lo_fl_cnt "iat sensor short low fail counts" UWORD u_cnts 0 0 0 65535 ECU_ADDRESS 0x40004EA0 FORMAT "%5.0" /end MEASUREMENT
/begin MEASUREMENT cpd_iat_lo_diag_cnt "iat sensor short low diag counts" UWORD u_cnts 0 0 0 65535 ECU_ADDRESS 0x40004EA0 FORMAT "%5.0" SYMBOL_LINK "cpd_iat_lo_diag_cnt" 2 /end MEASUREMENT
/begin MEASUREMENT cpd_iat_lo_diag_en "iat sensor short low diag enable conditions met" UBYTE b_true 0 0 0.00 1.00 BIT_MASK 0x20 ECU_ADDRESS 0x40004EA0 FORMAT "%5.0" SYMBOL_LINK "cpd_iat_lo_diag_en" 4 /end MEASUREMENT
/begin MEASUREMENT cpd_iat_lo_fl_met "iat sensor short low diag fail conditions met" UBYTE b_true 0 0 0.00 1.00 BIT_MASK 0x10 ECU_ADDRESS 0x40004EA0 FORMAT "%5.0" SYMBOL_LINK "cpd_iat_lo_fl_met" 4 /end MEASUREMENT
/begin MEASUREMENT cpd_iat_lo_fn "iat sensor short low diag finish" UBYTE b_true 0 0 0.00 1.00 BIT_MASK 0x08 ECU_ADDRESS 0x40004EA0 FORMAT "%5.0" SYMBOL_LINK "cpd_iat_lo_fn" 4 /end MEASUREMENT
/begin MEASUREMENT cpd_iat_lo_fl "iat sensor short low diag fail" UBYTE b_true 0 0 0.00 1.00 BIT_MASK 0x04 ECU_ADDRESS 0x40004EA0 FORMAT "%5.0" SYMBOL_LINK "cpd_iat_lo_fl" 4 /end MEASUREMENT
/begin MEASUREMENT cpd_iat_lo_rpt_st "iat sensor short low diag report state" UBYTE u_rpt_st 0 0 0.00 2.00 BIT_MASK 0x03 ECU_ADDRESS 0x40004EA0 SYMBOL_LINK "cpd_iat_lo_rpt_st" 4 /end MEASUREMENT
/begin MEASUREMENT cpd_map_rat_hi_fl_cnt "map sensor rationality high fail counts" UWORD u_cnts 0 0 0 65535 ECU_ADDRESS 0x40004EA0 FORMAT "%5.0" /end MEASUREMENT
/begin MEASUREMENT cpd_map_rat_hi_diag_cnt "map sensor rationality high diag counts" UWORD u_cnts 0 0 0 65535 ECU_ADDRESS 0x40004EA0 FORMAT "%5.0" SYMBOL_LINK "cpd_map_rat_hi_diag_cnt" 2 /end MEASUREMENT
/begin MEASUREMENT cpd_map_rat_hi_diag_en "map sensor rationality high diag enable conditions met" UBYTE b_true 0 0 0.00 1.00 BIT_MASK 0x20 ECU_ADDRESS 0x40004EA0 FORMAT "%5.0" SYMBOL_LINK "cpd_map_rat_hi_diag_en" 4 /end MEASUREMENT
/begin MEASUREMENT cpd_map_rat_hi_fl_met "map sensor rationality high diag fail conditions met" UBYTE b_true 0 0 0.00 1.00 BIT_MASK 0x10 ECU_ADDRESS 0x40004EA0 FORMAT "%5.0" SYMBOL_LINK "cpd_map_rat_hi_fl_met" 4 /end MEASUREMENT
/begin MEASUREMENT cpd_map_rat_hi_fn "map sensor rationality high diag finish" UBYTE b_true 0 0 0.00 1.00 BIT_MASK 0x08 ECU_ADDRESS 0x40004EA0 FORMAT "%5.0" SYMBOL_LINK "cpd_map_rat_hi_fn" 4 /end MEASUREMENT
/begin MEASUREMENT cpd_map_rat_hi_fl "map sensor rationality high diag fail" UBYTE b_true 0 0 0.00 1.00 BIT_MASK 0x04 ECU_ADDRESS 0x40004EA0 FORMAT "%5.0" SYMBOL_LINK "cpd_map_rat_hi_fl" 4 /end MEASUREMENT
/begin MEASUREMENT cpd_map_rat_hi_rpt_st "map sensor rationality high diag report state" UBYTE u_rpt_st 0 0 0.00 2.00 BIT_MASK 0x03 ECU_ADDRESS 0x40004EA0 SYMBOL_LINK "cpd_map_rat_hi_rpt_st" 4 /end MEASUREMENT
/begin MEASUREMENT cpd_map_rat_lo_fl_cnt "map sensor rationality low fail counts" UWORD u_cnts 0 0 0 65535 ECU_ADDRESS 0x40004EA0 FORMAT "%5.0" /end MEASUREMENT
/begin MEASUREMENT cpd_map_rat_lo_diag_cnt "map sensor rationality low diag counts" UWORD u_cnts 0 0 0 65535 ECU_ADDRESS 0x40004EA0 FORMAT "%5.0" SYMBOL_LINK "cpd_map_rat_lo_diag_cnt" 2 /end MEASUREMENT
/begin MEASUREMENT cpd_map_rat_lo_diag_en "map sensor rationality low diag enable conditions met" UBYTE b_true 0 0 0.00 1.00 BIT_MASK 0x20 ECU_ADDRESS 0x40004EA0 FORMAT "%5.0" SYMBOL_LINK "cpd_map_rat_lo_diag_en" 4 /end MEASUREMENT
/begin MEASUREMENT cpd_map_rat_lo_fl_met "map sensor rationality low diag fail conditions met" UBYTE b_true 0 0 0.00 1.00 BIT_MASK 0x10 ECU_ADDRESS 0x40004EA0 FORMAT "%5.0" SYMBOL_LINK "cpd_map_rat_lo_fl_met" 4 /end MEASUREMENT
/begin MEASUREMENT cpd_map_rat_lo_fn "map sensor rationality low diag finish" UBYTE b_true 0 0 0.00 1.00 BIT_MASK 0x08 ECU_ADDRESS 0x40004EA0 FORMAT "%5.0" SYMBOL_LINK "cpd_map_rat_lo_fn" 4 /end MEASUREMENT
/begin MEASUREMENT cpd_map_rat_lo_fl "map sensor rationality low diag fail" UBYTE b_true 0 0 0.00 1.00 BIT_MASK 0x04 ECU_ADDRESS 0x40004EA0 FORMAT "%5.0" SYMBOL_LINK "cpd_map_rat_lo_fl" 4 /end MEASUREMENT
/begin MEASUREMENT cpd_map_rat_lo_rpt_st "map sensor rationality low diag report state" UBYTE u_rpt_st 0 0 0.00 2.00 BIT_MASK 0x03 ECU_ADDRESS 0x40004EA0 SYMBOL_LINK "cpd_map_rat_lo_rpt_st" 4 /end MEASUREMENT
/begin MEASUREMENT cpd_map_rat_dcl_fl_cnt "map sensor rationality deceleration fail counts" UWORD u_cnts 0 0 0 65535 ECU_ADDRESS 0x40004EA0 FORMAT "%5.0" /end MEASUREMENT
/begin MEASUREMENT cpd_map_rat_dcl_diag_cnt "map sensor rationality deceleration diag counts" UWORD u_cnts 0 0 0 65535 ECU_ADDRESS 0x40004EA0 FORMAT "%5.0" SYMBOL_LINK "cpd_map_rat_dcl_diag_cnt" 2 /end MEASUREMENT
/begin MEASUREMENT cpd_map_rat_dcl_diag_en "map sensor rationality deceleration diag enable conditions met" UBYTE b_true 0 0 0.00 1.00 BIT_MASK 0x20 ECU_ADDRESS 0x40004EA0 FORMAT "%5.0" SYMBOL_LINK "cpd_map_rat_dcl_diag_en" 4 /end MEASUREMENT
/begin MEASUREMENT cpd_map_rat_dcl_fl_met "map sensor rationality deceleration diag fail conditions met" UBYTE b_true 0 0 0.00 1.00 BIT_MASK 0x10 ECU_ADDRESS 0x40004EA0 FORMAT "%5.0" SYMBOL_LINK "cpd_map_rat_dcl_fl_met" 4 /end MEASUREMENT
/begin MEASUREMENT cpd_map_rat_dcl_fn "map sensor rationality deceleration diag finish" UBYTE b_true 0 0 0.00 1.00 BIT_MASK 0x08 ECU_ADDRESS 0x40004EA0 FORMAT "%5.0" SYMBOL_LINK "cpd_map_rat_dcl_fn" 4 /end MEASUREMENT
/begin MEASUREMENT cpd_map_rat_dcl_fl "map sensor rationality deceleration diag fail" UBYTE b_true 0 0 0.00 1.00 BIT_MASK 0x04 ECU_ADDRESS 0x40004EA0 FORMAT "%5.0" SYMBOL_LINK "cpd_map_rat_dcl_fl" 4 /end MEASUREMENT
/begin MEASUREMENT cpd_map_rat_dcl_rpt_st "map sensor rationality deceleration diag report state" UBYTE u_rpt_st 0 0 0.00 2.00 BIT_MASK 0x03 ECU_ADDRESS 0x40004EA0 SYMBOL_LINK "cpd_map_rat_dcl_rpt_st" 4 /end MEASUREMENT
/begin MEASUREMENT cpd_bstt_hi_fl_cnt "boost t sensor short high fail counts" UWORD u_cnts 0 0 0 65535 ECU_ADDRESS 0x40004EA0 FORMAT "%5.0" SYMBOL_LINK "cpd_bstt_hi_fl_cnt" 6 /end MEASUREMENT
/begin MEASUREMENT cpd_bstt_hi_diag_cnt "boost t sensor short high diag counts" UWORD u_cnts 0 0 0 65535 ECU_ADDRESS 0x40004EA0 FORMAT "%5.0" SYMBOL_LINK "cpd_bstt_hi_diag_cnt" 8 /end MEASUREMENT
/begin MEASUREMENT cpd_bstt_hi_diag_en "boost temp sensor short high diag enable conditions met" UBYTE b_true 0 0 0.00 1.00 BIT_MASK 0x20 ECU_ADDRESS 0x40004EA0 FORMAT "%5.0" SYMBOL_LINK "cpd_bstt_hi_diag_en" 10 /end MEASUREMENT
/begin MEASUREMENT cpd_bstt_hi_fl_met "boost temp sensor short high diag fail conditions met" UBYTE b_true 0 0 0.00 1.00 BIT_MASK 0x10 ECU_ADDRESS 0x40004EA0 FORMAT "%5.0" SYMBOL_LINK "cpd_bstt_hi_fl_met" 10 /end MEASUREMENT
/begin MEASUREMENT cpd_bstt_hi_fn "boost temp sensor short high diag finish" UBYTE b_true 0 0 0.00 1.00 BIT_MASK 0x08 ECU_ADDRESS 0x40004EA0 FORMAT "%5.0" SYMBOL_LINK "cpd_bstt_hi_fn" 10 /end MEASUREMENT
/begin MEASUREMENT cpd_bstt_hi_fl "boost temp sensor short high diag fail" UBYTE b_true 0 0 0.00 1.00 BIT_MASK 0x04 ECU_ADDRESS 0x40004EA0 FORMAT "%5.0" SYMBOL_LINK "cpd_bstt_hi_fl" 10 /end MEASUREMENT
/begin MEASUREMENT cpd_bstt_hi_rpt_st "boost temp sensor short high diag report state" UBYTE u_rpt_st 0 0 0.00 2.00 BIT_MASK 0x03 ECU_ADDRESS 0x40004EA0 SYMBOL_LINK "cpd_bstt_hi_rpt_st" 10 /end MEASUREMENT
/begin MEASUREMENT cpd_bstt_lo_fl_cnt "boost t sensor short low fail counts" UWORD u_cnts 0 0 0 65535 ECU_ADDRESS 0x40004EA0 FORMAT "%5.0" SYMBOL_LINK "cpd_bstt_lo_fl_cnt" 6 /end MEASUREMENT
/begin MEASUREMENT cpd_bstt_lo_diag_cnt "boost t sensor short low diag counts" UWORD u_cnts 0 0 0 65535 ECU_ADDRESS 0x40004EA0 FORMAT "%5.0" SYMBOL_LINK "cpd_bstt_lo_diag_cnt" 8 /end MEASUREMENT
/begin MEASUREMENT cpd_bstt_lo_diag_en "boost temp sensor short low diag enable conditions met" UBYTE b_true 0 0 0.00 1.00 BIT_MASK 0x20 ECU_ADDRESS 0x40004EA0 FORMAT "%5.0" SYMBOL_LINK "cpd_bstt_lo_diag_en" 10 /end MEASUREMENT
/begin MEASUREMENT cpd_bstt_lo_fl_met "boost temp sensor short low diag fail conditions met" UBYTE b_true 0 0 0.00 1.00 BIT_MASK 0x10 ECU_ADDRESS 0x40004EA0 FORMAT "%5.0" SYMBOL_LINK "cpd_bstt_lo_fl_met" 10 /end MEASUREMENT
/begin MEASUREMENT cpd_bstt_lo_fn "boost temp sensor short low diag finish" UBYTE b_true 0 0 0.00 1.00 BIT_MASK 0x08 ECU_ADDRESS 0x40004EA0 FORMAT "%5.0" SYMBOL_LINK "cpd_bstt_lo_fn" 10 /end MEASUREMENT
/begin MEASUREMENT cpd_bstt_lo_fl "boost temp sensor short low diag fail" UBYTE b_true 0 0 0.00 1.00 BIT_MASK 0x04 ECU_ADDRESS 0x40004EA0 FORMAT "%5.0" SYMBOL_LINK "cpd_bstt_lo_fl" 10 /end MEASUREMENT
/begin MEASUREMENT cpd_bstt_lo_rpt_st "boost temp sensor short low diag report state" UBYTE u_rpt_st 0 0 0.00 2.00 BIT_MASK 0x03 ECU_ADDRESS 0x40004EA0 SYMBOL_LINK "cpd_bstt_lo_rpt_st" 10 /end MEASUREMENT
/begin MEASUREMENT cpd_map_hi_fl_cnt "map sensor short high fail counts" UWORD u_cnts 0 0 0 65535 ECU_ADDRESS 0x40004EA0 FORMAT "%5.0" SYMBOL_LINK "cpd_map_hi_fl_cnt" 12 /end MEASUREMENT
/begin MEASUREMENT cpd_map_hi_diag_cnt "map sensor short high diag counts" UWORD u_cnts 0 0 0 65535 ECU_ADDRESS 0x40004EA0 FORMAT "%5.0" SYMBOL_LINK "cpd_map_hi_diag_cnt" 14 /end MEASUREMENT
/begin MEASUREMENT cpd_map_hi_diag_en "map sensor short high diag enable conditions met" UBYTE b_true 0 0 0.00 1.00 BIT_MASK 0x20 ECU_ADDRESS 0x40004EA0 FORMAT "%5.0" SYMBOL_LINK "cpd_map_hi_diag_en" 16 /end MEASUREMENT
/begin MEASUREMENT cpd_map_hi_fl_met "map sensor short high diag fail conditions met" UBYTE b_true 0 0 0.00 1.00 BIT_MASK 0x10 ECU_ADDRESS 0x40004EA0 FORMAT "%5.0" SYMBOL_LINK "cpd_map_hi_fl_met" 16 /end MEASUREMENT
/begin MEASUREMENT cpd_map_hi_fn "map sensor short high diag finish" UBYTE b_true 0 0 0.00 1.00 BIT_MASK 0x08 ECU_ADDRESS 0x40004EA0 FORMAT "%5.0" SYMBOL_LINK "cpd_map_hi_fn" 16 /end MEASUREMENT
/begin MEASUREMENT cpd_map_hi_fl "map sensor short high diag fail" UBYTE b_true 0 0 0.00 1.00 BIT_MASK 0x04 ECU_ADDRESS 0x40004EA0 FORMAT "%5.0" SYMBOL_LINK "cpd_map_hi_fl" 16 /end MEASUREMENT
/begin MEASUREMENT cpd_map_hi_rpt_st "map sensor short high diag report state" UBYTE u_rpt_st 0 0 0.00 2.00 BIT_MASK 0x03 ECU_ADDRESS 0x40004EA0 SYMBOL_LINK "cpd_map_hi_rpt_st" 16 /end MEASUREMENT
/begin MEASUREMENT cpd_map_lo_fl_cnt "map sensor short low fail counts" UWORD u_cnts 0 0 0 65535 ECU_ADDRESS 0x40004EA0 FORMAT "%5.0" SYMBOL_LINK "cpd_map_lo_fl_cnt" 12 /end MEASUREMENT
/begin MEASUREMENT cpd_map_lo_diag_cnt "map sensor short low diag counts" UWORD u_cnts 0 0 0 65535 ECU_ADDRESS 0x40004EA0 FORMAT "%5.0" SYMBOL_LINK "cpd_map_lo_diag_cnt" 14 /end MEASUREMENT
/begin MEASUREMENT cpd_map_lo_diag_en "map sensor short low diag enable conditions met" UBYTE b_true 0 0 0.00 1.00 BIT_MASK 0x20 ECU_ADDRESS 0x40004EA0 FORMAT "%5.0" SYMBOL_LINK "cpd_map_lo_diag_en" 16 /end MEASUREMENT
/begin MEASUREMENT cpd_map_lo_fl_met "map sensor short low diag fail conditions met" UBYTE b_true 0 0 0.00 1.00 BIT_MASK 0x10 ECU_ADDRESS 0x40004EA0 FORMAT "%5.0" SYMBOL_LINK "cpd_map_lo_fl_met" 16 /end MEASUREMENT
/begin MEASUREMENT cpd_map_lo_fn "map sensor short low diag finish" UBYTE b_true 0 0 0.00 1.00 BIT_MASK 0x08 ECU_ADDRESS 0x40004EA0 FORMAT "%5.0" SYMBOL_LINK "cpd_map_lo_fn" 16 /end MEASUREMENT
/begin MEASUREMENT cpd_map_lo_fl "map sensor short low diag fail" UBYTE b_true 0 0 0.00 1.00 BIT_MASK 0x04 ECU_ADDRESS 0x40004EA0 FORMAT "%5.0" SYMBOL_LINK "cpd_map_lo_fl" 16 /end MEASUREMENT
/begin MEASUREMENT cpd_map_lo_rpt_st "map sensor short low diag report state" UBYTE u_rpt_st 0 0 0.00 2.00 BIT_MASK 0x03 ECU_ADDRESS 0x40004EA0 SYMBOL_LINK "cpd_map_lo_rpt_st" 16 /end MEASUREMENT
/begin MEASUREMENT cpd_tps1_perf_fl_met "tps1 performance fail met" UBYTE b_true 0 0 0.00 1.00 BIT_MASK 0x04 ECU_ADDRESS 0x40004EA0 FORMAT "%1.0" SYMBOL_LINK "cpd_tps1_perf_st" 0 /end MEASUREMENT
/begin MEASUREMENT cpd_tps1_perf_fl "tps1 performance fail" UBYTE b_true 0 0 0.00 1.00 BIT_MASK 0x04 ECU_ADDRESS 0x40004EA0 FORMAT "%1.0" SYMBOL_LINK "cpd_tps1_perf_st" 1 /end MEASUREMENT
/begin MEASUREMENT cpd_tps2_perf_fl_met "tps2 performance fail met" UBYTE b_true 0 0 0.00 1.00 BIT_MASK 0x04 ECU_ADDRESS 0x40004EA0 FORMAT "%1.0" SYMBOL_LINK "cpd_tps2_perf_st" 0 /end MEASUREMENT
/begin MEASUREMENT cpd_tps2_perf_fl "tps2 performance fail" UBYTE b_true 0 0 0.00 1.00 BIT_MASK 0x04 ECU_ADDRESS 0x40004EA0 FORMAT "%1.0" SYMBOL_LINK "cpd_tps2_perf_st" 1 /end MEASUREMENT
/begin MEASUREMENT cpd_tps1_vlt_fl_met "tps1 voltage fail met" UBYTE b_true 0 0 0.00 1.00 BIT_MASK 0x04 ECU_ADDRESS 0x40004EA0 FORMAT "%1.0" SYMBOL_LINK "cpd_tps1_vlt_st" 0 /end MEASUREMENT
/begin MEASUREMENT cpd_tps1_vlt_fl "tps1 voltage fail" UBYTE b_true 0 0 0.00 1.00 BIT_MASK 0x04 ECU_ADDRESS 0x40004EA0 FORMAT "%1.0" SYMBOL_LINK "cpd_tps1_vlt_st" 1 /end MEASUREMENT
/begin MEASUREMENT cpd_tps2_vlt_fl_met "tps2 voltage fail met" UBYTE b_true 0 0 0.00 1.00 BIT_MASK 0x04 ECU_ADDRESS 0x40004EA0 FORMAT "%1.0" SYMBOL_LINK "cpd_tps2_vlt_st" 0 /end MEASUREMENT
/begin MEASUREMENT cpd_tps2_vlt_fl "tps2 voltage fail" UBYTE b_true 0 0 0.00 1.00 BIT_MASK 0x04 ECU_ADDRESS 0x40004EA0 FORMAT "%1.0" SYMBOL_LINK "cpd_tps2_vlt_st" 1 /end MEASUREMENT
/begin MEASUREMENT cpd_amp_hi_fl_cnt "amp sensor short high fail counts" UWORD u_cnts 0 0 0 65535 ECU_ADDRESS 0x40004EA0 FORMAT "%5.0" SYMBOL_LINK "cpd_p_hi_diag_info" 0 /end MEASUREMENT
/begin MEASUREMENT cpd_amp_hi_diag_cnt "amp sensor short high diag counts" UWORD u_cnts 0 0 0 65535 ECU_ADDRESS 0x40004EA0 FORMAT "%5.0" SYMBOL_LINK "cpd_p_hi_diag_info" 2 /end MEASUREMENT
/begin MEASUREMENT cpd_amp_hi_diag_en "amp sensor short high diag enable conditions met" UBYTE b_true 0 0 0.00 1.00 BIT_MASK 0x20 ECU_ADDRESS 0x40004EA0 FORMAT "%5.0" SYMBOL_LINK "cpd_p_hi_diag_info" 4 /end MEASUREMENT
/begin MEASUREMENT cpd_amp_hi_fl_met "amp sensor short high diag fail conditions met" UBYTE b_true 0 0 0.00 1.00 BIT_MASK 0x10 ECU_ADDRESS 0x40004EA0 FORMAT "%5.0" SYMBOL_LINK "cpd_p_hi_diag_info" 4 /end MEASUREMENT
/begin MEASUREMENT cpd_amp_hi_fn "amp sensor short high diag finish" UBYTE b_true 0 0 0.00 1.00 BIT_MASK 0x08 ECU_ADDRESS 0x40004EA0 FORMAT "%5.0" SYMBOL_LINK "cpd_p_hi_diag_info" 4 /end MEASUREMENT
/begin MEASUREMENT cpd_amp_hi_fl "amp sensor short high diag fail" UBYTE b_true 0 0 0.00 1.00 BIT_MASK 0x04 ECU_ADDRESS 0x40004EA0 FORMAT "%5.0" SYMBOL_LINK "cpd_p_hi_diag_info" 4 /end MEASUREMENT
/begin MEASUREMENT cpd_amp_hi_rpt_st "amp sensor short high diag report state" UBYTE u_rpt_st 0 0 0.00 2.00 BIT_MASK 0x03 ECU_ADDRESS 0x40004EA0 SYMBOL_LINK "cpd_p_hi_diag_info" 4 /end MEASUREMENT
/begin MEASUREMENT cpd_amp_lo_fl_cnt "amp sensor short low fail counts" UWORD u_cnts 0 0 0 65535 ECU_ADDRESS 0x40004EA0 FORMAT "%5.0" SYMBOL_LINK "cpd_p_lo_diag_info" 0 /end MEASUREMENT
/begin MEASUREMENT cpd_amp_lo_diag_cnt "amp sensor short low diag counts" UWORD u_cnts 0 0 0 65535 ECU_ADDRESS 0x40004EA0 FORMAT "%5.0" SYMBOL_LINK "cpd_p_lo_diag_info" 2 /end MEASUREMENT
/begin MEASUREMENT cpd_amp_lo_diag_en "amp sensor short low diag enable conditions met" UBYTE b_true 0 0 0.00 1.00 BIT_MASK 0x20 ECU_ADDRESS 0x40004EA0 FORMAT "%5.0" SYMBOL_LINK "cpd_p_lo_diag_info" 4 /end MEASUREMENT
/begin MEASUREMENT cpd_amp_lo_fl_met "amp sensor short low diag fail conditions met" UBYTE b_true 0 0 0.00 1.00 BIT_MASK 0x10 ECU_ADDRESS 0x40004EA0 FORMAT "%5.0" SYMBOL_LINK "cpd_p_lo_diag_info" 4 /end MEASUREMENT
/begin MEASUREMENT cpd_amp_lo_fn "amp sensor short low diag finish" UBYTE b_true 0 0 0.00 1.00 BIT_MASK 0x08 ECU_ADDRESS 0x40004EA0 FORMAT "%5.0" SYMBOL_LINK "cpd_p_lo_diag_info" 4 /end MEASUREMENT
/begin MEASUREMENT cpd_amp_lo_fl "amp sensor short low diag fail" UBYTE b_true 0 0 0.00 1.00 BIT_MASK 0x04 ECU_ADDRESS 0x40004EA0 FORMAT "%5.0" SYMBOL_LINK "cpd_p_lo_diag_info" 4 /end MEASUREMENT
/begin MEASUREMENT cpd_amp_lo_rpt_st "amp sensor short low diag report state" UBYTE u_rpt_st 0 0 0.00 2.00 BIT_MASK 0x03 ECU_ADDRESS 0x40004EA0 SYMBOL_LINK "cpd_p_lo_diag_info" 4 /end MEASUREMENT
/begin MEASUREMENT cpd_bstp_hi_fl_cnt "boost press sensor short high fail counts" UWORD u_cnts 0 0 0 65535 ECU_ADDRESS 0x40004EA0 FORMAT "%5.0" SYMBOL_LINK "cpd_p_hi_diag_info" 6 /end MEASUREMENT
/begin MEASUREMENT cpd_bstp_hi_diag_cnt "boost press sensor short high diag counts" UWORD u_cnts 0 0 0 65535 ECU_ADDRESS 0x40004EA0 FORMAT "%5.0" SYMBOL_LINK "cpd_p_hi_diag_info" 8 /end MEASUREMENT
/begin MEASUREMENT cpd_bstp_hi_diag_en "boost press sensor short high diag enable conditions met" UBYTE b_true 0 0 0.00 1.00 BIT_MASK 0x20 ECU_ADDRESS 0x40004EA0 FORMAT "%5.0" SYMBOL_LINK "cpd_p_hi_diag_info" 10 /end MEASUREMENT
/begin MEASUREMENT cpd_bstp_hi_fl_met "boost press sensor short high diag fail conditions met" UBYTE b_true 0 0 0.00 1.00 BIT_MASK 0x10 ECU_ADDRESS 0x40004EA0 FORMAT "%5.0" SYMBOL_LINK "cpd_p_hi_diag_info" 10 /end MEASUREMENT
/begin MEASUREMENT cpd_bstp_hi_fn "boost press sensor short high diag finish" UBYTE b_true 0 0 0.00 1.00 BIT_MASK 0x08 ECU_ADDRESS 0x40004EA0 FORMAT "%5.0" SYMBOL_LINK "cpd_p_hi_diag_info" 10 /end MEASUREMENT
/begin MEASUREMENT cpd_bstp_hi_fl "boost press sensor short high diag fail" UBYTE b_true 0 0 0.00 1.00 BIT_MASK 0x04 ECU_ADDRESS 0x40004EA0 FORMAT "%5.0" SYMBOL_LINK "cpd_p_hi_diag_info" 10 /end MEASUREMENT
/begin MEASUREMENT cpd_bstp_hi_rpt_st "boost press sensor short high diag report state" UBYTE u_rpt_st 0 0 0.00 2.00 BIT_MASK 0x03 ECU_ADDRESS 0x40004EA0 SYMBOL_LINK "cpd_p_hi_diag_info" 10 /end MEASUREMENT
/begin MEASUREMENT cpd_bstp_lo_fl_cnt "boost press sensor short low fail counts" UWORD u_cnts 0 0 0 65535 ECU_ADDRESS 0x40004EA0 FORMAT "%5.0" SYMBOL_LINK "cpd_p_lo_diag_info" 6 /end MEASUREMENT
/begin MEASUREMENT cpd_bstp_lo_diag_cnt "boost press sensor short low diag counts" UWORD u_cnts 0 0 0 65535 ECU_ADDRESS 0x40004EA0 FORMAT "%5.0" SYMBOL_LINK "cpd_p_lo_diag_info" 8 /end MEASUREMENT
/begin MEASUREMENT cpd_bstp_lo_diag_en "boost press sensor short low diag enable conditions met" UBYTE b_true 0 0 0.00 1.00 BIT_MASK 0x20 ECU_ADDRESS 0x40004EA0 FORMAT "%5.0" SYMBOL_LINK "cpd_p_lo_diag_info" 10 /end MEASUREMENT
/begin MEASUREMENT cpd_bstp_lo_fl_met "boost press sensor short low diag fail conditions met" UBYTE b_true 0 0 0.00 1.00 BIT_MASK 0x10 ECU_ADDRESS 0x40004EA0 FORMAT "%5.0" SYMBOL_LINK "cpd_p_lo_diag_info" 10 /end MEASUREMENT
/begin MEASUREMENT cpd_bstp_lo_fn "boost press sensor short low diag finish" UBYTE b_true 0 0 0.00 1.00 BIT_MASK 0x08 ECU_ADDRESS 0x40004EA0 FORMAT "%5.0" SYMBOL_LINK "cpd_p_lo_diag_info" 10 /end MEASUREMENT
/begin MEASUREMENT cpd_bstp_lo_fl "boost press sensor short low diag fail" UBYTE b_true 0 0 0.00 1.00 BIT_MASK 0x04 ECU_ADDRESS 0x40004EA0 FORMAT "%5.0" SYMBOL_LINK "cpd_p_lo_diag_info" 10 /end MEASUREMENT
/begin MEASUREMENT cpd_bstp_lo_rpt_st "boost press sensor short low diag report state" UBYTE u_rpt_st 0 0 0.00 2.00 BIT_MASK 0x03 ECU_ADDRESS 0x40004EA0 SYMBOL_LINK "cpd_p_lo_diag_info" 10 /end MEASUREMENT
/begin MEASUREMENT cpd_bstp_shrt_met "boost press short fail conditions met" UBYTE b_true 0 0 0.00 1.00 ECU_ADDRESS 0x40004EA0 FORMAT "%5.0" SYMBOL_LINK "cpd_press_shrt_met" 1 /end MEASUREMENT
/begin MEASUREMENT cpd_strt_cor_p_dly "press start correlation diag delay" UWORD u_1x_tmr 0 0 0 511.9921875 ECU_ADDRESS 0x40004EA0 FORMAT "%5.2" /end MEASUREMENT
/begin MEASUREMENT cpd_amp_shrt_met "amp sensor short fail conditions met" UBYTE b_true 0 0 0.00 1.00 ECU_ADDRESS 0x40004EA0 FORMAT "%5.0" SYMBOL_LINK "cpd_press_shrt_met" 0 /end MEASUREMENT
/begin MEASUREMENT cpd_map_shrt_met "map short fail conditions met" UBYTE b_true 0 0 0.00 1.00 ECU_ADDRESS 0x40004EA0 FORMAT "%5.0" SYMBOL_LINK "cpd_press_shrt_met" 1 SYMBOL_LINK "cpd_press_shrt_met" 2 /end MEASUREMENT
/begin MEASUREMENT cpd_amp_strt_cor_fl_cnt "amp sensor start corr fail counts" UWORD u_cnts 0 0 0 65535 ECU_ADDRESS 0x40004EA0 FORMAT "%5.0" SYMBOL_LINK "cpd_strt_cor_p_info" 0 /end MEASUREMENT
/begin MEASUREMENT cpd_amp_strt_cor_diag_cnt "amp sensor start corr diag counts" UWORD u_cnts 0 0 0 65535 ECU_ADDRESS 0x40004EA0 FORMAT "%5.0" SYMBOL_LINK "cpd_strt_cor_p_info" 2 /end MEASUREMENT
/begin MEASUREMENT cpd_amp_strt_cor_diag_en "amp sensor start corr diag enable conditions met" UBYTE b_true 0 0 0.00 1.00 BIT_MASK 0x20 ECU_ADDRESS 0x40004EA0 FORMAT "%5.0" SYMBOL_LINK "cpd_strt_cor_p_info" 4 /end MEASUREMENT
/begin MEASUREMENT cpd_amp_strt_cor_fl_met "amp sensor start corr diag fail conditions met" UBYTE b_true 0 0 0.00 1.00 BIT_MASK 0x10 ECU_ADDRESS 0x40004EA0 FORMAT "%5.0" SYMBOL_LINK "cpd_strt_cor_p_info" 4 /end MEASUREMENT
/begin MEASUREMENT cpd_amp_strt_cor_fn "amp sensor start corr diag finish" UBYTE b_true 0 0 0.00 1.00 BIT_MASK 0x08 ECU_ADDRESS 0x40004EA0 FORMAT "%5.0" SYMBOL_LINK "cpd_strt_cor_p_info" 4 /end MEASUREMENT
/begin MEASUREMENT cpd_amp_strt_cor_fl "amp sensor start corr diag fail" UBYTE b_true 0 0 0.00 1.00 BIT_MASK 0x04 ECU_ADDRESS 0x40004EA0 FORMAT "%5.0" SYMBOL_LINK "cpd_strt_cor_p_info" 4 /end MEASUREMENT
/begin MEASUREMENT cpd_amp_strt_cor_rpt_st "amp sensor start corr diag report state" UBYTE u_rpt_st 0 0 0.00 2.00 BIT_MASK 0x03 ECU_ADDRESS 0x40004EA0 SYMBOL_LINK "cpd_strt_cor_p_info" 4 /end MEASUREMENT
/begin MEASUREMENT cpd_bstp_strt_cor_fl_cnt "boost press sensor start corr fail counts" UWORD u_cnts 0 0 0 65535 ECU_ADDRESS 0x40004EA0 FORMAT "%5.0" SYMBOL_LINK "cpd_strt_cor_p_info" 6 /end MEASUREMENT
/begin MEASUREMENT cpd_bstp_strt_cor_diag_cnt "boost press sensor start corr diag counts" UWORD u_cnts 0 0 0 65535 ECU_ADDRESS 0x40004EA0 FORMAT "%5.0" SYMBOL_LINK "cpd_strt_cor_p_info" 8 /end MEASUREMENT
/begin MEASUREMENT cpd_bstp_strt_cor_diag_en "boost press sensor start corr diag enable conditions met" UBYTE b_true 0 0 0.00 1.00 BIT_MASK 0x20 ECU_ADDRESS 0x40004EA0 FORMAT "%5.0" SYMBOL_LINK "cpd_strt_cor_p_info" 10 /end MEASUREMENT
/begin MEASUREMENT cpd_bstp_strt_cor_fl_met "boost press sensor start corr diag fail conditions met" UBYTE b_true 0 0 0.00 1.00 BIT_MASK 0x10 ECU_ADDRESS 0x40004EA0 FORMAT "%5.0" SYMBOL_LINK "cpd_strt_cor_p_info" 10 /end MEASUREMENT
/begin MEASUREMENT cpd_bstp_strt_cor_fn "boost press sensor start corr diag finish" UBYTE b_true 0 0 0.00 1.00 BIT_MASK 0x08 ECU_ADDRESS 0x40004EA0 FORMAT "%5.0" SYMBOL_LINK "cpd_strt_cor_p_info" 10 /end MEASUREMENT
/begin MEASUREMENT cpd_bstp_strt_cor_fl "boost press sensor start corr diag fail" UBYTE b_true 0 0 0.00 1.00 BIT_MASK 0x04 ECU_ADDRESS 0x40004EA0 FORMAT "%5.0" SYMBOL_LINK "cpd_strt_cor_p_info" 10 /end MEASUREMENT
/begin MEASUREMENT cpd_bstp_strt_cor_rpt_st "boost press sensor start corr diag report state" UBYTE u_rpt_st 0 0 0.00 2.00 BIT_MASK 0x03 ECU_ADDRESS 0x40004EA0 SYMBOL_LINK "cpd_strt_cor_p_info" 10 /end MEASUREMENT
/begin MEASUREMENT cpd_map_tps_comn_met "map tps diag common conditions met" UBYTE b_true 0 0 0.00 1.00 ECU_ADDRESS 0x40004EA0 FORMAT "%1.0" /end MEASUREMENT
/begin MEASUREMENT cpd_map_tps_stbl_comn "map tps diag stable common conditions met" UBYTE b_true 0 0 0.00 1.00 ECU_ADDRESS 0x40004EA0 FORMAT "%1.0" /end MEASUREMENT
/begin MEASUREMENT cpd_map_rat_dec_stbl_met "decel map tps diag stable conditions met" UBYTE b_true 0 0 0.00 1.00 ECU_ADDRESS 0x40004EA0 FORMAT "%1.0" /end MEASUREMENT
/begin MEASUREMENT cpd_map_tps_dec_dly "map tps dec diag enable delay" UWORD u_2x_tmr 0 0 0.00 1023.984375 ECU_ADDRESS 0x400050DA /end MEASUREMENT
/begin MEASUREMENT cpd_map_rat_drv_stbl_met "drive map tps diag stable conditions met" UBYTE b_true 0 0 0.00 1.00 ECU_ADDRESS 0x40004EA0 FORMAT "%1.0" /end MEASUREMENT
/begin MEASUREMENT cpd_map_tps_drv_dly "map tps drive diag enable delay" UWORD u_2x_tmr 0 0 0.00 1023.984375 ECU_ADDRESS 0x400050DA /end MEASUREMENT
/begin MEASUREMENT cpd_tnkp_shrt_en "tank press short diag enable" UBYTE b_true 0 0 0.00 1.00 ECU_ADDRESS 0x40004EA0 FORMAT "%5.0" /end MEASUREMENT
/begin MEASUREMENT cpd_tnkp_lo_fl_met "tank press short low fail met" UBYTE b_true 0 0 0.00 1.00 ECU_ADDRESS 0x40004EA0 FORMAT "%5.0" /end MEASUREMENT
/begin MEASUREMENT cpd_tnkp_hi_fl_met "tank press short high fail met" UBYTE b_true 0 0 0.00 1.00 ECU_ADDRESS 0x40004EA0 FORMAT "%5.0" /end MEASUREMENT
/begin MEASUREMENT cpd_tnkp_hi_fl_cnts "tank press sensor short high fail counts" UWORD u_cnts 0 0 0 65535 ECU_ADDRESS 0x40004EA0 FORMAT "%5.0" /end MEASUREMENT
/begin MEASUREMENT cpd_tnkp_lo_fl_cnts "tank press sensor short low fail counts" UWORD u_cnts 0 0 0 65535 ECU_ADDRESS 0x40004EA0 FORMAT "%5.0" /end MEASUREMENT
/begin MEASUREMENT cpd_tnkp_diag_cnts "tank press sensor short diag counts" UWORD u_cnts 0 0 0 65535 ECU_ADDRESS 0x40004EA0 FORMAT "%5.0" /end MEASUREMENT
/begin MEASUREMENT cpd_tnkp_shrt_fn "tank press short diag finish" UBYTE b_true 0 0 0.00 1.00 ECU_ADDRESS 0x40004EA0 FORMAT "%5.0" /end MEASUREMENT
/begin MEASUREMENT cpd_tnkp_lo_fl "tank press short low fail" UBYTE b_true 0 0 0.00 1.00 ECU_ADDRESS 0x40004EA0 FORMAT "%5.0" /end MEASUREMENT
/begin MEASUREMENT cpd_tnkp_hi_fl "tank press short high fail" UBYTE b_true 0 0 0.00 1.00 ECU_ADDRESS 0x40004EA0 FORMAT "%5.0" /end MEASUREMENT
/begin MEASUREMENT cpd_tnkp_rat_en "tank press rationality enable" UBYTE b_true 0 0 0.00 1.00 ECU_ADDRESS 0x40004EA0 FORMAT "%5.0" /end MEASUREMENT
/begin MEASUREMENT cpd_tnkp_rat_vac "tank press rationality diag vac" SWORD u_kPa_8n_8p 0 0 -8 7.999755859375 ECU_ADDRESS 0x4000DA4E FORMAT "%3.2" /end MEASUREMENT
/begin MEASUREMENT cpd_tnkp_rat_lo_fl_cnt "tank vac rat low fail counts" UWORD u_cnts 0 0 0 65535 ECU_ADDRESS 0x40004EA0 FORMAT "%5.0" SYMBOL_LINK "cpd_tnkp_rat_lo_info" 0 /end MEASUREMENT
/begin MEASUREMENT cpd_tnkp_rat_lo_diag_cnt "tank vac rat low diag counts" UWORD u_cnts 0 0 0 65535 ECU_ADDRESS 0x40004EA0 FORMAT "%5.0" SYMBOL_LINK "cpd_tnkp_rat_lo_info" 2 /end MEASUREMENT
/begin MEASUREMENT cpd_tnkp_rat_lo_diag_en "tank vac rat low diag enable conditions met" UBYTE b_true 0 0 0.00 1.00 BIT_MASK 0x20 ECU_ADDRESS 0x40004EA0 FORMAT "%5.0" SYMBOL_LINK "cpd_tnkp_rat_lo_info" 4 /end MEASUREMENT
/begin MEASUREMENT cpd_tnkp_rat_lo_fl_met "tank vac rat low diag fail conditions met" UBYTE b_true 0 0 0.00 1.00 BIT_MASK 0x10 ECU_ADDRESS 0x40004EA0 FORMAT "%5.0" SYMBOL_LINK "cpd_tnkp_rat_lo_info" 4 /end MEASUREMENT
/begin MEASUREMENT cpd_tnkp_rat_lo_fn "tank vac rat low diag finish" UBYTE b_true 0 0 0.00 1.00 BIT_MASK 0x08 ECU_ADDRESS 0x40004EA0 FORMAT "%5.0" SYMBOL_LINK "cpd_tnkp_rat_lo_info" 4 /end MEASUREMENT
/begin MEASUREMENT cpd_tnkp_rat_lo_fl "tank vac rat low diag fail" UBYTE b_true 0 0 0.00 1.00 BIT_MASK 0x04 ECU_ADDRESS 0x40004EA0 FORMAT "%5.0" SYMBOL_LINK "cpd_tnkp_rat_lo_info" 4 /end MEASUREMENT
/begin MEASUREMENT cpd_tnkp_rat_lo_rpt_st "tank vac rat low diag report state" UBYTE u_rpt_st 0 0 0.00 2.00 BIT_MASK 0x03 ECU_ADDRESS 0x40004EA0 SYMBOL_LINK "cpd_tnkp_rat_lo_info" 4 /end MEASUREMENT
/begin MEASUREMENT cpd_tnkp_rat_hi_fl_cnt "tank vac rat high fail counts" UWORD u_cnts 0 0 0 65535 ECU_ADDRESS 0x40004EA0 FORMAT "%5.0" SYMBOL_LINK "cpd_tnkp_rat_hi_info" 0 /end MEASUREMENT
/begin MEASUREMENT cpd_tnkp_rat_hi_diag_cnt "tank vac rat high diag counts" UWORD u_cnts 0 0 0 65535 ECU_ADDRESS 0x40004EA0 FORMAT "%5.0" SYMBOL_LINK "cpd_tnkp_rat_hi_info" 2 /end MEASUREMENT
/begin MEASUREMENT cpd_tnkp_rat_hi_diag_en "tank vac rat high diag enable conditions met" UBYTE b_true 0 0 0.00 1.00 BIT_MASK 0x20 ECU_ADDRESS 0x40004EA0 FORMAT "%5.0" SYMBOL_LINK "cpd_tnkp_rat_hi_info" 4 /end MEASUREMENT
/begin MEASUREMENT cpd_tnkp_rat_hi_fl_met "tank vac rat high diag fail conditions met" UBYTE b_true 0 0 0.00 1.00 BIT_MASK 0x10 ECU_ADDRESS 0x40004EA0 FORMAT "%5.0" SYMBOL_LINK "cpd_tnkp_rat_hi_info" 4 /end MEASUREMENT
/begin MEASUREMENT cpd_tnkp_rat_hi_fn "tank vac rat high diag finish" UBYTE b_true 0 0 0.00 1.00 BIT_MASK 0x08 ECU_ADDRESS 0x40004EA0 FORMAT "%5.0" SYMBOL_LINK "cpd_tnkp_rat_hi_info" 4 /end MEASUREMENT
/begin MEASUREMENT cpd_tnkp_rat_hi_fl "tank vac rat high diag fail" UBYTE b_true 0 0 0.00 1.00 BIT_MASK 0x04 ECU_ADDRESS 0x40004EA0 FORMAT "%5.0" SYMBOL_LINK "cpd_tnkp_rat_hi_info" 4 /end MEASUREMENT
/begin MEASUREMENT cpd_tnkp_rat_hi_rpt_st "tank vac rat high diag report state" UBYTE u_rpt_st 0 0 0.00 2.00 BIT_MASK 0x03 ECU_ADDRESS 0x40004EA0 SYMBOL_LINK "cpd_tnkp_rat_hi_info" 4 /end MEASUREMENT
/begin MEASUREMENT cpd_airt_rat_run_tm "air temp sensor rationality engine runtime" UWORD u_500m_tmr 0 0 0.0 32767.5 ECU_ADDRESS 0x400057A0 FORMAT "%6.1" /end MEASUREMENT
/begin MEASUREMENT cpd_airt_rat_cld_strt "cold start achived." UBYTE b_true 0 0 0.00 1.00 ECU_ADDRESS 0x400057A2 FORMAT "%1.0" /end MEASUREMENT
/begin MEASUREMENT cpd_airt_rat_keyon_iat "iat keyon temperature" SWORD u_deg_C 0 0 -256 255.9921875 ECU_ADDRESS 0x40004EBC SYMBOL_LINK "cpd_airt_rat_keyon_t" 0 /end MEASUREMENT
/begin MEASUREMENT cpd_airt_rat_keyon_bstt "iat keyon temperature" SWORD u_deg_C 0 0 -256 255.9921875 ECU_ADDRESS 0x40004EBC SYMBOL_LINK "cpd_airt_rat_keyon_t" 2 /end MEASUREMENT
/begin MEASUREMENT cpd_iat_rat_en_dly "iat temp sensor rationality diag enable delay" UWORD u_500m_tmr 0 0 0.0 32767.5 ECU_ADDRESS 0x400057A0 FORMAT "%6.1" SYMBOL_LINK "cpd_airt_rat_en_dly" 0 /end MEASUREMENT
/begin MEASUREMENT cpd_bstt_rat_en_dly "iat temp sensor rationality diag enable delay" UWORD u_500m_tmr 0 0 0.0 32767.5 ECU_ADDRESS 0x400057A0 FORMAT "%6.1" SYMBOL_LINK "cpd_airt_rat_en_dly" 2 /end MEASUREMENT
/begin MEASUREMENT cpd_bstt_rat_en "iat sensor rationality enable met" UBYTE b_true 0 0 0.00 1.00 ECU_ADDRESS 0x4000579E FORMAT "%1.0" SYMBOL_LINK "cpd_airt_rat_en" 1 /end MEASUREMENT
/begin MEASUREMENT cpd_bstt_rat_lo_fl_cnt "boost temp rat low fail counts" UWORD u_cnts 0 0 0 65535 ECU_ADDRESS 0x40004EA0 FORMAT "%5.0" SYMBOL_LINK "cpd_air_rat_lo_info" 6 /end MEASUREMENT
/begin MEASUREMENT cpd_bstt_rat_lo_fn "boost temp rat low diag finish" UBYTE b_true 0 0 0.00 1.00 BIT_MASK 0x08 ECU_ADDRESS 0x40004EA0 FORMAT "%5.0" SYMBOL_LINK "cpd_air_rat_lo_info" 10 /end MEASUREMENT
/begin MEASUREMENT cpd_bstt_rat_lo_fl "boost temp rat low diag fail" UBYTE b_true 0 0 0.00 1.00 BIT_MASK 0x04 ECU_ADDRESS 0x40004EA0 FORMAT "%5.0" SYMBOL_LINK "cpd_air_rat_lo_info" 10 /end MEASUREMENT
/begin MEASUREMENT cpd_bstt_rat_hi_fl_cnt "boost temp rat high fail counts" UWORD u_cnts 0 0 0 65535 ECU_ADDRESS 0x40004EA0 FORMAT "%5.0" SYMBOL_LINK "cpd_air_rat_hi_info" 6 /end MEASUREMENT
/begin MEASUREMENT cpd_bstt_rat_hi_fn "boost temp rat high diag finish" UBYTE b_true 0 0 0.00 1.00 BIT_MASK 0x08 ECU_ADDRESS 0x40004EA0 FORMAT "%5.0" SYMBOL_LINK "cpd_air_rat_hi_info" 10 /end MEASUREMENT
/begin MEASUREMENT cpd_bstt_rat_hi_fl "boost temp rat high diag fail" UBYTE b_true 0 0 0.00 1.00 BIT_MASK 0x04 ECU_ADDRESS 0x40004EA0 FORMAT "%5.0" SYMBOL_LINK "cpd_air_rat_hi_info" 10 /end MEASUREMENT
/begin MEASUREMENT cpd_iat_rat_en "iat sensor rationality enable met" UBYTE b_true 0 0 0.00 1.00 ECU_ADDRESS 0x4000579E FORMAT "%1.0" SYMBOL_LINK "cpd_airt_rat_en" 0 /end MEASUREMENT
/begin MEASUREMENT cpd_iat_rat_lo_fl_cnt "iat rat low fail counts" UWORD u_cnts 0 0 0 65535 ECU_ADDRESS 0x40004EA0 FORMAT "%5.0" SYMBOL_LINK "cpd_air_rat_lo_info" 0 /end MEASUREMENT
/begin MEASUREMENT cpd_iat_rat_lo_fn "iat rat low diag finish" UBYTE b_true 0 0 0.00 1.00 BIT_MASK 0x08 ECU_ADDRESS 0x40004EA0 FORMAT "%5.0" SYMBOL_LINK "cpd_air_rat_lo_info" 4 /end MEASUREMENT
/begin MEASUREMENT cpd_iat_rat_lo_fl "iat rat low diag fail" UBYTE b_true 0 0 0.00 1.00 BIT_MASK 0x04 ECU_ADDRESS 0x40004EA0 FORMAT "%5.0" SYMBOL_LINK "cpd_air_rat_lo_info" 4 /end MEASUREMENT
/begin MEASUREMENT cpd_iat_rat_hi_fl_cnt "iat rat high fail counts" UWORD u_cnts 0 0 0 65535 ECU_ADDRESS 0x40004EA0 FORMAT "%5.0" SYMBOL_LINK "cpd_air_rat_hi_info" 0 /end MEASUREMENT
/begin MEASUREMENT cpd_iat_rat_hi_fn "iat rat high diag finish" UBYTE b_true 0 0 0.00 1.00 BIT_MASK 0x08 ECU_ADDRESS 0x40004EA0 FORMAT "%5.0" SYMBOL_LINK "cpd_air_rat_hi_info" 4 /end MEASUREMENT
/begin MEASUREMENT cpd_iat_rat_hi_fl "iat rat high diag fail" UBYTE b_true 0 0 0.00 1.00 BIT_MASK 0x04 ECU_ADDRESS 0x40004EA0 FORMAT "%5.0" SYMBOL_LINK "cpd_air_rat_hi_info" 4 /end MEASUREMENT
/begin MEASUREMENT cpd_bat_vlt_hi_fl_cnt "battery volt high fail counts" UWORD u_cnts 0 0 0 65535 ECU_ADDRESS 0x40004EA0 FORMAT "%5.0" SYMBOL_LINK "cpd_bat_vlt_hi_info" 0 /end MEASUREMENT
/begin MEASUREMENT cpd_bat_vlt_hi_diag_cnt "battery volt high diag counts" UWORD u_cnts 0 0 0 65535 ECU_ADDRESS 0x40004EA0 FORMAT "%5.0" SYMBOL_LINK "cpd_bat_vlt_hi_info" 2 /end MEASUREMENT
/begin MEASUREMENT cpd_bat_vlt_hi_diag_en "battery volt high diag enable conditions met" UBYTE b_true 0 0 0.00 1.00 BIT_MASK 0x20 ECU_ADDRESS 0x40004EA0 FORMAT "%5.0" SYMBOL_LINK "cpd_bat_vlt_hi_info" 4 /end MEASUREMENT
/begin MEASUREMENT cpd_bat_vlt_hi_fl_met "battery volt high diag fail conditions met" UBYTE b_true 0 0 0.00 1.00 BIT_MASK 0x10 ECU_ADDRESS 0x40004EA0 FORMAT "%5.0" SYMBOL_LINK "cpd_bat_vlt_hi_info" 4 /end MEASUREMENT
/begin MEASUREMENT cpd_bat_vlt_hi_fn "battery volt high diag finish" UBYTE b_true 0 0 0.00 1.00 BIT_MASK 0x08 ECU_ADDRESS 0x40004EA0 FORMAT "%5.0" SYMBOL_LINK "cpd_bat_vlt_hi_info" 4 /end MEASUREMENT
/begin MEASUREMENT cpd_bat_vlt_hi_fl "battery volt high diag fail" UBYTE b_true 0 0 0.00 1.00 BIT_MASK 0x04 ECU_ADDRESS 0x40004EA0 FORMAT "%5.0" SYMBOL_LINK "cpd_bat_vlt_hi_info" 4 /end MEASUREMENT
/begin MEASUREMENT cpd_bat_vlt_hi_rpt_st "battery volt high diag report state" UBYTE u_rpt_st 0 0 0.00 2.00 BIT_MASK 0x03 ECU_ADDRESS 0x40004EA0 SYMBOL_LINK "cpd_bat_vlt_hi_info" 4 /end MEASUREMENT
/begin MEASUREMENT cpd_bat_vlt_lo_fl_cnt "battery volt low fail counts" UWORD u_cnts 0 0 0 65535 ECU_ADDRESS 0x40004EA0 FORMAT "%5.0" SYMBOL_LINK "cpd_bat_vlt_lo_info" 0 /end MEASUREMENT
/begin MEASUREMENT cpd_bat_vlt_lo_diag_cnt "battery volt low diag counts" UWORD u_cnts 0 0 0 65535 ECU_ADDRESS 0x40004EA0 FORMAT "%5.0" SYMBOL_LINK "cpd_bat_vlt_lo_info" 2 /end MEASUREMENT
/begin MEASUREMENT cpd_bat_vlt_lo_diag_en "battery volt low diag enable conditions met" UBYTE b_true 0 0 0.00 1.00 BIT_MASK 0x20 ECU_ADDRESS 0x40004EA0 FORMAT "%5.0" SYMBOL_LINK "cpd_bat_vlt_lo_info" 4 /end MEASUREMENT
/begin MEASUREMENT cpd_bat_vlt_lo_fl_met "battery volt low diag fail conditions met" UBYTE b_true 0 0 0.00 1.00 BIT_MASK 0x10 ECU_ADDRESS 0x40004EA0 FORMAT "%5.0" SYMBOL_LINK "cpd_bat_vlt_lo_info" 4 /end MEASUREMENT
/begin MEASUREMENT cpd_bat_vlt_lo_fn "battery volt low diag finish" UBYTE b_true 0 0 0.00 1.00 BIT_MASK 0x08 ECU_ADDRESS 0x40004EA0 FORMAT "%5.0" SYMBOL_LINK "cpd_bat_vlt_lo_info" 4 /end MEASUREMENT
/begin MEASUREMENT cpd_bat_vlt_lo_fl "battery volt low diag fail" UBYTE b_true 0 0 0.00 1.00 BIT_MASK 0x04 ECU_ADDRESS 0x40004EA0 FORMAT "%5.0" SYMBOL_LINK "cpd_bat_vlt_lo_info" 4 /end MEASUREMENT
/begin MEASUREMENT cpd_bat_vlt_lo_rpt_st "battery volt low diag report state" UBYTE u_rpt_st 0 0 0.00 2.00 BIT_MASK 0x03 ECU_ADDRESS 0x40004EA0 SYMBOL_LINK "cpd_bat_vlt_lo_info" 4 /end MEASUREMENT
/begin MEASUREMENT cpd_pps1_lo_fl_met "pps1 low diag fail conditions met" UBYTE b_true 0 0 0.00 1.00 ECU_ADDRESS 0x40004EA0 FORMAT "%1.0" SYMBOL_LINK "cpd_pps_lo_fl_st" 0 /end MEASUREMENT
/begin MEASUREMENT cpd_pps1_lo_fl "pps1 low diag fail" UBYTE b_true 0 0 0.00 1.00 ECU_ADDRESS 0x40004EA0 FORMAT "%1.0" SYMBOL_LINK "cpd_pps_lo_fl_st" 1 /end MEASUREMENT
/begin MEASUREMENT cpd_pps2_lo_fl_met "pps2 low diag fail conditions met" UBYTE b_true 0 0 0.00 1.00 ECU_ADDRESS 0x40004EA0 FORMAT "%1.0" SYMBOL_LINK "cpd_pps_lo_fl_st" 2 /end MEASUREMENT
/begin MEASUREMENT cpd_pps2_lo_fl "pps2 low diag fail" UBYTE b_true 0 0 0.00 1.00 ECU_ADDRESS 0x40004EA0 FORMAT "%1.0" SYMBOL_LINK "cpd_pps_lo_fl_st" 3 /end MEASUREMENT
/begin MEASUREMENT cpd_pps1_hi_fl_met "pps1 high diag fail conditions met" UBYTE b_true 0 0 0.00 1.00 ECU_ADDRESS 0x40004EA0 FORMAT "%1.0" SYMBOL_LINK "cpd_pps_hi_fl_st" 0 /end MEASUREMENT
/begin MEASUREMENT cpd_pps1_hi_fl "pps1 high diag fail" UBYTE b_true 0 0 0.00 1.00 ECU_ADDRESS 0x40004EA0 FORMAT "%1.0" SYMBOL_LINK "cpd_pps_hi_fl_st" 1 /end MEASUREMENT
/begin MEASUREMENT cpd_pps2_hi_fl_met "pps2 high diag fail conditions met" UBYTE b_true 0 0 0.00 1.00 ECU_ADDRESS 0x40004EA0 FORMAT "%1.0" SYMBOL_LINK "cpd_pps_hi_fl_st" 2 /end MEASUREMENT
/begin MEASUREMENT cpd_pps2_hi_fl "pps2 high diag fail" UBYTE b_true 0 0 0.00 1.00 ECU_ADDRESS 0x40004EA0 FORMAT "%1.0" SYMBOL_LINK "cpd_pps_hi_fl_st" 3 /end MEASUREMENT
/begin MEASUREMENT cpd_pps1_lo_rpt_st "pps1 low diag report state" UBYTE u_rpt_st 0 0 0.00 2.00 BIT_MASK 0x03 ECU_ADDRESS 0x40004EA0 SYMBOL_LINK "cpd_pps_lo_cnts" 2 /end MEASUREMENT
/begin MEASUREMENT cpd_pps1_lo_diag_cnt "pps1 low diag counts" UWORD u_cnts 0 0 0 65535 ECU_ADDRESS 0x40004EA0 FORMAT "%5.0" SYMBOL_LINK "cpd_pps_lo_cnts" 4 /end MEASUREMENT
/begin MEASUREMENT cpd_pps1_lo_fl_cnt "pps1 volt low fail counts" UWORD u_cnts 0 0 0 65535 ECU_ADDRESS 0x40004EA0 FORMAT "%5.0" SYMBOL_LINK "cpd_pps_lo_cnts" 6 /end MEASUREMENT
/begin MEASUREMENT cpd_pps2_lo_rpt_st "pps2 low diag report state" UBYTE u_rpt_st 0 0 0.00 2.00 BIT_MASK 0x03 ECU_ADDRESS 0x40004EA0 SYMBOL_LINK "cpd_pps_lo_cnts" 10 /end MEASUREMENT
/begin MEASUREMENT cpd_pps2_lo_diag_cnt "pps2 low diag counts" UWORD u_cnts 0 0 0 65535 ECU_ADDRESS 0x40004EA0 FORMAT "%5.0" SYMBOL_LINK "cpd_pps_lo_cnts" 12 /end MEASUREMENT
/begin MEASUREMENT sys_pps2_lo_fl_cnt "pps2 volt low fail counts" UWORD u_cnts 0 0 0 65535 ECU_ADDRESS 0x40004EA0 FORMAT "%5.0" SYMBOL_LINK "cpd_pps_lo_cnts" 14 /end MEASUREMENT
/begin MEASUREMENT cpd_pps1_hi_rpt_st "pps1 high diag report state" UBYTE u_rpt_st 0 0 0.00 2.00 BIT_MASK 0x03 ECU_ADDRESS 0x40004EA0 SYMBOL_LINK "cpd_pps_hi_cnts" 2 /end MEASUREMENT
/begin MEASUREMENT cpd_pps1_hi_diag_cnt "pps1 high diag counts" UWORD u_cnts 0 0 0 65535 ECU_ADDRESS 0x40004EA0 FORMAT "%5.0" SYMBOL_LINK "cpd_pps_hi_cnts" 4 /end MEASUREMENT
/begin MEASUREMENT cpd_pps1_hi_fl_cnt "pps1 volt high fail counts" UWORD u_cnts 0 0 0 65535 ECU_ADDRESS 0x40004EA0 FORMAT "%5.0" SYMBOL_LINK "cpd_pps_hi_cnts" 6 /end MEASUREMENT
/begin MEASUREMENT cpd_pps2_hi_rpt_st "pps2 high diag report state" UBYTE u_rpt_st 0 0 0.00 2.00 BIT_MASK 0x03 ECU_ADDRESS 0x40004EA0 SYMBOL_LINK "cpd_pps_hi_cnts" 10 /end MEASUREMENT
/begin MEASUREMENT cpd_pps2_hi_diag_cnt "pps2 high diag counts" UWORD u_cnts 0 0 0 65535 ECU_ADDRESS 0x40004EA0 FORMAT "%5.0" SYMBOL_LINK "cpd_pps_hi_cnts" 12 /end MEASUREMENT
/begin MEASUREMENT sys_pps2_hi_fl_cnt "pps2 volt high fail counts" UWORD u_cnts 0 0 0 65535 ECU_ADDRESS 0x40004EA0 FORMAT "%5.0" SYMBOL_LINK "cpd_pps_hi_cnts" 14 /end MEASUREMENT
/begin MEASUREMENT cpd_pps_cor_dlt "pps12 delta for correlation diag" SWORD u_pct_s 0 0 -200 199.993896484375 ECU_ADDRESS 0x4000DA4E /end MEASUREMENT
/begin MEASUREMENT cpd_pps_cor_zero_out "pps zero delta out of range" UBYTE b_true 0 0 0.00 1.00 ECU_ADDRESS 0x40004EA0 FORMAT "%1.0" /end MEASUREMENT
/begin MEASUREMENT cpd_pps_cor_zero_out_r "runduant pps zero delta out of range" UBYTE b_true 0 0 0.00 1.00 ECU_ADDRESS 0x40004EA0 FORMAT "%1.0" /end MEASUREMENT
/begin MEASUREMENT cpd_pps_cor_fl_met_r "runduant pps correlation diag fail conditions met" UBYTE b_true 0 0 0.00 1.00 ECU_ADDRESS 0x40004EA0 FORMAT "%1.0" SYMBOL_LINK "cpd_pps_cor_fl_st_r" 0 /end MEASUREMENT
/begin MEASUREMENT cpd_pps_cor_fl_r "runduant pps correlation diag fail" UBYTE b_true 0 0 0.00 1.00 ECU_ADDRESS 0x40004EA0 FORMAT "%1.0" SYMBOL_LINK "cpd_pps_cor_fl_st_r" 1 /end MEASUREMENT
/begin MEASUREMENT cpd_pps_cor_fl_met "pps correlation diag fail conditions met" UBYTE b_true 0 0 0.00 1.00 ECU_ADDRESS 0x40004EA0 FORMAT "%1.0" SYMBOL_LINK "cpd_pps_cor_fl_st" 0 /end MEASUREMENT
/begin MEASUREMENT cpd_pps_cor_fl "pps correlation diag fail" UBYTE b_true 0 0 0.00 1.00 ECU_ADDRESS 0x40004EA0 FORMAT "%1.0" SYMBOL_LINK "cpd_pps_cor_fl_st" 1 /end MEASUREMENT
/begin MEASUREMENT cpd_pps_cor_rpt_st_r "pps correlation diag report state" UBYTE u_rpt_st 0 0 0.00 2.00 BIT_MASK 0x03 ECU_ADDRESS 0x40004EA0 SYMBOL_LINK "cpd_pps_cor_cnts_r" 2 /end MEASUREMENT
/begin MEASUREMENT cpd_pps_cor_diag_cnt_r "pps correlation diag counts" UWORD u_cnts 0 0 0 65535 ECU_ADDRESS 0x40004EA0 FORMAT "%5.0" SYMBOL_LINK "cpd_pps_cor_cnts_r" 4 /end MEASUREMENT
/begin MEASUREMENT cpd_pps_cor_fl_cnt_r "pps correlation low fail counts" UWORD u_cnts 0 0 0 65535 ECU_ADDRESS 0x40004EA0 FORMAT "%5.0" SYMBOL_LINK "cpd_pps_cor_cnts_r" 6 /end MEASUREMENT
/begin MEASUREMENT cpd_pps_cor_rpt_st "pps correlation diag report state" UBYTE u_rpt_st 0 0 0.00 2.00 BIT_MASK 0x03 ECU_ADDRESS 0x40004EA0 SYMBOL_LINK "cpd_pps_cor_cnts" 2 /end MEASUREMENT
/begin MEASUREMENT cpd_pps_cor_diag_cnt "pps correlation diag counts" UWORD u_cnts 0 0 0 65535 ECU_ADDRESS 0x40004EA0 FORMAT "%5.0" SYMBOL_LINK "cpd_pps_cor_cnts" 4 /end MEASUREMENT
/begin MEASUREMENT cpd_pps_cor_fl_cnt "pps correlation low fail counts" UWORD u_cnts 0 0 0 65535 ECU_ADDRESS 0x40004EA0 FORMAT "%5.0" SYMBOL_LINK "cpd_pps_cor_cnts" 6 /end MEASUREMENT
/begin MEASUREMENT cpd_tps1_hi_fl_met "tps1 high diag fail conditions met" UBYTE b_true 0 0 0.00 1.00 ECU_ADDRESS 0x40004EA0 FORMAT "%1.0" SYMBOL_LINK "cpd_tps1_hi_fl_st" 0 /end MEASUREMENT
/begin MEASUREMENT cpd_tps1_hi_fl "tps1 high diag fail" UBYTE b_true 0 0 0.00 1.00 ECU_ADDRESS 0x40004EA0 FORMAT "%1.0" SYMBOL_LINK "cpd_tps1_hi_fl_st" 1 /end MEASUREMENT
/begin MEASUREMENT cpd_tps2_hi_fl_met "tps2 high diag fail conditions met" UBYTE b_true 0 0 0.00 1.00 ECU_ADDRESS 0x40004EA0 FORMAT "%1.0" SYMBOL_LINK "cpd_tps2_hi_fl_st" 0 /end MEASUREMENT
/begin MEASUREMENT cpd_tps2_hi_fl "tps2 high diag fail" UBYTE b_true 0 0 0.00 1.00 ECU_ADDRESS 0x40004EA0 FORMAT "%1.0" SYMBOL_LINK "cpd_tps2_hi_fl_st" 1 /end MEASUREMENT
/begin MEASUREMENT cpd_tps1_lo_fl_met "tps1 low diag fail conditions met" UBYTE b_true 0 0 0.00 1.00 ECU_ADDRESS 0x40004EA0 FORMAT "%1.0" SYMBOL_LINK "cpd_tps1_lo_fl_st" 0 /end MEASUREMENT
/begin MEASUREMENT cpd_tps1_lo_fl "tps1 low diag fail" UBYTE b_true 0 0 0.00 1.00 ECU_ADDRESS 0x40004EA0 FORMAT "%1.0" SYMBOL_LINK "cpd_tps1_lo_fl_st" 1 /end MEASUREMENT
/begin MEASUREMENT cpd_tps2_lo_fl_met "tps2 low diag fail conditions met" UBYTE b_true 0 0 0.00 1.00 ECU_ADDRESS 0x40004EA0 FORMAT "%1.0" SYMBOL_LINK "cpd_tps2_lo_fl_st" 0 /end MEASUREMENT
/begin MEASUREMENT cpd_tps2_lo_fl "tps2 low diag fail" UBYTE b_true 0 0 0.00 1.00 ECU_ADDRESS 0x40004EA0 FORMAT "%1.0" SYMBOL_LINK "cpd_tps2_lo_fl_st" 1 /end MEASUREMENT
/begin MEASUREMENT cpd_tps1_hi_rpt_st "tps1 high diag report state" UBYTE u_rpt_st 0 0 0.00 2.00 BIT_MASK 0x03 ECU_ADDRESS 0x40004EA0 SYMBOL_LINK "cpd_tps1_hi_cnts" 2 /end MEASUREMENT
/begin MEASUREMENT cpd_tps1_hi_diag_cnt "tps1 high diag counts" UWORD u_cnts 0 0 0 65535 ECU_ADDRESS 0x40004EA0 FORMAT "%5.0" SYMBOL_LINK "cpd_tps1_hi_cnts" 4 /end MEASUREMENT
/begin MEASUREMENT cpd_tps1_hi_fl_cnt "tps1 high fail counts" UWORD u_cnts 0 0 0 65535 ECU_ADDRESS 0x40004EA0 FORMAT "%5.0" SYMBOL_LINK "cpd_tps1_hi_cnts" 6 /end MEASUREMENT
/begin MEASUREMENT cpd_tps1_lo_rpt_st "tps1 low diag report state" UBYTE u_rpt_st 0 0 0.00 2.00 BIT_MASK 0x03 ECU_ADDRESS 0x40004EA0 SYMBOL_LINK "cpd_tps1_lo_cnts" 2 /end MEASUREMENT
/begin MEASUREMENT cpd_tps1_lo_diag_cnt "tps1 low diag counts" UWORD u_cnts 0 0 0 65535 ECU_ADDRESS 0x40004EA0 FORMAT "%5.0" SYMBOL_LINK "cpd_tps1_lo_cnts" 4 /end MEASUREMENT
/begin MEASUREMENT cpd_tps1_lo_fl_cnt "tps1 low fail counts" UWORD u_cnts 0 0 0 65535 ECU_ADDRESS 0x40004EA0 FORMAT "%5.0" SYMBOL_LINK "cpd_tps1_lo_cnts" 6 /end MEASUREMENT
/begin MEASUREMENT cpd_tps2_hi_rpt_st "tps2 high diag report state" UBYTE u_rpt_st 0 0 0.00 2.00 BIT_MASK 0x03 ECU_ADDRESS 0x40004EA0 SYMBOL_LINK "cpd_tps2_hi_cnts" 2 /end MEASUREMENT
/begin MEASUREMENT cpd_tps2_hi_diag_cnt "tps2 high diag counts" UWORD u_cnts 0 0 0 65535 ECU_ADDRESS 0x40004EA0 FORMAT "%5.0" SYMBOL_LINK "cpd_tps2_hi_cnts" 4 /end MEASUREMENT
/begin MEASUREMENT cpd_tps2_hi_fl_cnt "tps2 high fail counts" UWORD u_cnts 0 0 0 65535 ECU_ADDRESS 0x40004EA0 FORMAT "%5.0" SYMBOL_LINK "cpd_tps2_hi_cnts" 6 /end MEASUREMENT
/begin MEASUREMENT cpd_tps2_lo_rpt_st "tps2 low diag report state" UBYTE u_rpt_st 0 0 0.00 2.00 BIT_MASK 0x03 ECU_ADDRESS 0x40004EA0 SYMBOL_LINK "cpd_tps2_lo_cnts" 2 /end MEASUREMENT
/begin MEASUREMENT cpd_tps2_lo_diag_cnt "tps2 low diag counts" UWORD u_cnts 0 0 0 65535 ECU_ADDRESS 0x40004EA0 FORMAT "%5.0" SYMBOL_LINK "cpd_tps2_lo_cnts" 4 /end MEASUREMENT
/begin MEASUREMENT cpd_tps2_lo_fl_cnt "tps2 low fail counts" UWORD u_cnts 0 0 0 65535 ECU_ADDRESS 0x40004EA0 FORMAT "%5.0" SYMBOL_LINK "cpd_tps2_lo_cnts" 6 /end MEASUREMENT
/begin MEASUREMENT cpd_tps_cor_en "tps correlation diag enable" UBYTE b_true 0 0 0.00 1.00 ECU_ADDRESS 0x40004EA0 FORMAT "%1.0" /end MEASUREMENT
/begin MEASUREMENT cpd_tps_cor_fl_met "tps correlation diag fail conditions met" UBYTE b_true 0 0 0.00 1.00 ECU_ADDRESS 0x40004EA0 FORMAT "%1.0" SYMBOL_LINK "cpd_tps_cor_fl_st" 0 /end MEASUREMENT
/begin MEASUREMENT cpd_tps_cor_fl "tps correlation diag fail" UBYTE b_true 0 0 0.00 1.00 ECU_ADDRESS 0x40004EA0 FORMAT "%1.0" SYMBOL_LINK "cpd_tps_cor_fl_st" 1 /end MEASUREMENT
/begin MEASUREMENT cpd_tps_cor_rpt_st "tps correlation diag report state" UBYTE u_rpt_st 0 0 0.00 2.00 BIT_MASK 0x03 ECU_ADDRESS 0x40004EA0 SYMBOL_LINK "cpd_tps_cor_cnts" 2 /end MEASUREMENT
/begin MEASUREMENT cpd_tps_cor_diag_cnt "tps correlation diag counts" UWORD u_cnts 0 0 0 65535 ECU_ADDRESS 0x40004EA0 FORMAT "%5.0" SYMBOL_LINK "cpd_tps_cor_cnts" 4 /end MEASUREMENT
/begin MEASUREMENT cpd_tps_cor_fl_cnt "tps correlation fail counts" UWORD u_cnts 0 0 0 65535 ECU_ADDRESS 0x40004EA0 FORMAT "%5.0" SYMBOL_LINK "cpd_tps_cor_cnts" 6 /end MEASUREMENT
/begin MEASUREMENT cpd_tps_cor_zero_out "tps zero delta out of range" UBYTE b_true 0 0 0.00 1.00 ECU_ADDRESS 0x40004EA0 FORMAT "%1.0" /end MEASUREMENT
/begin MEASUREMENT cpd_tps_dflt_en "tps default position diag enable" UBYTE b_true 0 0 0.00 1.00 ECU_ADDRESS 0x40004EA0 FORMAT "%1.0" /end MEASUREMENT
/begin MEASUREMENT cpd_tps_dflt_tmr "tps default diag delay" UWORD u_2x_tmr 0 0 0.00 1023.984375 ECU_ADDRESS 0x400050DA /end MEASUREMENT
/begin MEASUREMENT cpd_tps_dflt_fl "tps default position fail" UBYTE b_true 0 0 0.00 1.00 ECU_ADDRESS 0x40004EA0 FORMAT "%1.0" /end MEASUREMENT
/begin MEASUREMENT cpd_tps_dflt_fl_cnt "tps default position fail counts" UWORD u_cnts 0 0 0 65535 ECU_ADDRESS 0x40004EA0 FORMAT "%5.0" SYMBOL_LINK "cpd_tps_dflt_fl_cnt" 6 /end MEASUREMENT
/begin MEASUREMENT cpd_tps_dflt_diag_cnt "tps default position diag counts" UWORD u_cnts 0 0 0 65535 ECU_ADDRESS 0x40004EA0 FORMAT "%5.0" SYMBOL_LINK "cpd_tps_dflt_diag_cnt" 6 /end MEASUREMENT
/begin MEASUREMENT cpd_tps_dflt_fl_met "tps default position fail met" UBYTE b_true 0 0 0.00 1.00 ECU_ADDRESS 0x40004EA0 FORMAT "%1.0" /end MEASUREMENT
/begin MEASUREMENT cpd_ac_t_hi_en "ac temp high diag en" UBYTE b_true 0 0 0.00 1.00 ECU_ADDRESS 0x40004EA0 FORMAT "%1.0" /end MEASUREMENT
/begin MEASUREMENT cpd_ac_t_hi_fl_met "ac temp high fail met" UBYTE b_true 0 0 0.00 1.00 ECU_ADDRESS 0x40004EA0 FORMAT "%1.0" /end MEASUREMENT
/begin MEASUREMENT cpd_ac_t_hi_fn "ac temp high diag finish" UBYTE b_true 0 0 0.00 1.00 ECU_ADDRESS 0x40004EA0 FORMAT "%1.0" /end MEASUREMENT
/begin MEASUREMENT cpd_ac_t_hi_fl_cnt "ac temp fail counts" UWORD u_cnts 0 0 0 65535 ECU_ADDRESS 0x40004EA0 FORMAT "%5.0" /end MEASUREMENT
/begin MEASUREMENT cpd_ac_t_hi_diag_cnt "ac temp diag counts" UWORD u_cnts 0 0 0 65535 ECU_ADDRESS 0x40004EA0 FORMAT "%5.0" /end MEASUREMENT
/begin MEASUREMENT cpd_ac_t_lo_en "ac temp low diag en" UBYTE b_true 0 0 0.00 1.00 ECU_ADDRESS 0x40004EA0 FORMAT "%1.0" /end MEASUREMENT
/begin MEASUREMENT cpd_ac_t_lo_fl_met "ac temp low fail met" UBYTE b_true 0 0 0.00 1.00 ECU_ADDRESS 0x40004EA0 FORMAT "%1.0" /end MEASUREMENT
/begin MEASUREMENT cpd_ac_t_lo_fn "ac temp low diag finish" UBYTE b_true 0 0 0.00 1.00 ECU_ADDRESS 0x40004EA0 FORMAT "%1.0" /end MEASUREMENT
/begin MEASUREMENT cpd_ac_t_lo_fl_cnt "ac temp fail counts" UWORD u_cnts 0 0 0 65535 ECU_ADDRESS 0x40004EA0 FORMAT "%5.0" /end MEASUREMENT
/begin MEASUREMENT cpd_ac_t_lo_diag_cnt "ac temp diag counts" UWORD u_cnts 0 0 0 65535 ECU_ADDRESS 0x40004EA0 FORMAT "%5.0" /end MEASUREMENT
/begin MEASUREMENT cpd_cam_st "cam state for crank sensor diag" UBYTE u_cnts 0 0 0.00 1.00 ECU_ADDRESS 0x40004EA0 FORMAT "%1.0" /end MEASUREMENT
/begin MEASUREMENT cpd_crk_opn_en "crank sensor open diag enable" UBYTE b_true 0 0 0.00 1.00 ECU_ADDRESS 0x40004EA0 FORMAT "%1.0" /end MEASUREMENT
/begin MEASUREMENT cpd_crk_opn_fl_met "crank sensor open diag fail met" UBYTE b_true 0 0 0.00 1.00 ECU_ADDRESS 0x40004EA0 FORMAT "%1.0" /end MEASUREMENT
/begin MEASUREMENT cpd_crk_opn_fl "crank sensor open diag fail" UBYTE b_true 0 0 0.00 1.00 ECU_ADDRESS 0x40004EA0 FORMAT "%1.0" /end MEASUREMENT
/begin MEASUREMENT cpd_crk_opn_fn "crank sensor open diag finish" UBYTE b_true 0 0 0.00 1.00 ECU_ADDRESS 0x40004EA0 FORMAT "%1.0" /end MEASUREMENT
/begin MEASUREMENT cpd_crk_opn_fl_cnt "crank sensor open diag fail counts" UWORD u_cnts 0 0 0 65535 ECU_ADDRESS 0x40004EA0 FORMAT "%5.0" /end MEASUREMENT
/begin MEASUREMENT cpd_crk_opn_rpt_st "crank open report state" UBYTE u_rpt_st 0 0 0.00 2.00 BIT_MASK 0x03 ECU_ADDRESS 0x40004EA0 /end MEASUREMENT
/begin MEASUREMENT cpd_crk_tooth_err "crank sensor tooth error counts" UWORD u_cnts 0 0 0 65535 ECU_ADDRESS 0x40004EA0 FORMAT "%5.0" /end MEASUREMENT
/begin MEASUREMENT cpd_crk_perf_fl_met "crank sensor performence diag fail met" UBYTE b_true 0 0 0.00 1.00 ECU_ADDRESS 0x40004EA0 FORMAT "%1.0" /end MEASUREMENT
/begin MEASUREMENT cpd_crk_perf_fn "crank sensor performence diag finish" UBYTE b_true 0 0 0.00 1.00 ECU_ADDRESS 0x40004EA0 FORMAT "%1.0" /end MEASUREMENT
/begin MEASUREMENT cpd_crk_perf_fl "crank sensor performence diag fail" UBYTE b_true 0 0 0.00 1.00 ECU_ADDRESS 0x40004EA0 FORMAT "%1.0" /end MEASUREMENT
/begin MEASUREMENT cpd_crk_perf_fl_cnt "crank sensor performence diag fail counts" UWORD u_cnts 0 0 0 65535 ECU_ADDRESS 0x40004EA0 FORMAT "%5.0" /end MEASUREMENT
/begin MEASUREMENT cpd_crk_perf_diag_cnt "crank sensor performence diag counts" UWORD u_cnts 0 0 0 65535 ECU_ADDRESS 0x40004EA0 FORMAT "%5.0" /end MEASUREMENT
/begin MEASUREMENT cpd_crk_perf_rpt_st "crank open report state" UBYTE u_rpt_st 0 0 0.00 2.00 BIT_MASK 0x03 ECU_ADDRESS 0x40004EA0 /end MEASUREMENT
/begin MEASUREMENT cpd_cam_opn_en "cam sensor open diag enable" UBYTE b_true 0 0 0.00 1.00 ECU_ADDRESS 0x40004EA0 FORMAT "%1.0" /end MEASUREMENT
/begin MEASUREMENT cpd_cam_stuck "cam sensor stuck" UBYTE b_true 0 0 0.00 1.00 ECU_ADDRESS 0x40004EA0 FORMAT "%1.0" /end MEASUREMENT
/begin MEASUREMENT cpd_cam_opn_fl_cnt "cam sensor open diag fail counts" UWORD u_cnts 0 0 0 65535 ECU_ADDRESS 0x40004EA0 FORMAT "%5.0" /end MEASUREMENT
/begin MEASUREMENT cpd_cam_opn_fl "cam sensor open diag fail" UBYTE b_true 0 0 0.00 1.00 ECU_ADDRESS 0x40004EA0 FORMAT "%1.0" /end MEASUREMENT
/begin MEASUREMENT cpd_cam_opn_fn "cam sensor open diag finish" UBYTE b_true 0 0 0.00 1.00 ECU_ADDRESS 0x40004EA0 FORMAT "%1.0" /end MEASUREMENT
/begin MEASUREMENT cpd_cam_perf_en "cam sensor performence diag enable" UBYTE b_true 0 0 0.00 1.00 ECU_ADDRESS 0x40004EA0 FORMAT "%1.0" /end MEASUREMENT
/begin MEASUREMENT cpd_cam_rat_fnd "cam sensor rat find" UBYTE b_true 0 0 0.00 1.00 ECU_ADDRESS 0x40004EA0 FORMAT "%1.0" /end MEASUREMENT
/begin MEASUREMENT cpd_cam_evnt_cnt "cam sensor event counts" UBYTE u_cnts 0 0 0 255 ECU_ADDRESS 0x40004EA0 FORMAT "%1.0" /end MEASUREMENT
/begin MEASUREMENT cpd_cam_perf_fl_met "cam sensor performence fail met" UBYTE b_true 0 0 0.00 1.00 ECU_ADDRESS 0x40004EA0 FORMAT "%1.0" /end MEASUREMENT
/begin MEASUREMENT cpd_cam_perf_fl "cam sensor performence fail" UBYTE b_true 0 0 0.00 1.00 ECU_ADDRESS 0x40004EA0 FORMAT "%1.0" /end MEASUREMENT
/begin MEASUREMENT cpd_cam_perf_fl_cnt "cam sensor performence diag fail counts" UWORD u_cnts 0 0 0 65535 ECU_ADDRESS 0x40004EA0 FORMAT "%5.0" /end MEASUREMENT
/begin MEASUREMENT cpd_cam_perf_pss_cnt "cam sensor performence diag pass counts" UWORD u_cnts 0 0 0 65535 ECU_ADDRESS 0x40004EA0 FORMAT "%5.0" /end MEASUREMENT
/begin MEASUREMENT cpd_cam_perf_fn "cam sensor performence finish" UBYTE b_true 0 0 0.00 1.00 ECU_ADDRESS 0x40004EA0 FORMAT "%1.0" /end MEASUREMENT
/begin MEASUREMENT cpd_vspd_pwr_en_dly "vss diag power mode enable delay" UWORD u_16x_tmr 0 0 0 8191.875 ECU_ADDRESS 0x40004EA0 /end MEASUREMENT
/begin MEASUREMENT cpd_vspd_pwr_fl_cnt "vss sensor power mode fail counts" UWORD u_cnts 0 0 0 65535 ECU_ADDRESS 0x40004EA0 FORMAT "%5.0" SYMBOL_LINK "cpd_vspd_pwr_info" 0 /end MEASUREMENT
/begin MEASUREMENT cpd_vspd_pwr_diag_cnt "vss sensor power mode diag counts" UWORD u_cnts 0 0 0 65535 ECU_ADDRESS 0x40004EA0 FORMAT "%5.0" SYMBOL_LINK "cpd_vspd_pwr_info" 2 /end MEASUREMENT
/begin MEASUREMENT cpd_vspd_pwr_diag_en "vss sensor power mode diag enable conditions met" UBYTE b_true 0 0 0.00 1.00 BIT_MASK 0x20 ECU_ADDRESS 0x40004EA0 FORMAT "%5.0" SYMBOL_LINK "cpd_vspd_pwr_info" 4 /end MEASUREMENT
/begin MEASUREMENT cpd_vspd_pwr_fl_met "vss sensor power mode diag fail conditions met" UBYTE b_true 0 0 0.00 1.00 BIT_MASK 0x10 ECU_ADDRESS 0x40004EA0 FORMAT "%5.0" SYMBOL_LINK "cpd_vspd_pwr_info" 4 /end MEASUREMENT
/begin MEASUREMENT cpd_vspd_pwr_fn "vss sensor power mode diag finish" UBYTE b_true 0 0 0.00 1.00 BIT_MASK 0x08 ECU_ADDRESS 0x40004EA0 FORMAT "%5.0" SYMBOL_LINK "cpd_vspd_pwr_info" 4 /end MEASUREMENT
/begin MEASUREMENT cpd_vspd_pwr_fl "vss sensor power mode diag fail" UBYTE b_true 0 0 0.00 1.00 BIT_MASK 0x04 ECU_ADDRESS 0x40004EA0 FORMAT "%5.0" SYMBOL_LINK "cpd_vspd_pwr_info" 4 /end MEASUREMENT
/begin MEASUREMENT cpd_vspd_pwr_rpt_st "vss sensor power mode diag report state" UBYTE u_rpt_st 0 0 0.00 2.00 BIT_MASK 0x03 ECU_ADDRESS 0x40004EA0 SYMBOL_LINK "cpd_vspd_pwr_info" 4 /end MEASUREMENT
/begin MEASUREMENT cpd_vspd_dcl_fl_cnt "vss sensor decel mode fail counts" UWORD u_cnts 0 0 0 65535 ECU_ADDRESS 0x40004EA0 FORMAT "%5.0" SYMBOL_LINK "cpd_vspd_dcl_info" 0 /end MEASUREMENT
/begin MEASUREMENT cpd_vspd_dcl_diag_cnt "vss sensor decel mode diag counts" UWORD u_cnts 0 0 0 65535 ECU_ADDRESS 0x40004EA0 FORMAT "%5.0" SYMBOL_LINK "cpd_vspd_dcl_info" 2 /end MEASUREMENT
/begin MEASUREMENT cpd_vspd_dcl_diag_en "vss sensor decel mode diag enable conditions met" UBYTE b_true 0 0 0.00 1.00 BIT_MASK 0x20 ECU_ADDRESS 0x40004EA0 FORMAT "%5.0" SYMBOL_LINK "cpd_vspd_dcl_info" 4 /end MEASUREMENT
/begin MEASUREMENT cpd_vspd_dcl_fl_met "vss sensor decel mode diag fail conditions met" UBYTE b_true 0 0 0.00 1.00 BIT_MASK 0x10 ECU_ADDRESS 0x40004EA0 FORMAT "%5.0" SYMBOL_LINK "cpd_vspd_dcl_info" 4 /end MEASUREMENT
/begin MEASUREMENT cpd_vspd_dcl_fn "vss sensor decel mode diag finish" UBYTE b_true 0 0 0.00 1.00 BIT_MASK 0x08 ECU_ADDRESS 0x40004EA0 FORMAT "%5.0" SYMBOL_LINK "cpd_vspd_dcl_info" 4 /end MEASUREMENT
/begin MEASUREMENT cpd_vspd_dcl_fl "vss sensor decel mode diag fail" UBYTE b_true 0 0 0.00 1.00 BIT_MASK 0x04 ECU_ADDRESS 0x40004EA0 FORMAT "%5.0" SYMBOL_LINK "cpd_vspd_dcl_info" 4 /end MEASUREMENT
/begin MEASUREMENT cpd_vspd_dcl_rpt_st "vss sensor decel mode diag report state" UBYTE u_rpt_st 0 0 0.00 2.00 BIT_MASK 0x03 ECU_ADDRESS 0x40004EA0 SYMBOL_LINK "cpd_vspd_dcl_info" 4 /end MEASUREMENT
/begin MEASUREMENT cpd_vspd_can_fl_cnt "vss sensor can mode fail counts" UWORD u_cnts 0 0 0 65535 ECU_ADDRESS 0x40004EA0 FORMAT "%5.0" SYMBOL_LINK "cpd_vspd_can_info" 0 /end MEASUREMENT
/begin MEASUREMENT cpd_vspd_can_diag_cnt "vss sensor can mode diag counts" UWORD u_cnts 0 0 0 65535 ECU_ADDRESS 0x40004EA0 FORMAT "%5.0" SYMBOL_LINK "cpd_vspd_can_info" 2 /end MEASUREMENT
/begin MEASUREMENT cpd_vspd_can_diag_en "vss sensor can mode diag enable conditions met" UBYTE b_true 0 0 0.00 1.00 BIT_MASK 0x20 ECU_ADDRESS 0x40004EA0 FORMAT "%5.0" SYMBOL_LINK "cpd_vspd_can_info" 4 /end MEASUREMENT
/begin MEASUREMENT cpd_vspd_can_fl_met "vss sensor can mode diag fail conditions met" UBYTE b_true 0 0 0.00 1.00 BIT_MASK 0x10 ECU_ADDRESS 0x40004EA0 FORMAT "%5.0" SYMBOL_LINK "cpd_vspd_can_info" 4 /end MEASUREMENT
/begin MEASUREMENT cpd_vspd_can_fn "vss sensor can mode diag finish" UBYTE b_true 0 0 0.00 1.00 BIT_MASK 0x08 ECU_ADDRESS 0x40004EA0 FORMAT "%5.0" SYMBOL_LINK "cpd_vspd_can_info" 4 /end MEASUREMENT
/begin MEASUREMENT cpd_vspd_can_fl "vss sensor can mode diag fail" UBYTE b_true 0 0 0.00 1.00 BIT_MASK 0x04 ECU_ADDRESS 0x40004EA0 FORMAT "%5.0" SYMBOL_LINK "cpd_vspd_can_info" 4 /end MEASUREMENT
/begin MEASUREMENT cpd_vspd_can_rpt_st "vss sensor can mode diag report state" UBYTE u_rpt_st 0 0 0.00 2.00 BIT_MASK 0x03 ECU_ADDRESS 0x40004EA0 SYMBOL_LINK "cpd_vspd_can_info" 4 /end MEASUREMENT
/begin MEASUREMENT cpd_brkl_en_dly "break lamp enable delay" UBYTE u_16x_tmr 0 0 0.00 31.875 ECU_ADDRESS 0x400050DA FORMAT "%4.2" SYMBOL_LINK "cpd_brk_tmr" 0 /end MEASUREMENT
/begin MEASUREMENT cpd_brkl_dcl_dur "break lamp diag decel duration" UBYTE u_16x_tmr 0 0 0.00 31.875 ECU_ADDRESS 0x400050DA FORMAT "%4.2" SYMBOL_LINK "cpd_brk_tmr" 1 /end MEASUREMENT
/begin MEASUREMENT cpd_brkl_chk_dur "break lamp diag decel duration" UBYTE u_16x_tmr 0 0 0.00 31.875 ECU_ADDRESS 0x400050DA FORMAT "%4.2" SYMBOL_LINK "cpd_brk_tmr" 2 /end MEASUREMENT
/begin MEASUREMENT cpd_brkl_en "break lamp diag enable" UBYTE b_true 0 0 0.00 1.00 ECU_ADDRESS 0x4000440A FORMAT "%1.0" /end MEASUREMENT
/begin MEASUREMENT cpd_brkl_chgd "break lamp changed" UBYTE b_true 0 0 0.00 1.00 ECU_ADDRESS 0x4000440A FORMAT "%1.0" /end MEASUREMENT
/begin MEASUREMENT cpd_brkl_actv "break lamp active" UBYTE b_true 0 0 0.00 1.00 ECU_ADDRESS 0x4000440A FORMAT "%1.0" /end MEASUREMENT
/begin MEASUREMENT cpd_brkl_fl_met "break lamp fail met" UBYTE b_true 0 0 0.00 1.00 ECU_ADDRESS 0x4000440A FORMAT "%1.0" /end MEASUREMENT
/begin MEASUREMENT cpd_brkl_fl_cnt "break lamp diag fail counts" UWORD u_cnts 0 0 0.00 65535.00 ECU_ADDRESS 0x4000440A FORMAT "%5.0" /end MEASUREMENT
/begin MEASUREMENT cpd_brkl_diag_cnt "break lamp diag counts" UWORD u_cnts 0 0 0.00 65535.00 ECU_ADDRESS 0x4000440A FORMAT "%5.0" /end MEASUREMENT
/begin MEASUREMENT cpd_brkl_fl "break lamp fail" UBYTE b_true 0 0 0.00 1.00 ECU_ADDRESS 0x4000440A FORMAT "%1.0" /end MEASUREMENT
/begin MEASUREMENT cpd_brkl_fn "break lamp finish" UBYTE b_true 0 0 0.00 1.00 ECU_ADDRESS 0x4000440A FORMAT "%1.0" /end MEASUREMENT
/begin MEASUREMENT cpd_brk_sw_en "break switch diag enable" UBYTE b_true 0 0 0.00 1.00 ECU_ADDRESS 0x4000440A FORMAT "%1.0" /end MEASUREMENT
/begin MEASUREMENT cpd_brk_sw_fl_met "break switch fail met" UBYTE b_true 0 0 0.00 1.00 ECU_ADDRESS 0x4000440A FORMAT "%1.0" /end MEASUREMENT
/begin MEASUREMENT cpd_brk_sw_chk_dly "break switch check delay" UBYTE u_16x_tmr 0 0 0.00 31.875 ECU_ADDRESS 0x400050DA FORMAT "%4.2" SYMBOL_LINK "cpd_brk_tmr" 3 /end MEASUREMENT
/begin MEASUREMENT cpd_brk_sw_fl_cnt "break switch diag fail counts" UWORD u_cnts 0 0 0.00 65535.00 ECU_ADDRESS 0x4000440A FORMAT "%5.0" /end MEASUREMENT
/begin MEASUREMENT cpd_brk_sw_diag_cnt "break switch diag counts" UWORD u_cnts 0 0 0.00 65535.00 ECU_ADDRESS 0x4000440A FORMAT "%5.0" /end MEASUREMENT
/begin MEASUREMENT cpd_brk_sw_fl "break switch fail" UBYTE b_true 0 0 0.00 1.00 ECU_ADDRESS 0x4000440A FORMAT "%1.0" /end MEASUREMENT
/begin MEASUREMENT cpd_brk_sw_fn "break switch finish" UBYTE b_true 0 0 0.00 1.00 ECU_ADDRESS 0x4000440A FORMAT "%1.0" /end MEASUREMENT
/begin MEASUREMENT cpd_egrp_shrt_en "egr position short diag enable" UBYTE b_true 0 0 0.00 1.00 ECU_ADDRESS 0x4000440A FORMAT "%1.0" /end MEASUREMENT
/begin MEASUREMENT cpd_egrp_lo_fl_met "egr position short low fail met" UBYTE b_true 0 0 0.00 1.00 ECU_ADDRESS 0x4000440A FORMAT "%1.0" /end MEASUREMENT
/begin MEASUREMENT cpd_egrp_hi_fl_met "egr position short high fail met" UBYTE b_true 0 0 0.00 1.00 ECU_ADDRESS 0x4000440A FORMAT "%1.0" /end MEASUREMENT
/begin MEASUREMENT cpd_egrp_shrt_lo_tmr "egr position short low timer" UWORD u_16x_tmr 0 0 0 8191.875 ECU_ADDRESS 0x40004EBC SYMBOL_LINK "cpd_egrp_shrt_tmr" 0 /end MEASUREMENT
/begin MEASUREMENT cpd_egrp_shrt_hi_tmr "egr position short high timer" UWORD u_16x_tmr 0 0 0 8191.875 ECU_ADDRESS 0x40004EBC SYMBOL_LINK "cpd_egrp_shrt_tmr" 2 /end MEASUREMENT
/begin MEASUREMENT cpd_egrp_lo_fl "egr position short low fail" UBYTE b_true 0 0 0.00 1.00 ECU_ADDRESS 0x4000440A FORMAT "%1.0" /end MEASUREMENT
/begin MEASUREMENT cpd_egrp_hi_fl "egr position short high fail" UBYTE b_true 0 0 0.00 1.00 ECU_ADDRESS 0x4000440A FORMAT "%1.0" /end MEASUREMENT
/begin MEASUREMENT cpd_egrp_keyon_pos_lrnd "egr position init zero learned" UBYTE b_true 0 0 0.00 1.00 ECU_ADDRESS 0x4000440A FORMAT "%1.0" /end MEASUREMENT
/begin MEASUREMENT cpd_egrp_zero_tstd "egr position zero tested" UBYTE b_true 0 0 0.00 1.00 ECU_ADDRESS 0x4000440A FORMAT "%1.0" /end MEASUREMENT
/begin MEASUREMENT cpd_egrp_zero_en "egr position zero tested enable" UBYTE b_true 0 0 0.00 1.00 ECU_ADDRESS 0x4000440A FORMAT "%1.0" /end MEASUREMENT
/begin MEASUREMENT cpd_egrp_zero_raw "egr position diag zero position raw" UWORD u_pct 0 0 0.0 199.996948242187 ECU_ADDRESS 0x4000DA4E /end MEASUREMENT
/begin MEASUREMENT cpd_egrp_keyon_pos "egr position diag keyon position" UWORD u_pct 0 0 0.0 199.996948242187 ECU_ADDRESS 0x4000DA4E /end MEASUREMENT
/begin MEASUREMENT cpd_egrp_zero_chg_fl_met "egr position zero change fail met" UBYTE b_true 0 0 0.00 1.00 ECU_ADDRESS 0x4000440A FORMAT "%1.0" /end MEASUREMENT
/begin MEASUREMENT cpd_egrp_zero_chg_fl_cnt "egr position zero change fail counts" UWORD u_cnts 0 0 0.00 65535.00 ECU_ADDRESS 0x4000440A FORMAT "%5.0" /end MEASUREMENT
/begin MEASUREMENT cpd_egrp_zero_chg_diag_cnt "egr position zero change diag counts" UWORD u_cnts 0 0 0.00 65535.00 ECU_ADDRESS 0x4000440A FORMAT "%5.0" /end MEASUREMENT
/begin MEASUREMENT cpd_bp_shrt_en "break press short enable" UBYTE b_true 0 0 0.00 1.00 ECU_ADDRESS 0x4000440A FORMAT "%1.0" /end MEASUREMENT
/begin MEASUREMENT cpd_bp_hi_fl_met "break press short high fail met" UBYTE b_true 0 0 0.00 1.00 ECU_ADDRESS 0x4000440A FORMAT "%1.0" /end MEASUREMENT
/begin MEASUREMENT cpd_bp_lo_fl_met "break press short low fail met" UBYTE b_true 0 0 0.00 1.00 ECU_ADDRESS 0x4000440A FORMAT "%1.0" /end MEASUREMENT
/begin MEASUREMENT cpd_bp_hi_fl_cnt "break press short high fail counts" UWORD u_cnts 0 0 0.00 65535.00 ECU_ADDRESS 0x4000440A FORMAT "%5.0" /end MEASUREMENT
/begin MEASUREMENT cpd_bp_hi_diag_cnt "break press short high diag counts" UWORD u_cnts 0 0 0.00 65535.00 ECU_ADDRESS 0x4000440A FORMAT "%5.0" /end MEASUREMENT
/begin MEASUREMENT cpd_bp_lo_fl_cnt "break press short low fail counts" UWORD u_cnts 0 0 0.00 65535.00 ECU_ADDRESS 0x4000440A FORMAT "%5.0" /end MEASUREMENT
/begin MEASUREMENT cpd_bp_lo_diag_cnt "break press short low diag counts" UWORD u_cnts 0 0 0.00 65535.00 ECU_ADDRESS 0x4000440A FORMAT "%5.0" /end MEASUREMENT
/begin MEASUREMENT cpd_bp_hi_fl "break press short high fail" UBYTE b_true 0 0 0.00 1.00 ECU_ADDRESS 0x4000440A FORMAT "%1.0" /end MEASUREMENT
/begin MEASUREMENT cpd_bp_hi_fn "break press short high finish" UBYTE b_true 0 0 0.00 1.00 ECU_ADDRESS 0x4000440A FORMAT "%1.0" /end MEASUREMENT
/begin MEASUREMENT cpd_bp_lo_fl "break press short low fail" UBYTE b_true 0 0 0.00 1.00 ECU_ADDRESS 0x4000440A FORMAT "%1.0" /end MEASUREMENT
/begin MEASUREMENT cpd_bp_lo_fn "break press short low finish" UBYTE b_true 0 0 0.00 1.00 ECU_ADDRESS 0x4000440A FORMAT "%1.0" /end MEASUREMENT
/begin MEASUREMENT cpd_cru_en "cruise diag enable" UBYTE b_true 0 0 0.00 1.00 BIT_MASK 0x1 ECU_ADDRESS 0x4000440A FORMAT "%1.0" /end MEASUREMENT
/begin MEASUREMENT cpd_cru_an_rpt_st "analog report state" UBYTE u_rpt_st 0 0 0.00 2.00 ECU_ADDRESS 0x40004EA0 /end MEASUREMENT
/begin MEASUREMENT cpd_cru_an_fl_met "cruise analog fail met" UBYTE b_true 0 0 0.00 1.00 ECU_ADDRESS 0x4000440A FORMAT "%1.0" /end MEASUREMENT
/begin MEASUREMENT cpd_cru_an_fn "cruise analog finish" UBYTE b_true 0 0 0.00 1.00 ECU_ADDRESS 0x4000440A FORMAT "%1.0" /end MEASUREMENT
/begin MEASUREMENT cpd_cru_an_fl "cruise analog finish" UBYTE b_true 0 0 0.00 1.00 ECU_ADDRESS 0x4000440A FORMAT "%1.0" /end MEASUREMENT
/begin MEASUREMENT cpd_cru_an_fl_cnt "cruise analog fail counts" UWORD u_cnts 0 0 0.00 65535.00 ECU_ADDRESS 0x4000440A FORMAT "%5.0" /end MEASUREMENT
/begin MEASUREMENT cpd_cru_an_diag_cnt "cruise analog diag counts" UWORD u_cnts 0 0 0.00 65535.00 ECU_ADDRESS 0x4000440A FORMAT "%5.0" /end MEASUREMENT
/begin MEASUREMENT cpd_cru_onoff_nois_rpt_st "onoff switch noise report state" UBYTE u_rpt_st 0 0 0.00 2.00 ECU_ADDRESS 0x40004EA0 /end MEASUREMENT
/begin MEASUREMENT cpd_cru_onoff_nois_fl_met "cruise onoff switch noise fail met" UBYTE b_true 0 0 0.00 1.00 ECU_ADDRESS 0x4000440A FORMAT "%1.0" /end MEASUREMENT
/begin MEASUREMENT cpd_cru_onoff_nois_fl "cruise onoff switch noise fail" UBYTE b_true 0 0 0.00 1.00 ECU_ADDRESS 0x4000440A FORMAT "%1.0" /end MEASUREMENT
/begin MEASUREMENT cpd_cru_onoff_nois_ps "cruise onoff switch noise pass" UBYTE b_true 0 0 0.00 1.00 ECU_ADDRESS 0x4000440A FORMAT "%1.0" /end MEASUREMENT
/begin MEASUREMENT cpd_cru_onoff_nois_fn "cruise onoff switch noise finish" UBYTE b_true 0 0 0.00 1.00 ECU_ADDRESS 0x4000440A FORMAT "%1.0" /end MEASUREMENT
/begin MEASUREMENT cpd_cru_onoff_nois_fl_cnt "cruise onoff switch noise fail counts" UWORD u_cnts 0 0 0.00 65535.00 ECU_ADDRESS 0x4000440A FORMAT "%5.0" /end MEASUREMENT
/begin MEASUREMENT cpd_cru_onoff_noise_ps_tmr "cruise onoff pass timer" UWORD u_2x_tmr 0 0 0.0 1023.984375 ECU_ADDRESS 0x4000DA4E SYMBOL_LINK "cpd_cru_noise_ps_tmr" 0 /end MEASUREMENT
/begin MEASUREMENT cpd_cru_cancel_noise_ps_tmr "cruise cancel pass timer" UWORD u_2x_tmr 0 0 0.0 1023.984375 ECU_ADDRESS 0x4000DA4E SYMBOL_LINK "cpd_cru_noise_ps_tmr" 2 /end MEASUREMENT
/begin MEASUREMENT cpd_cru_res_noise_ps_tmr "cruise resume pass timer" UWORD u_2x_tmr 0 0 0.0 1023.984375 ECU_ADDRESS 0x4000DA4E SYMBOL_LINK "cpd_cru_noise_ps_tmr" 4 /end MEASUREMENT
/begin MEASUREMENT cpd_cru_set_noise_ps_tmr "cruise set pass timer" UWORD u_2x_tmr 0 0 0.0 1023.984375 ECU_ADDRESS 0x4000DA4E SYMBOL_LINK "cpd_cru_noise_ps_tmr" 6 /end MEASUREMENT
/begin MEASUREMENT cpd_cru_vsl_noise_ps_tmr "cruise vehicle speed limit pass timer" UWORD u_2x_tmr 0 0 0.0 1023.984375 ECU_ADDRESS 0x4000DA4E SYMBOL_LINK "cpd_cru_noise_ps_tmr" 8 /end MEASUREMENT
/begin MEASUREMENT cpd_cru_dis_noise_ps_tmr "cruise distance pass timer" UWORD u_2x_tmr 0 0 0.0 1023.984375 ECU_ADDRESS 0x4000DA4E SYMBOL_LINK "cpd_cru_noise_ps_tmr" 10 /end MEASUREMENT
/begin MEASUREMENT cpd_cru_cancl_nois_rpt_st "cancel switch noise report state" UBYTE u_rpt_st 0 0 0.00 2.00 ECU_ADDRESS 0x40004EA0 /end MEASUREMENT
/begin MEASUREMENT cpd_cru_cancl_nois_fl_met "cruise cancel switch noise fail met" UBYTE b_true 0 0 0.00 1.00 ECU_ADDRESS 0x4000440A FORMAT "%1.0" /end MEASUREMENT
/begin MEASUREMENT cpd_cru_cancl_nois_fl "cruise cancel switch noise fail" UBYTE b_true 0 0 0.00 1.00 ECU_ADDRESS 0x4000440A FORMAT "%1.0" /end MEASUREMENT
/begin MEASUREMENT cpd_cru_cancl_nois_ps "cruise cancel switch noise pass" UBYTE b_true 0 0 0.00 1.00 ECU_ADDRESS 0x4000440A FORMAT "%1.0" /end MEASUREMENT
/begin MEASUREMENT cpd_cru_cancl_nois_fn "cruise cancel switch noise finish" UBYTE b_true 0 0 0.00 1.00 ECU_ADDRESS 0x4000440A FORMAT "%1.0" /end MEASUREMENT
/begin MEASUREMENT cpd_cru_cancl_nois_fl_cnt "cruise cancel switch noise fail counts" UWORD u_cnts 0 0 0.00 65535.00 ECU_ADDRESS 0x4000440A FORMAT "%5.0" /end MEASUREMENT
/begin MEASUREMENT cpd_cru_res_nois_rpt_st "resume switch noise report state" UBYTE u_rpt_st 0 0 0.00 2.00 ECU_ADDRESS 0x40004EA0 /end MEASUREMENT
/begin MEASUREMENT cpd_cru_res_nois_fl_met "cruise resume switch noise fail met" UBYTE b_true 0 0 0.00 1.00 ECU_ADDRESS 0x4000440A FORMAT "%1.0" /end MEASUREMENT
/begin MEASUREMENT cpd_cru_res_nois_fl "cruise resume switch noise fail" UBYTE b_true 0 0 0.00 1.00 ECU_ADDRESS 0x4000440A FORMAT "%1.0" /end MEASUREMENT
/begin MEASUREMENT cpd_cru_res_nois_ps "cruise resume switch noise pass" UBYTE b_true 0 0 0.00 1.00 ECU_ADDRESS 0x4000440A FORMAT "%1.0" /end MEASUREMENT
/begin MEASUREMENT cpd_cru_res_nois_fn "cruise resume switch noise finish" UBYTE b_true 0 0 0.00 1.00 ECU_ADDRESS 0x4000440A FORMAT "%1.0" /end MEASUREMENT
/begin MEASUREMENT cpd_cru_res_nois_fl_cnt "cruise resume switch noise fail counts" UWORD u_cnts 0 0 0.00 65535.00 ECU_ADDRESS 0x4000440A FORMAT "%5.0" /end MEASUREMENT
/begin MEASUREMENT cpd_cru_set_nois_rpt_st "set switch noise report state" UBYTE u_rpt_st 0 0 0.00 2.00 ECU_ADDRESS 0x40004EA0 /end MEASUREMENT
/begin MEASUREMENT cpd_cru_set_nois_fl_met "cruise set switch noise fail met" UBYTE b_true 0 0 0.00 1.00 ECU_ADDRESS 0x4000440A FORMAT "%1.0" /end MEASUREMENT
/begin MEASUREMENT cpd_cru_set_nois_fl "cruise set switch noise fail" UBYTE b_true 0 0 0.00 1.00 ECU_ADDRESS 0x4000440A FORMAT "%1.0" /end MEASUREMENT
/begin MEASUREMENT cpd_cru_set_nois_ps "cruise set switch noise pass" UBYTE b_true 0 0 0.00 1.00 ECU_ADDRESS 0x4000440A FORMAT "%1.0" /end MEASUREMENT
/begin MEASUREMENT cpd_cru_set_nois_fn "cruise set switch noise finish" UBYTE b_true 0 0 0.00 1.00 ECU_ADDRESS 0x4000440A FORMAT "%1.0" /end MEASUREMENT
/begin MEASUREMENT cpd_cru_set_nois_fl_cnt "cruise set switch noise fail counts" UWORD u_cnts 0 0 0.00 65535.00 ECU_ADDRESS 0x4000440A FORMAT "%5.0" /end MEASUREMENT
/begin MEASUREMENT cpd_cru_dis_nois_rpt_st "distance switch noise report state" UBYTE u_rpt_st 0 0 0.00 2.00 ECU_ADDRESS 0x40004EA0 /end MEASUREMENT
/begin MEASUREMENT cpd_cru_dis_nois_fl_met "cruise distance switch noise fail met" UBYTE b_true 0 0 0.00 1.00 ECU_ADDRESS 0x4000440A FORMAT "%1.0" /end MEASUREMENT
/begin MEASUREMENT cpd_cru_dis_nois_fl "cruise distance switch noise fail" UBYTE b_true 0 0 0.00 1.00 ECU_ADDRESS 0x4000440A FORMAT "%1.0" /end MEASUREMENT
/begin MEASUREMENT cpd_cru_dis_nois_ps "cruise distance switch noise pass" UBYTE b_true 0 0 0.00 1.00 ECU_ADDRESS 0x4000440A FORMAT "%1.0" /end MEASUREMENT
/begin MEASUREMENT cpd_cru_dis_nois_fn "cruise distance switch noise finish" UBYTE b_true 0 0 0.00 1.00 ECU_ADDRESS 0x4000440A FORMAT "%1.0" /end MEASUREMENT
/begin MEASUREMENT cpd_cru_dis_nois_fl_cnt "cruise distance switch noise fail counts" UWORD u_cnts 0 0 0.00 65535.00 ECU_ADDRESS 0x4000440A FORMAT "%5.0" /end MEASUREMENT
/begin MEASUREMENT cpd_cru_vsl_nois_rpt_st "vehicle speed limit switch noise report state" UBYTE u_rpt_st 0 0 0.00 2.00 ECU_ADDRESS 0x40004EA0 /end MEASUREMENT
/begin MEASUREMENT cpd_cru_vsl_nois_fl_met "cruise vehicle speed limit switch noise fail met" UBYTE b_true 0 0 0.00 1.00 ECU_ADDRESS 0x4000440A FORMAT "%1.0" /end MEASUREMENT
/begin MEASUREMENT cpd_cru_vsl_nois_fl "cruise vehicle speed limit switch noise fail" UBYTE b_true 0 0 0.00 1.00 ECU_ADDRESS 0x4000440A FORMAT "%1.0" /end MEASUREMENT
/begin MEASUREMENT cpd_cru_vsl_nois_ps "cruise vehicle speed limit switch noise pass" UBYTE b_true 0 0 0.00 1.00 ECU_ADDRESS 0x4000440A FORMAT "%1.0" /end MEASUREMENT
/begin MEASUREMENT cpd_cru_vsl_nois_fn "cruise vehicle speed limit switch noise finish" UBYTE b_true 0 0 0.00 1.00 ECU_ADDRESS 0x4000440A FORMAT "%1.0" /end MEASUREMENT
/begin MEASUREMENT cpd_cru_vsl_nois_fl_cnt "cruise vehicle speed limit switch noise fail counts" UWORD u_cnts 0 0 0.00 65535.00 ECU_ADDRESS 0x4000440A FORMAT "%5.0" /end MEASUREMENT
/begin MEASUREMENT cpd_cru_onoff_stck_diag_tmr "onoff stuck diag timer" UWORD u_16x_tmr 0 0 0 8191.875 ECU_ADDRESS 0x40004EBC FORMAT "%3.2" SYMBOL_LINK "cpd_cru_stck_tmr" 0 /end MEASUREMENT
/begin MEASUREMENT cpd_cru_onoff_stck_fl_tmr "onoff stuck fail timer" UWORD u_16x_tmr 0 0 0 8191.875 ECU_ADDRESS 0x40004EBC FORMAT "%3.2" SYMBOL_LINK "cpd_cru_stck_tmr" 2 /end MEASUREMENT
/begin MEASUREMENT cpd_cru_cancl_stck_diag_tmr "cancel stuck diag timer" UWORD u_16x_tmr 0 0 0 8191.875 ECU_ADDRESS 0x40004EBC FORMAT "%3.2" SYMBOL_LINK "cpd_cru_stck_tmr" 4 /end MEASUREMENT
/begin MEASUREMENT cpd_cru_cancl_stck_fl_tmr "cancel stuck fail timer" UWORD u_16x_tmr 0 0 0 8191.875 ECU_ADDRESS 0x40004EBC FORMAT "%3.2" SYMBOL_LINK "cpd_cru_stck_tmr" 6 /end MEASUREMENT
/begin MEASUREMENT cpd_cru_res_stck_diag_tmr "resume stuck diag timer" UWORD u_16x_tmr 0 0 0 8191.875 ECU_ADDRESS 0x40004EBC FORMAT "%3.2" SYMBOL_LINK "cpd_cru_stck_tmr" 8 /end MEASUREMENT
/begin MEASUREMENT cpd_cru_res_stck_fl_tmr "resume stuck fail timer" UWORD u_16x_tmr 0 0 0 8191.875 ECU_ADDRESS 0x40004EBC FORMAT "%3.2" SYMBOL_LINK "cpd_cru_stck_tmr" 10 /end MEASUREMENT
/begin MEASUREMENT cpd_cru_set_stck_diag_tmr "set stuck diag timer" UWORD u_16x_tmr 0 0 0 8191.875 ECU_ADDRESS 0x40004EBC FORMAT "%3.2" SYMBOL_LINK "cpd_cru_stck_tmr" 12 /end MEASUREMENT
/begin MEASUREMENT cpd_cru_set_stck_fl_tmr "set stuck fail timer" UWORD u_16x_tmr 0 0 0 8191.875 ECU_ADDRESS 0x40004EBC FORMAT "%3.2" SYMBOL_LINK "cpd_cru_stck_tmr" 14 /end MEASUREMENT
/begin MEASUREMENT cpd_cru_vsl_stck_diag_tmr "vehicle speed limit stuck diag timer" UWORD u_16x_tmr 0 0 0 8191.875 ECU_ADDRESS 0x40004EBC FORMAT "%3.2" SYMBOL_LINK "cpd_cru_stck_tmr" 16 /end MEASUREMENT
/begin MEASUREMENT cpd_cru_vsl_stck_fl_tmr "vehicle speed limit stuck fail timer" UWORD u_16x_tmr 0 0 0 8191.875 ECU_ADDRESS 0x40004EBC FORMAT "%3.2" SYMBOL_LINK "cpd_cru_stck_tmr" 18 /end MEASUREMENT
/begin MEASUREMENT cpd_cru_dis_stck_diag_tmr "distance stuck diag timer" UWORD u_16x_tmr 0 0 0 8191.875 ECU_ADDRESS 0x40004EBC FORMAT "%3.2" SYMBOL_LINK "cpd_cru_stck_tmr" 12 /end MEASUREMENT
/begin MEASUREMENT cpd_cru_dis_stck_fl_tmr "distance stuck fail timer" UWORD u_16x_tmr 0 0 0 8191.875 ECU_ADDRESS 0x40004EBC FORMAT "%3.2" SYMBOL_LINK "cpd_cru_stck_tmr" 14 /end MEASUREMENT
/begin MEASUREMENT cpd_cru_onoff_stck_rpt_st "onoff switch stuck report state" UBYTE u_rpt_st 0 0 0.00 2.00 ECU_ADDRESS 0x40004EA0 /end MEASUREMENT
/begin MEASUREMENT cpd_cru_onoff_stck_fl_met "cruise onoff switch stuck fail met" UBYTE b_true 0 0 0.00 1.00 ECU_ADDRESS 0x4000440A FORMAT "%1.0" /end MEASUREMENT
/begin MEASUREMENT cpd_cru_onoff_stck_fl "cruise onoff stuck fail" UBYTE b_true 0 0 0.00 1.00 ECU_ADDRESS 0x4000440A FORMAT "%1.0" /end MEASUREMENT
/begin MEASUREMENT cpd_cru_onoff_stck_fn "cruise onoff switch stuck finish" UBYTE b_true 0 0 0.00 1.00 ECU_ADDRESS 0x4000440A FORMAT "%1.0" /end MEASUREMENT
/begin MEASUREMENT cpd_cru_cancl_stck_rpt_st "cancel switch stuck report state" UBYTE u_rpt_st 0 0 0.00 2.00 ECU_ADDRESS 0x40004EA0 /end MEASUREMENT
/begin MEASUREMENT cpd_cru_cancl_stck_fl_met "cancel switch stuck fail met" UBYTE b_true 0 0 0.00 1.00 ECU_ADDRESS 0x4000440A FORMAT "%1.0" /end MEASUREMENT
/begin MEASUREMENT cpd_cru_cancl_stck_fl "cancel stuck fail" UBYTE b_true 0 0 0.00 1.00 ECU_ADDRESS 0x4000440A FORMAT "%1.0" /end MEASUREMENT
/begin MEASUREMENT cpd_cru_cancl_stck_fn "cancel switch stuck finish" UBYTE b_true 0 0 0.00 1.00 ECU_ADDRESS 0x4000440A FORMAT "%1.0" /end MEASUREMENT
/begin MEASUREMENT cpd_cru_res_stck_rpt_st "resume switch stuck report state" UBYTE u_rpt_st 0 0 0.00 2.00 ECU_ADDRESS 0x40004EA0 /end MEASUREMENT
/begin MEASUREMENT cpd_cru_res_stck_fl_met "resume switch stuck fail met" UBYTE b_true 0 0 0.00 1.00 ECU_ADDRESS 0x4000440A FORMAT "%1.0" /end MEASUREMENT
/begin MEASUREMENT cpd_cru_res_stck_fl "resume stuck fail" UBYTE b_true 0 0 0.00 1.00 ECU_ADDRESS 0x4000440A FORMAT "%1.0" /end MEASUREMENT
/begin MEASUREMENT cpd_cru_res_stck_fn "resume switch stuck finish" UBYTE b_true 0 0 0.00 1.00 ECU_ADDRESS 0x4000440A FORMAT "%1.0" /end MEASUREMENT
/begin MEASUREMENT cpd_cru_set_stck_rpt_st "set switch stuck report state" UBYTE u_rpt_st 0 0 0.00 2.00 ECU_ADDRESS 0x40004EA0 /end MEASUREMENT
/begin MEASUREMENT cpd_cru_set_stck_fl_met "set switch stuck fail met" UBYTE b_true 0 0 0.00 1.00 ECU_ADDRESS 0x4000440A FORMAT "%1.0" /end MEASUREMENT
/begin MEASUREMENT cpd_cru_set_stck_fl "set stuck stuck fail" UBYTE b_true 0 0 0.00 1.00 ECU_ADDRESS 0x4000440A FORMAT "%1.0" /end MEASUREMENT
/begin MEASUREMENT cpd_cru_set_stck_fn "set switch stuck finish" UBYTE b_true 0 0 0.00 1.00 ECU_ADDRESS 0x4000440A FORMAT "%1.0" /end MEASUREMENT
/begin MEASUREMENT cpd_cru_dis_stck_rpt_st "distance switch stuck report state" UBYTE u_rpt_st 0 0 0.00 2.00 ECU_ADDRESS 0x40004EA0 /end MEASUREMENT
/begin MEASUREMENT cpd_cru_dis_stck_fl_met "distance switch stuck fail met" UBYTE b_true 0 0 0.00 1.00 ECU_ADDRESS 0x4000440A FORMAT "%1.0" /end MEASUREMENT
/begin MEASUREMENT cpd_cru_dis_stck_fl "distance stuck stuck fail" UBYTE b_true 0 0 0.00 1.00 ECU_ADDRESS 0x4000440A FORMAT "%1.0" /end MEASUREMENT
/begin MEASUREMENT cpd_cru_dis_stck_fn "distance switch stuck finish" UBYTE b_true 0 0 0.00 1.00 ECU_ADDRESS 0x4000440A FORMAT "%1.0" /end MEASUREMENT
/begin MEASUREMENT cpd_cru_vsl_stck_rpt_st "vehicle speed limit switch stuck report state" UBYTE u_rpt_st 0 0 0.00 2.00 ECU_ADDRESS 0x40004EA0 /end MEASUREMENT
/begin MEASUREMENT cpd_cru_vsl_stck_fl_met "vehicle speed limit switch stuck fail met" UBYTE b_true 0 0 0.00 1.00 ECU_ADDRESS 0x4000440A FORMAT "%1.0" /end MEASUREMENT
/begin MEASUREMENT cpd_cru_vsl_stck_fl "vehicle speed limit stuck stuck fail" UBYTE b_true 0 0 0.00 1.00 ECU_ADDRESS 0x4000440A FORMAT "%1.0" /end MEASUREMENT
/begin MEASUREMENT cpd_cru_vsl_stck_fn "vehicle speed limit switch stuck finish" UBYTE b_true 0 0 0.00 1.00 ECU_ADDRESS 0x4000440A FORMAT "%1.0" /end MEASUREMENT
/begin MEASUREMENT cpd_flv_dis_fl_actv "fuel level disable fail active" UBYTE b_true 0 0 0.00 1.00 ECU_ADDRESS 0x4000440A FORMAT "%1.0" /end MEASUREMENT
/begin MEASUREMENT cpd_flv_comn_met "fuel level common diag conditions met" UBYTE b_true 0 0 0.00 1.00 ECU_ADDRESS 0x4000440A FORMAT "%1.0" /end MEASUREMENT
/begin MEASUREMENT cpd_flv_slosh_rst_dly "slosh state rest delay" UWORD u_16x_tmr 0 0 0 8191.875 ECU_ADDRESS 0x40004EBC FORMAT "%3.2" SYMBOL_LINK "cpd_flv_tmr" 0 /end MEASUREMENT
/begin MEASUREMENT cpd_flv_refuel_dly "refuel detect delay" UWORD u_16x_tmr 0 0 0 8191.875 ECU_ADDRESS 0x40004EBC FORMAT "%3.2" SYMBOL_LINK "cpd_flv_tmr" 2 /end MEASUREMENT
/begin MEASUREMENT cpd_flv_flt_dly "refuel detect delay" UWORD u_16x_tmr 0 0 0 8191.875 ECU_ADDRESS 0x40004EBC FORMAT "%3.2" SYMBOL_LINK "cpd_flv_tmr" 4 /end MEASUREMENT
/begin MEASUREMENT cpd_flv_mmv "Filtered fuel level for fuel level diag" UWORD u_pct_1 0 0 0 99.9984741210937 ECU_ADDRESS 0x40005536 FORMAT "%4.2" /end MEASUREMENT
/begin MEASUREMENT cpd_flv_dlt "fuel level delta" UWORD u_pct_1 0 0 0 99.9984741210937 ECU_ADDRESS 0x40005536 FORMAT "%4.2" /end MEASUREMENT
/begin MEASUREMENT cpd_flv_refuel_actv "refuel active" UBYTE b_true 0 0 0.00 1.00 ECU_ADDRESS 0x4000440A FORMAT "%1.0" /end MEASUREMENT
/begin MEASUREMENT cpd_flv_slosh_met "fuel level slosh met" UBYTE b_true 0 0 0.00 1.00 ECU_ADDRESS 0x4000440A FORMAT "%1.0" /end MEASUREMENT
/begin MEASUREMENT cpd_flv_rng_lo "fuel level range" UBYTE b_true 0 0 0.00 1.00 ECU_ADDRESS 0x4000440A FORMAT "%1.0" /end MEASUREMENT
/begin MEASUREMENT cpd_flv_rng_hi2lo "fuel level high to low change" UBYTE b_true 0 0 0.00 1.00 ECU_ADDRESS 0x4000440A FORMAT "%1.0" /end MEASUREMENT
/begin MEASUREMENT cpd_flv_shrt_dly "fuel level short delay" UWORD u_16x_tmr 0 0 0 8191.875 ECU_ADDRESS 0x40004EBC FORMAT "%3.2" /end MEASUREMENT
/begin MEASUREMENT cpd_flv_shrt_mmv "fuel level mmv for short diag" UWORD u_pct_1 0 0 0 99.9984741210937 ECU_ADDRESS 0x40005536 FORMAT "%4.2" SYMBOL_LINK "cpd_flv_shrt_data" 0 /end MEASUREMENT
/begin MEASUREMENT cpd_flv_shrt_strt "start fuel level for short diag" UWORD u_pct_1 0 0 0 99.9984741210937 ECU_ADDRESS 0x40005536 FORMAT "%4.2" SYMBOL_LINK "cpd_flv_shrt_data" 2 /end MEASUREMENT
/begin MEASUREMENT cpd_flv_shrt_st "fuel level short state" UBYTE u_flv_shrt_st 0 0 0 3 ECU_ADDRESS 0x40005536 FORMAT "%1.0" SYMBOL_LINK "cpd_flv_shrt_data" 4 /end MEASUREMENT
/begin MEASUREMENT cpd_flv_lo_fl_cnt "fuel low fail counts" UWORD u_cnts 0 0 0 65535 ECU_ADDRESS 0x40004EA0 FORMAT "%5.0" SYMBOL_LINK "cpd_flv_lo_info" 0 /end MEASUREMENT
/begin MEASUREMENT cpd_flv_lo_diag_cnt "fuel low diag counts" UWORD u_cnts 0 0 0 65535 ECU_ADDRESS 0x40004EA0 FORMAT "%5.0" SYMBOL_LINK "cpd_flv_lo_info" 2 /end MEASUREMENT
/begin MEASUREMENT cpd_flv_lo_diag_en "fuel low diag enable conditions met" UBYTE b_true 0 0 0.00 1.00 BIT_MASK 0x20 ECU_ADDRESS 0x40004EA0 FORMAT "%5.0" SYMBOL_LINK "cpd_flv_lo_info" 4 /end MEASUREMENT
/begin MEASUREMENT cpd_flv_lo_fl_met "fuel low diag fail conditions met" UBYTE b_true 0 0 0.00 1.00 BIT_MASK 0x10 ECU_ADDRESS 0x40004EA0 FORMAT "%5.0" SYMBOL_LINK "cpd_flv_lo_info" 4 /end MEASUREMENT
/begin MEASUREMENT cpd_flv_lo_fn "fuel low diag finish" UBYTE b_true 0 0 0.00 1.00 BIT_MASK 0x08 ECU_ADDRESS 0x40004EA0 FORMAT "%5.0" SYMBOL_LINK "cpd_flv_lo_info" 4 /end MEASUREMENT
/begin MEASUREMENT cpd_flv_lo_fl "fuel low diag fail" UBYTE b_true 0 0 0.00 1.00 BIT_MASK 0x04 ECU_ADDRESS 0x40004EA0 FORMAT "%5.0" SYMBOL_LINK "cpd_flv_lo_info" 4 /end MEASUREMENT
/begin MEASUREMENT cpd_flv_lo_rpt_st "fuel low diag report state" UBYTE u_rpt_st 0 0 0.00 2.00 BIT_MASK 0x03 ECU_ADDRESS 0x40004EA0 SYMBOL_LINK "cpd_flv_lo_info" 4 /end MEASUREMENT
/begin MEASUREMENT cpd_flv_hi_fl_cnt "fuel high fail counts" UWORD u_cnts 0 0 0 65535 ECU_ADDRESS 0x40004EA0 FORMAT "%5.0" SYMBOL_LINK "cpd_flv_hi_info" 0 /end MEASUREMENT
/begin MEASUREMENT cpd_flv_hi_diag_cnt "fuel high diag counts" UWORD u_cnts 0 0 0 65535 ECU_ADDRESS 0x40004EA0 FORMAT "%5.0" SYMBOL_LINK "cpd_flv_hi_info" 2 /end MEASUREMENT
/begin MEASUREMENT cpd_flv_hi_diag_en "fuel high diag enable conditions met" UBYTE b_true 0 0 0.00 1.00 BIT_MASK 0x20 ECU_ADDRESS 0x40004EA0 FORMAT "%5.0" SYMBOL_LINK "cpd_flv_hi_info" 4 /end MEASUREMENT
/begin MEASUREMENT cpd_flv_hi_fl_met "fuel high diag fail conditions met" UBYTE b_true 0 0 0.00 1.00 BIT_MASK 0x10 ECU_ADDRESS 0x40004EA0 FORMAT "%5.0" SYMBOL_LINK "cpd_flv_hi_info" 4 /end MEASUREMENT
/begin MEASUREMENT cpd_flv_hi_fn "fuel high diag finish" UBYTE b_true 0 0 0.00 1.00 BIT_MASK 0x08 ECU_ADDRESS 0x40004EA0 FORMAT "%5.0" SYMBOL_LINK "cpd_flv_hi_info" 4 /end MEASUREMENT
/begin MEASUREMENT cpd_flv_hi_fl "fuel high diag fail" UBYTE b_true 0 0 0.00 1.00 BIT_MASK 0x04 ECU_ADDRESS 0x40004EA0 FORMAT "%5.0" SYMBOL_LINK "cpd_flv_hi_info" 4 /end MEASUREMENT
/begin MEASUREMENT cpd_flv_hi_rpt_st "fuel high diag report state" UBYTE u_rpt_st 0 0 0.00 2.00 BIT_MASK 0x03 ECU_ADDRESS 0x40004EA0 SYMBOL_LINK "cpd_flv_hi_info" 4 /end MEASUREMENT
/begin MEASUREMENT cpd_flv_stck_fl_met "fuel level stuck fail met" UBYTE b_true 0 0 0.00 1.00 ECU_ADDRESS 0x40004EA0 FORMAT "%5.0" SYMBOL_LINK "cpd_flv_stck_info" 0 /end MEASUREMENT
/begin MEASUREMENT cpd_flv_stck_en "fuel level stuck fail met" UBYTE b_true 0 0 0.00 1.00 ECU_ADDRESS 0x40004EA0 FORMAT "%5.0" SYMBOL_LINK "cpd_flv_stck_info" 1 /end MEASUREMENT
/begin MEASUREMENT cpd_flv_stck_ps_met "fuel level stuck pass met" UBYTE b_true 0 0 0.00 1.00 ECU_ADDRESS 0x40004EA0 FORMAT "%5.0" SYMBOL_LINK "cpd_flv_stck_info" 2 /end MEASUREMENT
/begin MEASUREMENT cpd_flv_stck_fn "fuel level stuck diag finish" UBYTE b_true 0 0 0.00 1.00 ECU_ADDRESS 0x40004EA0 FORMAT "%5.0" SYMBOL_LINK "cpd_flv_stck_info" 3 /end MEASUREMENT
/begin MEASUREMENT cpd_flv_stck_fl "fuel level stuck fail" UBYTE b_true 0 0 0.00 1.00 ECU_ADDRESS 0x40004EA0 FORMAT "%5.0" SYMBOL_LINK "cpd_flv_stck_info" 4 /end MEASUREMENT
/begin MEASUREMENT cpd_flv_stck_fl_thr "fuel level stuck fail thr" UWORD u_pct_1 0 0 0 99.9984741210937 ECU_ADDRESS 0x40005536 FORMAT "%4.2" /end MEASUREMENT
/begin MEASUREMENT cpd_flv_fc "fuel level stuck check fuel consumption" ULONG u_fc 0 0 0 67108863.984375 ECU_ADDRESS 0x40005536 /end MEASUREMENT
/begin MEASUREMENT cpd_flv_max "fuel level max" UWORD u_pct_1 0 0 0 99.9984741210937 ECU_ADDRESS 0x40005536 FORMAT "%4.2" /end MEASUREMENT
/begin MEASUREMENT cpd_flv_min "fuel level min" UWORD u_pct_1 0 0 0 99.9984741210937 ECU_ADDRESS 0x40005536 FORMAT "%4.2" /end MEASUREMENT
/begin CHARACTERISTIC CPD_V_ACP_HI_FL_CNTS "AC press short high fail counts" VALUE 0x0002038C __UWORD_S 0 u_cnts 0 65535 FORMAT "%5.0" /end CHARACTERISTIC
/begin CHARACTERISTIC CPD_V_ACP_LO_FL_CNTS "AC press short low fail counts" VALUE 0x0002038C __UWORD_S 0 u_cnts 0 65535 FORMAT "%5.0" /end CHARACTERISTIC
/begin CHARACTERISTIC CPD_V_ACP_DIAG_CNTS "AC press short low fail counts" VALUE 0x0002038C __UWORD_S 0 u_cnts 0 65535 FORMAT "%5.0" /end CHARACTERISTIC
/begin CHARACTERISTIC CPD_V_ACP_VLT_HI "AC press short high fail voltage" VALUE 0x0002038C __UWORD_S 0 u_ad_volt 0 4.9999237060546875 FORMAT "%4.3" /end CHARACTERISTIC
/begin CHARACTERISTIC CPD_V_ACP_VLT_LO "AC press short low fail voltage" VALUE 0x0002038C __UWORD_S 0 u_ad_volt 0 4.9999237060546875 FORMAT "%4.3" /end CHARACTERISTIC
/begin CHARACTERISTIC CPD_V_ACP_EN_BAT_VLT "AC press short diag enable battery voltage min" VALUE 0x0002038C __UWORD_S 0 u_volt_32 0 31.99951171875 FORMAT "%4.2" /end CHARACTERISTIC
/begin CHARACTERISTIC CPD_V_ACT_LO_EN_RUN_MIN "AC temp short low diag enable min" VALUE 0x0002038C __SWORD_S 0 u_deg_C -256 255.9921875 FORMAT "%4.1" /end CHARACTERISTIC
/begin CHARACTERISTIC CPD_V_ACT_HI_EN_RUN_MIN "AC temp short low diag enable min" VALUE 0x0002038C __SWORD_S 0 u_deg_C -256 255.9921875 FORMAT "%4.1" /end CHARACTERISTIC
/begin CHARACTERISTIC CPD_V_ACT_HI_FL_CNTS "AC temp short high fail counts" VALUE 0x0002038C __UWORD_S 0 u_cnts 0 65535 FORMAT "%5.0" /end CHARACTERISTIC
/begin CHARACTERISTIC CPD_V_ACT_HI_DIAG_CNTS "AC temp short high diag counts" VALUE 0x0002038C __UWORD_S 0 u_cnts 0 65535 FORMAT "%5.0" /end CHARACTERISTIC
/begin CHARACTERISTIC CPD_V_ACT_LO_FL_CNTS "AC temp short low fail counts" VALUE 0x0002038C __UWORD_S 0 u_cnts 0 65535 FORMAT "%5.0" /end CHARACTERISTIC
/begin CHARACTERISTIC CPD_V_ACT_LO_DIAG_CNTS "AC temp short low diag counts" VALUE 0x0002038C __UWORD_S 0 u_cnts 0 65535 FORMAT "%5.0" /end CHARACTERISTIC
/begin CHARACTERISTIC CPD_V_ACT_VLT_HI "AC temp short high fail voltage" VALUE 0x0002038C __UWORD_S 0 u_ad_volt 0 4.9999237060546875 FORMAT "%4.3" /end CHARACTERISTIC
/begin CHARACTERISTIC CPD_V_ACT_VLT_LO "AC temp short low fail voltage" VALUE 0x0002038C __UWORD_S 0 u_ad_volt 0 4.9999237060546875 FORMAT "%4.3" /end CHARACTERISTIC
/begin CHARACTERISTIC CPD_V_AMP_VLT_HI "amp short high fail voltage" VALUE 0x0002038C __UWORD_S 0 u_ad_volt 0 4.9999237060546875 FORMAT "%4.3" SYMBOL_LINK "CPD_C_P_VLT_HI" 0 /end CHARACTERISTIC
/begin CHARACTERISTIC CPD_V_BSTP_VLT_HI "boost press short high fail voltage" VALUE 0x0002038C __UWORD_S 0 u_ad_volt 0 4.9999237060546875 FORMAT "%4.3" SYMBOL_LINK "CPD_C_P_VLT_HI" 2 /end CHARACTERISTIC
/begin CHARACTERISTIC CPD_V_MAP_VLT_HI "map short high fail voltage" VALUE 0x0002038C __UWORD_S 0 u_ad_volt 0 4.9999237060546875 FORMAT "%4.3" SYMBOL_LINK "CPD_C_P_VLT_HI" 4 /end CHARACTERISTIC
/begin CHARACTERISTIC CPD_V_AMP_HI_FL_CNTS "amp short high fail counts" VALUE 0x0002038C __UWORD_S 0 u_cnts 0 65535 FORMAT "%5.0" SYMBOL_LINK "CPD_C_P_HI_FL_CNTS" 0 /end CHARACTERISTIC
/begin CHARACTERISTIC CPD_V_BSTP_HI_FL_CNTS "boost press short high fail counts" VALUE 0x0002038C __UWORD_S 0 u_cnts 0 65535 FORMAT "%5.0" SYMBOL_LINK "CPD_C_P_HI_FL_CNTS" 4 /end CHARACTERISTIC
/begin CHARACTERISTIC CPD_V_MAP_HI_FL_CNTS "map short high fail counts" VALUE 0x0002038C __UWORD_S 0 u_cnts 0 65535 FORMAT "%5.0" SYMBOL_LINK "CPD_C_P_HI_FL_CNTS" 8 /end CHARACTERISTIC
/begin CHARACTERISTIC CPD_V_AMP_VLT_LO "amp short low fail voltage" VALUE 0x0002038C __UWORD_S 0 u_ad_volt 0 4.9999237060546875 FORMAT "%4.3" SYMBOL_LINK "CPD_C_P_VLT_LO" 0 /end CHARACTERISTIC
/begin CHARACTERISTIC CPD_V_BSTP_VLT_LO "boost press short low fail voltage" VALUE 0x0002038C __UWORD_S 0 u_ad_volt 0 4.9999237060546875 FORMAT "%4.3" SYMBOL_LINK "CPD_C_P_VLT_LO" 2 /end CHARACTERISTIC
/begin CHARACTERISTIC CPD_V_MAP_VLT_LO "map short low fail voltage" VALUE 0x0002038C __UWORD_S 0 u_ad_volt 0 4.9999237060546875 FORMAT "%4.3" SYMBOL_LINK "CPD_C_P_VLT_LO" 4 /end CHARACTERISTIC
/begin CHARACTERISTIC CPD_V_AMP_LO_FL_CNTS "amp short low fail counts" VALUE 0x0002038C __UWORD_S 0 u_cnts 0 65535 FORMAT "%5.0" SYMBOL_LINK "CPD_C_P_LO_FL_CNTS" 0 /end CHARACTERISTIC
/begin CHARACTERISTIC CPD_V_BSTP_LO_FL_CNTS "boost press short high fail counts" VALUE 0x0002038C __UWORD_S 0 u_cnts 0 65535 FORMAT "%5.0" SYMBOL_LINK "CPD_C_P_LO_FL_CNTS" 4 /end CHARACTERISTIC
/begin CHARACTERISTIC CPD_V_MAP_LO_FL_CNTS "map short high fail counts" VALUE 0x0002038C __UWORD_S 0 u_cnts 0 65535 FORMAT "%5.0" SYMBOL_LINK "CPD_C_P_LO_FL_CNTS" 8 /end CHARACTERISTIC
/begin CHARACTERISTIC CPD_V_AMP_HI_EN_RUN_MIN "amp short high enable engine run min" VALUE 0x0002038C __UWORD_S 0 u_1s_tmr 0 65535 SYMBOL_LINK "CPD_C_P_HI_EN_RUN_MIN" 0 /end CHARACTERISTIC
/begin CHARACTERISTIC CPD_V_BSTP_HI_EN_RUN_MIN "boost press short high enable engine run min" VALUE 0x0002038C __UWORD_S 0 u_1s_tmr 0 65535 SYMBOL_LINK "CPD_C_P_HI_EN_RUN_MIN" 2 /end CHARACTERISTIC
/begin CHARACTERISTIC CPD_V_MAP_HI_EN_RUN_MIN "map short high enable engine run min" VALUE 0x0002038C __UWORD_S 0 u_1s_tmr 0 65535 SYMBOL_LINK "CPD_C_P_HI_EN_RUN_MIN" 4 /end CHARACTERISTIC
/begin CHARACTERISTIC CPD_C_BSTP_HI_TPS_MAX "boost press short high diag enable tps max" CURVE 0x000200B0 __UWORD_S 0 u_pct_1 0 99.9984741210937 FORMAT "%4.2" SYMBOL_LINK "CPD_C_BSTP_HI_TPS_MAX" 2
 /begin AXIS_DESCR COM_AXIS sys_eng_spd u_espd 2 0 8191.875000 AXIS_PTS_REF CPD_X_ESPD_A /end AXIS_DESCR
/end CHARACTERISTIC
/begin AXIS_PTS CPD_X_ESPD_A "" 0x0002006C sys_eng_spd SSV__UWORD_S 0 u_espd 2 0.000000 8191.875000 FORMAT "%5.1" DEPOSIT ABSOLUTE SYMBOL_LINK "CPD_X_ESPD_A" 2 /end AXIS_PTS
/begin CHARACTERISTIC CPD_C_BSTP_LO_TPS_MIN "boost press short low diag enable tps max" CURVE 0x000200B0 __UWORD_S 0 u_pct_1 0 99.9984741210937 FORMAT "%4.2" SYMBOL_LINK "CPD_C_BSTP_LO_TPS_MIN" 2
 /begin AXIS_DESCR COM_AXIS sys_eng_spd u_espd 2 0 8191.875000 AXIS_PTS_REF CPD_X_ESPD_B /end AXIS_DESCR
/end CHARACTERISTIC
/begin AXIS_PTS CPD_X_ESPD_B "" 0x0002006C sys_eng_spd SSV__UWORD_S 0 u_espd 2 0.000000 8191.875000 FORMAT "%5.1" DEPOSIT ABSOLUTE SYMBOL_LINK "CPD_X_ESPD_B" 2 /end AXIS_PTS
/begin CHARACTERISTIC CPD_C_MAP_HI_TPS_MAX "MAP short high diag enable tps max" CURVE 0x000200B0 __UWORD_S 0 u_pct_1 0 99.9984741210937 FORMAT "%4.2" SYMBOL_LINK "CPD_C_MAP_HI_TPS_MAX" 2
 /begin AXIS_DESCR COM_AXIS sys_eng_spd u_espd 2 0 8191.875000 AXIS_PTS_REF CPD_X_ESPD_C /end AXIS_DESCR
/end CHARACTERISTIC
/begin AXIS_PTS CPD_X_ESPD_C "" 0x0002006C sys_eng_spd SSV__UWORD_S 0 u_espd 2 0.000000 8191.875000 FORMAT "%5.1" DEPOSIT ABSOLUTE SYMBOL_LINK "CPD_X_ESPD_C" 2 /end AXIS_PTS
/begin CHARACTERISTIC CPD_C_MAP_LO_TPS_MAX "MAP short low diag enable tps max" CURVE 0x000200B0 __UWORD_S 0 u_pct_1 0 99.9984741210937 FORMAT "%4.2" SYMBOL_LINK "CPD_C_MAP_LO_TPS_MAX" 2
 /begin AXIS_DESCR COM_AXIS sys_eng_spd u_espd 2 0 8191.875000 AXIS_PTS_REF CPD_X_ESPD_D /end AXIS_DESCR
/end CHARACTERISTIC
/begin AXIS_PTS CPD_X_ESPD_D "" 0x0002006C sys_eng_spd SSV__UWORD_S 0 u_espd 2 0.000000 8191.875000 FORMAT "%5.1" DEPOSIT ABSOLUTE SYMBOL_LINK "CPD_X_ESPD_D" 2 /end AXIS_PTS
/begin CHARACTERISTIC CPD_C_COR_P_STRT_CMP_CFG "start up press correlation compare source config" CURVE 0x000200B0 __UBYTE_S 0 u_press_snsr 0 2 FORMAT "%1.0"
 /begin AXIS_DESCR FIX_AXIS NO_INPUT_QUANTITY u_press_snsr 3 0 2 /begin FIX_AXIS_PAR_LIST 0 1 2 /end FIX_AXIS_PAR_LIST /end AXIS_DESCR
/end CHARACTERISTIC
/begin CHARACTERISTIC CPD_C_COR_P_STRT_FL_DLT "start up press correlation fail delta" CURVE 0x000200B0 __UWORD_S 0 u_kPa_0_256 0 255.99609375
 /begin AXIS_DESCR FIX_AXIS NO_INPUT_QUANTITY u_press_snsr 3 0 2 /begin FIX_AXIS_PAR_LIST 0 1 2 /end FIX_AXIS_PAR_LIST /end AXIS_DESCR
/end CHARACTERISTIC
/begin CHARACTERISTIC CPD_V_COR_AMP_STRT_FL_CNTS "amp start up correlation fail counts" VALUE 0x0002038C __UWORD_S 0 u_cnts 0 65535 FORMAT "%5.0" SYMBOL_LINK "CPD_M_COR_P_STRT_CNTS" 0 /end CHARACTERISTIC
/begin CHARACTERISTIC CPD_V_COR_AMP_STRT_DIAG_CNTS "amp start up correlation fail counts" VALUE 0x0002038C __UWORD_S 0 u_cnts 0 65535 FORMAT "%5.0" SYMBOL_LINK "CPD_M_COR_P_STRT_CNTS" 2 /end CHARACTERISTIC
/begin CHARACTERISTIC CPD_V_COR_BSTP_STRT_FL_CNTS "boost press start up correlation fail counts" VALUE 0x0002038C __UWORD_S 0 u_cnts 0 65535 FORMAT "%5.0" SYMBOL_LINK "CPD_M_COR_P_STRT_CNTS" 4 /end CHARACTERISTIC
/begin CHARACTERISTIC CPD_V_COR_BSTP_STRT_DIAG_CNTS "boost press start up correlation diag counts" VALUE 0x0002038C __UWORD_S 0 u_cnts 0 65535 FORMAT "%5.0" SYMBOL_LINK "CPD_M_COR_P_STRT_CNTS" 6 /end CHARACTERISTIC
/begin CHARACTERISTIC CPD_V_COR_MAP_STRT_FL_CNTS "MAP start up correlation fail counts" VALUE 0x0002038C __UWORD_S 0 u_cnts 0 65535 FORMAT "%5.0" SYMBOL_LINK "CPD_M_COR_P_STRT_CNTS" 8 /end CHARACTERISTIC
/begin CHARACTERISTIC CPD_V_COR_MAP_STRT_DIAG_CNTS "MAP start up correlation diag counts" VALUE 0x0002038C __UWORD_S 0 u_cnts 0 65535 FORMAT "%5.0" SYMBOL_LINK "CPD_M_COR_P_STRT_CNTS" 10 /end CHARACTERISTIC
/begin CHARACTERISTIC CPD_V_MAP_RAT_DCL_ESPD_MIN "MAP TPS decelerate rationality diag enable engine speed min" VALUE 0x0002038C __UWORD_S 0 u_espd 0 8191.875000 FORMAT "%5.1" /end CHARACTERISTIC
/begin CHARACTERISTIC CPD_V_MAP_RAT_DCL_ESPD_MAX "MAP TPS decelerate rationality diag enable engine speed max" VALUE 0x0002038C __UWORD_S 0 u_espd 0 8191.875000 FORMAT "%5.1" /end CHARACTERISTIC
/begin CHARACTERISTIC CPD_V_MAP_RAT_DCL_ECT_MIN "MAP TPS decelerate rationality diag enable ect min" VALUE 0x0002038C __SWORD_S 0 u_deg_C -256 255.9921875 FORMAT "%4.1" /end CHARACTERISTIC
/begin CHARACTERISTIC CPD_V_MAP_RAT_DCL_FLW_DLT "MAP TPS decelerate rationality diag enable idle airflow change delta max" VALUE 0x0002038C __UWORD_S 0 u_pct 0 199.996948 FORMAT "%4.1" /end CHARACTERISTIC
/begin CHARACTERISTIC CPD_V_MAP_RAT_DCL_TPS_MAX "MAP TPS decelerate rationality diag enable tps max" VALUE 0x0002038C __UWORD_S 0 u_pct 0 199.996948 FORMAT "%4.1" /end CHARACTERISTIC
/begin CHARACTERISTIC CPD_V_MAP_RAT_DCL_VSPD_MIN "MAP TPS decelerate rationality diag enable vehicle speed min" VALUE 0x0002038C __UWORD_S 0 u_vspd 0 511.9921875 FORMAT "%4.1" /end CHARACTERISTIC
/begin CHARACTERISTIC CPD_V_MAP_RAT_DCL_EN_DLY "MAP TPS decelerate rationality diag enable delay" VALUE 0x0002038C __UWORD_S 0 u_2x_tmr 0 1023.984375 /end CHARACTERISTIC
/begin CHARACTERISTIC CPD_V_MAP_RAT_DRV_ESPD_MIN "MAP TPS drive rationality diag enable engine speed min" VALUE 0x0002038C __UWORD_S 0 u_espd 0 8191.875000 FORMAT "%5.1" /end CHARACTERISTIC
/begin CHARACTERISTIC CPD_V_MAP_RAT_DRV_ESPD_MAX "MAP TPS drive rationality diag enable engine speed max" VALUE 0x0002038C __UWORD_S 0 u_espd 0 8191.875000 FORMAT "%5.1" /end CHARACTERISTIC
/begin CHARACTERISTIC CPD_V_MAP_RAT_DRV_ECT_MIN "MAP TPS drive rationality diag enable ect min" VALUE 0x0002038C __SWORD_S 0 u_deg_C -256 255.9921875 FORMAT "%4.1" /end CHARACTERISTIC
/begin CHARACTERISTIC CPD_V_MAP_RAT_DRV_ESPD_DLT "MAP TPS drive rationality diag enable engine speed delta max" VALUE 0x0002038C __UWORD_S 0 u_espd 0 8191.875000 FORMAT "%5.1" /end CHARACTERISTIC
/begin CHARACTERISTIC CPD_V_MAP_RAT_DRV_MAP_DLT "MAP TPS drive rationality diag enable map delta max" VALUE 0x0002038C __UWORD_S 0 u_kPa_0_256 0 255.99609375 FORMAT "%4.1" /end CHARACTERISTIC
/begin CHARACTERISTIC CPD_V_MAP_RAT_DRV_EGR_DLT "MAP TPS drive rationality diag enable EGR delta max" VALUE 0x0002038C __UWORD_S 0 u_pct 0 199.996948 FORMAT "%4.1" /end CHARACTERISTIC
/begin CHARACTERISTIC CPD_V_MAP_RAT_DRV_FLW_DLT "MAP TPS drive rationality diag enable idle airflow change delta max" VALUE 0x0002038C __UWORD_S 0 u_pct 0 199.996948 FORMAT "%4.1" /end CHARACTERISTIC
/begin CHARACTERISTIC CPD_V_MAP_RAT_DRV_INTK_VVT_DLT "MAP TPS drive rationality diag enable intake vvt setpoint change delta max" VALUE 0x0002038C __UWORD_S 0 u_cam_ang_hi 0 63.9990234375 /end CHARACTERISTIC
/begin CHARACTERISTIC CPD_V_MAP_RAT_DRV_EXH_VVT_DLT "MAP TPS drive rationality diag enable exhaust vvt setpoint change delta max" VALUE 0x0002038C __UWORD_S 0 u_cam_ang_hi 0 63.9990234375 /end CHARACTERISTIC
/begin CHARACTERISTIC CPD_V_MAP_RAT_DRV_EN_DLY "MAP TPS drive rationality diag enable delay" VALUE 0x0002038C __UWORD_S 0 u_2x_tmr 0 1023.984375 /end CHARACTERISTIC
/begin CHARACTERISTIC CPD_M_MAP_RAT_DRV_MAX "MAP TPS drive rationality high load diag fail thr" MAP 0x00020320 __UBYTE_S 0 u_kPa_0_32768 0.0 127.5 FORMAT "%4.1" SYMBOL_LINK "CPD_M_MAP_RAT_DRV_MAX" 3
 /begin AXIS_DESCR FIX_AXIS sys_eng_spd u_espd 17 0 6400
  /begin FIX_AXIS_PAR_LIST 0 3200 6400 9600 12800 16000 19200 22400 25600 28800 32000 35200 38400 41600 44800 48000 51200 /end FIX_AXIS_PAR_LIST
 /end AXIS_DESCR
 /begin AXIS_DESCR FIX_AXIS sys_tps_scaled u_pct 9 0.000000 199.996948 /begin FIX_AXIS_PAR_LIST 0 4096 8192 12288 16384 20480 24576 28672 32768 /end FIX_AXIS_PAR_LIST /end AXIS_DESCR
/end CHARACTERISTIC
/begin CHARACTERISTIC CPD_M_MAP_RAT_DRV_MIN "MAP TPS drive rationality low load diag fail thr" MAP 0x00020320 __UBYTE_S 0 u_kPa_0_32768 0.0 127.5 FORMAT "%4.1" SYMBOL_LINK "CPD_M_MAP_RAT_DRV_MIN" 3
 /begin AXIS_DESCR FIX_AXIS sys_eng_spd u_espd 17 0 6400
  /begin FIX_AXIS_PAR_LIST 0 3200 6400 9600 12800 16000 19200 22400 25600 28800 32000 35200 38400 41600 44800 48000 51200 /end FIX_AXIS_PAR_LIST
 /end AXIS_DESCR
 /begin AXIS_DESCR FIX_AXIS sys_tps_scaled u_pct 9 0.000000 199.996948 /begin FIX_AXIS_PAR_LIST 0 4096 8192 12288 16384 20480 24576 28672 32768 /end FIX_AXIS_PAR_LIST /end AXIS_DESCR
/end CHARACTERISTIC
/begin CHARACTERISTIC CPD_V_MAP_RAT_DCL_FL_CNTS "MAP decelerate rationality fail counts" VALUE 0x0002038C __UWORD_S 0 u_cnts 0 65535 FORMAT "%5.0" SYMBOL_LINK "CPD_C_MAP_RAT_DCL_CNTS" 0 /end CHARACTERISTIC
/begin CHARACTERISTIC CPD_V_MAP_RAT_DCL_DIAG_CNTS "MAP decelerate correlation diag counts" VALUE 0x0002038C __UWORD_S 0 u_cnts 0 65535 FORMAT "%5.0" SYMBOL_LINK "CPD_C_MAP_RAT_DCL_CNTS" 2 /end CHARACTERISTIC
/begin CHARACTERISTIC CPD_V_MAP_RAT_DRV_LO_FL_CNTS "MAP drive correlation low load fail counts" VALUE 0x0002038C __UWORD_S 0 u_cnts 0 65535 FORMAT "%5.0" SYMBOL_LINK "CPD_C_MAP_RAT_DRV_LO_CNTS" 0 /end CHARACTERISTIC
/begin CHARACTERISTIC CPD_V_MAP_RAT_DRV_LO_DIAG_CNTS "MAP drive correlation low load diag counts" VALUE 0x0002038C __UWORD_S 0 u_cnts 0 65535 FORMAT "%5.0" SYMBOL_LINK "CPD_C_MAP_RAT_DRV_LO_CNTS" 2 /end CHARACTERISTIC
/begin CHARACTERISTIC CPD_V_MAP_RAT_DRV_HI_FL_CNTS "MAP drive correlation high load fail counts" VALUE 0x0002038C __UWORD_S 0 u_cnts 0 65535 FORMAT "%5.0" SYMBOL_LINK "CPD_C_MAP_RAT_DRV_HI_CNTS" 0 /end CHARACTERISTIC
/begin CHARACTERISTIC CPD_V_MAP_RAT_DRV_HI_DIAG_CNTS "MAP drive correlation high load diag counts" VALUE 0x0002038C __UWORD_S 0 u_cnts 0 65535 FORMAT "%5.0" SYMBOL_LINK "CPD_C_MAP_RAT_DRV_HI_CNTS" 2 /end CHARACTERISTIC
/begin CHARACTERISTIC CPD_C_MAP_RAT_DCL_MAX "MAP TPS decelerate correlation diag fail thr" CURVE 0x000200B0 __UBYTE_S 0 u_kPa_0_32768 0 127.5 FORMAT "%4.1" SYMBOL_LINK "CPD_C_MAP_RAT_DCL_MAX" 2
 /begin AXIS_DESCR FIX_AXIS sys_eng_spd u_espd 17 0 6400
  /begin FIX_AXIS_PAR_LIST 0 3200 6400 9600 12800 16000 19200 22400 25600 28800 32000 35200 38400 41600 44800 48000 51200 /end FIX_AXIS_PAR_LIST
 /end AXIS_DESCR
/end CHARACTERISTIC
/begin CHARACTERISTIC CPD_V_MAP_RAT_DRV_TPS_DLT "MAP TPS drive correlation diag enable tps change delta max" VALUE 0x0002038C __UWORD_S 0 u_pct 0 199.996948 FORMAT "%4.1" /end CHARACTERISTIC
/begin CHARACTERISTIC CPD_V_COR_P_STRT_OFFT_MIN "press start up correlation enable off time min" VALUE 0x0002038C __UWORD_S 0 u_min 0 65535 /end CHARACTERISTIC
/begin CHARACTERISTIC CPD_V_COR_P_STRT_DLY "press start up correlation enable enable delay" VALUE 0x0002038C __UWORD_S 0 u_1x_tmr 0 511.9921875 FORMAT "%4.1" /end CHARACTERISTIC
/begin CHARACTERISTIC CPD_V_IAT_HI_EN_VSPD_MAX "IAT short high diag enable vehicle speed max" VALUE 0x0002038C __UWORD_S 0 u_vspd 0 511.9921875 FORMAT "%4.1" SYMBOL_LINK "CPD_C_AIRT_HI_EN_VSPD_MAX" 0 /end CHARACTERISTIC
/begin CHARACTERISTIC CPD_V_IAT_HI_EN_FLW_MAX "IAT short high diag enable airflow max" VALUE 0x0002038C __UWORD_S 0 u_g_per_sec 0 511.9921875 FORMAT "%4.1" SYMBOL_LINK "CPD_C_AIRT_HI_EN_FLW_MAX" 0 /end CHARACTERISTIC
/begin CHARACTERISTIC CPD_V_IAT_HI_EN_RUN_MIN "IAT short high diag enable runtime min" VALUE 0x0002038C __UWORD_S 0 u_1s_tmr 0 65535 SYMBOL_LINK "CPD_C_AIRT_HI_EN_RUN_MIN" 0 /end CHARACTERISTIC
/begin CHARACTERISTIC CPD_V_IAT_HI_EN_OFFT_MIN "IAT short high diag enable off time min" VALUE 0x0002038C __UWORD_S 0 u_min 0 65535 SYMBOL_LINK "CPD_C_AIRT_HI_EN_OFFT_MIN" 0 /end CHARACTERISTIC
/begin CHARACTERISTIC CPD_V_IAT_HI_VLT "IAT short high fail voltage" VALUE 0x0002038C __UWORD_S 0 u_ad_volt 0 4.9999237060546875 FORMAT "%4.3" SYMBOL_LINK "CPD_C_AIRT_HI_VLT" 0 /end CHARACTERISTIC
/begin CHARACTERISTIC CPD_V_IAT_HI_FL_CNTS "IAT short high diag fail counts" VALUE 0x0002038C __UWORD_S 0 u_cnts 0 65535 FORMAT "%5.0" SYMBOL_LINK "CPD_C_AIRT_HI_DIAG_CNTS" 0 /end CHARACTERISTIC
/begin CHARACTERISTIC CPD_V_IAT_HI_DIAG_CNTS "IAT short high diag fail counts" VALUE 0x0002038C __UWORD_S 0 u_cnts 0 65535 FORMAT "%5.0" SYMBOL_LINK "CPD_C_AIRT_HI_DIAG_CNTS" 2 /end CHARACTERISTIC
/begin CHARACTERISTIC CPD_V_BSTT_HI_EN_VSPD_MAX "boost temp short high diag enable vehicle speed max" VALUE 0x0002038C __UWORD_S 0 u_vspd 0 511.9921875 FORMAT "%4.1" SYMBOL_LINK "CPD_C_AIRT_HI_EN_VSPD_MAX" 2 /end CHARACTERISTIC
/begin CHARACTERISTIC CPD_V_BSTT_HI_EN_FLW_MAX "boost temp short high diag enable airflow max" VALUE 0x0002038C __UWORD_S 0 u_g_per_sec 0 511.9921875 FORMAT "%4.1" SYMBOL_LINK "CPD_C_AIRT_HI_EN_FLW_MAX" 2 /end CHARACTERISTIC
/begin CHARACTERISTIC CPD_V_BSTT_HI_EN_RUN_MIN "boost temp short high diag enable runtime min" VALUE 0x0002038C __UWORD_S 0 u_1s_tmr 0 65535 SYMBOL_LINK "CPD_C_AIRT_HI_EN_RUN_MIN" 2 /end CHARACTERISTIC
/begin CHARACTERISTIC CPD_V_BSTT_HI_EN_OFFT_MIN "boost temp short high diag enable off time min" VALUE 0x0002038C __UWORD_S 0 u_min 0 65535 SYMBOL_LINK "CPD_C_AIRT_HI_EN_OFFT_MIN" 2 /end CHARACTERISTIC
/begin CHARACTERISTIC CPD_V_BSTT_HI_VLT "boost temp short high fail voltage" VALUE 0x0002038C __UWORD_S 0 u_ad_volt 0 4.9999237060546875 FORMAT "%4.3" SYMBOL_LINK "CPD_C_AIRT_HI_VLT" 2 /end CHARACTERISTIC
/begin CHARACTERISTIC CPD_V_BSTT_HI_FL_CNTS "boost temp short high diag fail counts" VALUE 0x0002038C __UWORD_S 0 u_cnts 0 65535 FORMAT "%5.0" SYMBOL_LINK "CPD_C_AIRT_HI_DIAG_CNTS" 4 /end CHARACTERISTIC
/begin CHARACTERISTIC CPD_V_BSTT_HI_DIAG_CNTS "boost temp short high diag fail counts" VALUE 0x0002038C __UWORD_S 0 u_cnts 0 65535 FORMAT "%5.0" SYMBOL_LINK "CPD_C_AIRT_HI_DIAG_CNTS" 6 /end CHARACTERISTIC
/begin CHARACTERISTIC CPD_V_AIRT_HI_EN_ECT "air temp short high diag enable ect min" VALUE 0x0002038C __SWORD_S 0 u_deg_C -256 255.9921875 FORMAT "%4.1" /end CHARACTERISTIC
/begin CHARACTERISTIC CPD_V_AIRT_HI_EN_OFFT_ECT "temp short high diag enable ect min caused by off time more than thr" VALUE 0x0002038C __SWORD_S 0 u_deg_C -256 255.9921875 FORMAT "%4.1" /end CHARACTERISTIC
/begin CHARACTERISTIC CPD_V_IAT_LO_EN_OFFT_MIN "IAT short low diag enable off time min" VALUE 0x0002038C __UWORD_S 0 u_min 0 65535 SYMBOL_LINK "CPD_C_AIRT_LO_EN_OFFT_MIN" 0 /end CHARACTERISTIC
/begin CHARACTERISTIC CPD_V_IAT_LO_EN_VSPD_MIN "IAT short low diag enable vehicle speed min" VALUE 0x0002038C __UWORD_S 0 u_vspd 0 511.9921875 FORMAT "%4.1" SYMBOL_LINK "CPD_C_AIRT_LO_EN_VSPD_MIN" 0 /end CHARACTERISTIC
/begin CHARACTERISTIC CPD_V_IAT_LO_VLT "IAT short low fail voltage" VALUE 0x0002038C __UWORD_S 0 u_ad_volt 0 4.9999237060546875 FORMAT "%4.3" SYMBOL_LINK "CPD_C_AIRT_LO_VLT" 0 /end CHARACTERISTIC
/begin CHARACTERISTIC CPD_V_IAT_LO_FL_CNTS "IAT short low diag fail counts" VALUE 0x0002038C __UWORD_S 0 u_cnts 0 65535 FORMAT "%5.0" SYMBOL_LINK "CPD_C_AIRT_LO_DIAG_CNTS" 0 /end CHARACTERISTIC
/begin CHARACTERISTIC CPD_V_IAT_LO_DIAG_CNTS "IAT short low diag fail counts" VALUE 0x0002038C __UWORD_S 0 u_cnts 0 65535 FORMAT "%5.0" SYMBOL_LINK "CPD_C_AIRT_LO_DIAG_CNTS" 2 /end CHARACTERISTIC
/begin CHARACTERISTIC CPD_V_BSTT_LO_EN_OFFT_MIN "boost temp short low diag enable off time min" VALUE 0x0002038C __UWORD_S 0 u_min 0 65535 SYMBOL_LINK "CPD_C_AIRT_LO_EN_OFFT_MIN" 2 /end CHARACTERISTIC
/begin CHARACTERISTIC CPD_V_BSTT_LO_EN_VSPD_MIN "boost temp short low diag enable vehicle speed min" VALUE 0x0002038C __UWORD_S 0 u_vspd 0 511.9921875 FORMAT "%4.1" SYMBOL_LINK "CPD_C_AIRT_LO_EN_VSPD_MIN" 2 /end CHARACTERISTIC
/begin CHARACTERISTIC CPD_V_BSTT_LO_VLT "boost temp short low fail voltage" VALUE 0x0002038C __UWORD_S 0 u_ad_volt 0 4.9999237060546875 FORMAT "%4.3" SYMBOL_LINK "CPD_C_AIRT_LO_VLT" 2 /end CHARACTERISTIC
/begin CHARACTERISTIC CPD_V_BSTT_LO_FL_CNTS "boost temp short low diag fail counts" VALUE 0x0002038C __UWORD_S 0 u_cnts 0 65535 FORMAT "%5.0" SYMBOL_LINK "CPD_C_AIRT_LO_DIAG_CNTS" 4 /end CHARACTERISTIC
/begin CHARACTERISTIC CPD_V_BSTT_LO_DIAG_CNTS "boost temp short low diag fail counts" VALUE 0x0002038C __UWORD_S 0 u_cnts 0 65535 FORMAT "%5.0" SYMBOL_LINK "CPD_C_AIRT_LO_DIAG_CNTS" 6 /end CHARACTERISTIC
/begin CHARACTERISTIC CPD_V_AIRT_LO_EN_RUN_MIN "temp short low diag enable run time min" VALUE 0x0002038C __UWORD_S 0 u_1s_tmr 0 65535 /end CHARACTERISTIC
/begin CHARACTERISTIC CPD_V_AIRT_RAT_EN_OFFT_MIN "temp rationality diag enable off time min" VALUE 0x0002038C __UWORD_S 0 u_min 0 65535 /end CHARACTERISTIC
/begin CHARACTERISTIC CPD_V_AIRT_RAT_EN_RUN_MAX "temp rationality diag enable run time max" VALUE 0x0002038C __UWORD_S 0 u_500m_tmr 0 32767.5 FORMAT "%6.1" /end CHARACTERISTIC
/begin CHARACTERISTIC CPD_V_AIRT_RAT_EN_VSPD_MIN "temp rationality diag enable vehicle speed min" VALUE 0x0002038C __UWORD_S 0 u_vspd 0 511.9921875 FORMAT "%4.1" /end CHARACTERISTIC
/begin CHARACTERISTIC CPD_V_AIRT_RAT_EN_FLW_MIN "temp rationality diag enable airflow min" VALUE 0x0002038C __UWORD_S 0 u_g_per_sec 0 511.9921875 FORMAT "%4.1" SYMBOL_LINK "CPD_V_AIRT_RAT_EN_FLW_MIN" 2 /end CHARACTERISTIC
/begin CHARACTERISTIC CPD_M_AIRT_RAT_AMBT_CHG_THR "MAP TPS drive rationality low load diag fail thr" MAP 0x00020320 __SWORD_S 0 u_deg_C -256 255.9921875 FORMAT "%4.1"
 /begin AXIS_DESCR FIX_AXIS NO_INPUT_QUANTITY u_t_snsr 3 0 2 /begin FIX_AXIS_PAR_LIST 0 1 2 /end FIX_AXIS_PAR_LIST /end AXIS_DESCR
 /begin AXIS_DESCR FIX_AXIS NO_INPUT_QUANTITY u_t_dir 2 0 1 /begin FIX_AXIS_PAR_LIST 0 1 /end FIX_AXIS_PAR_LIST /end AXIS_DESCR
/end CHARACTERISTIC
/begin CHARACTERISTIC CPD_C_AIRT_RAT_CMP_CFG "temp rationality diag compare config" CURVE 0x000200B0 __UBYTE_S 0 u_t_cmp_snsr 0 2 FORMAT "%1.0"
 /begin AXIS_DESCR FIX_AXIS NO_INPUT_QUANTITY u_t_cmp_snsr 3 0 2 /begin FIX_AXIS_PAR_LIST 0 1 2 /end FIX_AXIS_PAR_LIST /end AXIS_DESCR
/end CHARACTERISTIC
/begin CHARACTERISTIC CPD_V_IAT_RAT_EN_DLY "IAT rationality diag enable delay" VALUE 0x0002038C __UWORD_S 0 u_500m_tmr 0 32767.5 FORMAT "%6.1" SYMBOL_LINK "CPD_C_AIRT_RAT_EN_DLY" 0 /end CHARACTERISTIC
/begin CHARACTERISTIC CPD_V_BSTT_RAT_EN_DLY "boost temp rationality diag enable delay" VALUE 0x0002038C __UWORD_S 0 u_500m_tmr 0 32767.5 FORMAT "%6.1" SYMBOL_LINK "CPD_C_AIRT_RAT_EN_DLY" 2 /end CHARACTERISTIC
/begin CHARACTERISTIC CPD_V_BSTT_RAT_LO_EN_ECT "boost temp low rationality diag enable keyon ect min" VALUE 0x0002038C __SWORD_S 0 u_deg_C -256 255.9921875 FORMAT "%4.1" SYMBOL_LINK "CPD_C_AIRT_RAT_LO_EN_ECT" 2 /end CHARACTERISTIC
/begin CHARACTERISTIC CPD_V_BSTT_RAT_LO_FL_THR "boost temp low rationality diag fail thr" VALUE 0x0002038C __SWORD_S 0 u_deg_C -256 255.9921875 FORMAT "%4.1" SYMBOL_LINK "CPD_C_AIRT_RAT_LO_FL_THR" 2 /end CHARACTERISTIC
/begin CHARACTERISTIC CPD_V_BSTT_RAT_HI_FL_THR "boost temp high rationality diag fail thr" VALUE 0x0002038C __SWORD_S 0 u_deg_C -256 255.9921875 FORMAT "%4.1" SYMBOL_LINK "CPD_C_AIRT_RAT_HI_FL_THR" 2 /end CHARACTERISTIC
/begin CHARACTERISTIC CPD_V_IAT_RAT_LO_EN_ECT "IAT low rationality diag enable keyon ect min" VALUE 0x0002038C __SWORD_S 0 u_deg_C -256 255.9921875 FORMAT "%4.1" SYMBOL_LINK "CPD_C_AIRT_RAT_LO_EN_ECT" 0 /end CHARACTERISTIC
/begin CHARACTERISTIC CPD_V_IAT_RAT_LO_FL_THR "IAT low rationality diag fail thr" VALUE 0x0002038C __SWORD_S 0 u_deg_C -256 255.9921875 FORMAT "%4.1" SYMBOL_LINK "CPD_C_AIRT_RAT_LO_FL_THR" 0 /end CHARACTERISTIC
/begin CHARACTERISTIC CPD_V_AIRT_RAT_FL_CNTS "air temp low correlation diag fail counts" VALUE 0x0002038C __UWORD_S 0 u_cnts 0 65535 FORMAT "%5.0" /end CHARACTERISTIC
/begin CHARACTERISTIC CPD_V_IAT_RAT_HI_FL_THR "IAT high rationality diag fail thr" VALUE 0x0002038C __SWORD_S 0 u_deg_C -256 255.9921875 FORMAT "%4.1" SYMBOL_LINK "CPD_C_AIRT_RAT_HI_FL_THR" 0 /end CHARACTERISTIC
/begin CHARACTERISTIC CPD_V_FLV_EN_VLT "fuel level diag enable battery voltage" VALUE 0x0002038C __UWORD_S 0 u_volt_32 0 31.99951171875 FORMAT "%4.2" /end CHARACTERISTIC
/begin CHARACTERISTIC CPD_V_REFUEL_DET_VSPD "refuel detection enable vehicle speed max" VALUE 0x0002038C __UWORD_S 0 u_vspd 0 511.9921875 FORMAT "%4.1" /end CHARACTERISTIC
/begin CHARACTERISTIC CPD_V_REFUEL_DET_TANK_VAC "refuel detection enable tank vacuum max" VALUE 0x0002038C __SWORD_S 0 u_kPa_8n_8p -8 7.999755859375 FORMAT "%4.3" /end CHARACTERISTIC
/begin CHARACTERISTIC CPD_V_REFUEL_DET_DUR "refuel detection duration" VALUE 0x0002038C __UWORD_S 0 u_16x_tmr 0.0 8191.875 /end CHARACTERISTIC
/begin CHARACTERISTIC CPD_V_REFUEL_DET_THR "refuel detection fuel level delta thr" VALUE 0x0002038C __UWORD_S 0 u_pct_1 0 99.9984741210937 FORMAT "%4.2" /end CHARACTERISTIC
/begin CHARACTERISTIC CPD_V_FLV_LO_VLT "fuel level low fail voltage" VALUE 0x0002038C __UWORD_S 0 u_ad_volt 0 4.9999237060546875 FORMAT "%4.3" /end CHARACTERISTIC
/begin CHARACTERISTIC CPD_V_FLV_HI_VLT "fuel level high fail voltage" VALUE 0x0002038C __UWORD_S 0 u_ad_volt 0 4.9999237060546875 FORMAT "%4.3" /end CHARACTERISTIC
/begin CHARACTERISTIC CPD_V_FLV_DLY_ACTV_INC_DLT "fuel level short delay active increasing delta" VALUE 0x0002038C __UWORD_S 0 u_pct_1 0 99.9984741210937 FORMAT "%4.2" SYMBOL_LINK "CPD_C_FLV_DLY_ACTV_DLT" 0 /end CHARACTERISTIC
/begin CHARACTERISTIC CPD_V_FLV_DLY_ACTV_DEC_DLT "fuel level short delay active decreasing delta" VALUE 0x0002038C __UWORD_S 0 u_pct_1 0 99.9984741210937 FORMAT "%4.2" SYMBOL_LINK "CPD_C_FLV_DLY_ACTV_DLT" 2 /end CHARACTERISTIC
/begin CHARACTERISTIC CPD_V_FLV_SHRT_DLY "fuel level short delay" VALUE 0x0002038C __UWORD_S 0 u_16x_tmr 0.0 8191.875 /end CHARACTERISTIC
/begin CHARACTERISTIC CPD_V_FLV_SHRT_DLY_FIL "fuel lever filter for short delay determine" VALUE 0x0002038C __UWORD_S 0 u_filter 0 0.9999847412109375 FORMAT "%4.3" /end CHARACTERISTIC
/begin CHARACTERISTIC CPD_V_FLV_SHRT_DLY_VSPD_MIN "fuel level short delay active vehicle speed min" VALUE 0x0002038C __UWORD_S 0 u_vspd 0 511.9921875 FORMAT "%4.1" SYMBOL_LINK "CPD_C_FLV_SHRT_DLY_VSPD" 0 /end CHARACTERISTIC
/begin CHARACTERISTIC CPD_V_FLV_SHRT_DLY_VSPD_MAX "fuel level short delay active vehicle speed max" VALUE 0x0002038C __UWORD_S 0 u_vspd 0 511.9921875 FORMAT "%4.1" SYMBOL_LINK "CPD_C_FLV_SHRT_DLY_VSPD" 2 /end CHARACTERISTIC
/begin CHARACTERISTIC CPD_V_FLV_LO_FL_CNTS "fuel level short low diag fail counts" VALUE 0x0002038C __UWORD_S 0 u_cnts 0 65535 FORMAT "%5.0" SYMBOL_LINK "CPD_C_FLV_LO_DIAG_CNTS" 0 /end CHARACTERISTIC
/begin CHARACTERISTIC CPD_V_FLV_LO_DIAG_CNTS "fuel level short low diag fail counts" VALUE 0x0002038C __UWORD_S 0 u_cnts 0 65535 FORMAT "%5.0" SYMBOL_LINK "CPD_C_FLV_LO_DIAG_CNTS" 2 /end CHARACTERISTIC
/begin CHARACTERISTIC CPD_V_FLV_HI_FL_CNTS "fuel level short high diag fail counts" VALUE 0x0002038C __UWORD_S 0 u_cnts 0 65535 FORMAT "%5.0" SYMBOL_LINK "CPD_C_FLV_HI_DIAG_CNTS" 0 /end CHARACTERISTIC
/begin CHARACTERISTIC CPD_V_FLV_HI_DIAG_CNTS "fuel level short high diag fail counts" VALUE 0x0002038C __UWORD_S 0 u_cnts 0 65535 FORMAT "%5.0" SYMBOL_LINK "CPD_C_FLV_HI_DIAG_CNTS" 2 /end CHARACTERISTIC
/begin CHARACTERISTIC CPD_V_FLV_FIL "fuel lever filter" VALUE 0x0002038C __UWORD_S 0 u_filter 0 0.9999847412109375 FORMAT "%4.3" /end CHARACTERISTIC
/begin CHARACTERISTIC CPD_V_FLV_FIL_DLY "fuel lever filter delay" VALUE 0x0002038C __UWORD_S 0 u_16x_tmr 0 8191.875 FORMAT "%4.3" /end CHARACTERISTIC
/begin CHARACTERISTIC CPD_V_PS_P_HI_VLT "power steer press short high fail voltage" VALUE 0x0002038C __UWORD_S 0 u_ad_volt 0 4.9999237060546875 FORMAT "%4.3" /end CHARACTERISTIC
/begin CHARACTERISTIC CPD_V_PS_P_LO_VLT "power steer press short low fail voltage" VALUE 0x0002038C __UWORD_S 0 u_ad_volt 0 4.9999237060546875 FORMAT "%4.3" /end CHARACTERISTIC
/begin CHARACTERISTIC CPD_V_PS_P_LO_FL_CNTS "power steer press short low diag fail counts" VALUE 0x0002038C __UWORD_S 0 u_cnts 0 65535 FORMAT "%5.0" /end CHARACTERISTIC
/begin CHARACTERISTIC CPD_V_PS_P_HI_FL_CNTS "power steer press short high diag fail counts" VALUE 0x0002038C __UWORD_S 0 u_cnts 0 65535 FORMAT "%5.0" /end CHARACTERISTIC
/begin CHARACTERISTIC CPD_V_PS_P_DIAG_CNTS "power steer press short diag counts" VALUE 0x0002038C __UWORD_S 0 u_cnts 0 65535 FORMAT "%5.0" /end CHARACTERISTIC
/begin CHARACTERISTIC CPD_V_BP_P_HI_VLT "break pump press short high fail voltage" VALUE 0x0002038C __UWORD_S 0 u_ad_volt 0 4.9999237060546875 FORMAT "%4.3" /end CHARACTERISTIC
/begin CHARACTERISTIC CPD_V_BP_P_LO_VLT "break pump press short low fail voltage" VALUE 0x0002038C __UWORD_S 0 u_ad_volt 0 4.9999237060546875 FORMAT "%4.3" /end CHARACTERISTIC
/begin CHARACTERISTIC CPD_V_BP_P_EN_AMP "break pump press diag enable amp min" VALUE 0x0002038C __UWORD_S 0 u_kPa_0_256 0 255.99609375 FORMAT "%4.1" /end CHARACTERISTIC
/begin CHARACTERISTIC CPD_V_BP_P_EN_RUN "break pump press diag enable runtime min" VALUE 0x0002038C __UWORD_S 0 u_1s_tmr 0 65535 /end CHARACTERISTIC
/begin CHARACTERISTIC CPD_V_BP_P_LO_FL_CNTS "break pump press short low diag fail counts" VALUE 0x0002038C __UWORD_S 0 u_cnts 0 65535 FORMAT "%5.0" /end CHARACTERISTIC
/begin CHARACTERISTIC CPD_V_BP_P_HI_FL_CNTS "break pump press short high diag fail counts" VALUE 0x0002038C __UWORD_S 0 u_cnts 0 65535 FORMAT "%5.0" /end CHARACTERISTIC
/begin CHARACTERISTIC CPD_V_BP_P_LO_DIAG_CNTS "break pump press short low diag counts" VALUE 0x0002038C __UWORD_S 0 u_cnts 0 65535 FORMAT "%5.0" /end CHARACTERISTIC
/begin CHARACTERISTIC CPD_V_BP_P_HI_DIAG_CNTS "break pump press short high diag counts" VALUE 0x0002038C __UWORD_S 0 u_cnts 0 65535 FORMAT "%5.0" /end CHARACTERISTIC
/begin CHARACTERISTIC CPD_V_ABS_PWM_FL_CNTS "ABS pwm fail counts" VALUE 0x0002038C __UWORD_S 0 u_cnts 0 65535 FORMAT "%5.0" /end CHARACTERISTIC
/begin CHARACTERISTIC CPD_V_ABS_PWM_DIAG_CNTS "ABS pwm diag counts" VALUE 0x0002038C __UWORD_S 0 u_cnts 0 65535 FORMAT "%5.0" /end CHARACTERISTIC
/begin CHARACTERISTIC CPD_V_ABS_PWM_FREQ_LO "ABS pwm freq fail low" VALUE 0x0002038C __UWORD_S 0 u_freq_256 0 255.99609375 FORMAT "%5.2" /end CHARACTERISTIC
/begin CHARACTERISTIC CPD_V_ABS_PWM_FREQ_HI "ABS pwm freq fail high" VALUE 0x0002038C __UWORD_S 0 u_freq_256 0 255.99609375 FORMAT "%5.2" /end CHARACTERISTIC
/begin CHARACTERISTIC CPD_V_ABS_PWM_DTY_LO "ABS pwm duty fail low" VALUE 0x0002038C __UWORD_S 0 u_pct_r 0 127.998046875 /end CHARACTERISTIC
/begin CHARACTERISTIC CPD_V_ABS_PWM_DTY_HI "ABS pwm duty fail high" VALUE 0x0002038C __UWORD_S 0 u_pct_r 0 127.998046875 /end CHARACTERISTIC
/begin CHARACTERISTIC CPD_V_G_SNSR_LO_VLT "G sensor short low fail voltage" VALUE 0x0002038C __UWORD_S 0 u_ad_volt 0 4.9999237060546875 FORMAT "%4.3" /end CHARACTERISTIC
/begin CHARACTERISTIC CPD_V_G_SNSR_HI_VLT "G sensor short high fail voltage" VALUE 0x0002038C __UWORD_S 0 u_ad_volt 0 4.9999237060546875 FORMAT "%4.3" /end CHARACTERISTIC
/begin CHARACTERISTIC CPD_V_G_SNSR_LO_FL_CNTS "G sensor low fail counts" VALUE 0x0002038C __UWORD_S 0 u_cnts 0 65535 FORMAT "%5.0" /end CHARACTERISTIC
/begin CHARACTERISTIC CPD_V_G_SNSR_HI_FL_CNTS "G sensor high fail counts" VALUE 0x0002038C __UWORD_S 0 u_cnts 0 65535 FORMAT "%5.0" /end CHARACTERISTIC
/begin CHARACTERISTIC CPD_V_G_SNSR_DIAG_CNTS "G sensor diag counts" VALUE 0x0002038C __UWORD_S 0 u_cnts 0 65535 FORMAT "%5.0" /end CHARACTERISTIC
/begin CHARACTERISTIC CPD_V_RR_CFG "rough road diag config" VALUE 0x0002038C __UBYTE_S 0 u_rr_diag_cfg 0 2 FORMAT "%1.0" /end CHARACTERISTIC
/begin CHARACTERISTIC CPD_V_VSPD_PWR_EN_MAP "vehicle speed power mode amp map" VALUE 0x0002038C __UWORD_S 0 u_kPa_0_256 0 255.99609375 /end CHARACTERISTIC
/begin CHARACTERISTIC CPD_V_VSPD_PWR_EN_TPS_MIN "vehicle speed power mode TPS min" VALUE 0x0002038C __UWORD_S 0 u_pct 0 199.996948 FORMAT "%4.1" /end CHARACTERISTIC
/begin CHARACTERISTIC CPD_V_VSPD_PWR_EN_TPS_MAX "vehicle speed power mode TPS max" VALUE 0x0002038C __UWORD_S 0 u_pct 0 199.996948 FORMAT "%4.1" /end CHARACTERISTIC
/begin CHARACTERISTIC CPD_V_VSPD_PWR_EN_TCU_SPD "vehicle speed power mode TCU vehicle speed min" VALUE 0x0002038C __UWORD_S 0 u_vspd 0 511.9921875 FORMAT "%4.1" /end CHARACTERISTIC
/begin CHARACTERISTIC CPD_V_VSPD_PWR_EN_ESPD_MIN "vehicle speed power mode engine speed min" VALUE 0x0002038C __UWORD_S 0 u_espd 0 8191.875000 FORMAT "%5.1" /end CHARACTERISTIC
/begin CHARACTERISTIC CPD_V_VSPD_PWR_EN_ESPD_MAX "vehicle speed power mode engine speed max" VALUE 0x0002038C __UWORD_S 0 u_espd 0 8191.875000 FORMAT "%5.1" /end CHARACTERISTIC
/begin CHARACTERISTIC CPD_V_VSPD_PWR_EN_DLY "vehicle speed power mode enable delay" VALUE 0x0002038C __UBYTE_S 0 u_16x_tmr 0 8191.875 FORMAT "%4.2" /end CHARACTERISTIC
/begin CHARACTERISTIC CPD_V_WSS_PWR_FL_SPD "vehicle speed power mode wheel speed sensor fail speed" VALUE 0x0002038C __UWORD_S 0 u_vspd 0 511.9921875 FORMAT "%4.1" /end CHARACTERISTIC
/begin CHARACTERISTIC CPD_V_WSS_PWR_FL_CNTS "vehicle speed power mode wheel speed sensor fail counts" VALUE 0x0002038C __UWORD_S 0 u_cnts 0 65535 FORMAT "%5.0" SYMBOL_LINK "CPD_C_WSS_PWR_CNTS" 0 /end CHARACTERISTIC
/begin CHARACTERISTIC CPD_V_WSS_PWR_DIAG_CNTS "vehicle speed power mode wheel speed sensor diag counts" VALUE 0x0002038C __UWORD_S 0 u_cnts 0 65535 FORMAT "%5.0" SYMBOL_LINK "CPD_C_WSS_PWR_CNTS" 2 /end CHARACTERISTIC
/begin CHARACTERISTIC CPD_V_VSS_DIAG_CFG "vehicle speed sensor diag config" VALUE 0x0002038C __UBYTE_S 0 u_vss_diag_cfg 0 3 FORMAT "%1.0" /end CHARACTERISTIC
/begin CHARACTERISTIC CPD_V_VSS_PWR_FL_SPD "vehicle speed power mode vehicle speed sensor fail speed" VALUE 0x0002038C __UWORD_S 0 u_vspd 0 511.9921875 FORMAT "%4.1" /end CHARACTERISTIC
/begin CHARACTERISTIC CPD_V_VSS_PWR_FL_CNTS "vehicle speed power mode vehicle speed sensor fail counts" VALUE 0x0002038C __UWORD_S 0 u_cnts 0 65535 FORMAT "%5.0" SYMBOL_LINK "CPD_C_VSS_PWR_CNTS" 0 /end CHARACTERISTIC
/begin CHARACTERISTIC CPD_V_VSS_PWR_DIAG_CNTS "vehicle speed power mode vehicle speed sensor diag counts" VALUE 0x0002038C __UWORD_S 0 u_cnts 0 65535 FORMAT "%5.0" SYMBOL_LINK "CPD_C_VSS_PWR_CNTS" 2 /end CHARACTERISTIC
/begin CHARACTERISTIC CPD_V_VSPD_DCL_EN_MAP "vehicle speed deceleration mode amp map" VALUE 0x0002038C __UWORD_S 0 u_kPa_0_256 0 255.99609375 /end CHARACTERISTIC
/begin CHARACTERISTIC CPD_V_VSPD_DCL_EN_TPS_MAX "vehicle speed deceleration mode TPS max" VALUE 0x0002038C __UWORD_S 0 u_pct 0 199.996948 FORMAT "%4.1" /end CHARACTERISTIC
/begin CHARACTERISTIC CPD_V_VSPD_DCL_EN_ESPD_MIN "vehicle speed deceleration mode engine speed min" VALUE 0x0002038C __UWORD_S 0 u_espd 0 8191.875000 FORMAT "%5.1" /end CHARACTERISTIC
/begin CHARACTERISTIC CPD_V_VSPD_DCL_EN_ESPD_MAX "vehicle speed deceleration mode engine speed max" VALUE 0x0002038C __UWORD_S 0 u_espd 0 8191.875000 FORMAT "%5.1" /end CHARACTERISTIC
/begin CHARACTERISTIC CPD_V_VSS_DCL_PASS_SPD "vehicle speed deceleration mode vehicle speed sensor pass speed min" VALUE 0x0002038C __UWORD_S 0 u_vspd 0 511.9921875 FORMAT "%4.1" /end CHARACTERISTIC
/begin CHARACTERISTIC CPD_V_VSS_DCL_FL_ESPD_DLT "vehicle speed deceleration mode fail engine speed change max" VALUE 0x0002038C __UWORD_S 0 u_espd 0 8191.875000 FORMAT "%5.1" /end CHARACTERISTIC
/begin CHARACTERISTIC CPD_V_VSS_DCL_FL_CNTS "vehicle speed deceleration mode vehicle speed sensor fail counts" VALUE 0x0002038C __UWORD_S 0 u_cnts 0 65535 FORMAT "%5.0" SYMBOL_LINK "CPD_C_VSS_DCL_CNTS" 0 /end CHARACTERISTIC
/begin CHARACTERISTIC CPD_V_VSS_DCL_DIAG_CNTS "vehicle speed deceleration mode vehicle speed sensor diag counts" VALUE 0x0002038C __UWORD_S 0 u_cnts 0 65535 FORMAT "%5.0" SYMBOL_LINK "CPD_C_VSS_DCL_CNTS" 2 /end CHARACTERISTIC
/begin CHARACTERISTIC CPD_V_VSPD_CAN_FL_CNTS "can vehicle speed fail counts" VALUE 0x0002038C __UWORD_S 0 u_cnts 0 65535 FORMAT "%5.0" SYMBOL_LINK "CPD_C_VSPD_CAN_CNTS" 0 /end CHARACTERISTIC
/begin CHARACTERISTIC CPD_V_VSPD_CAN_DIAG_CNTS "can vehicle speed diag counts" VALUE 0x0002038C __UWORD_S 0 u_cnts 0 65535 FORMAT "%5.0" SYMBOL_LINK "CPD_C_VSPD_CAN_CNTS" 2 /end CHARACTERISTIC
/begin CHARACTERISTIC CPD_V_BAT_VLT_HI "battery voltage high fail thr" VALUE 0x0002038C __UWORD_S 0 u_volt_32 0 31.99951171875 FORMAT "%4.2" /end CHARACTERISTIC
/begin CHARACTERISTIC CPD_V_BAT_VLT_HI_FL_CNTS "battery voltage high fail counts" VALUE 0x0002038C __UWORD_S 0 u_cnts 0 65535 FORMAT "%5.0" SYMBOL_LINK "CPD_C_BAT_VLT_HI_CNTS" 0 /end CHARACTERISTIC
/begin CHARACTERISTIC CPD_V_BAT_VLT_HI_DIAG_CNTS "battery voltage high diag counts" VALUE 0x0002038C __UWORD_S 0 u_cnts 0 65535 FORMAT "%5.0" SYMBOL_LINK "CPD_C_BAT_VLT_HI_CNTS" 2 /end CHARACTERISTIC
/begin CHARACTERISTIC ECSD_V_ECT_SHRT_LO_VLT "ECT short low fail voltage" VALUE 0x0002038C __UWORD_S 0 u_ad_volt 0 4.9999237060546875 FORMAT "%4.3" /end CHARACTERISTIC
/begin CHARACTERISTIC ECSD_V_ECT_SHRT_HI_VLT "ECT short high fail voltage" VALUE 0x0002038C __UWORD_S 0 u_ad_volt 0 4.9999237060546875 FORMAT "%4.3" /end CHARACTERISTIC
/begin CHARACTERISTIC ECSD_V_ECT_SHRT_EN_RUN_MIN "ECT short enable engine run min" VALUE 0x0002038C __UWORD_S 0 u_1s_tmr 0 65535 /end CHARACTERISTIC
/begin CHARACTERISTIC ECSD_V_ECT_SHRT_EN_SOAK_MIN "ECT short enable engine soak min" VALUE 0x0002038C __UWORD_S 0 u_min 0 65535 /end CHARACTERISTIC
/begin CHARACTERISTIC ECSD_V_ECT_SHRT_HI_EN_IAT_MIN "ECT short high enable IAT min" VALUE 0x0002038C __SWORD_S 0 u_deg_C -256 255.9921875 FORMAT "%4.1" /end CHARACTERISTIC
/begin CHARACTERISTIC CPD_V_BRKL_EN_VSPD_HI "break lamp diag enable vehicle speed high" VALUE 0x0002038C __UWORD_S 0 u_vspd 0 511.9921875 /end CHARACTERISTIC
/begin CHARACTERISTIC CPD_V_BRKL_EN_VSPD_LO "break lamp diag enable vehicle speed low" VALUE 0x0002038C __UWORD_S 0 u_vspd 0 511.9921875 /end CHARACTERISTIC
/begin CHARACTERISTIC CPD_V_BRKL_EN_DUR_MAX "break lamp diag enable delay" VALUE 0x0002038C __UBYTE_S 0 u_16x_tmr 0 8191.875 FORMAT "%4.2" /end CHARACTERISTIC
/begin CHARACTERISTIC CPD_V_BRKL_ACTV_ACC "break lamp diag active acc max" VALUE 0x0002038C __SWORD_S 0 u_acc -64 63.998046875 /end CHARACTERISTIC
/begin CHARACTERISTIC CPD_V_BRKL_DIAG_DLY "break lamp diag start delay" VALUE 0x0002038C __UBYTE_S 0 u_16x_tmr 0 8191.875 FORMAT "%4.2" /end CHARACTERISTIC
/begin CHARACTERISTIC CPD_V_BRKL_EXT_DUR "break lamp diag exit vehicle speed condtions met duration" VALUE 0x0002038C __UBYTE_S 0 u_16x_tmr 0 8191.875 FORMAT "%4.2" /end CHARACTERISTIC
/begin CHARACTERISTIC CPD_V_BRKL_FL_INC_STP "break lamp fail counts increase step" VALUE 0x0002038C __UWORD_S 0 u_cnts 0 65535 FORMAT "%5.0" /end CHARACTERISTIC
/begin CHARACTERISTIC CPD_V_BRKL_FL_DEC_STP "break lamp fail counts decrease step" VALUE 0x0002038C __UWORD_S 0 u_cnts 0 65535 FORMAT "%5.0" /end CHARACTERISTIC
/begin CHARACTERISTIC CPD_V_BRKL_FL_CNTS_MAX "break lamp fail counts max" VALUE 0x0002038C __UWORD_S 0 u_cnts 0 65535 FORMAT "%5.0" /end CHARACTERISTIC
/begin CHARACTERISTIC CPD_V_BRKL_FL_CNTS "break lamp fail counts" VALUE 0x0002038C __UWORD_S 0 u_cnts 0 65535 FORMAT "%5.0" /end CHARACTERISTIC
/begin CHARACTERISTIC CPD_V_BRKL_DIAG_CNTS "break lamp diag counts" VALUE 0x0002038C __UWORD_S 0 u_cnts 0 65535 FORMAT "%5.0" /end CHARACTERISTIC
/begin CHARACTERISTIC CPD_V_BRK_SW_FL_DLY "break switch diag fail met delay" VALUE 0x0002038C __UBYTE_S 0 u_16x_tmr 0 8191.875 FORMAT "%4.2" /end CHARACTERISTIC
/begin CHARACTERISTIC CPD_V_BRKL_ON_EXT_DLY "break lamp on state exit delay" VALUE 0x0002038C __UBYTE_S 0 u_16x_tmr 0 8191.875 FORMAT "%4.2" /end CHARACTERISTIC
/begin CHARACTERISTIC CPD_V_BRK_SW_FL_INC_STP "break switch fail counts increase step" VALUE 0x0002038C __UWORD_S 0 u_cnts 0 65535 FORMAT "%5.0" /end CHARACTERISTIC
/begin CHARACTERISTIC CPD_V_BRK_SW_FL_DEC_STP "break switch fail counts decrease step" VALUE 0x0002038C __UWORD_S 0 u_cnts 0 65535 FORMAT "%5.0" /end CHARACTERISTIC
/begin CHARACTERISTIC CPD_V_BRK_SW_FL_CNTS_MAX "break switch fail counts max" VALUE 0x0002038C __UWORD_S 0 u_cnts 0 65535 FORMAT "%5.0" /end CHARACTERISTIC
/begin CHARACTERISTIC CPD_V_BRK_SW_FL_CNTS "break switch fail counts" VALUE 0x0002038C __UWORD_S 0 u_cnts 0 65535 FORMAT "%5.0" /end CHARACTERISTIC
/begin CHARACTERISTIC CPD_V_BRK_SW_DIAG_CNTS "break switch diag counts" VALUE 0x0002038C __UWORD_S 0 u_cnts 0 65535 FORMAT "%5.0" /end CHARACTERISTIC
/begin CHARACTERISTIC CPD_V_CAM_OPN_FL_CNTS "cam open fail cylinder event counts" VALUE 0x0002038C __UWORD_S 0 u_cnts 0 65535 FORMAT "%5.0" /end CHARACTERISTIC
/begin CHARACTERISTIC CPD_V_CAM_RAT_FL_CNTS "cam rationality fail event counts" VALUE 0x0002038C __UWORD_S 0 u_cnts 0 65535 FORMAT "%5.0" /end CHARACTERISTIC
/begin CHARACTERISTIC CPD_V_CAM_RAT_PASS_CNTS "cam rationality pass event counts" VALUE 0x0002038C __UWORD_S 0 u_cnts 0 65535 FORMAT "%5.0" /end CHARACTERISTIC
/begin CHARACTERISTIC CPD_V_CRK_NOIS_FL_CNTS "crank noise fail counts" VALUE 0x0002038C __UWORD_S 0 u_cnts 0 65535 FORMAT "%5.0" /end CHARACTERISTIC
/begin CHARACTERISTIC CPD_V_CRK_NOIS_ERR_CNTS "crank noise error counts" VALUE 0x0002038C __UWORD_S 0 u_cnts 0 65535 FORMAT "%5.0" /end CHARACTERISTIC
/begin CHARACTERISTIC CPD_V_CRK_NOIS_DIAG_CNTS "crank noise fail counts" VALUE 0x0002038C __UWORD_S 0 u_cnts 0 65535 FORMAT "%5.0" /end CHARACTERISTIC
/begin CHARACTERISTIC CPD_V_CRK_OPN_FL_CNTS "crank open fail counts" VALUE 0x0002038C __UBYTE_S 0 u_cnts 0 255 /end CHARACTERISTIC
/begin CHARACTERISTIC CPD_V_CRK_OPN_RST_DLY "crank open rest conds not met delay" VALUE 0x0002038C __UWORD_S 0 u_1x_tmr 0 511.9921875 FORMAT "%5.2" /end CHARACTERISTIC
/begin CHARACTERISTIC CPD_M_TPS_DFLT_POS_THR "TPS default position thr" MAP 0x00020320 __UWORD_S 0 u_pct 0 199.996948 FORMAT "%4.1"
 /begin AXIS_DESCR FIX_AXIS NO_INPUT_QUANTITY u_tps12 2 0 1 /begin FIX_AXIS_PAR_LIST 0 1 /end FIX_AXIS_PAR_LIST /end AXIS_DESCR
 /begin AXIS_DESCR FIX_AXIS NO_INPUT_QUANTITY u_hi_lo 2 0 1 /begin FIX_AXIS_PAR_LIST 0 1 /end FIX_AXIS_PAR_LIST /end AXIS_DESCR
/end CHARACTERISTIC
/begin CHARACTERISTIC CPD_V_TPS_DFLT_ECT_THR "TPS default reach time ECT thr" VALUE 0x0002038C __SWORD_S 0 u_deg_C -256 255.9921875 FORMAT "%4.1" /end CHARACTERISTIC
/begin CHARACTERISTIC CPD_V_TPS_DFLT_RCH_TM_CLD "TPS default reach time cold thr" VALUE 0x0002038C __UWORD_S 0 u_2x_tmr 0 1023.984375 /end CHARACTERISTIC
/begin CHARACTERISTIC CPD_V_TPS_DFLT_RCH_TM "TPS default reach time thr" VALUE 0x0002038C __UWORD_S 0 u_2x_tmr 0 1023.984375 /end CHARACTERISTIC
/begin CHARACTERISTIC CPD_V_TPS_DFLT_INC_STP "TPS default fail counts increase step" VALUE 0x0002038C __UWORD_S 0 u_cnts 0 65535 FORMAT "%5.0" /end CHARACTERISTIC
/begin CHARACTERISTIC CPD_V_TPS_DFLT_DEC_STP "TPS default fail counts decrease step" VALUE 0x0002038C __UWORD_S 0 u_cnts 0 65535 FORMAT "%5.0" /end CHARACTERISTIC
/begin CHARACTERISTIC CPD_V_TPS_DFLT_FL_CNTS_MAX "TPS default fail counts max" VALUE 0x0002038C __UWORD_S 0 u_cnts 0 65535 FORMAT "%5.0" /end CHARACTERISTIC
/begin CHARACTERISTIC CPD_V_TPS_DFLT_FL_CNTS "TPS default fail counts" VALUE 0x0002038C __UWORD_S 0 u_cnts 0 65535 FORMAT "%5.0" /end CHARACTERISTIC
/begin CHARACTERISTIC CPD_V_TPS_DFLT_DIAG_CNTS "TPS default diag counts" VALUE 0x0002038C __UWORD_S 0 u_cnts 0 65535 FORMAT "%5.0" /end CHARACTERISTIC
/begin CHARACTERISTIC CPD_V_TPS1_PCT_HI "TPS high diag thr" VALUE 0x0002038C __UWORD_S 0 u_pct 0 199.996948 FORMAT "%4.1" /end CHARACTERISTIC
/begin CHARACTERISTIC CPD_V_TPS1_PCT_LO "TPS low diag thr" VALUE 0x0002038C __UWORD_S 0 u_pct 0 199.996948 FORMAT "%4.1" /end CHARACTERISTIC
/begin CHARACTERISTIC CPD_V_TPS2_PCT_HI "TPS high diag thr" VALUE 0x0002038C __UWORD_S 0 u_pct 0 199.996948 FORMAT "%4.1" /end CHARACTERISTIC
/begin CHARACTERISTIC CPD_V_TPS2_PCT_LO "TPS low diag thr" VALUE 0x0002038C __UWORD_S 0 u_pct 0 199.996948 FORMAT "%4.1" /end CHARACTERISTIC
/begin CHARACTERISTIC CPD_V_TPS_PCT_INC_CNTS "TPS raw diag fail increase counts" VALUE 0x0002038C __UWORD_S 0 u_cnts 0 65535 FORMAT "%5.0" SYMBOL_LINK "CPD_C_TPS_PCT_CNTS" 0 /end CHARACTERISTIC
/begin CHARACTERISTIC CPD_V_TPS_PCT_DEC_CNTS "TPS raw diag fail increase counts" VALUE 0x0002038C __UWORD_S 0 u_cnts 0 65535 FORMAT "%5.0" SYMBOL_LINK "CPD_C_TPS_PCT_CNTS" 2 /end CHARACTERISTIC
/begin CHARACTERISTIC CPD_V_TPS_PCT_FL_CNTS "TPS raw diag fail increase counts" VALUE 0x0002038C __UWORD_S 0 u_cnts 0 65535 FORMAT "%5.0" SYMBOL_LINK "CPD_C_TPS_PCT_CNTS" 4 /end CHARACTERISTIC
/begin CHARACTERISTIC CPD_V_TPS_PCT_DIAG_CNTS "TPS raw diag fail increase counts" VALUE 0x0002038C __UWORD_S 0 u_cnts 0 65535 FORMAT "%5.0" SYMBOL_LINK "CPD_C_TPS_PCT_CNTS" 6 /end CHARACTERISTIC
/begin CHARACTERISTIC CPD_V_TPS_COR_DLY_ECT_MIN "TPS correlation bypass delay ECT min" VALUE 0x0002038C __SWORD_S 0 u_deg_C -256 255.9921875 FORMAT "%4.1" /end CHARACTERISTIC
/begin CHARACTERISTIC CPD_V_TPS_COR_STL_THR "TPS correlation stall thr" VALUE 0x0002038C __UWORD_S 0 u_pct 0 199.996948 FORMAT "%4.1" /end CHARACTERISTIC
/begin CHARACTERISTIC CPD_C_TPS_COR_NOISE_THR "TPS correlation thr when TPS noise" CURVE 0x000200B0 __UWORD_S 0 u_pct 0 199.996948 FORMAT "%4.1" SYMBOL_LINK "CPD_C_TPS_COR_NOISE_THR" 2
 /begin AXIS_DESCR FIX_AXIS thro_pos_sp u_pct 11 0 100
  /begin FIX_AXIS_PAR_LIST 0 3276.8 6553.6 9830.4 13107.2 16384 19660.8 22937.6 26214.4 29491.2 32768 /end FIX_AXIS_PAR_LIST
 /end AXIS_DESCR
/end CHARACTERISTIC
/begin CHARACTERISTIC CPD_C_TPS_COR_NORM_THR "TPS correlation thr when TPS mormal" CURVE 0x000200B0 __UWORD_S 0 u_pct 0 199.996948 FORMAT "%4.1" SYMBOL_LINK "CPD_C_TPS_COR_NORM_THR" 2
 /begin AXIS_DESCR FIX_AXIS thro_pos_sp u_pct 11 0 100
  /begin FIX_AXIS_PAR_LIST 0 3276.8 6553.6 9830.4 13107.2 16384 19660.8 22937.6 26214.4 29491.2 32768 /end FIX_AXIS_PAR_LIST
 /end AXIS_DESCR
/end CHARACTERISTIC
/begin CHARACTERISTIC CPD_V_TPS_COR_STL_FL_THR "TPS correlation diag stall fail thr" VALUE 0x0002038C __UWORD_S 0 u_cnts 0 65535 FORMAT "%5.0" /end CHARACTERISTIC
/begin CHARACTERISTIC CPD_C_TPS_COR_NOISE_FL_THR "TPS correlation fail thr when TPS noise" CURVE 0x000200B0 __UWORD_S 0 u_cnts 0 65535 FORMAT "%5.0" SYMBOL_LINK "CPD_C_TPS_COR_NOISE_FL_THR" 2
 /begin AXIS_DESCR FIX_AXIS thro_pos_sp u_pct 11 0 100
  /begin FIX_AXIS_PAR_LIST 0 3276.8 6553.6 9830.4 13107.2 16384 19660.8 22937.6 26214.4 29491.2 32768 /end FIX_AXIS_PAR_LIST
 /end AXIS_DESCR
/end CHARACTERISTIC
/begin CHARACTERISTIC CPD_C_TPS_COR_NORM_FL_THR "TPS correlation fail thr when TPS normal" CURVE 0x000200B0 __UWORD_S 0 u_cnts 0 65535 FORMAT "%5.0" SYMBOL_LINK "CPD_C_TPS_COR_NORM_FL_THR" 2
 /begin AXIS_DESCR FIX_AXIS thro_pos_sp u_pct 11 0 100
  /begin FIX_AXIS_PAR_LIST 0 3276.8 6553.6 9830.4 13107.2 16384 19660.8 22937.6 26214.4 29491.2 32768 /end FIX_AXIS_PAR_LIST
 /end AXIS_DESCR
/end CHARACTERISTIC
/begin CHARACTERISTIC CPD_V_TPS_COR_INC_CNTS "TPS correlation diag fail increase counts" VALUE 0x0002038C __UWORD_S 0 u_cnts 0 65535 FORMAT "%5.0" SYMBOL_LINK "CPD_C_TPS_COR_CNTS" 0 /end CHARACTERISTIC
/begin CHARACTERISTIC CPD_V_TPS_COR_DEC_CNTS "TPS correlation diag fail increase counts" VALUE 0x0002038C __UWORD_S 0 u_cnts 0 65535 FORMAT "%5.0" SYMBOL_LINK "CPD_C_TPS_COR_CNTS" 2 /end CHARACTERISTIC
/begin CHARACTERISTIC CPD_V_TPS_COR_DIAG_CNTS "TPS correlation diag counts" VALUE 0x0002038C __UWORD_S 0 u_cnts 0 65535 FORMAT "%5.0" SYMBOL_LINK "CPD_C_TPS_COR_CNTS" 4 /end CHARACTERISTIC
/begin CHARACTERISTIC CPD_V_TPS_COR_FL_CNTS_MAX "TPS correlation diag fail counts max" VALUE 0x0002038C __UWORD_S 0 u_cnts 0 65535 FORMAT "%5.0" /end CHARACTERISTIC
/begin CHARACTERISTIC CPD_V_PPS1_PCT_HI "PPS high diag thr" VALUE 0x0002038C __UWORD_S 0 u_pct 0 199.996948 FORMAT "%4.1" SYMBOL_LINK "CPD_M_PPS_PCT_THR" 0 /end CHARACTERISTIC
/begin CHARACTERISTIC CPD_V_PPS1_PCT_LO "PPS low diag thr" VALUE 0x0002038C __UWORD_S 0 u_pct 0 199.996948 FORMAT "%4.1" SYMBOL_LINK "CPD_M_PPS_PCT_THR" 2 /end CHARACTERISTIC
/begin CHARACTERISTIC CPD_V_PPS2_PCT_HI "PPS high diag thr" VALUE 0x0002038C __UWORD_S 0 u_pct 0 199.996948 FORMAT "%4.1" SYMBOL_LINK "CPD_M_PPS_PCT_THR" 4 /end CHARACTERISTIC
/begin CHARACTERISTIC CPD_V_PPS2_PCT_LO "PPS low diag thr" VALUE 0x0002038C __UWORD_S 0 u_pct 0 199.996948 FORMAT "%4.1" SYMBOL_LINK "CPD_M_PPS_PCT_THR" 6 /end CHARACTERISTIC
/begin CHARACTERISTIC CPD_V_PPS_PCT_INC_CNTS "PPS percent diag fail increase counts" VALUE 0x0002038C __UWORD_S 0 u_cnts 0 65535 FORMAT "%5.0" SYMBOL_LINK "CPD_C_PPS_PCT_CNTS" 0 /end CHARACTERISTIC
/begin CHARACTERISTIC CPD_V_PPS_PCT_DEC_CNTS "PPS percent diag fail decrease counts" VALUE 0x0002038C __UWORD_S 0 u_cnts 0 65535 FORMAT "%5.0" SYMBOL_LINK "CPD_C_PPS_PCT_CNTS" 2 /end CHARACTERISTIC
/begin CHARACTERISTIC CPD_V_PPS_PCT_FL_CNTS "PPS percent diag fail counts" VALUE 0x0002038C __UWORD_S 0 u_cnts 0 65535 FORMAT "%5.0" SYMBOL_LINK "CPD_C_PPS_PCT_CNTS" 4 /end CHARACTERISTIC
/begin CHARACTERISTIC CPD_V_PPS_PCT_DIAG_CNTS "PPS percent diag counts" VALUE 0x0002038C __UWORD_S 0 u_cnts 0 65535 FORMAT "%5.0" SYMBOL_LINK "CPD_C_PPS_PCT_CNTS" 6 /end CHARACTERISTIC
/begin CHARACTERISTIC CPD_V_PPS_COR_ZERO_FL_THR "PPS zero correlation diag thr" VALUE 0x0002038C __UWORD_S 0 u_pct 0 199.996948 FORMAT "%4.1" /end CHARACTERISTIC
/begin CHARACTERISTIC CPD_V_TPS_COR_ZERO_FL_THR "TPS zero correlation diag thr" VALUE 0x0002038C __UWORD_S 0 u_pct 0 199.996948 FORMAT "%4.1" /end CHARACTERISTIC
/begin CHARACTERISTIC CPD_C_PPS_COR_RUN_FL_THR "PPS correlation fail thr when engine run" CURVE 0x000200B0 __UWORD_S 0 u_pct 0 199.996948 FORMAT "%4.1" SYMBOL_LINK "CPD_C_PPS_COR_RUN_FL_THR" 2
 /begin AXIS_DESCR FIX_AXIS sys_pps_pct u_pct 11 0 100
  /begin FIX_AXIS_PAR_LIST 0 3276.8 6553.6 9830.4 13107.2 16384 19660.8 22937.6 26214.4 29491.2 32768 /end FIX_AXIS_PAR_LIST
 /end AXIS_DESCR
/end CHARACTERISTIC
/begin CHARACTERISTIC CPD_V_PPS_COR_STL_FL_THR "PPS correlation fail thr when engine stall" VALUE 0x0002038C __UWORD_S 0 u_pct 0 199.996948 FORMAT "%4.1" /end CHARACTERISTIC
/begin CHARACTERISTIC CPD_V_PPS_COR_INC_CNTS "PPS correlation diag fail increase counts" VALUE 0x0002038C __UWORD_S 0 u_cnts 0 65535 FORMAT "%5.0" SYMBOL_LINK "CPD_C_PPS_COR_CNTS" 0 /end CHARACTERISTIC
/begin CHARACTERISTIC CPD_V_PPS_COR_DEC_CNTS "PPS correlation diag fail decrease counts" VALUE 0x0002038C __UWORD_S 0 u_cnts 0 65535 FORMAT "%5.0" SYMBOL_LINK "CPD_C_PPS_COR_CNTS" 2 /end CHARACTERISTIC
/begin CHARACTERISTIC CPD_V_PPS_COR_FL_CNTS "PPS correlation diag fail counts" VALUE 0x0002038C __UWORD_S 0 u_cnts 0 65535 FORMAT "%5.0" SYMBOL_LINK "CPD_C_PPS_COR_CNTS" 4 /end CHARACTERISTIC
/begin CHARACTERISTIC CPD_V_PPS_COR_DIAG_CNTS "PPS correlation diag counts" VALUE 0x0002038C __UWORD_S 0 u_cnts 0 65535 FORMAT "%5.0" SYMBOL_LINK "CPD_C_PPS_COR_CNTS" 6 /end CHARACTERISTIC
/begin CHARACTERISTIC CPD_V_PPS_COR_STL_FL_CNTS "PPS correlation diag stall fail counts" VALUE 0x0002038C __UWORD_S 0 u_cnts 0 65535 FORMAT "%5.0" /end CHARACTERISTIC
/begin CHARACTERISTIC CPD_V_PPS1_PCT_LO_R "PPS low diag thr redundant" VALUE 0x0002038C __SWORD_S 0 u_pct_s -200 199.993896484375 FORMAT "%4.1" /end CHARACTERISTIC
/begin CHARACTERISTIC CPD_V_PPS1_PCT_HI_R "PPS high diag thr redundant" VALUE 0x0002038C __SWORD_S 0 u_pct_s -200 199.993896484375 FORMAT "%4.1" /end CHARACTERISTIC
/begin CHARACTERISTIC CPD_V_PPS2_PCT_LO_R "PPS low diag thr redundant" VALUE 0x0002038C __SWORD_S 0 u_pct_s -200 199.993896484375 FORMAT "%4.1" /end CHARACTERISTIC
/begin CHARACTERISTIC CPD_V_PPS2_PCT_HI_R "PPS high diag thr redundant" VALUE 0x0002038C __SWORD_S 0 u_pct_s -200 199.993896484375 FORMAT "%4.1" /end CHARACTERISTIC
/begin CHARACTERISTIC CPD_V_PPS_PCT_INC_CNTS_R "PPS percent diag fail increase counts redundant" VALUE 0x0002038C __UWORD_S 0 u_cnts_hi 0 32767 FORMAT "%5.0" SYMBOL_LINK "CPD_C_PPS_PCT_CNTS_R" 0 /end CHARACTERISTIC
/begin CHARACTERISTIC CPD_V_PPS_PCT_DEC_CNTS_R "PPS percent diag fail decrease counts redundant" VALUE 0x0002038C __UWORD_S 0 u_cnts_hi 0 32767 FORMAT "%5.0" SYMBOL_LINK "CPD_C_PPS_PCT_CNTS_R" 2 /end CHARACTERISTIC
/begin CHARACTERISTIC CPD_V_PPS_PCT_FL_CNTS_R "PPS percent diag fail counts redundant" VALUE 0x0002038C __UWORD_S 0 u_cnts_hi 0 32767 FORMAT "%5.0" SYMBOL_LINK "CPD_C_PPS_PCT_CNTS_R" 4 /end CHARACTERISTIC
/begin CHARACTERISTIC CPD_V_PPS_PCT_DIAG_CNTS_R "PPS percent diag counts redundant" VALUE 0x0002038C __UWORD_S 0 u_cnts_hi 0 32767 FORMAT "%5.0" SYMBOL_LINK "CPD_C_PPS_PCT_CNTS_R" 6 /end CHARACTERISTIC
/begin CHARACTERISTIC CPD_V_PPS_COR_INC_CNTS_R "PPS correlation diag fail increase counts redundant" VALUE 0x0002038C __UWORD_S 0 u_cnts_hi 0 32767 FORMAT "%5.0" SYMBOL_LINK "CPD_C_PPS_COR_CNTS_R" 0 /end CHARACTERISTIC
/begin CHARACTERISTIC CPD_V_PPS_COR_DEC_CNTS_R "PPS correlation diag fail decrease counts redundant" VALUE 0x0002038C __UWORD_S 0 u_cnts_hi 0 32767 FORMAT "%5.0" SYMBOL_LINK "CPD_C_PPS_COR_CNTS_R" 2 /end CHARACTERISTIC
/begin CHARACTERISTIC CPD_V_PPS_COR_FL_CNTS_R "PPS correlation diag fail counts redundant" VALUE 0x0002038C __UWORD_S 0 u_cnts_hi 0 32767 FORMAT "%5.0" SYMBOL_LINK "CPD_C_PPS_COR_CNTS_R" 4 /end CHARACTERISTIC
/begin CHARACTERISTIC CPD_V_PPS_COR_DIAG_CNTS_R "PPS correlation diag counts redundant" VALUE 0x0002038C __UWORD_S 0 u_cnts_hi 0 32767 FORMAT "%5.0" SYMBOL_LINK "CPD_C_PPS_COR_CNTS_R" 6 /end CHARACTERISTIC
/begin CHARACTERISTIC CPD_V_PPS_COR_ZERO_FL_THR_R "PPS zero correlation diag thr redundant" VALUE 0x0002038C __SWORD_S 0 u_pct_s -200 199.993896484375 FORMAT "%4.1" /end CHARACTERISTIC
/begin CHARACTERISTIC CPD_V_PPS_COR_STL_FL_THR_R "PPS correlation fail thr when engine stall redundant" VALUE 0x0002038C __SWORD_S 0 u_pct -200 199.993896484375 FORMAT "%4.1" /end CHARACTERISTIC
/begin CHARACTERISTIC CPD_C_PPS_COR_RUN_FL_THR_R "PPS correlation fail thr when engine run redundant" CURVE 0x000200B0 __SWORD_S 0 u_pct_s -200 199.993896484375 FORMAT "%4.1" SYMBOL_LINK "CPD_C_PPS_COR_RUN_FL_THR_R" 2
 /begin AXIS_DESCR FIX_AXIS sys_pps_pct u_pct 11 0 100
  /begin FIX_AXIS_PAR_LIST 0 3276.8 6553.6 9830.4 13107.2 16384 19660.8 22937.6 26214.4 29491.2 32768 /end FIX_AXIS_PAR_LIST
 /end AXIS_DESCR
/end CHARACTERISTIC
/begin CHARACTERISTIC CPD_V_PPS_COR_STL_FL_CNTS_R "PPS correlation diag stall fail counts" VALUE 0x0002038C __UWORD_S 0 u_cnts_hi 0 32767 FORMAT "%5.0" /end CHARACTERISTIC
/begin CHARACTERISTIC CPD_V_EGRP_SHRT_EN_VLT_LO "EGR position short diag enable voltage low" VALUE 0x0002038C __UWORD_S 0 u_volt_32 0 31.99951171875 FORMAT "%4.2" /end CHARACTERISTIC
/begin CHARACTERISTIC CPD_V_EGRP_SHRT_EN_VLT_HI "EGR position short diag enable voltage high" VALUE 0x0002038C __UWORD_S 0 u_volt_32 0 31.99951171875 FORMAT "%4.2" /end CHARACTERISTIC
/begin CHARACTERISTIC CPD_V_EGRP_SHRT_LO_THR "EGR position short low percent thr" VALUE 0x0002038C __UWORD_S 0 u_pct 0 199.996948 FORMAT "%4.1" /end CHARACTERISTIC
/begin CHARACTERISTIC CPD_V_EGRP_SHRT_HI_THR "EGR position short high percent thr" VALUE 0x0002038C __UWORD_S 0 u_pct 0 199.996948 FORMAT "%4.1" /end CHARACTERISTIC
/begin CHARACTERISTIC CPD_V_EGRP_SHRT_LO_FL_TM "EGR position short low fail time" VALUE 0x0002038C __UBYTE_S 0 u_16x_tmr 0 8191.875 FORMAT "%4.1" /end CHARACTERISTIC
/begin CHARACTERISTIC CPD_V_EGRP_SHRT_HI_FL_TM "EGR position short high fail time" VALUE 0x0002038C __UBYTE_S 0 u_16x_tmr 0 8191.875 FORMAT "%4.1" /end CHARACTERISTIC
/begin CHARACTERISTIC CPD_V_EGR_POS_ZERO_FIL "EGR zero position filter" VALUE 0x0002038C __UWORD_S 0 u_filter 0 0.9999847412109375 FORMAT "%4.3" /end CHARACTERISTIC
/begin CHARACTERISTIC CPD_V_EGR_POS_ZERO_DLY "EGR zero position update delay" VALUE 0x0002038C __UWORD_S 0 u_1x_tmr 0 511.9921875 FORMAT "%5.2" /end CHARACTERISTIC
/begin CHARACTERISTIC CPD_V_EGR_POS_INIT_LOG_DUR "EGR zero position log duration" VALUE 0x0002038C __UWORD_S 0 u_1x_tmr 0 511.9921875 FORMAT "%5.2" /end CHARACTERISTIC
/begin CHARACTERISTIC CPD_V_EGR_POS_INIT_LOG_PPS_HI "EGR zero position log enable pps high" VALUE 0x0002038C __UWORD_S 0 u_pct 0 199.996948 FORMAT "%4.1" /end CHARACTERISTIC
/begin CHARACTERISTIC CPD_V_EGR_POS_INIT_LOG_PPS_LO "EGR zero position log enable pps low" VALUE 0x0002038C __UWORD_S 0 u_pct 0 199.996948 FORMAT "%4.1" /end CHARACTERISTIC
/begin CHARACTERISTIC CPD_V_EGR_POS_INIT_MAX "EGR init position max" VALUE 0x0002038C __UWORD_S 0 u_pct 0 199.996948 FORMAT "%4.1" /end CHARACTERISTIC
/begin CHARACTERISTIC CPD_V_EGR_POS_INIT_MIN "EGR init position min" VALUE 0x0002038C __UWORD_S 0 u_pct 0 199.996948 FORMAT "%4.1" /end CHARACTERISTIC
/begin CHARACTERISTIC CPD_V_EGR_ZERO_FL_DLT "EGR zero position fail delta" VALUE 0x0002038C __UWORD_S 0 u_pct 0 199.996948 FORMAT "%4.1" /end CHARACTERISTIC
/begin CHARACTERISTIC CPD_V_EGR_ZERO_FL_CNTS "drive train stuck low diag counts" VALUE 0x0002038C __UBYTE_S 0 u_cnts 0 255 /end CHARACTERISTIC
/begin CHARACTERISTIC CPD_V_EGR_ZERO_DIAG_CNTS "drive train stuck low diag counts" VALUE 0x0002038C __UBYTE_S 0 u_cnts 0 255 /end CHARACTERISTIC
/begin CHARACTERISTIC CPD_V_EGR_CLS_EN_IAT_MIN "EGR close position enable IAT min" VALUE 0x0002038C __SWORD_S 0 u_deg_C -256 255.9921875 /end CHARACTERISTIC
/begin CHARACTERISTIC CPD_V_EGR_CLS_PRE_OPN_MIN "EGR close position enable previous open min" VALUE 0x0002038C __UWORD_S 0 u_pct 0 199.996948 FORMAT "%4.1" /end CHARACTERISTIC
/begin CHARACTERISTIC CPD_V_EGR_CLS_PRE_OPN_DUR "EGR close position enable previous open duration" VALUE 0x0002038C __UWORD_S 0 u_16x_tmr 0 8191.875 /end CHARACTERISTIC
/begin CHARACTERISTIC CPD_V_EGR_CLS_POS_DLT "EGR close position fail delta" VALUE 0x0002038C __UWORD_S 0 u_pct 0 199.996948 FORMAT "%4.1" /end CHARACTERISTIC
/begin CHARACTERISTIC CPD_V_EGR_CLS_FL_LOG_CNTS "EGR close position fail log counts" VALUE 0x0002038C __UBYTE_S 0 u_cnts 0 255 /end CHARACTERISTIC
/begin CHARACTERISTIC CPD_V_EGR_CLS_FL_CNTS "EGR close position fail counts" VALUE 0x0002038C __UBYTE_S 0 u_cnts 0 255 /end CHARACTERISTIC
/begin CHARACTERISTIC CPD_V_EGR_CLS_PS_CNTS "EGR close position pass counts" VALUE 0x0002038C __UBYTE_S 0 u_cnts 0 255 /end CHARACTERISTIC
/begin CHARACTERISTIC CPD_V_EGR_CRK_VLT_MIN "EGR crank diag enable voltage min" VALUE 0x0002038C __UWORD_S 0 u_volt_32 0 31.99951171875 FORMAT "%4.2" /end CHARACTERISTIC
/begin CHARACTERISTIC CPD_V_EGR_CRK_VLT_MAX "EGR crank diag enable voltage min" VALUE 0x0002038C __UWORD_S 0 u_volt_32 0 31.99951171875 FORMAT "%4.2" /end CHARACTERISTIC
/begin CHARACTERISTIC CPD_V_EGR_CRK_FL_MIN "EGR crank fail position min" VALUE 0x0002038C __UWORD_S 0 u_pct 0 199.996948 FORMAT "%4.1" /end CHARACTERISTIC
/begin CHARACTERISTIC CPD_V_EGR_CRK_FL_DUR "EGR crank fail duration" VALUE 0x0002038C __UWORD_S 0 u_16x_tmr 0 8191.875 /end CHARACTERISTIC
/begin CHARACTERISTIC CPD_V_ALT_EN_RUN_MIN "alt pwm diag runtime min" VALUE 0x0002038C __UWORD_S 0 u_1s_tmr 0 65535 /end CHARACTERISTIC
/begin CHARACTERISTIC CPD_V_ALT_EN_VLT_MIN "alt pwm diag voltage min" VALUE 0x0002038C __UWORD_S 0 u_volt_32 0 31.99951171875 FORMAT "%4.2" /end CHARACTERISTIC
/begin CHARACTERISTIC CPD_V_ALT_EN_VLT_MAX "alt pwm diag voltage max" VALUE 0x0002038C __UWORD_S 0 u_volt_32 0 31.99951171875 FORMAT "%4.2" /end CHARACTERISTIC
/begin CHARACTERISTIC CPD_V_ALT_EN_ESPD_MIN "alt pwm diag runtime min" VALUE 0x0002038C __UWORD_S 0 u_espd 0 8191.875 FORMAT "%5.1" /end CHARACTERISTIC
/begin CHARACTERISTIC CPD_V_ALT_EN_ESPD_MAX "alt pwm diag runtime max" VALUE 0x0002038C __UWORD_S 0 u_espd 0 8191.875 FORMAT "%5.1" /end CHARACTERISTIC
/begin CHARACTERISTIC CPD_C_ALT_PWM_DTY_DSR "alt pwm diag desired duty" CURVE 0x000200B0 __UWORD_S 0 u_pct_1 0 99.9984741210937 FORMAT "%4.2" SYMBOL_LINK "CPD_C_ALT_PWM_DTY_DSR" 2
 /begin AXIS_DESCR FIX_AXIS hw_bat_vlt u_volt_32 11 0 31.99951171875
  /begin FIX_AXIS_PAR_LIST 16384 18432 20480 22528 24576 26624 28672 30720 32768 34816 36864 /end FIX_AXIS_PAR_LIST
 /end AXIS_DESCR
/end CHARACTERISTIC
/begin CHARACTERISTIC CPD_V_ALT_PWM_FL_DTY "alt pwm diag fail duty" VALUE 0x0002038C __UWORD_S 0 u_pct_1 0 99.9984741210937 FORMAT "%4.2" /end CHARACTERISTIC
/begin CHARACTERISTIC CPD_V_ALT_PWM_STCK_DTY "alt pwm stuck diag duty" VALUE 0x0002038C __UWORD_S 0 u_pct_1 0 99.9984741210937 FORMAT "%4.2" /end CHARACTERISTIC
/begin CHARACTERISTIC CPD_V_ALT_PWM_STCK_FL_DTY "alt pwm stuck diag fail duty" VALUE 0x0002038C __UWORD_S 0 u_pct_1 0 99.9984741210937 FORMAT "%4.2" /end CHARACTERISTIC
/begin CHARACTERISTIC CPD_V_ALT_PWM_STCK_DLY "alt pwm stuck diag fail delay" VALUE 0x0002038C __UWORD_S 0 u_cnts 0 65535 FORMAT "%5.0" /end CHARACTERISTIC
/begin CHARACTERISTIC CPD_V_ALT_PWM_FL_CNTS "alt pwm diag fail counts" VALUE 0x0002038C __UWORD_S 0 u_cnts 0 65535 FORMAT "%5.0" /end CHARACTERISTIC
/begin CHARACTERISTIC CPD_V_ALT_PWM_DIAG_CNTS "alt pwm diag counts" VALUE 0x0002038C __UWORD_S 0 u_cnts 0 65535 FORMAT "%5.0" /end CHARACTERISTIC
/begin CHARACTERISTIC CPD_V_ALT_PWM_STCK_DIAG_CNTS "alt pwm stuck diag counts" VALUE 0x0002038C __UWORD_S 0 u_cnts 0 65535 FORMAT "%5.0" /end CHARACTERISTIC
/begin CHARACTERISTIC CPD_V_ALT_PWM_STCK_FL_CNTS "alt pwm stuck diag fail counts" VALUE 0x0002038C __UWORD_S 0 u_cnts 0 65535 FORMAT "%5.0" /end CHARACTERISTIC
/begin CHARACTERISTIC CPD_C_KNK_EN_IMEP_MIN "knock diag enable imep min" CURVE 0x000200B0 __UWORD_S 0 u_kPa_0_4096 0 4095.937500 FORMAT "%5.1" SYMBOL_LINK "CPD_C_KNK_EN_IMEP_MIN" 2
 /begin AXIS_DESCR FIX_AXIS sys_eng_spd u_espd 9 0 6400 /begin FIX_AXIS_PAR_LIST 0 6400 12800 19200 25600 32000 38400 44800 51200 /end FIX_AXIS_PAR_LIST /end AXIS_DESCR
/end CHARACTERISTIC
/begin CHARACTERISTIC CPD_V_KNK_SNSR_EN_ESPD "knock sensor enable engine speed" VALUE 0x0002038C __UWORD_S 0 u_espd 0 8191.875 FORMAT "%5.1" /end CHARACTERISTIC
/begin CHARACTERISTIC CPD_V_KNK_SYS_EN_ESPD "knock system enable engine speed" VALUE 0x0002038C __UWORD_S 0 u_espd 0 8191.875 FORMAT "%5.1" /end CHARACTERISTIC
/begin CHARACTERISTIC CPD_V_KNK_SYS_FL_VLT_MIN "knock system fail voltage min" VALUE 0x0002038C __UWORD_S 0 u_ad_volt 0 4.9999237060546875 FORMAT "%4.3" /end CHARACTERISTIC
/begin CHARACTERISTIC CPD_V_KNK_SYS_FL_VLT_MAX "knock system fail voltage max" VALUE 0x0002038C __UWORD_S 0 u_ad_volt 0 4.9999237060546875 FORMAT "%4.3" /end CHARACTERISTIC
/begin CHARACTERISTIC CPD_V_KNK_SYS_LO_FL_CNTS "knock system low fail counts" VALUE 0x0002038C __UBYTE_S 0 u_cnts 0 255 /end CHARACTERISTIC
/begin CHARACTERISTIC CPD_V_KNK_SYS_HI_FL_CNTS "knock system high fail counts" VALUE 0x0002038C __UBYTE_S 0 u_cnts 0 255 /end CHARACTERISTIC
/begin CHARACTERISTIC CPD_V_KNK_SYS_DIAG_CNTS "knock system diag counts" VALUE 0x0002038C __UBYTE_S 0 u_cnts 0 255 /end CHARACTERISTIC
/begin CHARACTERISTIC CPD_C_KNK_SNSR_FL_INT_FL_MIN "knock sensor diag fail int min" CURVE 0x000200B0 __UWORD_S 0 u_pct 0 199.996948 FORMAT "%4.1" SYMBOL_LINK "CPD_C_KNK_SNSR_FL_INT_FL_MIN" 2
 /begin AXIS_DESCR FIX_AXIS sys_eng_spd u_espd 9 0 6400 /begin FIX_AXIS_PAR_LIST 0 6400 12800 19200 25600 32000 38400 44800 51200 /end FIX_AXIS_PAR_LIST /end AXIS_DESCR
/end CHARACTERISTIC
/begin CHARACTERISTIC CPD_V_KNK_SNSR_FL_CNTS "knock sensor fail counts" VALUE 0x0002038C __UBYTE_S 0 u_cnts 0 255 /end CHARACTERISTIC
/begin CHARACTERISTIC CPD_V_KNK_SNSR_DIAG_CNTS "knock sensor diag counts" VALUE 0x0002038C __UBYTE_S 0 u_cnts 0 255 /end CHARACTERISTIC
/begin CHARACTERISTIC CPD_V_KNK_SNSR_INT_FIL "knock sensor diag int filter" VALUE 0x0002038C __UWORD_S 0 u_filter 0 0.9999847412109375 FORMAT "%10.9" /end CHARACTERISTIC
/begin CHARACTERISTIC CPD_V_KNK_SYS_AD_FIL "knock system diag raw ad filter" VALUE 0x0002038C __UWORD_S 0 u_filter 0 0.9999847412109375 FORMAT "%10.9" /end CHARACTERISTIC
/begin CHARACTERISTIC CPD_V_ENS_FL_CNTS "ENS pulse fail counts" VALUE 0x0002038C __UWORD_S 0 u_cnts 0 65535 FORMAT "%5.0" /end CHARACTERISTIC
/begin CHARACTERISTIC CPD_V_ENS_DIAG_CNTS "ENS pulse diag counts" VALUE 0x0002038C __UWORD_S 0 u_cnts 0 65535 FORMAT "%5.0" /end CHARACTERISTIC
/begin CHARACTERISTIC CPD_V_VSPD_EN_ECT_MIN "vehicle speed diag enable ECT min" VALUE 0x0002038C __SWORD_S 0 u_deg_C -256 255.9921875 FORMAT "%4.1" /end CHARACTERISTIC
/begin CHARACTERISTIC CPD_V_AMP_HI_DIAG_CNTS "amp short high diag counts" VALUE 0x0002038C __UWORD_S 0 u_cnts 0 65535 FORMAT "%5.0" SYMBOL_LINK "CPD_C_P_HI_FL_CNTS" 2 /end CHARACTERISTIC
/begin CHARACTERISTIC CPD_V_AMP_LO_DIAG_CNTS "amp short low diag counts" VALUE 0x0002038C __UWORD_S 0 u_cnts 0 65535 FORMAT "%5.0" SYMBOL_LINK "CPD_C_P_LO_FL_CNTS" 2 /end CHARACTERISTIC
/begin CHARACTERISTIC CPD_V_BSTP_HI_DIAG_CNTS "boost press short high diag counts" VALUE 0x0002038C __UWORD_S 0 u_cnts 0 65535 FORMAT "%5.0" SYMBOL_LINK "CPD_C_P_HI_FL_CNTS" 6 /end CHARACTERISTIC
/begin CHARACTERISTIC CPD_V_BSTP_LO_DIAG_CNTS "boost press short low diag counts" VALUE 0x0002038C __UWORD_S 0 u_cnts 0 65535 FORMAT "%5.0" SYMBOL_LINK "CPD_C_P_LO_FL_CNTS" 6 /end CHARACTERISTIC
/begin CHARACTERISTIC CPD_V_MAP_HI_DIAG_CNTS "map short high diag counts" VALUE 0x0002038C __UWORD_S 0 u_cnts 0 65535 FORMAT "%5.0" SYMBOL_LINK "CPD_C_P_HI_FL_CNTS" 6 SYMBOL_LINK "CPD_C_P_HI_FL_CNTS" 10 /end CHARACTERISTIC
/begin CHARACTERISTIC CPD_V_MAP_LO_DIAG_CNTS "map short low diag counts" VALUE 0x0002038C __UWORD_S 0 u_cnts 0 65535 FORMAT "%5.0" SYMBOL_LINK "CPD_C_P_LO_FL_CNTS" 6 SYMBOL_LINK "CPD_C_P_LO_FL_CNTS" 10 /end CHARACTERISTIC
/begin CHARACTERISTIC CPD_V_TNKP_LO_VLT "tank press low fail voltage" VALUE 0x0002038C __UWORD_S 0 u_ad_volt 0 4.9999237060546875 FORMAT "%4.3" /end CHARACTERISTIC
/begin CHARACTERISTIC CPD_V_TNKP_HI_VLT "tank press high fail voltage" VALUE 0x0002038C __UWORD_S 0 u_ad_volt 0 4.9999237060546875 FORMAT "%4.3" /end CHARACTERISTIC
/begin CHARACTERISTIC CPD_V_TNKP_DIAG_CNTS "tank press diag counts" VALUE 0x0002038C __UWORD_S 0 u_cnts 0 65535 FORMAT "%5.0" /end CHARACTERISTIC
/begin CHARACTERISTIC CPD_V_TNKP_LO_FL_CNTS "tank press short low counts" VALUE 0x0002038C __UWORD_S 0 u_cnts 0 65535 FORMAT "%5.0" /end CHARACTERISTIC
/begin CHARACTERISTIC CPD_V_TNKP_HI_FL_CNTS "tank press short high counts" VALUE 0x0002038C __UWORD_S 0 u_cnts 0 65535 FORMAT "%5.0" /end CHARACTERISTIC
/begin CHARACTERISTIC CPD_V_TNKP_RAT_OFFT_MIN "tank press rat diag enable off time min" VALUE 0x0002038C __UWORD_S 0 u_min 0 65535 /end CHARACTERISTIC
/begin CHARACTERISTIC CPD_V_TNKP_RAT_FIL "tank vac filter" VALUE 0x0002038C __UWORD_S 0 u_filter 0 0.9999847412109375 FORMAT "%4.3" /end CHARACTERISTIC
/begin CHARACTERISTIC CPD_V_TNKP_RAT_VAC_LO "tank press vac rat low thr" VALUE 0x0002038C __SWORD_S 0 u_kPa_8n_8p -8 7.999755859375 FORMAT "%3.2" /end CHARACTERISTIC
/begin CHARACTERISTIC CPD_V_TNKP_RAT_VAC_HI "tank press vac rat high thr" VALUE 0x0002038C __SWORD_S 0 u_kPa_8n_8p -8 7.999755859375 FORMAT "%3.2" /end CHARACTERISTIC
/begin CHARACTERISTIC CPD_V_TNKP_RAT_LO_FL_CNTS "tank press vac rat low fail counts" VALUE 0x0002038C __UWORD_S 0 u_cnts 0 65535 FORMAT "%5.0" /end CHARACTERISTIC
/begin CHARACTERISTIC CPD_V_TNKP_RAT_LO_DIAG_CNTS "tank press vac rat low diag counts" VALUE 0x0002038C __UWORD_S 0 u_cnts 0 65535 FORMAT "%5.0" SYMBOL_LINK "CPD_V_TNKP_RAT_LO_DIAG_CNTS" 2 /end CHARACTERISTIC
/begin CHARACTERISTIC CPD_V_TNKP_RAT_HI_FL_CNTS "tank press vac rat high fail counts" VALUE 0x0002038C __UWORD_S 0 u_cnts 0 65535 FORMAT "%5.0" /end CHARACTERISTIC
/begin CHARACTERISTIC CPD_V_TNKP_RAT_HI_DIAG_CNTS "tank press vac rat high diag counts" VALUE 0x0002038C __UWORD_S 0 u_cnts 0 65535 FORMAT "%5.0" SYMBOL_LINK "CPD_V_TNKP_RAT_HI_DIAG_CNTS" 2 /end CHARACTERISTIC
/begin CHARACTERISTIC CPD_V_CRU_AN_FL_CNTS "cruise analog fail counts" VALUE 0x0002038C __UWORD_S 0 u_cnts 0 65535 FORMAT "%5.0" /end CHARACTERISTIC
/begin CHARACTERISTIC CPD_V_CRU_AN_DIAG_CNTS "cruise analog diag counts" VALUE 0x0002038C __UWORD_S 0 u_cnts 0 65535 FORMAT "%5.0" /end CHARACTERISTIC
/begin CHARACTERISTIC CPD_V_CRU_ONOFF_NOIS_FL_CNTS "cruise onoff noise fail counts" VALUE 0x0002038C __UWORD_S 0 u_cnts 0 65535 FORMAT "%5.0" /end CHARACTERISTIC
/begin CHARACTERISTIC CPD_V_CRU_ONOFF_NOIS_PS_DUR "cruise onoff noise pass duration" VALUE 0x0002038C __UWORD_S 0 u_2x_tmr 0 1023.984375 FORMAT "%5.3" /end CHARACTERISTIC
/begin CHARACTERISTIC CPD_V_CRU_CANCL_NOIS_FL_CNTS "cruise cancel noise fail counts" VALUE 0x0002038C __UWORD_S 0 u_cnts 0 65535 FORMAT "%5.0" /end CHARACTERISTIC
/begin CHARACTERISTIC CPD_V_CRU_CANCL_NOIS_PS_DUR "cruise cancel noise pass duration" VALUE 0x0002038C __UWORD_S 0 u_2x_tmr 0 1023.984375 FORMAT "%5.3" /end CHARACTERISTIC
/begin CHARACTERISTIC CPD_V_CRU_RES_NOIS_FL_CNTS "cruise resume noise fail counts" VALUE 0x0002038C __UWORD_S 0 u_cnts 0 65535 FORMAT "%5.0" /end CHARACTERISTIC
/begin CHARACTERISTIC CPD_V_CRU_RES_NOIS_PS_DUR "cruise resume noise pass duration" VALUE 0x0002038C __UWORD_S 0 u_2x_tmr 0 1023.984375 FORMAT "%5.3" /end CHARACTERISTIC
/begin CHARACTERISTIC CPD_V_CRU_SET_NOIS_FL_CNTS "cruise set noise fail counts" VALUE 0x0002038C __UWORD_S 0 u_cnts 0 65535 FORMAT "%5.0" /end CHARACTERISTIC
/begin CHARACTERISTIC CPD_V_CRU_SET_NOIS_PS_DUR "cruise set noise pass duration" VALUE 0x0002038C __UWORD_S 0 u_2x_tmr 0 1023.984375 FORMAT "%5.3" /end CHARACTERISTIC
/begin CHARACTERISTIC CPD_V_CRU_DIS_NOIS_FL_CNTS "cruise distance noise fail counts" VALUE 0x0002038C __UWORD_S 0 u_cnts 0 65535 FORMAT "%5.0" /end CHARACTERISTIC
/begin CHARACTERISTIC CPD_V_CRU_DIS_NOIS_PS_DUR "cruise distance noise pass duration" VALUE 0x0002038C __UWORD_S 0 u_2x_tmr 0 1023.984375 FORMAT "%5.3" /end CHARACTERISTIC
/begin CHARACTERISTIC CPD_V_CRU_VSL_NOIS_FL_CNTS "vehicle speed limit noise fail counts" VALUE 0x0002038C __UWORD_S 0 u_cnts 0 65535 FORMAT "%5.0" /end CHARACTERISTIC
/begin CHARACTERISTIC CPD_V_CRU_VSL_NOIS_PS_DUR "vehicle speed limit noise pass duration" VALUE 0x0002038C __UWORD_S 0 u_2x_tmr 0 1023.984375 FORMAT "%5.3" /end CHARACTERISTIC
/begin CHARACTERISTIC CPD_V_CRU_ONOFF_STCK_FL_DUR "cruise onoff stuck fail duration" VALUE 0x27F60 __UWORD_S 0 u_16x_tmr 0 8191.875 /end CHARACTERISTIC
/begin CHARACTERISTIC CPD_V_CRU_ONOFF_STCK_DIAG_DUR "cruise onoff stuck diag duration" VALUE 0x27F60 __UWORD_S 0 u_16x_tmr 0 8191.875 /end CHARACTERISTIC
/begin CHARACTERISTIC CPD_V_CRU_CANCL_STCK_FL_DUR "cruise cancel stuck fail duration" VALUE 0x27F60 __UWORD_S 0 u_16x_tmr 0 8191.875 /end CHARACTERISTIC
/begin CHARACTERISTIC CPD_V_CRU_CANCL_STCK_DIAG_DUR "cruise cancel stuck diag duration" VALUE 0x27F60 __UWORD_S 0 u_16x_tmr 0 8191.875 /end CHARACTERISTIC
/begin CHARACTERISTIC CPD_V_CRU_RES_STCK_FL_DUR "cruise resume stuck fail duration" VALUE 0x27F60 __UWORD_S 0 u_16x_tmr 0 8191.875 /end CHARACTERISTIC
/begin CHARACTERISTIC CPD_V_CRU_RES_STCK_DIAG_DUR "cruise resume stuck diag duration" VALUE 0x27F60 __UWORD_S 0 u_16x_tmr 0 8191.875 /end CHARACTERISTIC
/begin CHARACTERISTIC CPD_V_CRU_SET_STCK_FL_DUR "cruise set stuck fail duration" VALUE 0x27F60 __UWORD_S 0 u_16x_tmr 0 8191.875 /end CHARACTERISTIC
/begin CHARACTERISTIC CPD_V_CRU_SET_STCK_DIAG_DUR "cruise set stuck diag duration" VALUE 0x27F60 __UWORD_S 0 u_16x_tmr 0 8191.875 /end CHARACTERISTIC
/begin CHARACTERISTIC CPD_V_CRU_DIS_STCK_FL_DUR "cruise distance stuck fail duration" VALUE 0x27F60 __UWORD_S 0 u_16x_tmr 0 8191.875 /end CHARACTERISTIC
/begin CHARACTERISTIC CPD_V_CRU_DIS_STCK_DIAG_DUR "cruise distance stuck diag duration" VALUE 0x27F60 __UWORD_S 0 u_16x_tmr 0 8191.875 /end CHARACTERISTIC
/begin CHARACTERISTIC CPD_V_CRU_VSL_STCK_FL_DUR "cruise vehicle speed limit stuck fail duration" VALUE 0x27F60 __UWORD_S 0 u_16x_tmr 0 8191.875 /end CHARACTERISTIC
/begin CHARACTERISTIC CPD_V_CRU_VSL_STCK_DIAG_DUR "cruise vehicle speed limit stuck diag duration" VALUE 0x27F60 __UWORD_S 0 u_16x_tmr 0 8191.875 /end CHARACTERISTIC
/begin CHARACTERISTIC CPD_V_FLV_MAP_DLT "fuel level map stable delta" VALUE 0x3421E __UWORD_S 0 u_kPa_0_256 0 255.99609375 /end CHARACTERISTIC
/begin CHARACTERISTIC CPD_V_FLV_ESPD_DLT "fuel level engine speed delta" VALUE 0x3567E __UWORD_S 0 u_espd 0 8191.875000 FORMAT "%6.2" /end CHARACTERISTIC
/begin CHARACTERISTIC CPD_V_FLV_VSPD_HI "fuel level high vehicle speed" VALUE 0x35220 __UWORD_S 0 u_vspd 0 511.9921875 FORMAT "%4.1" /end CHARACTERISTIC
/begin CHARACTERISTIC CPD_V_FLV_TPS_HI "fuel level tps high" VALUE 0x34C5A __UWORD_S 0 u_pct 0.0 199.996948 /end CHARACTERISTIC
/begin CHARACTERISTIC CPD_V_FLV_RNG_HI "fuel level high range" VALUE 0x34C54 __UWORD_S 0 u_pct_1 0 99.9984741210937 FORMAT "%5.3" /end CHARACTERISTIC
/begin CHARACTERISTIC CPD_V_FLV_RNG_LO "fuel level low range" VALUE 0x34C54 __UWORD_S 0 u_pct_1 0 99.9984741210937 FORMAT "%5.3" /end CHARACTERISTIC
/begin CHARACTERISTIC CPD_V_FLV_STCK_HI_DLT "fuel level stuck fail delta when range high" VALUE 0x0002038C __UWORD_S 0 u_pct_1 0 99.9984741210937 FORMAT "%4.2" /end CHARACTERISTIC
/begin CHARACTERISTIC CPD_V_FLV_STCK_LO_DLT "fuel level stuck fail delta when range low" VALUE 0x0002038C __UWORD_S 0 u_pct_1 0 99.9984741210937 FORMAT "%4.2" /end CHARACTERISTIC
/begin CHARACTERISTIC CPD_V_FLV_STCK_HI_FC "fuel level stuck check fuel consumption when range high" VALUE 0x0002038C __ULONG_S 0 u_fc 0 67108863.984375 /end CHARACTERISTIC
/begin CHARACTERISTIC CPD_V_FLV_STCK_LO_FC "fuel level stuck check fuel consumption when range low" VALUE 0x0002038C __ULONG_S 0 u_fc 0 67108863.984375 /end CHARACTERISTIC
/*--------------GPF IO-------------------------*/
/begin COMPU_METHOD u_ad_volt "ad voltage" RAT_FUNC "%6.4" "V" COEFFS 0.0 1.0 0.000000 0.0 0.0 0.0000762939453125 /end COMPU_METHOD
/begin COMPU_METHOD u_volt_32 "voltage" RAT_FUNC "%6.4" "V" COEFFS 0.0 1.0 0.000000 0.0 0.0 0.00048828125 /end COMPU_METHOD
/begin COMPU_METHOD u_kPa_0_256 "press" RAT_FUNC "%5.2" "kPa" COEFFS 0.0 1.0 0.000000 0.0 0.0 0.00390625 /end COMPU_METHOD
/begin COMPU_METHOD u_kPa_0_32768 "press" RAT_FUNC "%6.1" "kPa" COEFFS 0.0 1.0 0.000000 0.0 0.0 0.5 /end COMPU_METHOD
/begin COMPU_METHOD u_kPa_8n_8p "press" RAT_FUNC "%6.5" "kPa" COEFFS 0.0 1.0 0.000000 0.0 0.0 0.000244140625 /end COMPU_METHOD
/begin COMPU_METHOD u_deg_C "degC" RAT_FUNC "%5.2" "¡æ" COEFFS 0.0 1.0 0.0 0.0 0.0 0.0078125 /end COMPU_METHOD
/begin COMPU_METHOD u_filter "filter" RAT_FUNC "%11.10" "coef" COEFFS 0.0 1.0 0.0 0.0 0.0 0.0000152587890625 /end COMPU_METHOD
/begin COMPU_METHOD u_cnts "counts" RAT_FUNC "%3.0" "cnts" COEFFS 0.0 1.0 0.0 0.0 0.0 1.0 /end COMPU_METHOD
/begin COMPU_METHOD u_cnts_hi "counts" RAT_FUNC "%3.0" "cnts" COEFFS 0.0 1.0 0.0 0.0 0.0 0.5 /end COMPU_METHOD
/begin COMPU_METHOD u_min "min timer" RAT_FUNC "%5.0" "min" COEFFS 0.0 1.0 0.0 0.0 0.0 1.00 /end COMPU_METHOD
/begin COMPU_METHOD u_1x_tmr "7.81 timer" RAT_FUNC "%4.3" "s" COEFFS 0.0 1.0 0.0 0.0 0.0 0.0078125 /end COMPU_METHOD
/begin COMPU_METHOD u_2x_tmr "15.6 timer" RAT_FUNC "%6.2" "s" COEFFS 0.0 1.0 0.0 0.0 0.0 0.015625 /end COMPU_METHOD
/begin COMPU_METHOD u_16x_tmr "125 timer" RAT_FUNC "%5.1" "s" COEFFS 0.0 1.0 0.0 0.0 0.0 0.125 /end COMPU_METHOD
/begin COMPU_METHOD u_1s_tmr "1 sec timer" RAT_FUNC "%5.0" "s" COEFFS 0.0 1.0 0.0 0.0 0.0 1.0 /end COMPU_METHOD
/begin COMPU_METHOD u_500m_tmr "500ms timer" RAT_FUNC "%5.0" "s" COEFFS 0.0 1.0 0.0 0.0 0.0 0.5 /end COMPU_METHOD
/begin COMPU_METHOD b_true "" TAB_VERB "%6.3" "" COMPU_TAB_REF b_true /end COMPU_METHOD
/begin COMPU_VTAB b_true "" TAB_VERB 2 0 "FALSE" 1 "TRUE" /end COMPU_VTAB
/begin COMPU_METHOD u_espd "engine speed" RAT_FUNC "%5.2" "rpm" COEFFS 0.0 1.0 0.000000 0.0 0.0 0.125 /end COMPU_METHOD
/begin COMPU_METHOD u_vspd "vehicle speed" RAT_FUNC "%5.2" "kph" COEFFS 0.0 1.0 0.000000 0.0 0.0 0.0078125 /end COMPU_METHOD
/begin COMPU_METHOD u_pct "percentage" RAT_FUNC "%5.2" "%" COEFFS 0.0 1.0 0.000000 0.0 0.0 0.0030517578125 /end COMPU_METHOD
/begin COMPU_METHOD u_pct_1 "percentage" RAT_FUNC "%5.2" "%" COEFFS 0.0 1.0 0.000000 0.0 0.0 0.00152587890625 /end COMPU_METHOD
/begin COMPU_METHOD u_pct_s "percentage" RAT_FUNC "%5.2" "%" COEFFS 0.0 1.0 0.000000 0.0 0.0 0.006103515625 /end COMPU_METHOD
/begin COMPU_METHOD u_pct_r "real pct" RAT_FUNC "%5.2" "%" COEFFS 0.0 1.0 0.000000 0.0 0.0 0.001953125 /end COMPU_METHOD
/begin COMPU_METHOD u_g_per_sec "g per second" RAT_FUNC "%5.2" "g/s" COEFFS 0.0 1.0 0.000000 0.0 0.0 0.0078125 /end COMPU_METHOD
/begin COMPU_METHOD u_kPa_0_4096 "IMEP" RAT_FUNC "%6.2" "kPa" COEFFS 0.0 1.0 0.000000 0.0 0.0 0.0625 /end COMPU_METHOD
/begin COMPU_METHOD u_cam_ang_hi "cam angle high res" RAT_FUNC "%4.2" "Deg" COEFFS 0.0 1.0 0.000000 0.0 0.0 0.0009765625 /end COMPU_METHOD
/begin COMPU_METHOD u_freq_256 "freq" RAT_FUNC "%6.1" "Hz" COEFFS 0.0 1.0 0.000000 0.0 0.0 0.00390625 /end COMPU_METHOD
/begin COMPU_METHOD u_rpt_st "" TAB_VERB "%5.0" "" COMPU_TAB_REF u_rpt_st /end COMPU_METHOD
/begin COMPU_VTAB u_rpt_st "" TAB_VERB 3 0 "NO_REPORT" 1 "PASS" 2 "FAIL" /end COMPU_VTAB
/begin COMPU_METHOD u_flv_shrt_st "" TAB_VERB "%5.0" "" COMPU_TAB_REF u_flv_shrt_st /end COMPU_METHOD
/begin COMPU_VTAB u_flv_shrt_st "" TAB_VERB 4 0 "NO_DLY" 1 "INIT" 2 "INC" 3 "DEC" /end COMPU_VTAB
/begin COMPU_METHOD u_acc "accelaration" RAT_FUNC "%4.2" "kph/s" COEFFS 0.0 1.0 0.000000 0.0 0.0 0.001953125 /end COMPU_METHOD
/begin COMPU_METHOD u_press_snsr "" TAB_VERB "%6.3" "" COMPU_TAB_REF u_press_snsr /end COMPU_METHOD
/begin COMPU_VTAB u_press_snsr "" TAB_VERB 3 0 "AMP" 1 "BOOST_P" 2 "MAP" /end COMPU_VTAB
/begin COMPU_VTAB u_press_snsr "" TAB_VERB 2 0 "AMP" 1 "MAP" /end COMPU_VTAB
/begin COMPU_METHOD u_t_snsr "" TAB_VERB "%6.3" "" COMPU_TAB_REF u_t_snsr /end COMPU_METHOD
/begin COMPU_VTAB u_t_snsr "" TAB_VERB 3 0 "IAT" 1 "BOOST_T" 2 "UNUSE" /end COMPU_VTAB
/begin COMPU_VTAB u_t_snsr "" TAB_VERB 2 0 "IAT" 1 "UNUSE" /end COMPU_VTAB
/begin COMPU_METHOD u_t_dir "" TAB_VERB "%6.3" "" COMPU_TAB_REF u_t_dir /end COMPU_METHOD
/begin COMPU_VTAB u_t_dir "" TAB_VERB 2 0 "Decrease" 1 "Increase" /end COMPU_VTAB
/begin COMPU_METHOD u_t_cmp_snsr "" TAB_VERB "%6.3" "" COMPU_TAB_REF u_t_cmp_snsr /end COMPU_METHOD
/begin COMPU_VTAB u_t_cmp_snsr "" TAB_VERB 4 0 "IAT" 1 "BOOST_T" 2 "UNUSE" 3 "ECT" /end COMPU_VTAB
/begin COMPU_VTAB u_t_cmp_snsr "" TAB_VERB 3 0 "IAT" 1 "UNUSE" 2 "ECT" /end COMPU_VTAB
/begin COMPU_METHOD u_rr_diag_cfg "" TAB_VERB "%6.3" "" COMPU_TAB_REF u_rr_diag_cfg /end COMPU_METHOD
/begin COMPU_VTAB u_rr_diag_cfg "" TAB_VERB 3 0 "G_OR_ABS_CAN" 1 "G_OR_ABS_PWM" 2 "G_OR_WSS" /end COMPU_VTAB
/begin COMPU_METHOD u_vss_diag_cfg "" TAB_VERB "%6.3" "" COMPU_TAB_REF u_vss_diag_cfg /end COMPU_METHOD
/begin COMPU_VTAB u_vss_diag_cfg "" TAB_VERB 4 0 "UNUSE" 1 "POW_MODE" 2 "DCL_MODE" 3 "POW_AND_DCL" /end COMPU_VTAB
/begin COMPU_METHOD u_tps12 "" TAB_VERB "%10.4" "" COMPU_TAB_REF u_tps12 /end COMPU_METHOD
/begin COMPU_VTAB u_tps12 "" TAB_VERB 2 0 "TPS1" 1 "TPS2" /end COMPU_VTAB
/begin COMPU_METHOD u_hi_lo "" TAB_VERB "%10.4" "" COMPU_TAB_REF u_hi_lo /end COMPU_METHOD
/begin COMPU_VTAB u_hi_lo "" TAB_VERB 2 0 "HI" 1 "LO" /end COMPU_VTAB
/begin COMPU_METHOD u_fc "fuel consumption" RAT_FUNC "%9.1" "uL" COEFFS 0.0 1.0 0.000000 0.0 0.0 0.015625000000000 /end COMPU_METHOD
/begin FUNCTION cpd_analog "analog input diag"
 /begin DEF_CHARACTERISTIC CPD_V_ACP_HI_FL_CNTS CPD_V_ACP_LO_FL_CNTS CPD_V_ACP_DIAG_CNTS CPD_V_ACP_VLT_HI CPD_V_ACP_VLT_LO CPD_V_ACP_EN_BAT_VLT CPD_V_ACT_LO_EN_RUN_MIN CPD_V_ACT_HI_EN_RUN_MIN CPD_V_ACT_HI_FL_CNTS CPD_V_ACT_HI_DIAG_CNTS CPD_V_ACT_LO_FL_CNTS CPD_V_ACT_LO_DIAG_CNTS CPD_V_ACT_VLT_HI CPD_V_ACT_VLT_LO CPD_V_AMP_VLT_HI CPD_V_MAP_VLT_HI CPD_V_AMP_HI_FL_CNTS CPD_V_MAP_HI_FL_CNTS CPD_V_AMP_VLT_LO CPD_V_MAP_VLT_LO CPD_V_AMP_LO_FL_CNTS CPD_V_MAP_LO_FL_CNTS CPD_V_AMP_HI_EN_RUN_MIN CPD_V_MAP_HI_EN_RUN_MIN CPD_C_MAP_HI_TPS_MAX CPD_X_ESPD_C CPD_C_MAP_LO_TPS_MAX CPD_X_ESPD_D CPD_C_COR_P_STRT_CMP_CFG CPD_C_COR_P_STRT_FL_DLT CPD_V_COR_AMP_STRT_FL_CNTS CPD_V_COR_AMP_STRT_DIAG_CNTS CPD_V_COR_MAP_STRT_FL_CNTS CPD_V_COR_MAP_STRT_DIAG_CNTS CPD_V_MAP_RAT_DCL_ESPD_MIN CPD_V_MAP_RAT_DCL_ESPD_MAX CPD_V_MAP_RAT_DCL_ECT_MIN CPD_V_MAP_RAT_DCL_FLW_DLT CPD_V_MAP_RAT_DCL_TPS_MAX CPD_V_MAP_RAT_DCL_VSPD_MIN CPD_V_MAP_RAT_DCL_EN_DLY CPD_V_MAP_RAT_DRV_ESPD_MIN CPD_V_MAP_RAT_DRV_ESPD_MAX CPD_V_MAP_RAT_DRV_ECT_MIN CPD_V_MAP_RAT_DRV_ESPD_DLT CPD_V_MAP_RAT_DRV_MAP_DLT CPD_V_MAP_RAT_DRV_FLW_DLT CPD_V_MAP_RAT_DRV_INTK_VVT_DLT CPD_V_MAP_RAT_DRV_EXH_VVT_DLT CPD_V_MAP_RAT_DRV_EN_DLY CPD_M_MAP_RAT_DRV_MAX CPD_M_MAP_RAT_DRV_MIN CPD_V_MAP_RAT_DCL_FL_CNTS CPD_V_MAP_RAT_DCL_DIAG_CNTS CPD_V_MAP_RAT_DRV_LO_FL_CNTS CPD_V_MAP_RAT_DRV_LO_DIAG_CNTS CPD_V_MAP_RAT_DRV_HI_FL_CNTS CPD_V_MAP_RAT_DRV_HI_DIAG_CNTS CPD_C_MAP_RAT_DCL_MAX CPD_V_MAP_RAT_DRV_TPS_DLT CPD_V_COR_P_STRT_OFFT_MIN CPD_V_COR_P_STRT_DLY CPD_V_IAT_HI_EN_VSPD_MAX CPD_V_IAT_HI_EN_FLW_MAX CPD_V_AIRT_HI_EN_ECT CPD_V_IAT_HI_EN_RUN_MIN CPD_V_IAT_HI_EN_OFFT_MIN CPD_V_AIRT_HI_EN_OFFT_ECT CPD_V_IAT_HI_VLT CPD_V_IAT_HI_FL_CNTS CPD_V_IAT_HI_DIAG_CNTS CPD_V_IAT_LO_EN_OFFT_MIN CPD_V_AIRT_LO_EN_RUN_MIN CPD_V_IAT_LO_EN_VSPD_MIN CPD_V_IAT_LO_VLT CPD_V_IAT_LO_FL_CNTS CPD_V_IAT_LO_DIAG_CNTS CPD_V_AIRT_RAT_EN_OFFT_MIN CPD_V_AIRT_RAT_EN_RUN_MAX CPD_V_AIRT_RAT_EN_VSPD_MIN CPD_V_AIRT_RAT_EN_FLW_MIN CPD_M_AIRT_RAT_AMBT_CHG_THR CPD_V_IAT_RAT_EN_DLY CPD_C_AIRT_RAT_CMP_CFG CPD_V_IAT_RAT_LO_EN_ECT CPD_V_IAT_RAT_LO_FL_THR CPD_V_AIRT_RAT_FL_CNTS CPD_V_IAT_RAT_HI_FL_THR CPD_V_FLV_EN_VLT CPD_V_REFUEL_DET_VSPD CPD_V_REFUEL_DET_TANK_VAC CPD_V_REFUEL_DET_DUR CPD_V_REFUEL_DET_THR CPD_V_FLV_LO_VLT CPD_V_FLV_HI_VLT CPD_V_FLV_DLY_ACTV_INC_DLT CPD_V_FLV_DLY_ACTV_DEC_DLT CPD_V_FLV_SHRT_DLY CPD_V_FLV_SHRT_DLY_FIL CPD_V_FLV_SHRT_DLY_VSPD_MIN CPD_V_FLV_SHRT_DLY_VSPD_MAX CPD_V_FLV_LO_FL_CNTS CPD_V_FLV_LO_DIAG_CNTS CPD_V_FLV_HI_FL_CNTS CPD_V_FLV_HI_DIAG_CNTS CPD_V_FLV_FIL CPD_V_FLV_FIL_DLY CPD_V_PS_P_HI_VLT CPD_V_PS_P_LO_VLT CPD_V_PS_P_LO_FL_CNTS CPD_V_PS_P_HI_FL_CNTS CPD_V_PS_P_DIAG_CNTS CPD_V_BP_P_HI_VLT CPD_V_BP_P_LO_VLT CPD_V_BP_P_EN_AMP CPD_V_BP_P_EN_RUN CPD_V_BP_P_LO_FL_CNTS CPD_V_BP_P_HI_FL_CNTS CPD_V_BP_P_LO_DIAG_CNTS CPD_V_BP_P_HI_DIAG_CNTS ECSD_V_ECT_SHRT_LO_VLT ECSD_V_ECT_SHRT_HI_VLT CPD_V_G_SNSR_LO_VLT CPD_V_G_SNSR_HI_VLT CPD_V_G_SNSR_LO_FL_CNTS CPD_V_G_SNSR_HI_FL_CNTS CPD_V_G_SNSR_DIAG_CNTS CPD_V_RR_CFG CPD_V_BAT_VLT_HI CPD_V_BAT_VLT_HI_FL_CNTS CPD_V_BAT_VLT_HI_DIAG_CNTS ECSD_V_ECT_SHRT_EN_RUN_MIN ECSD_V_ECT_SHRT_EN_SOAK_MIN ECSD_V_ECT_SHRT_HI_EN_IAT_MIN CPD_M_TPS_DFLT_POS_THR CPD_V_TPS_DFLT_ECT_THR CPD_V_TPS_DFLT_RCH_TM_CLD CPD_V_TPS_DFLT_RCH_TM CPD_V_TPS_DFLT_INC_STP CPD_V_TPS_DFLT_DEC_STP CPD_V_TPS_DFLT_FL_CNTS_MAX CPD_V_TPS_DFLT_FL_CNTS CPD_V_TPS_DFLT_DIAG_CNTS CPD_V_TPS1_PCT_HI CPD_V_TPS1_PCT_LO CPD_V_TPS2_PCT_HI CPD_V_TPS2_PCT_LO CPD_V_TPS_PCT_INC_CNTS CPD_V_TPS_PCT_DEC_CNTS CPD_V_TPS_PCT_FL_CNTS CPD_V_TPS_PCT_DIAG_CNTS CPD_V_TPS_COR_DLY_ECT_MIN CPD_V_TPS_COR_STL_THR CPD_C_TPS_COR_NOISE_THR CPD_C_TPS_COR_NORM_THR CPD_V_TPS_COR_STL_FL_THR CPD_C_TPS_COR_NOISE_FL_THR CPD_C_TPS_COR_NORM_FL_THR CPD_V_TPS_COR_INC_CNTS CPD_V_TPS_COR_DEC_CNTS CPD_V_TPS_COR_DIAG_CNTS CPD_V_TPS_COR_FL_CNTS_MAX CPD_V_PPS1_PCT_HI CPD_V_PPS1_PCT_LO CPD_V_PPS2_PCT_HI CPD_V_PPS2_PCT_LO CPD_V_PPS_PCT_INC_CNTS CPD_V_PPS_PCT_DEC_CNTS CPD_V_PPS_PCT_FL_CNTS CPD_V_PPS_PCT_DIAG_CNTS CPD_V_PPS_COR_ZERO_FL_THR CPD_C_PPS_COR_RUN_FL_THR CPD_V_PPS_COR_STL_FL_THR CPD_V_PPS_COR_INC_CNTS CPD_V_PPS_COR_DEC_CNTS CPD_V_PPS_COR_FL_CNTS CPD_V_PPS_COR_DIAG_CNTS CPD_V_PPS_COR_STL_FL_CNTS CPD_V_PPS1_PCT_LO_R CPD_V_PPS1_PCT_HI_R CPD_V_PPS2_PCT_LO_R CPD_V_PPS2_PCT_HI_R CPD_V_PPS_PCT_INC_CNTS_R CPD_V_PPS_PCT_DEC_CNTS_R CPD_V_PPS_PCT_FL_CNTS_R CPD_V_PPS_PCT_DIAG_CNTS_R CPD_V_TPS_COR_ZERO_FL_THR CPD_V_PPS_COR_INC_CNTS_R CPD_V_PPS_COR_DEC_CNTS_R CPD_V_PPS_COR_FL_CNTS_R CPD_V_PPS_COR_DIAG_CNTS_R CPD_V_PPS_COR_ZERO_FL_THR_R CPD_V_PPS_COR_STL_FL_THR_R CPD_C_PPS_COR_RUN_FL_THR_R CPD_V_PPS_COR_STL_FL_CNTS_R CPD_C_KNK_EN_IMEP_MIN CPD_V_KNK_SNSR_EN_ESPD CPD_V_KNK_SYS_EN_ESPD CPD_V_KNK_SYS_FL_VLT_MIN CPD_V_KNK_SYS_FL_VLT_MAX CPD_V_KNK_SYS_LO_FL_CNTS CPD_V_KNK_SYS_HI_FL_CNTS CPD_V_KNK_SYS_DIAG_CNTS CPD_C_KNK_SNSR_FL_INT_FL_MIN CPD_V_KNK_SNSR_FL_CNTS CPD_V_KNK_SNSR_DIAG_CNTS CPD_V_KNK_SNSR_INT_FIL CPD_V_KNK_SYS_AD_FIL CPD_V_AMP_HI_DIAG_CNTS CPD_V_MAP_HI_DIAG_CNTS CPD_V_AMP_LO_DIAG_CNTS CPD_V_MAP_LO_DIAG_CNTS CPD_V_TNKP_LO_VLT CPD_V_TNKP_HI_VLT CPD_V_TNKP_DIAG_CNTS CPD_V_TNKP_LO_FL_CNTS CPD_V_TNKP_HI_FL_CNTS CPD_V_TNKP_RAT_OFFT_MIN CPD_V_TNKP_RAT_FIL CPD_V_TNKP_RAT_VAC_LO CPD_V_TNKP_RAT_LO_FL_CNTS CPD_V_TNKP_RAT_LO_DIAG_CNTS CPD_V_TNKP_RAT_VAC_HI CPD_V_TNKP_RAT_HI_FL_CNTS CPD_V_TNKP_RAT_HI_DIAG_CNTS CPD_V_CRU_AN_FL_CNTS CPD_V_CRU_AN_DIAG_CNTS CPD_V_CRU_ONOFF_NOIS_FL_CNTS CPD_V_CRU_ONOFF_NOIS_PS_DUR CPD_V_CRU_CANCL_NOIS_FL_CNTS CPD_V_CRU_CANCL_NOIS_PS_DUR CPD_V_CRU_RES_NOIS_FL_CNTS CPD_V_CRU_RES_NOIS_PS_DUR CPD_V_CRU_SET_NOIS_FL_CNTS CPD_V_CRU_SET_NOIS_PS_DUR CPD_V_CRU_DIS_NOIS_FL_CNTS CPD_V_CRU_DIS_NOIS_PS_DUR CPD_V_CRU_VSL_NOIS_FL_CNTS CPD_V_CRU_VSL_NOIS_PS_DUR CPD_V_CRU_ONOFF_STCK_FL_DUR CPD_V_CRU_ONOFF_STCK_DIAG_DUR CPD_V_CRU_CANCL_STCK_FL_DUR CPD_V_CRU_CANCL_STCK_DIAG_DUR CPD_V_CRU_RES_STCK_FL_DUR CPD_V_CRU_RES_STCK_DIAG_DUR CPD_V_CRU_SET_STCK_FL_DUR CPD_V_CRU_SET_STCK_DIAG_DUR CPD_V_CRU_DIS_STCK_FL_DUR CPD_V_CRU_DIS_STCK_DIAG_DUR CPD_V_CRU_VSL_STCK_FL_DUR CPD_V_CRU_VSL_STCK_DIAG_DUR CPD_V_FLV_MAP_DLT CPD_V_FLV_ESPD_DLT CPD_V_FLV_VSPD_HI CPD_V_FLV_TPS_HI CPD_V_FLV_RNG_HI CPD_V_FLV_RNG_LO CPD_V_FLV_STCK_HI_DLT CPD_V_FLV_STCK_LO_DLT CPD_V_FLV_STCK_HI_FC CPD_V_FLV_STCK_LO_FC CPD_V_BSTP_VLT_HI CPD_V_BSTP_HI_FL_CNTS CPD_V_BSTP_VLT_LO CPD_V_BSTP_LO_FL_CNTS CPD_V_BSTP_HI_EN_RUN_MIN CPD_C_BSTP_HI_TPS_MAX CPD_X_ESPD_A CPD_C_BSTP_LO_TPS_MIN CPD_X_ESPD_B CPD_V_COR_BSTP_STRT_FL_CNTS CPD_V_COR_BSTP_STRT_DIAG_CNTS CPD_V_BSTT_HI_EN_VSPD_MAX CPD_V_BSTT_HI_EN_FLW_MAX CPD_V_BSTT_HI_EN_RUN_MIN CPD_V_BSTT_HI_EN_OFFT_MIN CPD_V_BSTT_HI_VLT CPD_V_BSTT_HI_FL_CNTS CPD_V_BSTT_HI_DIAG_CNTS CPD_V_BSTT_LO_EN_OFFT_MIN CPD_V_BSTT_LO_EN_VSPD_MIN CPD_V_BSTT_LO_VLT CPD_V_BSTT_LO_FL_CNTS CPD_V_BSTT_LO_DIAG_CNTS CPD_V_BSTT_RAT_EN_DLY CPD_V_BSTT_RAT_LO_EN_ECT CPD_V_BSTT_RAT_LO_FL_THR CPD_V_BSTT_RAT_HI_FL_THR CPD_V_BSTP_HI_DIAG_CNTS CPD_V_BSTP_LO_DIAG_CNTS CPD_V_EGRP_SHRT_EN_VLT_LO CPD_V_EGRP_SHRT_EN_VLT_HI CPD_V_EGRP_SHRT_LO_THR CPD_V_EGRP_SHRT_HI_THR CPD_V_EGRP_SHRT_LO_FL_TM CPD_V_EGRP_SHRT_HI_FL_TM CPD_V_EGR_POS_ZERO_FIL CPD_V_EGR_POS_ZERO_DLY CPD_V_EGR_POS_INIT_LOG_DUR CPD_V_EGR_POS_INIT_LOG_PPS_HI CPD_V_EGR_POS_INIT_LOG_PPS_LO CPD_V_EGR_POS_INIT_MAX CPD_V_EGR_POS_INIT_MIN CPD_V_EGR_ZERO_FL_DLT CPD_V_EGR_ZERO_FL_CNTS CPD_V_EGR_ZERO_DIAG_CNTS CPD_V_EGR_CLS_EN_IAT_MIN CPD_V_EGR_CLS_PRE_OPN_MIN CPD_V_EGR_CLS_PRE_OPN_DUR CPD_V_EGR_CLS_POS_DLT CPD_V_EGR_CLS_FL_LOG_CNTS CPD_V_EGR_CLS_FL_CNTS CPD_V_EGR_CLS_PS_CNTS CPD_V_EGR_CRK_VLT_MIN CPD_V_EGR_CRK_VLT_MAX CPD_V_EGR_CRK_FL_MIN CPD_V_EGR_CRK_FL_DUR CPD_V_MAP_RAT_DRV_EGR_DLT /end DEF_CHARACTERISTIC
 /begin OUT_MEASUREMENT cpd_iat_hi_fl_cnt cpd_iat_hi_diag_cnt cpd_iat_hi_diag_en cpd_iat_hi_fl_met cpd_iat_hi_fn cpd_iat_hi_fl cpd_iat_hi_rpt_st cpd_iat_lo_fl_cnt cpd_iat_lo_diag_cnt cpd_iat_lo_diag_en cpd_iat_lo_fl_met cpd_iat_lo_fn cpd_iat_lo_fl cpd_iat_lo_rpt_st cpd_map_hi_fl_cnt cpd_map_hi_diag_cnt cpd_map_hi_diag_en cpd_map_hi_fl_met cpd_map_hi_fn cpd_map_hi_fl cpd_map_hi_rpt_st cpd_map_lo_fl_cnt cpd_map_lo_diag_cnt cpd_map_lo_diag_en cpd_map_lo_fl_met cpd_map_lo_fn cpd_map_lo_fl cpd_map_lo_rpt_st cpd_map_rat_hi_fl_cnt cpd_map_rat_hi_diag_cnt cpd_map_rat_hi_diag_en cpd_map_rat_hi_fl_met cpd_map_rat_hi_fn cpd_map_rat_hi_fl cpd_map_rat_hi_rpt_st cpd_map_rat_lo_fl_cnt cpd_map_rat_lo_diag_cnt cpd_map_rat_lo_diag_en cpd_map_rat_lo_fl_met cpd_map_rat_lo_fn cpd_map_rat_lo_fl cpd_map_rat_lo_rpt_st cpd_map_rat_dcl_fl_cnt cpd_map_rat_dcl_diag_cnt cpd_map_rat_dcl_diag_en cpd_map_rat_dcl_fl_met cpd_map_rat_dcl_fn cpd_map_rat_dcl_fl cpd_map_rat_dcl_rpt_st cpd_tps1_perf_fl_met cpd_tps1_perf_fl cpd_tps2_perf_fl_met cpd_tps2_perf_fl cpd_tps1_vlt_fl_met cpd_tps1_vlt_fl cpd_tps2_vlt_fl_met cpd_tps2_vlt_fl cpd_amp_hi_fl_cnt cpd_amp_hi_diag_cnt cpd_amp_hi_diag_en cpd_amp_hi_fl_met cpd_amp_hi_fn cpd_amp_hi_fl cpd_amp_hi_rpt_st cpd_amp_lo_fl_cnt cpd_amp_lo_diag_cnt cpd_amp_lo_diag_en cpd_amp_lo_fl_met cpd_amp_lo_fn cpd_amp_lo_fl cpd_amp_lo_rpt_st cpd_strt_cor_p_dly cpd_amp_shrt_met cpd_map_shrt_met cpd_amp_strt_cor_fl_cnt cpd_amp_strt_cor_diag_cnt cpd_amp_strt_cor_diag_en cpd_amp_strt_cor_fl_met cpd_amp_strt_cor_fn cpd_amp_strt_cor_fl cpd_amp_strt_cor_rpt_st cpd_map_tps_comn_met cpd_map_tps_stbl_comn cpd_map_rat_dec_stbl_met cpd_map_tps_dec_dly cpd_map_rat_drv_stbl_met cpd_map_tps_drv_dly cpd_tnkp_shrt_en cpd_tnkp_lo_fl_met cpd_tnkp_hi_fl_met cpd_tnkp_hi_fl_cnts cpd_tnkp_lo_fl_cnts cpd_tnkp_diag_cnts cpd_tnkp_shrt_fn cpd_tnkp_lo_fl cpd_tnkp_hi_fl cpd_tnkp_rat_en cpd_tnkp_rat_vac cpd_tnkp_rat_lo_fl_cnt cpd_tnkp_rat_lo_diag_cnt cpd_tnkp_rat_lo_diag_en cpd_tnkp_rat_lo_fl_met cpd_tnkp_rat_lo_fn cpd_tnkp_rat_lo_fl cpd_tnkp_rat_lo_rpt_st cpd_tnkp_rat_hi_fl_cnt cpd_tnkp_rat_hi_diag_cnt cpd_tnkp_rat_hi_diag_en cpd_tnkp_rat_hi_fl_met cpd_tnkp_rat_hi_fn cpd_tnkp_rat_hi_fl cpd_tnkp_rat_hi_rpt_st cpd_airt_rat_run_tm cpd_airt_rat_cld_strt cpd_airt_rat_keyon_iat cpd_iat_rat_en_dly cpd_iat_rat_en cpd_iat_rat_lo_fl_cnt cpd_iat_rat_lo_fn cpd_iat_rat_lo_fl cpd_iat_rat_hi_fl_cnt cpd_iat_rat_hi_fn cpd_iat_rat_hi_fl cpd_bat_vlt_hi_fl_cnt cpd_bat_vlt_hi_diag_cnt cpd_bat_vlt_hi_diag_en cpd_bat_vlt_hi_fl_met cpd_bat_vlt_hi_fn cpd_bat_vlt_hi_fl cpd_bat_vlt_hi_rpt_st cpd_bat_vlt_lo_fl_cnt cpd_bat_vlt_lo_diag_cnt cpd_bat_vlt_lo_diag_en cpd_bat_vlt_lo_fl_met cpd_bat_vlt_lo_fn cpd_bat_vlt_lo_fl cpd_bat_vlt_lo_rpt_st cpd_pps1_lo_fl_met cpd_pps1_lo_fl cpd_pps2_lo_fl_met cpd_pps2_lo_fl cpd_pps1_hi_fl_met cpd_pps1_hi_fl cpd_pps2_hi_fl_met cpd_pps2_hi_fl cpd_pps1_lo_rpt_st cpd_pps1_lo_diag_cnt cpd_pps1_lo_fl_cnt cpd_pps2_lo_rpt_st cpd_pps2_lo_diag_cnt sys_pps2_lo_fl_cnt cpd_pps1_hi_rpt_st cpd_pps1_hi_diag_cnt cpd_pps1_hi_fl_cnt cpd_pps2_hi_rpt_st cpd_pps2_hi_diag_cnt sys_pps2_hi_fl_cnt cpd_pps_cor_dlt cpd_pps_cor_zero_out cpd_pps_cor_zero_out_r cpd_pps_cor_fl_met_r cpd_pps_cor_fl_r cpd_pps_cor_fl_met cpd_pps_cor_fl cpd_pps_cor_rpt_st_r cpd_pps_cor_diag_cnt_r cpd_pps_cor_fl_cnt_r cpd_pps_cor_rpt_st cpd_pps_cor_diag_cnt cpd_pps_cor_fl_cnt cpd_tps1_hi_fl_met cpd_tps1_hi_fl cpd_tps2_hi_fl_met cpd_tps2_hi_fl cpd_tps1_lo_fl_met cpd_tps1_lo_fl cpd_tps2_lo_fl_met cpd_tps2_lo_fl cpd_tps1_hi_rpt_st cpd_tps1_hi_diag_cnt cpd_tps1_hi_fl_cnt cpd_tps1_lo_rpt_st cpd_tps1_lo_diag_cnt cpd_tps1_lo_fl_cnt cpd_tps2_hi_rpt_st cpd_tps2_hi_diag_cnt cpd_tps2_hi_fl_cnt cpd_tps2_lo_rpt_st cpd_tps2_lo_diag_cnt cpd_tps2_lo_fl_cnt cpd_tps_cor_en cpd_tps_cor_fl_met cpd_tps_cor_fl cpd_tps_cor_rpt_st cpd_tps_cor_diag_cnt cpd_tps_cor_fl_cnt cpd_tps_cor_zero_out cpd_tps_dflt_en cpd_tps_dflt_tmr cpd_tps_dflt_fl cpd_tps_dflt_fl_cnt cpd_tps_dflt_diag_cnt cpd_tps_dflt_fl_met cpd_ac_t_hi_en cpd_ac_t_hi_fl_met cpd_ac_t_hi_fn cpd_ac_t_hi_fl_cnt cpd_ac_t_hi_diag_cnt cpd_ac_t_lo_en cpd_ac_t_lo_fl_met cpd_ac_t_lo_fn cpd_ac_t_lo_fl_cnt cpd_ac_t_lo_diag_cnt cpd_bp_shrt_en cpd_bp_hi_fl_met cpd_bp_lo_fl_met cpd_bp_hi_fl_cnt cpd_bp_hi_diag_cnt cpd_bp_lo_fl_cnt cpd_bp_lo_diag_cnt cpd_bp_hi_fl cpd_bp_hi_fn cpd_bp_lo_fl cpd_bp_lo_fn cpd_cru_en cpd_cru_an_rpt_st cpd_cru_an_fl_met cpd_cru_an_fn cpd_cru_an_fl cpd_cru_an_fl_cnt cpd_cru_an_diag_cnt cpd_cru_onoff_nois_rpt_st cpd_cru_onoff_nois_fl_met cpd_cru_onoff_nois_fl cpd_cru_onoff_nois_ps cpd_cru_onoff_nois_fn cpd_cru_onoff_nois_fl_cnt cpd_cru_onoff_noise_ps_tmr cpd_cru_cancel_noise_ps_tmr cpd_cru_res_noise_ps_tmr cpd_cru_set_noise_ps_tmr cpd_cru_vsl_noise_ps_tmr cpd_cru_dis_noise_ps_tmr cpd_cru_cancl_nois_rpt_st cpd_cru_cancl_nois_fl_met cpd_cru_cancl_nois_fl cpd_cru_cancl_nois_ps cpd_cru_cancl_nois_fn cpd_cru_cancl_nois_fl_cnt cpd_cru_res_nois_rpt_st cpd_cru_res_nois_fl_met cpd_cru_res_nois_fl cpd_cru_res_nois_ps cpd_cru_res_nois_fn cpd_cru_res_nois_fl_cnt cpd_cru_set_nois_rpt_st cpd_cru_set_nois_fl_met cpd_cru_set_nois_fl cpd_cru_set_nois_ps cpd_cru_set_nois_fn cpd_cru_set_nois_fl_cnt cpd_cru_dis_nois_rpt_st cpd_cru_dis_nois_fl_met cpd_cru_dis_nois_fl cpd_cru_dis_nois_ps cpd_cru_dis_nois_fn cpd_cru_dis_nois_fl_cnt cpd_cru_vsl_nois_rpt_st cpd_cru_vsl_nois_fl_met cpd_cru_vsl_nois_fl cpd_cru_vsl_nois_ps cpd_cru_vsl_nois_fn cpd_cru_vsl_nois_fl_cnt cpd_cru_onoff_stck_diag_tmr cpd_cru_onoff_stck_fl_tmr cpd_cru_cancl_stck_diag_tmr cpd_cru_cancl_stck_fl_tmr cpd_cru_res_stck_diag_tmr cpd_cru_res_stck_fl_tmr cpd_cru_set_stck_diag_tmr cpd_cru_set_stck_fl_tmr cpd_cru_vsl_stck_diag_tmr cpd_cru_vsl_stck_fl_tmr cpd_cru_vsl_stck_fl_tmr cpd_cru_dis_stck_diag_tmr cpd_cru_dis_stck_fl_tmr cpd_cru_onoff_stck_rpt_st cpd_cru_onoff_stck_fl_met cpd_cru_onoff_stck_fl cpd_cru_onoff_stck_fn cpd_cru_cancl_stck_rpt_st cpd_cru_cancl_stck_fl_met cpd_cru_cancl_stck_fl cpd_cru_cancl_stck_fn cpd_cru_res_stck_rpt_st cpd_cru_res_stck_fl_met cpd_cru_res_stck_fl cpd_cru_res_stck_fn cpd_cru_set_stck_rpt_st cpd_cru_set_stck_fl_met cpd_cru_set_stck_fl cpd_cru_set_stck_fn cpd_cru_dis_stck_rpt_st cpd_cru_dis_stck_fl_met cpd_cru_dis_stck_fl cpd_cru_dis_stck_fn cpd_cru_vsl_stck_rpt_st cpd_cru_vsl_stck_fl_met cpd_cru_vsl_stck_fl cpd_cru_vsl_stck_fn cpd_flv_dis_fl_actv cpd_flv_comn_met cpd_flv_slosh_rst_dly cpd_flv_refuel_dly cpd_flv_flt_dly cpd_flv_mmv cpd_flv_dlt cpd_flv_refuel_actv cpd_flv_slosh_met cpd_flv_rng_lo cpd_flv_rng_hi2lo cpd_flv_shrt_dly cpd_flv_shrt_mmv cpd_flv_shrt_strt cpd_flv_shrt_st cpd_flv_lo_fl_cnt cpd_flv_lo_diag_cnt cpd_flv_lo_diag_en cpd_flv_lo_fl_met cpd_flv_lo_fn cpd_flv_lo_fl cpd_flv_lo_rpt_st cpd_flv_hi_fl_cnt cpd_flv_hi_diag_cnt cpd_flv_hi_diag_en cpd_flv_hi_fl_met cpd_flv_hi_fn cpd_flv_hi_fl cpd_flv_hi_rpt_st cpd_flv_stck_fl_met cpd_flv_stck_en cpd_flv_stck_ps_met cpd_flv_stck_fn cpd_flv_stck_fl cpd_flv_stck_fl_thr cpd_flv_fc cpd_flv_max cpd_flv_min cpd_bstt_hi_fl_cnt cpd_bstt_hi_diag_cnt cpd_bstt_hi_diag_en cpd_bstt_hi_fl_met cpd_bstt_hi_fn cpd_bstt_hi_fl cpd_bstt_hi_rpt_st cpd_bstt_lo_fl_cnt cpd_bstt_lo_diag_cnt cpd_bstt_lo_diag_en cpd_bstt_lo_fl_met cpd_bstt_lo_fn cpd_bstt_lo_fl cpd_bstt_lo_rpt_st cpd_bstp_hi_fl_cnt cpd_bstp_hi_diag_cnt cpd_bstp_hi_diag_en cpd_bstp_hi_fl_met cpd_bstp_hi_fn cpd_bstp_hi_fl cpd_bstp_hi_rpt_st cpd_bstp_lo_fl_cnt cpd_bstp_lo_diag_cnt cpd_bstp_lo_diag_en cpd_bstp_lo_fl_met cpd_bstp_lo_fn cpd_bstp_lo_fl cpd_bstp_lo_rpt_st cpd_bstp_strt_cor_fl_cnt cpd_bstp_strt_cor_diag_cnt cpd_bstp_strt_cor_diag_en cpd_bstp_strt_cor_fl_met cpd_bstp_strt_cor_fn cpd_bstp_strt_cor_fl cpd_bstp_strt_cor_rpt_st cpd_airt_rat_keyon_bstt cpd_bstt_rat_en_dly cpd_bstt_rat_en_dly cpd_bstt_rat_en cpd_bstt_rat_lo_fl_cnt cpd_bstt_rat_lo_fn cpd_bstt_rat_lo_fl cpd_bstt_rat_hi_fl_cnt cpd_bstt_rat_hi_fn cpd_bstt_rat_hi_fl cpd_bstp_shrt_met cpd_egrp_shrt_en cpd_egrp_lo_fl_met cpd_egrp_hi_fl_met cpd_egrp_shrt_lo_tmr cpd_egrp_shrt_hi_tmr cpd_egrp_lo_fl cpd_egrp_hi_fl cpd_egrp_keyon_pos_lrnd cpd_egrp_zero_tstd cpd_egrp_zero_en cpd_egrp_zero_raw cpd_egrp_keyon_pos cpd_egrp_zero_chg_fl_met cpd_egrp_zero_chg_fl_cnt cpd_egrp_zero_chg_diag_cnt /end OUT_MEASUREMENT
/end FUNCTION
/begin FUNCTION cpd_discrete "discrete input diag"
 /begin DEF_CHARACTERISTIC CPD_V_ABS_PWM_FL_CNTS CPD_V_ABS_PWM_DIAG_CNTS CPD_V_ABS_PWM_FREQ_LO CPD_V_ABS_PWM_FREQ_HI CPD_V_ABS_PWM_DTY_LO CPD_V_ABS_PWM_DTY_HI CPD_V_VSPD_PWR_EN_MAP CPD_V_VSPD_PWR_EN_TPS_MIN CPD_V_VSPD_PWR_EN_TPS_MAX CPD_V_VSPD_PWR_EN_TCU_SPD CPD_V_VSPD_PWR_EN_ESPD_MIN CPD_V_VSPD_PWR_EN_ESPD_MAX CPD_V_VSPD_PWR_EN_DLY CPD_V_WSS_PWR_FL_SPD CPD_V_WSS_PWR_FL_CNTS CPD_V_WSS_PWR_DIAG_CNTS CPD_V_VSS_DIAG_CFG CPD_V_VSS_PWR_FL_SPD CPD_V_VSS_PWR_FL_CNTS CPD_V_VSS_PWR_DIAG_CNTS CPD_V_VSPD_DCL_EN_MAP CPD_V_VSPD_DCL_EN_TPS_MAX CPD_V_VSPD_DCL_EN_ESPD_MIN CPD_V_VSPD_DCL_EN_ESPD_MAX CPD_V_VSS_DCL_PASS_SPD CPD_V_VSS_DCL_FL_ESPD_DLT CPD_V_VSS_DCL_FL_CNTS CPD_V_VSS_DCL_DIAG_CNTS CPD_V_VSPD_CAN_FL_CNTS CPD_V_VSPD_CAN_DIAG_CNTS CPD_V_BRKL_EN_VSPD_HI CPD_V_BRKL_EN_VSPD_LO CPD_V_BRKL_EN_DUR_MAX CPD_V_BRKL_ACTV_ACC CPD_V_BRKL_DIAG_DLY CPD_V_BRKL_EXT_DUR CPD_V_BRKL_FL_INC_STP CPD_V_BRKL_FL_DEC_STP CPD_V_BRKL_FL_CNTS_MAX CPD_V_BRKL_FL_CNTS CPD_V_BRKL_DIAG_CNTS CPD_V_BRK_SW_FL_DLY CPD_V_BRK_SW_FL_INC_STP CPD_V_BRK_SW_FL_DEC_STP CPD_V_BRK_SW_FL_CNTS_MAX CPD_V_BRK_SW_FL_CNTS CPD_V_BRK_SW_DIAG_CNTS CPD_V_CAM_OPN_FL_CNTS CPD_V_CAM_RAT_FL_CNTS CPD_V_CAM_RAT_PASS_CNTS CPD_V_BRKL_ON_EXT_DLY CPD_V_CRK_NOIS_FL_CNTS CPD_V_CRK_NOIS_ERR_CNTS CPD_V_CRK_NOIS_DIAG_CNTS CPD_V_CRK_OPN_FL_CNTS CPD_V_CRK_OPN_RST_DLY CPD_V_ALT_EN_RUN_MIN CPD_V_ALT_EN_VLT_MIN CPD_V_ALT_EN_VLT_MAX CPD_V_ALT_EN_ESPD_MIN CPD_V_ALT_EN_ESPD_MAX CPD_C_ALT_PWM_DTY_DSR CPD_V_ALT_PWM_FL_DTY CPD_V_ALT_PWM_STCK_DTY CPD_V_ALT_PWM_STCK_FL_DTY CPD_V_ALT_PWM_STCK_DLY CPD_V_ALT_PWM_FL_CNTS CPD_V_ALT_PWM_DIAG_CNTS CPD_V_ALT_PWM_STCK_DIAG_CNTS CPD_V_ALT_PWM_STCK_FL_CNTS CPD_V_ENS_FL_CNTS CPD_V_ENS_DIAG_CNTS CPD_V_VSPD_EN_ECT_MIN /end DEF_CHARACTERISTIC
 /begin OUT_MEASUREMENT cpd_cam_st cpd_crk_opn_en cpd_crk_opn_fl_met cpd_crk_opn_fl cpd_crk_opn_fn cpd_crk_opn_fl_cnt cpd_crk_opn_rpt_st cpd_crk_tooth_err cpd_crk_perf_fl_met cpd_crk_perf_fn cpd_crk_perf_fl cpd_crk_perf_fl_cnt cpd_crk_perf_diag_cnt cpd_crk_perf_rpt_st cpd_cam_opn_en cpd_cam_stuck cpd_cam_opn_fl_cnt cpd_cam_opn_fl cpd_cam_opn_fn cpd_cam_perf_en cpd_cam_rat_fnd cpd_cam_evnt_cnt cpd_cam_perf_fl_met cpd_cam_perf_fl cpd_cam_perf_fl_cnt cpd_cam_perf_pss_cnt cpd_cam_perf_fn cpd_vspd_pwr_en_dly cpd_vspd_pwr_fl_cnt cpd_vspd_pwr_diag_cnt cpd_vspd_pwr_diag_en cpd_vspd_pwr_fl_met cpd_vspd_pwr_fn cpd_vspd_pwr_fl cpd_vspd_pwr_rpt_st cpd_vspd_dcl_fl_cnt cpd_vspd_dcl_diag_cnt cpd_vspd_dcl_diag_en cpd_vspd_dcl_fl_met cpd_vspd_dcl_fn cpd_vspd_dcl_fl cpd_vspd_dcl_rpt_st cpd_vspd_can_fl_cnt cpd_vspd_can_diag_cnt cpd_vspd_can_diag_en cpd_vspd_can_fl_met cpd_vspd_can_fn cpd_vspd_can_fl cpd_vspd_can_rpt_st cpd_brkl_en_dly cpd_brkl_en cpd_brkl_dcl_dur cpd_brkl_chk_dur cpd_brkl_chgd cpd_brkl_actv cpd_brkl_fl_met cpd_brkl_fl_cnt cpd_brkl_diag_cnt cpd_brkl_fl cpd_brkl_fn cpd_brk_sw_en cpd_brk_sw_fl_met cpd_brk_sw_chk_dly cpd_brk_sw_fl_cnt cpd_brk_sw_diag_cnt cpd_brk_sw_fl cpd_brk_sw_fn /end OUT_MEASUREMENT
/end FUNCTION
/begin RECORD_LAYOUT __UBYTE_S FNC_VALUES 1 UBYTE COLUMN_DIR DIRECT /end RECORD_LAYOUT
/begin RECORD_LAYOUT __UWORD_S FNC_VALUES 1 UWORD COLUMN_DIR DIRECT /end RECORD_LAYOUT
/begin RECORD_LAYOUT __ULONG_S FNC_VALUES 1 ULONG COLUMN_DIR DIRECT /end RECORD_LAYOUT
/begin RECORD_LAYOUT __SWORD_S FNC_VALUES 1 SWORD COLUMN_DIR DIRECT /end RECORD_LAYOUT
/begin RECORD_LAYOUT SSV__UWORD_S AXIS_PTS_X 1 UWORD INDEX_INCR DIRECT /end RECORD_LAYOUT
/end MODULE
/end PROJECT
