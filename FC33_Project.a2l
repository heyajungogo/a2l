ASAP2_VERSION 1 60
/begin PROJECT FC33 ""
/begin HEADER "" VERSION "1.0" /end HEADER
/begin MODULE FC33 ""
/begin MOD_COMMON "" BYTE_ORDER MSB_FIRST ALIGNMENT_LONG 2 ALIGNMENT_WORD 1 /end MOD_COMMON
/begin MEASUREMENT ac_evap_t_dis "ac evap temp disable" UBYTE b_true 0 0 0.00 1.00 BIT_MASK 0x1 ECU_ADDRESS 0x400050DA FORMAT "%1.0" /end MEASUREMENT
/begin MEASUREMENT ac_vspd_hi_dis "ac vehicle speed high disable" UBYTE b_true 0 0 0.00 1.00 BIT_MASK 0x1 ECU_ADDRESS 0x400050DA FORMAT "%1.0" /end MEASUREMENT
/begin MEASUREMENT ac_pps_hi_dis "ac pps high disable" UBYTE b_true 0 0 0.00 1.00 BIT_MASK 0x1 ECU_ADDRESS 0x400050DA FORMAT "%1.0" /end MEASUREMENT
/begin MEASUREMENT ac_hi_pps_actv_vspd "vehicle speed when ac pps high active" UWORD u_vspd 0 0 0.00 511.9921875 ECU_ADDRESS 0x400050DA FORMAT "%4.1" /end MEASUREMENT
/begin MEASUREMENT ac_ps_espd_dis "ac power steer engine speed low disable" UBYTE b_true 0 0 0.00 1.00 BIT_MASK 0x1 ECU_ADDRESS 0x400050DA FORMAT "%1.0" /end MEASUREMENT
/begin MEASUREMENT ac_espd_hi_dis "ac engine speed high disable" UBYTE b_true 0 0 0.00 1.00 BIT_MASK 0x1 ECU_ADDRESS 0x400050DA FORMAT "%1.0" /end MEASUREMENT
/begin MEASUREMENT ac_espd_lo_dis "ac engine speed low disable" UBYTE b_true 0 0 0.00 1.00 BIT_MASK 0x1 ECU_ADDRESS 0x400050DA FORMAT "%1.0" /end MEASUREMENT
/begin MEASUREMENT ac_veh_lnch_dis "ac vehicle launch disable" UBYTE b_true 0 0 0.00 1.00 BIT_MASK 0x1 ECU_ADDRESS 0x400050DA FORMAT "%1.0" /end MEASUREMENT
/begin MEASUREMENT ac_ect_hi_dis "ac ect high disable" UBYTE b_true 0 0 0.00 1.00 BIT_MASK 0x1 ECU_ADDRESS 0x400050DA FORMAT "%1.0" /end MEASUREMENT
/begin MEASUREMENT ac_press_hi_dis "ac press high disable" UBYTE b_true 0 0 0.00 1.00 BIT_MASK 0x1 ECU_ADDRESS 0x400050DA FORMAT "%1.0" /end MEASUREMENT
/begin MEASUREMENT ac_ctrl_hld "ac hold control state" UBYTE b_true 0 0 0.00 1.00 BIT_MASK 0x1 ECU_ADDRESS 0x400050DA FORMAT "%1.0" /end MEASUREMENT
/begin MEASUREMENT ac_dis_conds_not_met "ac hold control state" UBYTE b_true 0 0 0.00 1.00 BIT_MASK 0x1 ECU_ADDRESS 0x400050DA FORMAT "%1.0" /end MEASUREMENT
/begin MEASUREMENT ac_on_conds_met "ac on conditions met" UBYTE b_true 0 0 0.00 1.00 BIT_MASK 0x1 ECU_ADDRESS 0x400050DA FORMAT "%1.0" /end MEASUREMENT
/begin MEASUREMENT ac_ctrl_on "ac on" UBYTE b_true 0 0 0.00 1.00 BIT_MASK 0x1 ECU_ADDRESS 0x400050DA FORMAT "%1.0" /end MEASUREMENT
/begin MEASUREMENT ac_ctrl_chg "ac control change" UBYTE b_true 0 0 0.00 1.00 BIT_MASK 0x1 ECU_ADDRESS 0x400050DA FORMAT "%1.0" /end MEASUREMENT
/begin MEASUREMENT ac_trip_1st_on "ac control change" UBYTE b_true 0 0 0.00 1.00 BIT_MASK 0x1 ECU_ADDRESS 0x400050DA FORMAT "%1.0" /end MEASUREMENT
/begin MEASUREMENT ac_sys_detced "ac system detected" UBYTE b_true 0 0 0.00 1.00 BIT_MASK 0x1 ECU_ADDRESS 0x400050DA FORMAT "%1.0" /end MEASUREMENT
/begin MEASUREMENT ente_ico_offr_tmr "intercooler off run timer" UWORD u_16x_tmr 0 0 0.00 8191.875 ECU_ADDRESS 0x4000440A /end MEASUREMENT
/begin MEASUREMENT ente_exh_t_filt "exhaust temp filted" UWORD u_deg_K 0 0 0.00 2047.96875 ECU_ADDRESS 0x400050DA FORMAT "%5.1" /end MEASUREMENT
/begin MEASUREMENT ente_ico_rad_t "intercooler radiator temperature" SWORD u_deg_C 0 0 -256 255.9921875 ECU_ADDRESS 0x40004EBC /end MEASUREMENT
/begin MEASUREMENT ente_ico_out_t_sp "intercooler outlet temperature" SWORD u_deg_C 0 0 -256 255.9921875 ECU_ADDRESS 0x40004EBC /end MEASUREMENT
/begin MEASUREMENT ente_ico_dty_sp "intercooler duty setpoint" UWORD u_pct 0 0 0.0 100 ECU_ADDRESS 0x4000440A FORMAT "%4.1" /end MEASUREMENT
/begin MEASUREMENT vhsc_cru_vspd_dlt "vehicle speed" SWORD u_vspd 0 0 -256 255.9921875 ECU_ADDRESS 0x4000440A FORMAT "%4.1" /end MEASUREMENT
/begin MEASUREMENT vhsc_cru_lrn_typ "cruise learn type" UBYTE u_cru_lrn_typ 0 0 0.00 255.00 ECU_ADDRESS 0x4000440A FORMAT "%3.0" /end MEASUREMENT
/begin MEASUREMENT mf_eng_load "engine load percent calculated by airflow at diag start event" UWORD u_pct_1 0 0 0 99.9984741210937 ECU_ADDRESS 0x40004EA0 FORMAT "%4.1" /end MEASUREMENT
/begin MEASUREMENT mf_trq_idx "misfire torq mode diag index" ULONG u_cnts 0 0 0 4294967295 ECU_ADDRESS 0x40004EA0 FORMAT "%10.0" /end MEASUREMENT
/begin MEASUREMENT mf_trq_idx_thr "misfire torq mode diag index thr" ULONG u_cnts 0 0 0 4294967295 ECU_ADDRESS 0x40004EA0 FORMAT "%10.0" /end MEASUREMENT
/begin MEASUREMENT mf_eng_cyl "engine run cycle times" UBYTE u_cnts 0 0 0 255 ECU_ADDRESS 0x40004EA0 /end MEASUREMENT
/begin MEASUREMENT mf_acl_dev_max1 "misfire accelerate mode diag devation max" ULONG u_cnts 0 0 0 4294967295 ECU_ADDRESS 0x40004EA0 FORMAT "%10.0" /end MEASUREMENT
/begin MEASUREMENT mf_acl_dev_max2 "misfire accelerate mode diag devation max" ULONG u_cnts 0 0 0 4294967295 ECU_ADDRESS 0x40004EA0 FORMAT "%10.0" /end MEASUREMENT
/begin MEASUREMENT mf_misf_tms "total misfire times" UWORD u_cnts 0 0 0 65535 ECU_ADDRESS 0x40004EA0 FORMAT "%5.0" /end MEASUREMENT
/begin MEASUREMENT mf_acl_idx_thr "misfire accelerate mode diag index thr" ULONG u_cnts 0 0 0 4294967295 ECU_ADDRESS 0x40004EA0 FORMAT "%10.0" /end MEASUREMENT
/begin MEASUREMENT mf_misf_cyl_tms "cylinder misfire times" UBYTE u_cnts 0 0 0 255 ARRAY_SIZE 4 ECU_ADDRESS 0x40004EA0 /end MEASUREMENT
/begin MEASUREMENT mf_acl_tm_dlt "misfire acceleration mode time delta" SLONG u_cnts 0 0 -2147483648 2147483647 ARRAY_SIZE 16 ECU_ADDRESS 0x40004EA0 FORMAT "%10.0" /end MEASUREMENT
/begin MEASUREMENT mf_trq_tm_dlt "misfire torq mode time delta" SLONG u_cnts 0 0 -2147483648 2147483647 ARRAY_SIZE 16 ECU_ADDRESS 0x40004EA0 FORMAT "%10.0" /end MEASUREMENT
/begin MEASUREMENT mf_log_idx "log index" UBYTE u_cnts 0 0 0 255 ECU_ADDRESS 0x40004EA0 /end MEASUREMENT
/begin MEASUREMENT mf_cycle_bg "log cycle begin" UBYTE b_true 0 0 0 1 ECU_ADDRESS 0x40004EA0 FORMAT "%1.0" /end MEASUREMENT
/begin MEASUREMENT mf_trs_pos_tms "positive transient times" UBYTE u_cnts 0 0 0 255 ECU_ADDRESS 0x40004EA0 /end MEASUREMENT
/begin MEASUREMENT mf_trs_neg_tms "negtive transient times" UBYTE u_cnts 0 0 0 255 ECU_ADDRESS 0x40004EA0 /end MEASUREMENT
/begin MEASUREMENT mf_trs_pos_actv "positive transient active" UBYTE b_true 0 0 0 1 ECU_ADDRESS 0x40004EA0 FORMAT "%1.0" /end MEASUREMENT
/begin MEASUREMENT mf_trs_neg_actv "negtive transient active" UBYTE b_true 0 0 0 1 ECU_ADDRESS 0x40004EA0 FORMAT "%1.0" /end MEASUREMENT
/begin MEASUREMENT mf_init_eval_fn "initial eval finish" UBYTE b_true 0 0 0 1 ECU_ADDRESS 0x40004EA0 FORMAT "%1.0" /end MEASUREMENT
/begin MEASUREMENT mf_init_eval_cycle "initial eval engine cycle" UWORD u_cnts 0 0 0 65535 ECU_ADDRESS 0x40004EA0 FORMAT "%5.0" /end MEASUREMENT
/begin MEASUREMENT mf_trq_trs_fac "torq mode transient factor" UWORD u_fac_2 0 0 0 1.999969482421875 ECU_ADDRESS 0x400044FA FORMAT "%5.4" /end MEASUREMENT
/begin MEASUREMENT mf_acl_trs_fac "acl mode transient factor" UWORD u_fac_2 0 0 0 1.999969482421875 ECU_ADDRESS 0x400044FA FORMAT "%5.4" /end MEASUREMENT
/begin MEASUREMENT mf_trq_tcc_fac "torq mode tcc factor" UWORD u_fac_2 0 0 0 1.999969482421875 ECU_ADDRESS 0x400044FA FORMAT "%5.4" /end MEASUREMENT
/begin MEASUREMENT mf_acl_tcc_fac "acl mode tcc factor" UWORD u_fac_2 0 0 0 1.999969482421875 ECU_ADDRESS 0x400044FA FORMAT "%5.4" /end MEASUREMENT
/begin MEASUREMENT mf_trs_fac_dur "transient factor engine cycle duration" UWORD u_cnts 0 0 0 65535 ECU_ADDRESS 0x40004EA0 FORMAT "%5.0" /end MEASUREMENT
/begin MEASUREMENT mf_tcc_fac_dur "tcc factor engine cycle duration" UWORD u_cnts 0 0 0 65535 ECU_ADDRESS 0x40004EA0 FORMAT "%5.0" /end MEASUREMENT
/begin MEASUREMENT mf_fac_rsn "factor active reason" UBYTE u_mf_fac_rsn 0 0 0 255 ECU_ADDRESS 0x40004EA0 FORMAT "%3.0" /end MEASUREMENT
/begin MEASUREMENT mf_trs_actv "transient active" UBYTE b_true 0 0 0 1 ECU_ADDRESS 0x40004EA0 FORMAT "%1.0" /end MEASUREMENT
/begin MEASUREMENT mf_trq_fn_fac "torq mode finial factor" UWORD u_fac_2 0 0 0 1.999969482421875 ECU_ADDRESS 0x400044FA FORMAT "%5.4" /end MEASUREMENT
/begin MEASUREMENT mf_acl_fn_fac "acl mode finial factor" UWORD u_fac_2 0 0 0 1.999969482421875 ECU_ADDRESS 0x400044FA FORMAT "%5.4" /end MEASUREMENT
/begin MEASUREMENT mf_cam_resyn "cam resyn" UBYTE b_true 0 0 0 1 ECU_ADDRESS 0x40004EA0 FORMAT "%1.0" /end MEASUREMENT
/begin MEASUREMENT mf_en_dly "enable delay" UWORD u_cnts 0 0 0 65535 ECU_ADDRESS 0x40004EA0 FORMAT "%5.0" /end MEASUREMENT
/begin MEASUREMENT mf_dly_rsn "delay reason" UBYTE u_mf_dly_rsn 0 0 0 31 ECU_ADDRESS 0x40004EA0 FORMAT "%2.0" /end MEASUREMENT
/begin MEASUREMENT mf_trip_dis_fl "disable fail this trip" UBYTE b_true 0 0 0 1 ECU_ADDRESS 0x40004EA0 FORMAT "%1.0" /end MEASUREMENT
/begin MEASUREMENT mf_actv_dis_fl "disable fail this trip" UBYTE b_true 0 0 0 1 ECU_ADDRESS 0x40004EA0 FORMAT "%1.0" /end MEASUREMENT
/begin MEASUREMENT mf_tcc_unlck_req "misfire tcc unlock request" UBYTE b_true 0 0 0 1 ECU_ADDRESS 0x40004EA0 FORMAT "%1.0" /end MEASUREMENT
/begin MEASUREMENT mf_throt_dlt "throttle position delta" SWORD u_pct 0 0 -100.00 99.9969482421875 ECU_ADDRESS 0x40004EA0 /end MEASUREMENT
/begin MEASUREMENT mf_trq_undetct "torq mode undetected" UBYTE b_true 0 0 0 1 ECU_ADDRESS 0x40004EA0 FORMAT "%1.0" /end MEASUREMENT
/begin MEASUREMENT mf_acl_undetct "acl mode undetected" UBYTE b_true 0 0 0 1 ECU_ADDRESS 0x40004EA0 FORMAT "%1.0" /end MEASUREMENT
/begin MEASUREMENT mf_cam_syn_err "cam syn error" UBYTE b_true 0 0 0 1 ECU_ADDRESS 0x40004EA0 FORMAT "%1.0" /end MEASUREMENT
/begin MEASUREMENT mf_fast_trq_chg "fast torq change" UWORD u_pct 0 0 0 199.996948242187 ARRAY_SIZE 4 ECU_ADDRESS 0x400044FA /end MEASUREMENT
/begin MEASUREMENT mf_trq_actv "misfire torq mode active" UBYTE b_true 0 0 0 1 ECU_ADDRESS 0x40004EA0 FORMAT "%1.0" /end MEASUREMENT
/begin MEASUREMENT mf_acl_actv "misfire acl mode active" UBYTE b_true 0 0 0 1 ECU_ADDRESS 0x40004EA0 FORMAT "%1.0" /end MEASUREMENT
/begin MEASUREMENT mf_opps_acl_met "misfire opposing acl mode met" UBYTE b_true 0 0 0 1 ECU_ADDRESS 0x40004EA0 FORMAT "%1.0" /end MEASUREMENT
/begin MEASUREMENT mf_adj_acl_met "misfire adj acl mode met" UBYTE b_true 0 0 0 1 ECU_ADDRESS 0x40004EA0 FORMAT "%1.0" /end MEASUREMENT
/begin MEASUREMENT mf_strt_thr_fac_actv "start emission fail thr factor active" UBYTE b_true 0 0 0 1 ECU_ADDRESS 0x40004EA0 FORMAT "%1.0" /end MEASUREMENT
/begin MEASUREMENT mf_strt_cycle "start engine cycle" UWORD u_cnts 0 0 0 65535 ECU_ADDRESS 0x40004EA0 FORMAT "%5.0" /end MEASUREMENT
/begin MEASUREMENT mf_cons_misf_cnts "consecutive misfire counts" UBYTE u_cnts 0 0 0 255 ECU_ADDRESS 0x40004EA0 /end MEASUREMENT
/begin MEASUREMENT mf_cons_no_misf_cnts "consecutive misfire counts" UBYTE u_cnts 0 0 0 255 ECU_ADDRESS 0x40004EA0 /end MEASUREMENT
/begin MEASUREMENT mf_misf_det "misfire detected" UBYTE b_true 0 0 0 1 ECU_ADDRESS 0x40004EA0 FORMAT "%1.0" /end MEASUREMENT
/begin MEASUREMENT mf_acl_dev1_det "acl mode dev1 misfire detected" UBYTE b_true 0 0 0 1 ECU_ADDRESS 0x40004EA0 FORMAT "%1.0" /end MEASUREMENT
/begin MEASUREMENT mf_acl_dev2_det "acl mode dev2 misfire detected" UBYTE b_true 0 0 0 1 ECU_ADDRESS 0x40004EA0 FORMAT "%1.0" /end MEASUREMENT
/begin MEASUREMENT mf_adj_acl_actv "misfire adj acl mode active" UBYTE b_true 0 0 0 1 ECU_ADDRESS 0x40004EA0 FORMAT "%1.0" /end MEASUREMENT
/begin MEASUREMENT mf_trq_det "torq mode misfire detected" UBYTE b_true 0 0 0 1 ECU_ADDRESS 0x40004EA0 FORMAT "%1.0" /end MEASUREMENT
/begin MEASUREMENT mf_opps_acl_actv "misfire opposing acl mode met" UBYTE b_true 0 0 0 1 ECU_ADDRESS 0x40004EA0 FORMAT "%1.0" /end MEASUREMENT
/begin MEASUREMENT mf_acl_dev1_id "acl mode dev1 index" UBYTE u_cnts 0 0 0 255 ECU_ADDRESS 0x40004EA0 /end MEASUREMENT
/begin MEASUREMENT mf_acl_dev2_id "acl mode dev2 index" UBYTE u_cnts 0 0 0 255 ECU_ADDRESS 0x40004EA0 /end MEASUREMENT
/begin MEASUREMENT mf_opps_cyl_tms "opposing misfire cylinder times" UBYTE u_cnts 0 0 0 255 ARRAY_SIZE 4 ECU_ADDRESS 0x40004EA0 /end MEASUREMENT
/begin MEASUREMENT mf_opps_acl_det "misfire opposing acl mode detected" UBYTE b_true 0 0 0 1 ECU_ADDRESS 0x40004EA0 FORMAT "%1.0" /end MEASUREMENT
/begin MEASUREMENT mf_adj_cyl_tms "adj misfire cylinder times" UBYTE u_cnts 0 0 0 255 ARRAY_SIZE 4 ECU_ADDRESS 0x40004EA0 /end MEASUREMENT
/begin MEASUREMENT mf_adj_acl_det "misfire adj acl mode detected" UBYTE b_true 0 0 0 1 ECU_ADDRESS 0x40004EA0 FORMAT "%1.0" /end MEASUREMENT
/begin MEASUREMENT mf_opps_misf_det "misfire opposing acl mode detected" UBYTE b_true 0 0 0 1 ECU_ADDRESS 0x40004EA0 FORMAT "%1.0" /end MEASUREMENT
/begin MEASUREMENT mf_adj_misf_det "misfire adj acl mode detected" UBYTE b_true 0 0 0 1 ECU_ADDRESS 0x40004EA0 FORMAT "%1.0" /end MEASUREMENT
/begin MEASUREMENT mf_cat_dmg_tms_thr "cat damage fail misfire times thr" UWORD u_cnts 0 0 0 65535 ECU_ADDRESS 0x40004EA0 FORMAT "%5.0" /end MEASUREMENT
/begin MEASUREMENT mf_emi_dmg_tms_thr "emission damage fail misfire times thr" UWORD u_cnts 0 0 0 65535 ECU_ADDRESS 0x40004EA0 FORMAT "%5.0" /end MEASUREMENT
/begin MEASUREMENT mf_cat_dmg_blk_det "cat damage block misfire detected" UBYTE b_true 0 0 0 1 ECU_ADDRESS 0x40004EA0 FORMAT "%1.0" /end MEASUREMENT
/begin MEASUREMENT mf_emi_dmg_blk_det "emission damage block misfire detected" UBYTE b_true 0 0 0 1 ECU_ADDRESS 0x40004EA0 FORMAT "%1.0" /end MEASUREMENT
/begin MEASUREMENT mf_rr_det "rough road detected" UBYTE b_true 0 0 0 1 ECU_ADDRESS 0x40004EA0 FORMAT "%1.0" /end MEASUREMENT
/begin MEASUREMENT mf_emi_dmg_blk_cnts "emission damage block counts" UBYTE u_cnts 0 0 0 255 ECU_ADDRESS 0x40004EA0 /end MEASUREMENT
/begin MEASUREMENT mf_cat_dmg_blk_cnts "cat damage block counts" UBYTE u_cnts 0 0 0 255 ECU_ADDRESS 0x40004EA0 /end MEASUREMENT
/begin MEASUREMENT mf_emi_dmg_fl "emission damage fail" UBYTE b_true 0 0 0 1 ECU_ADDRESS 0x40004EA0 FORMAT "%1.0" /end MEASUREMENT
/begin MEASUREMENT mf_cat_dmg_fl "cat damage fail" UBYTE b_true 0 0 0 1 ECU_ADDRESS 0x40004EA0 FORMAT "%1.0" /end MEASUREMENT
/begin MEASUREMENT mf_emi_dmg_log_cnts "emission damage block counts" UBYTE u_cnts 0 0 0 255 ECU_ADDRESS 0x40004EA0 /end MEASUREMENT
/begin MEASUREMENT mf_cat_dmg_log_cnts "cat damage block counts" UBYTE u_cnts 0 0 0 255 ECU_ADDRESS 0x40004EA0 /end MEASUREMENT
/begin MEASUREMENT mf_emi_dmg_rpt_st "emission damage report state" UBYTE u_rpt_st 0 0 0.00 2.00 ECU_ADDRESS 0x4000580E /end MEASUREMENT
/begin MEASUREMENT mf_cat_dmg_rpt_st "cat damage report state" UBYTE u_rpt_st 0 0 0.00 2.00 ECU_ADDRESS 0x4000580E /end MEASUREMENT
/begin MEASUREMENT mf_emi_rr_misf_det "emission damage rough road misfire detected" UBYTE b_true 0 0 0 1 ECU_ADDRESS 0x40004EA0 FORMAT "%1.0" /end MEASUREMENT
/begin MEASUREMENT mf_cat_rr_misf_det "cat damage rough road misfire detected" UBYTE b_true 0 0 0 1 ECU_ADDRESS 0x40004EA0 FORMAT "%1.0" /end MEASUREMENT
/begin MEASUREMENT mf_cat_dmg_blk_thr "cat damage fail block counts thr" UWORD u_cnts 0 0 0 65535 ECU_ADDRESS 0x40004EA0 FORMAT "%5.0" /end MEASUREMENT
/begin MEASUREMENT mf_total_emi_misf_tms "all blocks total misfire times" UWORD u_cnts 0 0 0 65535 ARRAY_SIZE 4 ECU_ADDRESS 0x40004EA0 FORMAT "%5.0" /end MEASUREMENT
/begin MEASUREMENT mf_total_cat_misf_tms "all blocks total misfire times" UWORD u_cnts 0 0 0 65535 ARRAY_SIZE 4 ECU_ADDRESS 0x40004EA0 FORMAT "%5.0" /end MEASUREMENT
/begin MEASUREMENT cfd_osc_raw "catalyst osc duration" UWORD u_millisec_65535 0 0 0 65.535 ECU_ADDRESS 0x40004EA0 /end MEASUREMENT
/begin MEASUREMENT cfd_osc "catalyst osc duration" UWORD u_millisec_65535 0 0 0 65.535 ECU_ADDRESS 0x40004EA0 /end MEASUREMENT
/begin MEASUREMENT cfd_air_flw_avg "airflow average" UWORD u_g_per_sec 0 0 0 511.9921875 ECU_ADDRESS 0x40004EA0 /end MEASUREMENT
/begin MEASUREMENT cfd_stg2_uo2_resp_dur "stage2 uo2 response duration" UWORD u_millisec_65535 0 0 0 65.535 ECU_ADDRESS 0x40004EA0 /end MEASUREMENT
/begin MEASUREMENT cfd_diag_typ "diag type" UBYTE u_cfd_diag_typ 0 0 0 2 ECU_ADDRESS 0x40004EA0 FORMAT "%1.0" /end MEASUREMENT
/begin MEASUREMENT cfd_diag_dis_rsn "diag disable reason" UBYTE u_cfd_diag_dis 0 0 0 255 ECU_ADDRESS 0x40004EA0 FORMAT "%1.0" /end MEASUREMENT
/begin MEASUREMENT cfd_eng_stbl "engine stable condition met" UBYTE b_true 0 0 0.00 1.00 BIT_MASK 0x1 ECU_ADDRESS 0x4000440A FORMAT "%1.0" /end MEASUREMENT
/begin MEASUREMENT cfd_diag_try_cnts "diag try times" UBYTE u_cnts 0 0 0 255 ECU_ADDRESS 0x40004EA0 FORMAT "%1.0" /end MEASUREMENT
/begin MEASUREMENT cfd_dis_fault_actv "disable fault active" UBYTE b_true 0 0 0.00 1.00 BIT_MASK 0x1 ECU_ADDRESS 0x4000440A FORMAT "%1.0" /end MEASUREMENT
/begin MEASUREMENT cfd_conds_met "diag conditions met" UBYTE b_true 0 0 0.00 1.00 BIT_MASK 0x1 ECU_ADDRESS 0x4000440A FORMAT "%1.0" /end MEASUREMENT
/begin MEASUREMENT cfd_idl_tm_excd "diag idle time exceed" UBYTE b_true 0 0 0.00 1.00 BIT_MASK 0x1 ECU_ADDRESS 0x4000440A FORMAT "%1.0" /end MEASUREMENT
/begin MEASUREMENT cfd_diag_fn "diag finish" UBYTE b_true 0 0 0.00 1.00 BIT_MASK 0x1 ECU_ADDRESS 0x4000440A FORMAT "%1.0" /end MEASUREMENT
/begin MEASUREMENT cfd_ext_rsn "diag exit reason" UBYTE u_cfd_diag_ext 0 0 0 255 ECU_ADDRESS 0x40004EA0 FORMAT "%1.0" /end MEASUREMENT
/begin MEASUREMENT osd_uo2_pow_ln_diag_cnt "up o2 sensor lean at power state diag counts" UWORD u_cnts 0 0 0 65535 ECU_ADDRESS 0x40004EA0 FORMAT "%5.0" /end MEASUREMENT
/begin MEASUREMENT osd_uo2_pow_ln_fl_cnt "up o2 sensor lean at power state fail counts" UWORD u_cnts 0 0 0 65535 ECU_ADDRESS 0x40004EA0 FORMAT "%5.0" /end MEASUREMENT
/begin MEASUREMENT osd_uo2_pow_ln_en "uo2 lean at power state diag enable" UBYTE b_true 0 0 0.00 1.00 BIT_MASK 0x1 ECU_ADDRESS 0x4000440A FORMAT "%1.0" /end MEASUREMENT
/begin MEASUREMENT osd_uo2_pow_ln_fl_met "uo2 lean at power state fail conds met" UBYTE b_true 0 0 0.00 1.00 BIT_MASK 0x1 ECU_ADDRESS 0x4000440A FORMAT "%1.0" /end MEASUREMENT
/begin MEASUREMENT osd_uo2_pow_ln_fn "uo2 lean at power state diag finish" UBYTE b_true 0 0 0.00 1.00 BIT_MASK 0x1 ECU_ADDRESS 0x4000440A FORMAT "%1.0" /end MEASUREMENT
/begin MEASUREMENT osd_uo2_pow_ln_fl "uo2 lean at power state diag fail" UBYTE b_true 0 0 0.00 1.00 BIT_MASK 0x1 ECU_ADDRESS 0x4000440A FORMAT "%1.0" /end MEASUREMENT
/begin MEASUREMENT osd_uo2_puc_rch_diag_cnt "up o2 sensor rich at puc state diag counts" UWORD u_cnts 0 0 0 65535 ECU_ADDRESS 0x40004EA0 FORMAT "%5.0" /end MEASUREMENT
/begin MEASUREMENT osd_uo2_puc_rch_fl_cnt "up o2 sensor rich at puc state fail counts" UWORD u_cnts 0 0 0 65535 ECU_ADDRESS 0x40004EA0 FORMAT "%5.0" /end MEASUREMENT
/begin MEASUREMENT osd_uo2_puc_rch_en "uo2 rich at puc state state diag enable" UBYTE b_true 0 0 0.00 1.00 BIT_MASK 0x1 ECU_ADDRESS 0x4000440A FORMAT "%1.0" /end MEASUREMENT
/begin MEASUREMENT osd_uo2_puc_rch_fl_met "uo2 rich at puc state state fail conds met" UBYTE b_true 0 0 0.00 1.00 BIT_MASK 0x1 ECU_ADDRESS 0x4000440A FORMAT "%1.0" /end MEASUREMENT
/begin MEASUREMENT osd_uo2_puc_rch_fn "uo2 rich at puc state state diag finish" UBYTE b_true 0 0 0.00 1.00 BIT_MASK 0x1 ECU_ADDRESS 0x4000440A FORMAT "%1.0" /end MEASUREMENT
/begin MEASUREMENT osd_uo2_puc_rch_fl "uo2 rich at puc state state diag fail" UBYTE b_true 0 0 0.00 1.00 BIT_MASK 0x1 ECU_ADDRESS 0x4000440A FORMAT "%1.0" /end MEASUREMENT
/begin MEASUREMENT osd_uo2_vlt "upstream o2 sensor volt filtered" UWORD u_volt_32 0 0 0 31.99951171875 ECU_ADDRESS 0x400050DA FORMAT "%5.2" /end MEASUREMENT
/begin MEASUREMENT osd_uo2_filt_espd "filtered engine speed for uo2 aged diag" UWORD u_espd 0 0 0 8191.875 ECU_ADDRESS 0x400050DA FORMAT "%6.2" /end MEASUREMENT
/begin MEASUREMENT osd_uo2_lo_diag_cnt "up o2 sensor short low diag counts" UWORD u_cnts 0 0 0 65535 ECU_ADDRESS 0x40004EA0 FORMAT "%5.0" /end MEASUREMENT
/begin MEASUREMENT osd_uo2_lo_fl_cnt "up o2 sensor short low fail counts" UWORD u_cnts 0 0 0 65535 ECU_ADDRESS 0x40004EA0 FORMAT "%5.0" /end MEASUREMENT
/begin MEASUREMENT osd_uo2_lo_en "uo2 short low diag enable" UBYTE b_true 0 0 0.00 1.00 BIT_MASK 0x1 ECU_ADDRESS 0x4000440A FORMAT "%1.0" /end MEASUREMENT
/begin MEASUREMENT osd_uo2_lo_fl_met "uo2 short low fail conds met" UBYTE b_true 0 0 0.00 1.00 BIT_MASK 0x1 ECU_ADDRESS 0x4000440A FORMAT "%1.0" /end MEASUREMENT
/begin MEASUREMENT osd_uo2_lo_fn "uo2 short low diag finish" UBYTE b_true 0 0 0.00 1.00 BIT_MASK 0x1 ECU_ADDRESS 0x4000440A FORMAT "%1.0" /end MEASUREMENT
/begin MEASUREMENT osd_uo2_lo_fl "uo2 short low diag fail" UBYTE b_true 0 0 0.00 1.00 BIT_MASK 0x1 ECU_ADDRESS 0x4000440A FORMAT "%1.0" /end MEASUREMENT
/begin MEASUREMENT osd_uo2_hi_diag_cnt "up o2 sensor short high diag counts" UWORD u_cnts 0 0 0 65535 ECU_ADDRESS 0x40004EA0 FORMAT "%5.0" /end MEASUREMENT
/begin MEASUREMENT osd_uo2_hi_fl_cnt "up o2 sensor short high fail counts" UWORD u_cnts 0 0 0 65535 ECU_ADDRESS 0x40004EA0 FORMAT "%5.0" /end MEASUREMENT
/begin MEASUREMENT osd_uo2_hi_en "uo2 short high diag enable" UBYTE b_true 0 0 0.00 1.00 BIT_MASK 0x1 ECU_ADDRESS 0x4000440A FORMAT "%1.0" /end MEASUREMENT
/begin MEASUREMENT osd_uo2_hi_fl_met "uo2 short high fail conds met" UBYTE b_true 0 0 0.00 1.00 BIT_MASK 0x1 ECU_ADDRESS 0x4000440A FORMAT "%1.0" /end MEASUREMENT
/begin MEASUREMENT osd_uo2_hi_fn "uo2 short high diag finish" UBYTE b_true 0 0 0.00 1.00 BIT_MASK 0x1 ECU_ADDRESS 0x4000440A FORMAT "%1.0" /end MEASUREMENT
/begin MEASUREMENT osd_uo2_hi_fl "uo2 short high diag fail" UBYTE b_true 0 0 0.00 1.00 BIT_MASK 0x1 ECU_ADDRESS 0x4000440A FORMAT "%1.0" /end MEASUREMENT
/begin MEASUREMENT osd_uo2_opn_diag_cnt "up o2 sensor open diag counts" UWORD u_cnts 0 0 0 65535 ECU_ADDRESS 0x40004EA0 FORMAT "%5.0" /end MEASUREMENT
/begin MEASUREMENT osd_uo2_opn_fl_cnt "up o2 sensor open fail counts" UWORD u_cnts 0 0 0 65535 ECU_ADDRESS 0x40004EA0 FORMAT "%5.0" /end MEASUREMENT
/begin MEASUREMENT osd_uo2_opn_en "uo2 open diag enable" UBYTE b_true 0 0 0.00 1.00 BIT_MASK 0x1 ECU_ADDRESS 0x4000440A FORMAT "%1.0" /end MEASUREMENT
/begin MEASUREMENT osd_uo2_opn_fl_met "uo2 open fail conds met" UBYTE b_true 0 0 0.00 1.00 BIT_MASK 0x1 ECU_ADDRESS 0x4000440A FORMAT "%1.0" /end MEASUREMENT
/begin MEASUREMENT osd_uo2_opn_fn "uo2 open diag finish" UBYTE b_true 0 0 0.00 1.00 BIT_MASK 0x1 ECU_ADDRESS 0x4000440A FORMAT "%1.0" /end MEASUREMENT
/begin MEASUREMENT osd_uo2_opn_fl "uo2 open diag fail" UBYTE b_true 0 0 0.00 1.00 BIT_MASK 0x1 ECU_ADDRESS 0x4000440A FORMAT "%1.0" /end MEASUREMENT
/begin MEASUREMENT osd_do2_hi_diag_cnt "down o2 sensor short high diag counts" UWORD u_cnts 0 0 0 65535 ECU_ADDRESS 0x40004EA0 FORMAT "%5.0" /end MEASUREMENT
/begin MEASUREMENT osd_do2_hi_fl_cnt "down o2 sensor short high fail counts" UWORD u_cnts 0 0 0 65535 ECU_ADDRESS 0x40004EA0 FORMAT "%5.0" /end MEASUREMENT
/begin MEASUREMENT osd_do2_hi_en "do2 short high diag enable" UBYTE b_true 0 0 0.00 1.00 BIT_MASK 0x1 ECU_ADDRESS 0x4000440A FORMAT "%1.0" /end MEASUREMENT
/begin MEASUREMENT osd_do2_hi_fl_met "do2 short high fail conds met" UBYTE b_true 0 0 0.00 1.00 BIT_MASK 0x1 ECU_ADDRESS 0x4000440A FORMAT "%1.0" /end MEASUREMENT
/begin MEASUREMENT osd_do2_hi_fl "do2 short high diag fail" UBYTE b_true 0 0 0.00 1.00 BIT_MASK 0x1 ECU_ADDRESS 0x4000440A FORMAT "%1.0" /end MEASUREMENT
/begin MEASUREMENT osd_do2_lo_diag_cnt "down o2 sensor short low diag counts" UWORD u_cnts 0 0 0 65535 ECU_ADDRESS 0x40004EA0 FORMAT "%5.0" /end MEASUREMENT
/begin MEASUREMENT osd_do2_lo_fl_cnt "down o2 sensor short low fail counts" UWORD u_cnts 0 0 0 65535 ECU_ADDRESS 0x40004EA0 FORMAT "%5.0" /end MEASUREMENT
/begin MEASUREMENT osd_do2_lo_en "do2 short low diag enable" UBYTE b_true 0 0 0.00 1.00 BIT_MASK 0x1 ECU_ADDRESS 0x4000440A FORMAT "%1.0" /end MEASUREMENT
/begin MEASUREMENT osd_do2_lo_fl_met "do2 short low fail conds met" UBYTE b_true 0 0 0.00 1.00 BIT_MASK 0x1 ECU_ADDRESS 0x4000440A FORMAT "%1.0" /end MEASUREMENT
/begin MEASUREMENT osd_do2_lo_fl "do2 short low diag fail" UBYTE b_true 0 0 0.00 1.00 BIT_MASK 0x1 ECU_ADDRESS 0x4000440A FORMAT "%1.0" /end MEASUREMENT
/begin MEASUREMENT osd_do2_opn_diag_cnt "do2 sensor open diag counts" UWORD u_cnts 0 0 0 65535 ECU_ADDRESS 0x40004EA0 FORMAT "%5.0" /end MEASUREMENT
/begin MEASUREMENT osd_do2_opn_fl_cnt "do2 sensor open fail counts" UWORD u_cnts 0 0 0 65535 ECU_ADDRESS 0x40004EA0 FORMAT "%5.0" /end MEASUREMENT
/begin MEASUREMENT osd_do2_opn_en "do2 open diag enable" UBYTE b_true 0 0 0.00 1.00 BIT_MASK 0x1 ECU_ADDRESS 0x4000440A FORMAT "%1.0" /end MEASUREMENT
/begin MEASUREMENT osd_do2_opn_fl_met "uo2 open fail conds met" UBYTE b_true 0 0 0.00 1.00 BIT_MASK 0x1 ECU_ADDRESS 0x4000440A FORMAT "%1.0" /end MEASUREMENT
/begin MEASUREMENT osd_do2_opn_fn "do2 open diag finish" UBYTE b_true 0 0 0.00 1.00 BIT_MASK 0x1 ECU_ADDRESS 0x4000440A FORMAT "%1.0" /end MEASUREMENT
/begin MEASUREMENT osd_do2_opn_fl "do2 open diag fail" UBYTE b_true 0 0 0.00 1.00 BIT_MASK 0x1 ECU_ADDRESS 0x4000440A FORMAT "%1.0" /end MEASUREMENT
/begin MEASUREMENT osd_do2_pow_ln_diag_cnt "do2 sensor lean at power state diag counts" UWORD u_cnts 0 0 0 65535 ECU_ADDRESS 0x40004EA0 FORMAT "%5.0" /end MEASUREMENT
/begin MEASUREMENT osd_do2_pow_ln_fl_cnt "do2 sensor lean at power state fail counts" UWORD u_cnts 0 0 0 65535 ECU_ADDRESS 0x40004EA0 FORMAT "%5.0" /end MEASUREMENT
/begin MEASUREMENT osd_do2_pow_ln_en "do2 lean at power state diag enable" UBYTE b_true 0 0 0.00 1.00 BIT_MASK 0x1 ECU_ADDRESS 0x4000440A FORMAT "%1.0" /end MEASUREMENT
/begin MEASUREMENT osd_do2_pow_ln_fl_met "do2 lean at power state fail conds met" UBYTE b_true 0 0 0.00 1.00 BIT_MASK 0x1 ECU_ADDRESS 0x4000440A FORMAT "%1.0" /end MEASUREMENT
/begin MEASUREMENT osd_do2_pow_ln_fn "do2 lean at power state diag finish" UBYTE b_true 0 0 0.00 1.00 BIT_MASK 0x1 ECU_ADDRESS 0x4000440A FORMAT "%1.0" /end MEASUREMENT
/begin MEASUREMENT osd_do2_pow_ln_fl "do2 lean at power state diag fail" UBYTE b_true 0 0 0.00 1.00 BIT_MASK 0x1 ECU_ADDRESS 0x4000440A FORMAT "%1.0" /end MEASUREMENT
/begin MEASUREMENT osd_do2_puc_rch_diag_cnt "do2 sensor rich at puc state diag counts" UWORD u_cnts 0 0 0 65535 ECU_ADDRESS 0x40004EA0 FORMAT "%5.0" /end MEASUREMENT
/begin MEASUREMENT osd_do2_puc_rch_fl_cnt "do2 sensor rich at puc state fail counts" UWORD u_cnts 0 0 0 65535 ECU_ADDRESS 0x40004EA0 FORMAT "%5.0" /end MEASUREMENT
/begin MEASUREMENT osd_do2_puc_rch_en "do2 rich at puc state state diag enable" UBYTE b_true 0 0 0.00 1.00 BIT_MASK 0x1 ECU_ADDRESS 0x4000440A FORMAT "%1.0" /end MEASUREMENT
/begin MEASUREMENT osd_do2_puc_rch_fl_met "do2 rich at puc state state fail conds met" UBYTE b_true 0 0 0.00 1.00 BIT_MASK 0x1 ECU_ADDRESS 0x4000440A FORMAT "%1.0" /end MEASUREMENT
/begin MEASUREMENT osd_do2_puc_rch_fn "do2 rich at puc state state diag finish" UBYTE b_true 0 0 0.00 1.00 BIT_MASK 0x1 ECU_ADDRESS 0x4000440A FORMAT "%1.0" /end MEASUREMENT
/begin MEASUREMENT osd_do2_puc_rch_fl "do2 rich at puc state state diag fail" UBYTE b_true 0 0 0.00 1.00 BIT_MASK 0x1 ECU_ADDRESS 0x4000440A FORMAT "%1.0" /end MEASUREMENT
/begin MEASUREMENT osd_aged_en_dly "uo2 aged diag enable delay" UWORD u_1x_tmr 0 0 0 511.9921875 ECU_ADDRESS 0x40004EA0 FORMAT "%5.2" SYMBOL_LINK "osd_aged_tmr" 2 /end MEASUREMENT
/begin MEASUREMENT osd_aged_diag_tm "uo2 aged diag time" UWORD u_1x_tmr 0 0 0 511.9921875 ECU_ADDRESS 0x40004EA0 FORMAT "%5.2" SYMBOL_LINK "osd_aged_tmr" 4 /end MEASUREMENT
/begin MEASUREMENT osd_aged_lr_sw_tms "uo2 aged diag lean to rich switch times" UWORD u_cnts 0 0 0 65535 ECU_ADDRESS 0x40004EA0 FORMAT "%5.0" /end MEASUREMENT
/begin MEASUREMENT osd_aged_rl_sw_tms "uo2 aged diag rich to lean switch times" UWORD u_cnts 0 0 0 65535 ECU_ADDRESS 0x40004EA0 FORMAT "%5.0" SYMBOL_LINK "osd_aged_rl_sw_tms" 2 /end MEASUREMENT
/begin MEASUREMENT osd_aged_lr_tm "uo2 aged diag lean to rich time" UWORD u_1x_tmr 0 0 0 511.9921875 ECU_ADDRESS 0x40004EA0 FORMAT "%5.2" /end MEASUREMENT
/begin MEASUREMENT osd_aged_rl_tm "uo2 aged diag rich to lean time" UWORD u_1x_tmr 0 0 0 511.9921875 ECU_ADDRESS 0x40004EA0 FORMAT "%5.2" SYMBOL_LINK "osd_aged_rl_tm" 2 /end MEASUREMENT
/begin MEASUREMENT osd_aged_lr_sw_tms_nv "uo2 aged diag lean to rich switch times" UWORD u_cnts 0 0 0 65535 ECU_ADDRESS 0x40004EA0 FORMAT "%5.0" /end MEASUREMENT
/begin MEASUREMENT osd_aged_rl_sw_tms_nv "uo2 aged diag rich to lean switch times" UWORD u_cnts 0 0 0 65535 ECU_ADDRESS 0x40004EA0 FORMAT "%5.0" SYMBOL_LINK "osd_aged_rl_sw_tms_nv" 2 /end MEASUREMENT
/begin MEASUREMENT osd_aged_lr_avg_tm_nv "uo2 aged diag lean to rich average time" UWORD u_1x_tmr 0 0 0 511.9921875 ECU_ADDRESS 0x40004EA0 FORMAT "%5.2" /end MEASUREMENT
/begin MEASUREMENT osd_aged_en "aged diag enable" UBYTE b_true 0 0 0.00 1.00 BIT_MASK 0x1 ECU_ADDRESS 0x4000440A FORMAT "%1.0" /end MEASUREMENT
/begin MEASUREMENT osd_aged_dis_rsn "aged disable reason" UBYTE u_osd_dis_rsn 0 0 0 255 ECU_ADDRESS 0x40004EA0 FORMAT "%1.0" /end MEASUREMENT
/begin MEASUREMENT osd_uo2_cld_cnt "counter used to determinate cold status of uo2" UWORD u_cnts 0 0 0.00 65535.00 ECU_ADDRESS 0x4000440A FORMAT "%5.0" /end MEASUREMENT
/begin MEASUREMENT osd_uo2_cld_stat "true means uo2 sensor is considerred cold " UBYTE b_true 0 0 0.00 1.00 BIT_MASK 0x1 ECU_ADDRESS 0x40003F41 FORMAT "%1.0" /end MEASUREMENT
/begin MEASUREMENT osd_uo2_conds_met "true means uo2 sensor diag general conditions met" UBYTE b_true 0 0 0.00 1.00 BIT_MASK 0x1 ECU_ADDRESS 0x40003F41 FORMAT "%1.0" /end MEASUREMENT
/begin MEASUREMENT osd_uo2_pmp_opn_fl_met "true means uo2 with pump current open fail conditions met" UBYTE b_true 0 0 0.00 1.00 BIT_MASK 0x1 ECU_ADDRESS 0x4000440A FORMAT "%1.0" /end MEASUREMENT
/begin MEASUREMENT osd_uo2_pmp_opn_diag_cnt "uo2 sensor with pump current open diag counts" UWORD u_cnts 0 0 0 65535 ECU_ADDRESS 0x40004EA0 FORMAT "%5.0" /end MEASUREMENT
/begin MEASUREMENT osd_uo2_pmp_opn_fl_cnt "uo2 sensor with pump current open fail counts" UWORD u_cnts 0 0 0 65535 ECU_ADDRESS 0x40004EA0 FORMAT "%5.0" /end MEASUREMENT
/begin MEASUREMENT osd_do2_vlt "downstream o2 sensor volt filtered used in OSD" UWORD u_volt_32 0 0 0 31.99951171875 ECU_ADDRESS 0x400050DA FORMAT "%5.2" /end MEASUREMENT
/begin MEASUREMENT osd_do2_cld_cnt "counter used to determinate cold status of do2" UWORD u_cnts 0 0 0.00 65535.00 ECU_ADDRESS 0x4000440A FORMAT "%5.0" /end MEASUREMENT
/begin MEASUREMENT osd_do2_cld_stat "true means do2 sensor is considerred cold " UBYTE b_true 0 0 0.00 1.00 BIT_MASK 0x1 ECU_ADDRESS 0x40003F41 FORMAT "%1.0" /end MEASUREMENT
/begin MEASUREMENT osd_do2_conds_met "true means do2 sensor diag general conditions met" UBYTE b_true 0 0 0.00 1.00 BIT_MASK 0x1 ECU_ADDRESS 0x40003F41 FORMAT "%1.0" /end MEASUREMENT
/begin MEASUREMENT osd_do2_pmp_opn_fl_met "true means do2 with pump current open fail conditions met" UBYTE b_true 0 0 0.00 1.00 BIT_MASK 0x1 ECU_ADDRESS 0x4000440A FORMAT "%1.0" /end MEASUREMENT
/begin MEASUREMENT osd_do2_pmp_opn_diag_cnt "do2 sensor with pump current open diag counts" UWORD u_cnts 0 0 0 65535 ECU_ADDRESS 0x40004EA0 FORMAT "%5.0" /end MEASUREMENT
/begin MEASUREMENT osd_do2_pmp_opn_fl_cnt "do2 sensor with pump current open fail counts" UWORD u_cnts 0 0 0 65535 ECU_ADDRESS 0x40004EA0 FORMAT "%5.0" /end MEASUREMENT
/begin MEASUREMENT osd_aged_rl_avg_tm_nv "uo2 aged diag rich to lean average time" UWORD u_1x_tmr 0 0 0 511.9921875 ECU_ADDRESS 0x40004EA0 FORMAT "%5.2" SYMBOL_LINK "osd_aged_rl_avg_tm_nv" 2 /end MEASUREMENT
/begin MEASUREMENT osd_aged_rat_avg_tm "uo2 aged diag ratio average time" UWORD u_1x_tmr 0 0 0 511.9921875 ECU_ADDRESS 0x40004EA0 FORMAT "%5.2" /end MEASUREMENT
/begin MEASUREMENT osd_aged_avg_rat "uo2 aged diag average ratio" UWORD u_fac_256 0 0 0 255.99609375 ECU_ADDRESS 0x400050DA FORMAT "%6.3" /end MEASUREMENT
/begin MEASUREMENT osd_ht_uo2_curr_fil "uo2 heater current filtered " UWORD u_amp_65 0 0 0 65.535 ECU_ADDRESS 0x400050DA /end MEASUREMENT
/begin MEASUREMENT osd_ht_do2_curr_fil "do2 heater current filtered " UWORD u_amp_65 0 0 0 65.535 ECU_ADDRESS 0x400050DA SYMBOL_LINK "osd_ht_do2_curr_fil" 2 /end MEASUREMENT
/begin MEASUREMENT osd_ht_uo2_curr_conds_met "true means filter counts thr have been reached to enable uo2 heater diag" UBYTE b_true 0 0 0.00 1.00 BIT_MASK 0x1 ECU_ADDRESS 0x400050DA FORMAT "%1.0" /end MEASUREMENT
/begin MEASUREMENT osd_ht_do2_curr_conds_met "true means filter counts thr have been reached to enable do2 heater diag" UBYTE b_true 0 0 0.00 1.00 BIT_MASK 0x1 ECU_ADDRESS 0x400050DA FORMAT "%1.0" SYMBOL_LINK "osd_ht_do2_curr_conds_met" 1 /end MEASUREMENT
/begin MEASUREMENT osd_ht_uo2_curr_en "true means uo2 heater current diag enable" UBYTE b_true 0 0 0.00 1.00 BIT_MASK 0x20 ECU_ADDRESS 0x40004EA0 FORMAT "%5.0" SYMBOL_LINK "osd_ht_uo2_curr_en" 4 /end MEASUREMENT
/begin MEASUREMENT osd_ht_do2_curr_en "true means do2 heater current diag enable" UBYTE b_true 0 0 0.00 1.00 BIT_MASK 0x20 ECU_ADDRESS 0x40004EA0 FORMAT "%5.0" SYMBOL_LINK "osd_ht_do2_curr_en" 10 /end MEASUREMENT
/begin MEASUREMENT osd_ht_uo2_curr_undr_diag_cnt "diag counter of uo2 heater current under diag" UWORD u_cnts 0 0 0 65535 ECU_ADDRESS 0x40004EA0 FORMAT "%5.0" SYMBOL_LINK "osd_ht_uo2_curr_undr_diag_cnt" 2 /end MEASUREMENT
/begin MEASUREMENT osd_ht_do2_curr_undr_diag_cnt "diag counter of do2 heater current under diag" UWORD u_cnts 0 0 0 65535 ECU_ADDRESS 0x40004EA0 FORMAT "%5.0" SYMBOL_LINK "osd_ht_do2_curr_undr_diag_cnt" 8 /end MEASUREMENT
/begin MEASUREMENT osd_ht_uo2_curr_undr_fl_cnt "fail counter of uo2 heater current under diag" UWORD u_cnts 0 0 0 65535 ECU_ADDRESS 0x40004EA0 FORMAT "%5.0" /end MEASUREMENT
/begin MEASUREMENT osd_ht_do2_curr_undr_fl_cnt "fail counter of do2 heater current under diag" UWORD u_cnts 0 0 0 65535 ECU_ADDRESS 0x40004EA0 FORMAT "%5.0" SYMBOL_LINK "osd_ht_do2_curr_undr_fl_cnt" 6 /end MEASUREMENT
/begin MEASUREMENT osd_ht_uo2_curr_undr_fl_met "uo2 heater current under diag fail condition met" UBYTE b_true 0 0 0.00 1.00 BIT_MASK 0x10 ECU_ADDRESS 0x40004EA0 FORMAT "%5.0" SYMBOL_LINK "osd_ht_uo2_curr_undr_fl_met" 4 /end MEASUREMENT
/begin MEASUREMENT osd_ht_do2_curr_undr_fl_met "do2 heater current under diag fail condition met" UBYTE b_true 0 0 0.00 1.00 BIT_MASK 0x10 ECU_ADDRESS 0x40004EA0 FORMAT "%5.0" SYMBOL_LINK "osd_ht_do2_curr_undr_fl_met" 10 /end MEASUREMENT
/begin MEASUREMENT osd_ht_uo2_curr_undr_fn "uo2 heater current under diag finished" UBYTE b_true 0 0 0.00 1.00 BIT_MASK 0x08 ECU_ADDRESS 0x40004EA0 FORMAT "%5.0" SYMBOL_LINK "osd_ht_uo2_curr_undr_fn" 4 /end MEASUREMENT
/begin MEASUREMENT osd_ht_do2_curr_undr_fn "do2 heater current under diag finished" UBYTE b_true 0 0 0.00 1.00 BIT_MASK 0x08 ECU_ADDRESS 0x40004EA0 FORMAT "%5.0" SYMBOL_LINK "osd_ht_do2_curr_undr_fn" 10 /end MEASUREMENT
/begin MEASUREMENT osd_ht_uo2_curr_undr_fl "uo2 heater current under diag failed" UBYTE b_true 0 0 0.00 1.00 BIT_MASK 0x04 ECU_ADDRESS 0x40004EA0 FORMAT "%5.0" SYMBOL_LINK "osd_ht_uo2_curr_undr_fl" 4 /end MEASUREMENT
/begin MEASUREMENT osd_ht_do2_curr_undr_fl "do2 heater current under diag failed" UBYTE b_true 0 0 0.00 1.00 BIT_MASK 0x04 ECU_ADDRESS 0x40004EA0 FORMAT "%5.0" SYMBOL_LINK "osd_ht_do2_curr_undr_fl" 10 /end MEASUREMENT
/begin MEASUREMENT osd_ht_uo2_curr_ovr_diag_cnt "diag counter of uo2 heater current over diag" UWORD u_cnts 0 0 0 65535 ECU_ADDRESS 0x40004EA0 FORMAT "%5.0" SYMBOL_LINK "osd_ht_uo2_curr_ovr_diag_cnt" 2 /end MEASUREMENT
/begin MEASUREMENT osd_ht_do2_curr_ovr_diag_cnt "diag counter of do2 heater current over diag" UWORD u_cnts 0 0 0 65535 ECU_ADDRESS 0x40004EA0 FORMAT "%5.0" SYMBOL_LINK "osd_ht_do2_curr_ovr_diag_cnt" 8 /end MEASUREMENT
/begin MEASUREMENT osd_ht_uo2_curr_ovr_fl_cnt "fail counter of uo2 heater current over diag" UWORD u_cnts 0 0 0 65535 ECU_ADDRESS 0x40004EA0 FORMAT "%5.0" /end MEASUREMENT
/begin MEASUREMENT osd_ht_do2_curr_ovr_fl_cnt "fail counter of do2 heater current over diag" UWORD u_cnts 0 0 0 65535 ECU_ADDRESS 0x40004EA0 FORMAT "%5.0" SYMBOL_LINK "osd_ht_do2_curr_ovr_fl_cnt" 6 /end MEASUREMENT
/begin MEASUREMENT osd_ht_uo2_curr_ovr_fl_met "uo2 heater current over diag fail condition met" UBYTE b_true 0 0 0.00 1.00 BIT_MASK 0x10 ECU_ADDRESS 0x40004EA0 FORMAT "%5.0" SYMBOL_LINK "osd_ht_uo2_curr_ovr_fl_met" 4 /end MEASUREMENT
/begin MEASUREMENT osd_ht_do2_curr_ovr_fl_met "do2 heater current over diag fail condition met" UBYTE b_true 0 0 0.00 1.00 BIT_MASK 0x10 ECU_ADDRESS 0x40004EA0 FORMAT "%5.0" SYMBOL_LINK "osd_ht_do2_curr_ovr_fl_met" 10 /end MEASUREMENT
/begin MEASUREMENT osd_ht_uo2_curr_ovr_fn "uo2 heater current over diag finished" UBYTE b_true 0 0 0.00 1.00 BIT_MASK 0x08 ECU_ADDRESS 0x40004EA0 FORMAT "%5.0" SYMBOL_LINK "osd_ht_uo2_curr_ovr_fn" 4 /end MEASUREMENT
/begin MEASUREMENT osd_ht_do2_curr_ovr_fn "do2 heater current over diag finished" UBYTE b_true 0 0 0.00 1.00 BIT_MASK 0x08 ECU_ADDRESS 0x40004EA0 FORMAT "%5.0" SYMBOL_LINK "osd_ht_do2_curr_ovr_fn" 10 /end MEASUREMENT
/begin MEASUREMENT osd_ht_uo2_curr_ovr_fl "uo2 heater current over diag failed" UBYTE b_true 0 0 0.00 1.00 BIT_MASK 0x04 ECU_ADDRESS 0x40004EA0 FORMAT "%5.0" SYMBOL_LINK "osd_ht_uo2_curr_ovr_fl" 4 /end MEASUREMENT
/begin MEASUREMENT osd_ht_do2_curr_ovr_fl "do2 heater current over diag failed" UBYTE b_true 0 0 0.00 1.00 BIT_MASK 0x04 ECU_ADDRESS 0x40004EA0 FORMAT "%5.0" SYMBOL_LINK "osd_ht_do2_curr_ovr_fl" 10 /end MEASUREMENT
/begin MEASUREMENT osd_rsp_puc_en "true means do2 sensor PUC response diag enabled" UBYTE b_true 0 0 0.00 1.00 BIT_MASK 0x1 ECU_ADDRESS 0x40003F41 FORMAT "%1.0" /end MEASUREMENT
/begin MEASUREMENT osd_rsp_puc_rst "true means do2 sensor PUC response diag reset due to do2 volt increase" UBYTE b_true 0 0 0.00 1.00 BIT_MASK 0x1 ECU_ADDRESS 0x40003F41 FORMAT "%1.0" /end MEASUREMENT
/begin MEASUREMENT osd_rsp_puc_tm "filtered response time of do2 sensor PUC response diag" UWORD u_tmr_8 0 0 0.0 7.9998779296875 ECU_ADDRESS 0x4000DA4E /end MEASUREMENT
/begin MEASUREMENT osd_rsp_puc_tm_raw "raw response time of last do2 sensor PUC response diag" UWORD u_1x_tmr 0 0 0.0 511.9921875 ECU_ADDRESS 0x4000DA4E FORMAT "%6.3" /end MEASUREMENT
/begin MEASUREMENT osd_rsp_puc_fn "do2 sensor PUC response diag finished" UBYTE b_true 0 0 0.00 1.00 BIT_MASK 0x1 ECU_ADDRESS 0x40003F41 FORMAT "%1.0" /end MEASUREMENT
/begin MEASUREMENT osd_rsp_puc_fl "do2 sensor PUC response diag failed" UBYTE b_true 0 0 0.00 1.00 BIT_MASK 0x1 ECU_ADDRESS 0x40003F41 FORMAT "%1.0" /end MEASUREMENT
/begin MEASUREMENT osd_rsp_pow_en "true means do2 sensor POW response diag enabled" UBYTE b_true 0 0 0.00 1.00 BIT_MASK 0x1 ECU_ADDRESS 0x40003F41 FORMAT "%1.0" /end MEASUREMENT
/begin MEASUREMENT osd_rsp_pow_rst "true means do2 sensor POW response diag reset due to do2 volt decrease" UBYTE b_true 0 0 0.00 1.00 BIT_MASK 0x1 ECU_ADDRESS 0x40003F41 FORMAT "%1.0" /end MEASUREMENT
/begin MEASUREMENT osd_rsp_pow_tm "filtered response time of do2 sensor POW response diag" UWORD u_tmr_8 0 0 0.0 7.9998779296875 ECU_ADDRESS 0x4000DA4E /end MEASUREMENT
/begin MEASUREMENT tel_eol_actv "TRUE means EOL tooth error learn is active" UBYTE b_true 0 0 0.00 1.00 BIT_MASK 0x1 ECU_ADDRESS 0x400050DA FORMAT "%1.0" /end MEASUREMENT
/begin MEASUREMENT tel_fco_req "true means fuel cut off is requested by tooth error learn" UBYTE b_true 0 0 0.00 1.00 BIT_MASK 0x1 ECU_ADDRESS 0x400050DA FORMAT "%1.0" /end MEASUREMENT
/begin MEASUREMENT tel_fac_avl "tooth error learn factor available" UBYTE b_true 0 0 0.00 1.00 BIT_MASK 0x1 ECU_ADDRESS 0x400050DA FORMAT "%1.0" /end MEASUREMENT
/begin MEASUREMENT tel_dis_rsn "tooth error learn disable reason" UBYTE u_tel_dis_rsn 0 0 0.00 20.00 ECU_ADDRESS 0x400050DA FORMAT "%1.0" /end MEASUREMENT
/begin MEASUREMENT tel_trip_lrnd "tooth error learned this trip" UBYTE b_true 0 0 0.00 1.00 BIT_MASK 0x1 ECU_ADDRESS 0x400050DA FORMAT "%1.0" /end MEASUREMENT
/begin MEASUREMENT tel_eol_trip_lrnd "tooth error learned this trip by eol" UBYTE b_true 0 0 0.00 1.00 BIT_MASK 0x1 ECU_ADDRESS 0x400050DA FORMAT "%1.0" /end MEASUREMENT
/begin MEASUREMENT tel_drv_stbl_met "drive learn stable conditions met" UBYTE b_true 0 0 0.00 1.00 BIT_MASK 0x1 ECU_ADDRESS 0x400050DA FORMAT "%1.0" /end MEASUREMENT
/begin MEASUREMENT tel_eol_lrn_tms "eol learn times" UBYTE u_cnts 0 0 0.00 255.00 ECU_ADDRESS 0x400050DA FORMAT "%1.0" /end MEASUREMENT
/begin MEASUREMENT tel_eol_lrn_ext "eol learn exit" UBYTE b_true 0 0 0.00 1.00 BIT_MASK 0x1 ECU_ADDRESS 0x400050DA FORMAT "%1.0" /end MEASUREMENT
/begin MEASUREMENT tel_eol_fac_fl "eol tooth error learned fail" UBYTE b_true 0 0 0.00 1.00 BIT_MASK 0x1 ECU_ADDRESS 0x400050DA FORMAT "%1.0" /end MEASUREMENT
/begin MEASUREMENT tel_lrn_en "tooth error learn enable" UBYTE b_true 0 0 0.00 1.00 BIT_MASK 0x1 ECU_ADDRESS 0x400050DA FORMAT "%1.0" /end MEASUREMENT
/begin MEASUREMENT tel_drv_stbl_dly "drive mode stable delay" UWORD u_16x_tmr 0 0 0 8191.875 ECU_ADDRESS 0x4000DD76 /end MEASUREMENT
/begin MEASUREMENT tel_log_tms "tooth learn log times" UBYTE u_cnts 0 0 0.00 255.00 ECU_ADDRESS 0x400050DA FORMAT "%1.0" /end MEASUREMENT
/begin MEASUREMENT tel_acc_unstbl "acc unstable condition met" UBYTE b_true 0 0 0.00 1.00 BIT_MASK 0x1 ECU_ADDRESS 0x400050DA FORMAT "%1.0" /end MEASUREMENT
/begin MEASUREMENT tel_fac_raw "tooth factor raw" UWORD u_fac_2 0 0 0.0 1.999969482421875 ARRAY_SIZE 4 ECU_ADDRESS 0x40003EA0 FORMAT "%16.15" /end MEASUREMENT
/begin MEASUREMENT tel_opps_fac_dlt_hi "opposing factor delta high" UBYTE b_true 0 0 0.00 1.00 BIT_MASK 0x1 ECU_ADDRESS 0x400050DA FORMAT "%1.0" /end MEASUREMENT
/begin MEASUREMENT tel_fac_opps_avg "tooth factor opposing average" UWORD u_fac_2 0 0 0.0 1.999969482421875 ARRAY_SIZE 4 ECU_ADDRESS 0x40003EA0 FORMAT "%16.15" /end MEASUREMENT
/begin MEASUREMENT tel_fac_avg "tooth factor average" UWORD u_fac_2 0 0 0.0 1.999969482421875 ARRAY_SIZE 4 ECU_ADDRESS 0x40003EA0 FORMAT "%16.15" /end MEASUREMENT
/begin MEASUREMENT tel_fac_sum "tooth factor average" ULONG u_fac_2 0 0 0.0 131072 ARRAY_SIZE 4 ECU_ADDRESS 0x40003EA0 FORMAT "%16.15" /end MEASUREMENT
/begin MEASUREMENT tel_fac_mmv_req "factor mmv request" UBYTE b_true 0 0 0.00 1.00 BIT_MASK 0x1 ECU_ADDRESS 0x400050DA FORMAT "%1.0" /end MEASUREMENT
/begin MEASUREMENT tel_fac_dlt_sum "tooth factor average" SLONG u_fac_2 0 0 -65536.0 65535 ECU_ADDRESS 0x40003EA0 FORMAT "%16.15" /end MEASUREMENT
/begin MEASUREMENT tel_fac_raw_avl "factor available" UBYTE b_true 0 0 0.00 1.00 BIT_MASK 0x1 ECU_ADDRESS 0x400050DA FORMAT "%1.0" /end MEASUREMENT
/begin MEASUREMENT tel_fac_mmv "tooth factor mmv" UWORD u_fac_2 0 0 0.0 1.999969482421875 ARRAY_SIZE 4 ECU_ADDRESS 0x40003EA0 FORMAT "%16.15" /end MEASUREMENT
/begin MEASUREMENT tel_fac_mmv_dlt_sum "tooth factor average" SLONG u_fac_2 0 0 -65536.0 65535 ECU_ADDRESS 0x40003EA0 FORMAT "%16.15" /end MEASUREMENT
/begin MEASUREMENT tel_lrn_fn "factor learn finish" UBYTE b_true 0 0 0.00 1.00 BIT_MASK 0x1 ECU_ADDRESS 0x400050DA FORMAT "%1.0" /end MEASUREMENT
/begin MEASUREMENT tel_lrn_fl "factor learn fail" UBYTE b_true 0 0 0.00 1.00 BIT_MASK 0x1 ECU_ADDRESS 0x400050DA FORMAT "%1.0" /end MEASUREMENT
/begin MEASUREMENT tel_strt_odo "start locked odometer" UWORD u_km 0 0 0.0 65535 ECU_ADDRESS 0x4000DA4E /end MEASUREMENT
/begin MEASUREMENT tel_log_prd_fl_cnts "log fail period counts" UWORD u_cnts 0 0 0.0 65535 ECU_ADDRESS 0x4000DA4E FORMAT "%5.0" /end MEASUREMENT
/begin CHARACTERISTIC ENTE_V_EXH_T_DEC_FIL "exhaust temp decrease filter" VALUE 0x2886C __UWORD_S 0 u_filter 0 0.9999847412109375 FORMAT "%10.9" /end CHARACTERISTIC
/begin CHARACTERISTIC ENTE_V_EXH_T_INC_FIL "exhaust temp increase filter" VALUE 0x2886C __UWORD_S 0 u_filter 0 0.9999847412109375 FORMAT "%10.9" /end CHARACTERISTIC
/begin CHARACTERISTIC ENTE_V_ICO_DTY_SP_DEC_FIL "intercooler pump speed decrease filter" VALUE 0x2886C __UWORD_S 0 u_filter 0 0.9999847412109375 FORMAT "%10.9" /end CHARACTERISTIC
/begin CHARACTERISTIC ENTE_V_ICO_DTY_SP_INC_FIL "intercooler pump duty decrease filter" VALUE 0x2886C __UWORD_S 0 u_filter 0 0.9999847412109375 FORMAT "%10.9" /end CHARACTERISTIC
/begin CHARACTERISTIC ENTE_V_ICO_T_FIL "intercooler outlet temp filter" VALUE 0x2886C __UWORD_S 0 u_filter 0 0.9999847412109375 FORMAT "%10.9" /end CHARACTERISTIC
/begin CHARACTERISTIC ENTE_M_ICO_T_SP "intercooler outlet temp setpoint,IMEP break point based on ENTE_M_IMEP_AXIS" MAP 0x00020320 __SWORD_S 0 u_deg_C -256.0 255.9921875 FORMAT "%4.1" SYMBOL_LINK "ENTE_M_ICO_T_SP" 4
 /begin AXIS_DESCR COM_AXIS sys_amb_t u_deg_C 6 -256.0 255.9921875 AXIS_PTS_REF ENTE_X_AMB_T /end AXIS_DESCR
 /begin AXIS_DESCR FIX_AXIS NO_INPUT_QUANTITY u_cnts 6 0 5 /begin FIX_AXIS_PAR_LIST 0 1 2 3 4 5 /end FIX_AXIS_PAR_LIST /end AXIS_DESCR
/end CHARACTERISTIC
/begin AXIS_PTS ENTE_X_AMB_T "" 0x0002006C sys_amb_t SSV__SWORD_S 0 u_deg_C 6 -256.0 255.9921875 DEPOSIT ABSOLUTE SYMBOL_LINK "ENTE_X_AMB_T" 2 /end AXIS_PTS
/begin CHARACTERISTIC ENTE_M_ICO_IMEP_AXIS "intercooler outlet temp setpoint IMEP break point" MAP 0x00020320 __UWORD_S 0 u_kPa_0_4096 0 4095.9375 FORMAT "%5.1" SYMBOL_LINK "ENTE_M_ICO_IMEP_AXIS" 4
 /begin AXIS_DESCR COM_AXIS sys_eng_spd u_espd 9 0 8191.875 AXIS_PTS_REF ENTE_X_ESPD_A /end AXIS_DESCR
 /begin AXIS_DESCR FIX_AXIS NO_INPUT_QUANTITY u_cnts 6 0 5 /begin FIX_AXIS_PAR_LIST 0 1 2 3 4 5 /end FIX_AXIS_PAR_LIST /end AXIS_DESCR
/end CHARACTERISTIC
/begin AXIS_PTS ENTE_X_ESPD_A "" 0x0002006C sys_eng_spd SSV__UWORD_S 0 u_espd 9 0 8191.875 FORMAT "%5.1" DEPOSIT ABSOLUTE SYMBOL_LINK "ENTE_X_ESPD_A" 2 /end AXIS_PTS
/begin CHARACTERISTIC ENTE_C_ICO_RAD_DTY_FAC "intercooler radiator temp pump speed heat transfer factor" CURVE 0x000200B0 __UWORD_S 0 u_fac_2 0 1.999969482421875 FORMAT "%4.3" SYMBOL_LINK "ENTE_C_ICO_RAD_DTY_FAC" 2
 /begin AXIS_DESCR COM_AXIS ente_ico_dty_sp u_pct 6 0 199.996948 AXIS_PTS_REF ENTE_X_PUMP_DTY /end AXIS_DESCR
/end CHARACTERISTIC
/begin AXIS_PTS ENTE_X_PUMP_DTY "pump duty break point" 0x0002006C ente_ico_dty_sp SSV__UWORD_S 0 u_pct 6 0 199.996948 DEPOSIT ABSOLUTE SYMBOL_LINK "ENTE_X_PUMP_DTY" 2 /end AXIS_PTS
/begin CHARACTERISTIC ENTE_C_ICO_RAD_VSPD_FAC "intercooler radiator temp vehicle speed heat transfer factor" CURVE 0x000200B0 __UWORD_S 0 u_fac_2 0 1.999969482421875 FORMAT "%4.3" SYMBOL_LINK "ENTE_C_ICO_RAD_VSPD_FAC" 2
 /begin AXIS_DESCR COM_AXIS sys_veh_spd u_vspd 6 0.000000 511.992188 AXIS_PTS_REF ENTE_X_VSPD_A /end AXIS_DESCR
/end CHARACTERISTIC
/begin AXIS_PTS ENTE_X_VSPD_A "vehicle speed break point" 0x0002006C sys_veh_spd SSV__UWORD_S 0 u_vspd 6 0.000000 511.992188 DEPOSIT ABSOLUTE SYMBOL_LINK "ENTE_X_VSPD_A" 2 /end AXIS_PTS
/begin CHARACTERISTIC ENTE_M_ICO_DTY_BS "intercooler pump speed control base" MAP 0x00020320 __UWORD_S 0 u_pct 0 199.996948 SYMBOL_LINK "ENTE_M_ICO_DTY_BS" 4
 /begin AXIS_DESCR COM_AXIS ente_ico_out_t_sp u_deg_C 9 -256.0 255.9921875 AXIS_PTS_REF ENTE_X_ICO_OUT_T_SP /end AXIS_DESCR
 /begin AXIS_DESCR COM_AXIS ente_ico_rad_t u_deg_C 9 -256.0 255.9921875 AXIS_PTS_REF ENTE_X_ICO_RAD_T /end AXIS_DESCR
/end CHARACTERISTIC
/begin AXIS_PTS ENTE_X_ICO_OUT_T_SP "cooler pump out temp setpoint break point" 0x0002006C ente_ico_out_t_sp SSV__SWORD_S 0 u_deg_C 9 -256.0 255.9921875 DEPOSIT ABSOLUTE SYMBOL_LINK "ENTE_X_ICO_OUT_T_SP" 2 /end AXIS_PTS
/begin AXIS_PTS ENTE_X_ICO_RAD_T "cooler pump radiator temp break point" 0x0002006C ente_ico_rad_t SSV__SWORD_S 0 u_deg_C 9 -256.0 255.9921875 DEPOSIT ABSOLUTE SYMBOL_LINK "ENTE_X_ICO_RAD_T" 2 /end AXIS_PTS
/begin CHARACTERISTIC ENTE_C_ICO_DTY_LD_FAC "intercooler pump speed control load factor" CURVE 0x000200B0 __UWORD_S 0 u_fac_4 0 3.99993896484375 FORMAT "%4.3" SYMBOL_LINK "ENTE_C_ICO_DTY_LD_FAC" 2
 /begin AXIS_DESCR COM_AXIS afm_stk_flw_pct u_pct_8 9 0.000000 799.987793 AXIS_PTS_REF ENTE_X_STK_FLW /end AXIS_DESCR
/end CHARACTERISTIC
/begin AXIS_PTS ENTE_X_STK_FLW "stroke flow percent break point" 0x0002006C afm_stk_flw_pct SSV__UWORD_S 0 u_pct_8 9 0.000000 799.987793 DEPOSIT ABSOLUTE SYMBOL_LINK "ENTE_X_STK_FLW" 2 /end AXIS_PTS
/begin CHARACTERISTIC ENTE_V_ICO_DTY_I_GN "intercooler pump control int gain" VALUE 0x2886C __UWORD_S 0 u_fac_2 0 1.999969482421875 FORMAT "%4.3" /end CHARACTERISTIC
/begin CHARACTERISTIC ENTE_C_ICO_DTY_P "intercooler pump control prop" CURVE 0x000200B0 __SWORD_S 0 u_pct -100 99.9969482421875 SYMBOL_LINK "ENTE_C_ICO_DTY_P" 2
 /begin AXIS_DESCR COM_AXIS NO_INPUT_QUANTITY u_deg_C 9 -256.0 255.9921875 AXIS_PTS_REF ENTE_X_ICO_T_DLT_A /end AXIS_DESCR
/end CHARACTERISTIC
/begin AXIS_PTS ENTE_X_ICO_T_DLT_A "cooler pump out temp delta" 0x0002006C NO_INPUT_QUANTITY SSV__SWORD_S 0 u_deg_C 9 -256.0 255.9921875 DEPOSIT ABSOLUTE SYMBOL_LINK "ENTE_X_ICO_T_DLT_A" 2 /end AXIS_PTS
/begin CHARACTERISTIC ENTE_M_ICO_DTY_D "intercooler pump control duty deriv term" MAP 0x00020320 __SWORD_S 0 u_pct -100 99.996948 SYMBOL_LINK "ENTE_M_ICO_DTY_D" 4
 /begin AXIS_DESCR COM_AXIS NO_INPUT_QUANTITY u_deg_C 7 -256.0 255.9921875 AXIS_PTS_REF ENTE_X_ICO_OUT_T_SP_CHG /end AXIS_DESCR
 /begin AXIS_DESCR COM_AXIS NO_INPUT_QUANTITY u_deg_C 7 -256.0 255.9921875 AXIS_PTS_REF ENTE_X_ICO_T_DLT_B /end AXIS_DESCR
/end CHARACTERISTIC
/begin AXIS_PTS ENTE_X_ICO_OUT_T_SP_CHG "cooler pump out temp change delta" 0x0002006C NO_INPUT_QUANTITY SSV__SWORD_S 0 u_deg_C 7 -256.0 255.9921875 DEPOSIT ABSOLUTE SYMBOL_LINK "ENTE_X_ICO_OUT_T_SP_CHG" 2 /end AXIS_PTS
/begin AXIS_PTS ENTE_X_ICO_T_DLT_B "cooler pump out temp delta" 0x0002006C NO_INPUT_QUANTITY SSV__SWORD_S 0 u_deg_C 7 -256.0 255.9921875 DEPOSIT ABSOLUTE SYMBOL_LINK "ENTE_X_ICO_T_DLT_B" 2 /end AXIS_PTS
/begin CHARACTERISTIC ENTE_C_ICO_DTY_MIN "intercooler pump duty min" CURVE 0x000200B0 __UWORD_S 0 u_pct 0 199.9969482421875 SYMBOL_LINK "ENTE_C_ICO_DTY_MIN" 2
 /begin AXIS_DESCR COM_AXIS ente_exh_t_filt u_deg_K 9 0 2047.96875 AXIS_PTS_REF ENTE_X_EXH_T /end AXIS_DESCR
/end CHARACTERISTIC
/begin AXIS_PTS ENTE_X_EXH_T "exhaust temp" 0x0002006C NO_INPUT_QUANTITY SSV__UWORD_S 0 u_deg_K 9 0 2047.96875 FORMAT "%5.1" DEPOSIT ABSOLUTE SYMBOL_LINK "ENTE_X_EXH_T" 2 /end AXIS_PTS
/begin CHARACTERISTIC ENTE_V_ICO_DTY_MAX "intercooler control duty max" VALUE 0x2886C __UWORD_S 0 u_pct 0 199.9969482421875 FORMAT "%4.1" /end CHARACTERISTIC
/begin CHARACTERISTIC ENTE_V_ICO_TYP "intercooler pump type" VALUE 0x2886C __UBYTE_S 0 u_ico_typ 0 3 FORMAT "%1.0" /end CHARACTERISTIC
/begin CHARACTERISTIC ENTE_V_ICO_ACTV_DTY "intercooler pump active duty" VALUE 0x2886C __UWORD_S 0 u_pct 0 199.9969482421875 FORMAT "%4.1" /end CHARACTERISTIC
/begin CHARACTERISTIC ENTE_V_ICO_INACTV_DTY "intercooler pump inactive duty" VALUE 0x2886C __UWORD_S 0 u_pct 0 199.9969482421875 FORMAT "%4.1" /end CHARACTERISTIC
/begin CHARACTERISTIC ENTE_V_ICO_OFFR_VLT "intercooler pump off run exit voltage" VALUE 0x0002038C __UWORD_S 0 u_volt_32 0 31.99951171875 FORMAT "%4.2" /end CHARACTERISTIC
/begin CHARACTERISTIC ENTE_C_ICO_OFFR_DTY "intercooler pump off run duty" CURVE 0x000200B0 __UWORD_S 0 u_pct 0 199.9969482421875 SYMBOL_LINK "ENTE_C_ICO_OFFR_DTY" 2
 /begin AXIS_DESCR COM_AXIS ente_ico_offr_tmr u_16x_tmr 9 0 8191.875 AXIS_PTS_REF ENTE_X_ICO_OFFR_TM /end AXIS_DESCR
/end CHARACTERISTIC
/begin AXIS_PTS ENTE_X_ICO_OFFR_TM "engine off run timer" 0x0002006C ente_ico_offr_tmr SSV__UWORD_S 0 u_16x_tmr 9 0 8191.875 DEPOSIT ABSOLUTE SYMBOL_LINK "ENTE_X_ICO_OFFR_TM" 2 /end AXIS_PTS
/begin CHARACTERISTIC ENTE_V_ICO_INT_MAX "intercooler control int max" VALUE 0x2886C __UWORD_S 0 u_pct 0 199.9969482421875 FORMAT "%4.1" /end CHARACTERISTIC
/begin CHARACTERISTIC ENTE_V_ICO_INT_MIN "intercooler control int min" VALUE 0x2886C __UWORD_S 0 u_pct 0 199.9969482421875 FORMAT "%4.1" /end CHARACTERISTIC
/begin CHARACTERISTIC ENTE_V_ICO_OFFR_AMBT_CFG "intercooler pump off run ambient temp config" VALUE 0x2886C __UBYTE_S 0 u_ico_amb_t 0 1 FORMAT "%1.0" /end CHARACTERISTIC
/begin CHARACTERISTIC ENTE_M_ICO_OFFR_DUR "intercooler pump speed control base" MAP 0x00020320 __UWORD_S 0 u_16x_tmr 0 8191.875 SYMBOL_LINK "ENTE_M_ICO_OFFR_DUR" 4
 /begin AXIS_DESCR COM_AXIS ente_exh_t_filt u_deg_K 9 0 2047.96875 AXIS_PTS_REF ENTE_X_EXH_T_B /end AXIS_DESCR
 /begin AXIS_DESCR COM_AXIS NO_INPUT_QUANTITY u_deg_C 6 -256.0 255.9921875 AXIS_PTS_REF ENTE_X_AMB_T_B /end AXIS_DESCR
/end CHARACTERISTIC
/begin AXIS_PTS ENTE_X_EXH_T_B "exhaust temp" 0x0002006C NO_INPUT_QUANTITY SSV__UWORD_S 0 u_deg_K 9 0 2047.96875 FORMAT "%5.1" DEPOSIT ABSOLUTE SYMBOL_LINK "ENTE_X_EXH_T_B" 2 /end AXIS_PTS
/begin AXIS_PTS ENTE_X_AMB_T_B "" 0x0002006C NO_INPUT_QUANTITY SSV__SWORD_S 0 u_deg_C 6 -256.0 255.9921875 DEPOSIT ABSOLUTE SYMBOL_LINK "ENTE_X_AMB_T_B" 2 /end AXIS_PTS
/begin CHARACTERISTIC ENTE_V_FAN_OFFR_TEMP_DUR "fan off run duration due to over temp" VALUE 0x0002038C __UWORD_S 0 u_16x_tmr 0.0 8191.875 /end CHARACTERISTIC
/begin CHARACTERISTIC ENTE_V_FAN_T_SRC "fan control temp source" VALUE 0x0002038C __UBYTE_S 0 u_fan_t_src 0 1 FORMAT "%1.0" /end CHARACTERISTIC
/begin CHARACTERISTIC VHSC_V_LMT_SRC "vehicle speed limit cmd source" VALUE 0x2886C __UBYTE_S 0 u_vhsc_lmt 0 1 FORMAT "%1.0" /end CHARACTERISTIC
/begin CHARACTERISTIC VHSC_V_LMT_EN "vehicle speed limit enable" VALUE 0x2886C __UBYTE_S 0 b_true 0 1 FORMAT "%1.0" /end CHARACTERISTIC
/begin CHARACTERISTIC VHSC_V_LMT_EN_ESPD_MIN "vehicle speed limit enable engine speed min" VALUE 0x0002038C __UWORD_S 0 u_espd 0.0 8191.875 FORMAT "%5.1" /end CHARACTERISTIC
/begin CHARACTERISTIC VHSC_V_LMT_SW_CFG "speed limit switch config" VALUE 0x2886C __UBYTE_S 0 u_vhsc_sw_cfg 0 1 FORMAT "%1.0" /end CHARACTERISTIC
/begin CHARACTERISTIC VHSC_V_LMT_PINC_HLD_MIN "vehicle speed limit period increase active switch hold min" VALUE 0x0002038C __UWORD_S 0 u_2x_tmr 0.0 1023.984375 /end CHARACTERISTIC
/begin CHARACTERISTIC VHSC_V_LMT_PDEC_HLD_MIN "vehicle speed limit period decrease active switch hold min" VALUE 0x0002038C __UWORD_S 0 u_2x_tmr 0.0 1023.984375 /end CHARACTERISTIC
/begin CHARACTERISTIC VHSC_V_LMT_PRD_RND_BS "vehicle speed limit period change round base" VALUE 0x0002038C __UWORD_S 0 u_vspd 0.000000 511.992188 /end CHARACTERISTIC
/begin CHARACTERISTIC VHSC_V_LMT_PRD_DEC_STP "vehicle speed limit period decrease step" VALUE 0x0002038C __UWORD_S 0 u_vspd 0.000000 511.992188 /end CHARACTERISTIC
/begin CHARACTERISTIC VHSC_V_LMT_PRD_INC_STP "vehicle speed limit period increase step" VALUE 0x0002038C __UWORD_S 0 u_vspd 0.000000 511.992188 /end CHARACTERISTIC
/begin CHARACTERISTIC VHSC_V_LMT_TAP_DEC_STP "vehicle speed limit tap decrease step" VALUE 0x0002038C __UWORD_S 0 u_vspd 0.000000 511.992188 /end CHARACTERISTIC
/begin CHARACTERISTIC VHSC_V_LMT_TAP_INC_STP "vehicle speed limit tap increase step" VALUE 0x0002038C __UWORD_S 0 u_vspd 0.000000 511.992188 /end CHARACTERISTIC
/begin CHARACTERISTIC VHSC_V_LMT_SPD_EXC_HYS "vehicle speed exceed limit hys" VALUE 0x0002038C __UWORD_S 0 u_vspd 0.000000 511.992188 /end CHARACTERISTIC
/begin CHARACTERISTIC VHSC_V_LMT_PEDL_OVR_HI "pedal override thr high" VALUE 0x0002038C __UWORD_S 0 u_pct 0.0 199.996948 /end CHARACTERISTIC
/begin CHARACTERISTIC VHSC_V_LMT_PEDL_OVR_LO "pedal override thr low" VALUE 0x0002038C __UWORD_S 0 u_pct 0.0 199.996948 /end CHARACTERISTIC
/begin CHARACTERISTIC VHSC_V_LMT_INC_MAX "vehicle speed limit increase step max" VALUE 0x0002038C __UWORD_S 0 u_vspd 0.000000 511.992188 /end CHARACTERISTIC
/begin CHARACTERISTIC VHSC_V_LMT_DEC_MAX "vehicle speed limit increase step max" VALUE 0x0002038C __UWORD_S 0 u_vspd 0.000000 511.992188 /end CHARACTERISTIC
/begin CHARACTERISTIC VHSC_V_LMT_RMP_ACTV_DLT "vehicle speed limit ramp active delta" VALUE 0x0002038C __UWORD_S 0 u_vspd 0.000000 511.992188 /end CHARACTERISTIC
/begin CHARACTERISTIC VHSC_V_LMT_DEC_PRD "vehicle speed limit decrease period" VALUE 0x0002038C __UWORD_S 0 u_2x_tmr 0.0 1023.984375 /end CHARACTERISTIC
/begin CHARACTERISTIC VHSC_V_LMT_INC_PRD "vehicle speed limit increase period" VALUE 0x0002038C __UWORD_S 0 u_2x_tmr 0.0 1023.984375 /end CHARACTERISTIC
/begin CHARACTERISTIC VHSC_V_LMT_MAX "vehicle speed limit max" VALUE 0x0002038C __UWORD_S 0 u_vspd 0.000000 511.992188 /end CHARACTERISTIC
/begin CHARACTERISTIC VHSC_V_LMT_MIN "vehicle speed limit min" VALUE 0x0002038C __UWORD_S 0 u_vspd 0.000000 511.992188 /end CHARACTERISTIC
/begin CHARACTERISTIC VHSC_V_LMT_RES_EN "vehicle speed limit resume enable" VALUE 0x2886C __UBYTE_S 0 b_true 0 1 FORMAT "%1.0" /end CHARACTERISTIC
/begin CHARACTERISTIC VHSC_V_CRU_LRN_TYP "cruise learn type" VALUE 0x2886C __UBYTE_S 0 u_cru_lrn_typ 0 2 FORMAT "%1.0" /end CHARACTERISTIC
/begin CHARACTERISTIC VHSC_V_CRU_TYP "cruise control type" VALUE 0x2886C __UBYTE_S 0 u_cru_ctrl_typ 0 3 FORMAT "%1.0" /end CHARACTERISTIC
/begin CHARACTERISTIC VHSC_V_CRU_EN_ESPD_MIN "cruise enable engine speed min" VALUE 0x0002038C __UWORD_S 0 u_espd 0.0 8191.875 FORMAT "%5.1" /end CHARACTERISTIC
/begin CHARACTERISTIC VHSC_V_CRU_SW_CFG "cruise switch config" VALUE 0x2886C __UBYTE_S 0 u_vhsc_sw_cfg 0 1 FORMAT "%1.0" /end CHARACTERISTIC
/begin CHARACTERISTIC VHSC_C_CRU_EN_ERR_MIN "cruise enable vehicle speed error min" CURVE 0x000200B0 __SWORD_S 0 u_vspd_err -512 511.984375 SYMBOL_LINK "VHSC_C_CRU_EN_ERR_MIN" 2
 /begin AXIS_DESCR COM_AXIS sys_cru_vspd u_vspd 15 0 511.9921875 AXIS_PTS_REF VHSC_X_CRU_VSPD_A /end AXIS_DESCR
/end CHARACTERISTIC
/begin AXIS_PTS VHSC_X_CRU_VSPD_A "" 0x0002006C cfd_air_flw_avg SSV__UWORD_S 0 u_vspd 15 0 511.9921875 DEPOSIT ABSOLUTE SYMBOL_LINK "VHSC_X_CRU_VSPD_A" 2 /end AXIS_PTS
/begin CHARACTERISTIC VHSC_V_CRU_EN_ERR_MAX "cruise enable vehicle speed error max" VALUE 0x0002038C __SWORD_S 0 u_vspd_err -512 511.984375 /end CHARACTERISTIC
/begin CHARACTERISTIC VHSC_V_CRU_EXT_VSPD_MAX "cruise exit vehicle speed max" VALUE 0x0002038C __UWORD_S 0 u_vspd 0 511.9921875 /end CHARACTERISTIC
/begin CHARACTERISTIC VHSC_V_CRU_EXT_VSPD_MIN "cruise exit vehicle speed min" VALUE 0x0002038C __UWORD_S 0 u_vspd 0 511.9921875 /end CHARACTERISTIC
/begin CHARACTERISTIC VHSC_C_CRU_EN_ACC_MAX "cruise enable vehicle speed acceleration max" CURVE 0x000200B0 __SWORD_S 0 u_vspd_per_sec -64 63.998046875 SYMBOL_LINK "VHSC_C_CRU_EN_ACC_MAX" 2
 /begin AXIS_DESCR COM_AXIS sys_cru_vspd u_vspd 15 0 511.9921875 AXIS_PTS_REF VHSC_X_CRU_VSPD_A /end AXIS_DESCR
/end CHARACTERISTIC
/begin CHARACTERISTIC VHSC_C_CRU_EN_ACC_MIN "cruise enable vehicle speed acceleration min" CURVE 0x000200B0 __SWORD_S 0 u_vspd_per_sec -64 63.998046875 SYMBOL_LINK "VHSC_C_CRU_EN_ACC_MIN" 2
 /begin AXIS_DESCR COM_AXIS sys_cru_vspd u_vspd 15 0 511.9921875 AXIS_PTS_REF VHSC_X_CRU_VSPD_A /end AXIS_DESCR
/end CHARACTERISTIC
/begin CHARACTERISTIC VHSC_C_CRU_BIAS_RES_DLT "cruise resume acceleration vehicle speed delta setpoint" CURVE 0x000200B0 __UWORD_S 0 u_vspd 0 511.9921875 SYMBOL_LINK "VHSC_C_CRU_BIAS_RES_DLT" 2
 /begin AXIS_DESCR FIX_AXIS vhsc_cru_vspd_dlt u_vspd 13 -256 0
  /begin FIX_AXIS_PAR_LIST -9216 -8448 -7680 -6912 -6144 -5376 -4608 -3840 -3072 -2304 -1536 -768 0 /end FIX_AXIS_PAR_LIST
 /end AXIS_DESCR
/end CHARACTERISTIC
/begin CHARACTERISTIC VHSC_C_CRU_BIAS_ACC_DLT "cruise acceleration vehicle speed delta setpoint" CURVE 0x000200B0 __UWORD_S 0 u_vspd 0 511.9921875 SYMBOL_LINK "VHSC_C_CRU_BIAS_ACC_DLT" 2
 /begin AXIS_DESCR FIX_AXIS vhsc_cru_vspd_dlt u_vspd 13 -256 0
  /begin FIX_AXIS_PAR_LIST -9216 -8448 -7680 -6912 -6144 -5376 -4608 -3840 -3072 -2304 -1536 -768 0 /end FIX_AXIS_PAR_LIST
 /end AXIS_DESCR
/end CHARACTERISTIC
/begin CHARACTERISTIC VHSC_V_CRU_BIAS_CST_DLT "cruise coast mode vehicle speed error bias delta" VALUE 0x0002038C __SWORD_S 0 u_vspd -256 255.9921875 /end CHARACTERISTIC
/begin CHARACTERISTIC VHSC_V_CRU_BIAS_PLS_DLT "cruise plus mode vehicle speed error bias delta" VALUE 0x0002038C __SWORD_S 0 u_vspd -256 255.9921875 /end CHARACTERISTIC
/begin CHARACTERISTIC VHSC_V_CRU_BIAS_TRS_DLT "cruise mode transient vehicle speed error bias delta" VALUE 0x0002038C __SWORD_S 0 u_vspd -256 255.9921875 /end CHARACTERISTIC
/begin CHARACTERISTIC VHSC_V_CRU_BIAS_MNS_DLT "cruise minus mode vehicle speed error bias delta" VALUE 0x0002038C __SWORD_S 0 u_vspd -256 255.9921875 /end CHARACTERISTIC
/begin CHARACTERISTIC VHSC_V_CRU_SP_CHG_CST_DUR "cruise setpoint update coast switch keep duration min" VALUE 0x0002038C __UWORD_S 0 u_2x_tmr 0.0 1023.984375 /end CHARACTERISTIC
/begin CHARACTERISTIC VHSC_V_CRU_BIAS_ACC_FAC "cruise vehicle speed error bias acceleration mode factor" VALUE 0x0002038C __UWORD_S 0 u_fac_16 0.0 15.999756 FORMAT "%4.2" /end CHARACTERISTIC
/begin CHARACTERISTIC VHSC_V_CRU_ACTV_EN_DUR "cruise active coast/acc switch keep duration min" VALUE 0x0002038C __UWORD_S 0 u_2x_tmr 0.0 1023.984375 /end CHARACTERISTIC
/begin CHARACTERISTIC VHSC_C_CRU_ACC_INIT_DLT "cruise acceleration mode initial bias delta" CURVE 0x000200B0 __UWORD_S 0 u_vspd 0 511.9921875 SYMBOL_LINK "VHSC_C_CRU_ACC_INIT_DLT" 2
 /begin AXIS_DESCR FIX_AXIS sys_cru_vspd u_vspd 12 39 182
  /begin FIX_AXIS_PAR_LIST 4992 6656 8320 9984 11648 13312 14976 16640 18304 19968 21632 23296 /end FIX_AXIS_PAR_LIST
 /end AXIS_DESCR
/end CHARACTERISTIC
/begin CHARACTERISTIC VHSC_V_CRU_BIAS_RES_FAC "cruise vehicle speed error bias resume mode factor" VALUE 0x0002038C __UWORD_S 0 u_fac_16 0.0 15.999756 FORMAT "%4.2" /end CHARACTERISTIC
/begin CHARACTERISTIC VHSC_V_CRU_MNS_ERR_HI "cruise minus mode vehicle speed error high" VALUE 0x0002038C __SWORD_S 0 u_vspd -256 255.9921875 /end CHARACTERISTIC
/begin CHARACTERISTIC VHSC_V_CRU_MNS_SW_OFF_DUR "cruise minus mode switch release duration min" VALUE 0x0002038C __UWORD_S 0 u_2x_tmr 0.0 1023.984375 /end CHARACTERISTIC
/begin CHARACTERISTIC VHSC_V_CRU_PLS_ERR_HI "cruise plus mode vehicle speed error high" VALUE 0x0002038C __SWORD_S 0 u_vspd -256 255.9921875 /end CHARACTERISTIC
/begin CHARACTERISTIC VHSC_V_CRU_PLS_ERR_LO "cruise plus mode vehicle speed error low" VALUE 0x0002038C __SWORD_S 0 u_vspd -256 255.9921875 /end CHARACTERISTIC
/begin CHARACTERISTIC VHSC_V_CRU_SP_CHG_ACC_DUR "cruise setpoint update acc switch keep duration min" VALUE 0x0002038C __UWORD_S 0 u_2x_tmr 0.0 1023.984375 /end CHARACTERISTIC
/begin CHARACTERISTIC VHSC_V_CRU_ACC_SW_DUR "cruise acc mode active acc switch duration min" VALUE 0x0002038C __UWORD_S 0 u_2x_tmr 0.0 1023.984375 /end CHARACTERISTIC
/begin CHARACTERISTIC VHSC_V_CRU_RES_SW_DUR "cruise resume mode active acc switch duration min" VALUE 0x0002038C __UWORD_S 0 u_2x_tmr 0.0 1023.984375 /end CHARACTERISTIC
/begin CHARACTERISTIC VHSC_V_CRU_MNS_CST_DUR "cruise minus/coast switch duration" VALUE 0x0002038C __UWORD_S 0 u_2x_tmr 0.0 1023.984375 /end CHARACTERISTIC
/begin CHARACTERISTIC VHSC_V_CRU_EN_VSPD_MAX "cruise enable vehicle speed max" VALUE 0x0002038C __UWORD_S 0 u_vspd 0 511.9921875 /end CHARACTERISTIC
/begin CHARACTERISTIC VHSC_V_CRU_EN_VSPD_MIN "cruise enable vehicle speed min" VALUE 0x0002038C __UWORD_S 0 u_vspd 0 511.9921875 /end CHARACTERISTIC
/begin CHARACTERISTIC VHSC_V_CRU_TAP_DLT "cruise tap vehicle speed delta" VALUE 0x0002038C __UWORD_S 0 u_vspd 0 511.9921875 /end CHARACTERISTIC
/begin CHARACTERISTIC VHSC_V_CRU_BIAS_ACC_MAX "cruise bias acc max" VALUE 0x0002038C __SWORD_S 0 u_vspd -256 255.9921875 /end CHARACTERISTIC
/begin CHARACTERISTIC VHSC_V_CRU_RES2ACTV_SW_DUR "resume to active mode acc switch off duration" VALUE 0x0002038C __UWORD_S 0 u_2x_tmr 0.0 1023.984375 /end CHARACTERISTIC
/begin AXIS_PTS VHSC_X_VSPD_DLT "vehicle speed control vehicle speed delta axis." 0x0002006C vhsc_cru_vspd_dlt SSV__SWORD_S 0 u_vspd 6 -256 255.9921875 DEPOSIT ABSOLUTE SYMBOL_LINK "VHSC_X_VSPD_DLT" 2 /end AXIS_PTS
/begin CHARACTERISTIC VHSC_V_MX_EFF_VSPD_DLT "Determines the maximum allowable value for the effective vehicle speed error." VALUE 0x0002038C __SWORD_S 0 u_vspd -256 255.9921875 /end CHARACTERISTIC
/begin CHARACTERISTIC VHSC_V_CTRL_HYS "Vehicle speed control hysteresis when torque is not limited by min value." VALUE 0x0002038C __UWORD_S 0 u_fac_4 0 3.99993896484375 FORMAT "%3.2" /end CHARACTERISTIC
/begin CHARACTERISTIC VHSC_V_CTRL_HYS_MN "Vehicle speed control hysteresis when torque is limited by min value." VALUE 0x0002038C __UWORD_S 0 u_fac_4 0 3.99993896484375 FORMAT "%3.2" /end CHARACTERISTIC
/begin CHARACTERISTIC VHSC_V_INT_MX "Vehicle speed control integrator item max limit." VALUE 0x0002038C __SWORD_S 0 u_fac_n32_p32 -32 31.9990234375 /end CHARACTERISTIC
/begin CHARACTERISTIC VHSC_V_INT_MN "Vehicle speed control integrator item min limit." VALUE 0x0002038C __SWORD_S 0 u_fac_n32_p32 -32 31.9990234375 /end CHARACTERISTIC
/begin CHARACTERISTIC VHSC_V_LCK_INT_MX "Vehicle speed control locked integrator item max limit." VALUE 0x0002038C __SWORD_S 0 u_fac_n32_p32 -32 31.9990234375 /end CHARACTERISTIC
/begin CHARACTERISTIC VHSC_V_LCK_INT_MN "Vehicle speed control locked integrator item min limit." VALUE 0x0002038C __SWORD_S 0 u_fac_n32_p32 -32 31.9990234375 /end CHARACTERISTIC
/begin CHARACTERISTIC VHSC_V_VSPD_STP_MX "Vehicle speed max change step setpoint in one loop." VALUE 0x0002038C __SWORD_S 0 u_vspd_err_n2_p2 -2 1.99993896484375 /end CHARACTERISTIC
/begin CHARACTERISTIC VHSC_V_VSPD_STP_MN "Vehicle speed min change step setpoint in one loop." VALUE 0x0002038C __SWORD_S 0 u_vspd_err_n2_p2 -2 1.99993896484375 /end CHARACTERISTIC
/begin AXIS_PTS VHSC_X_AMP "vehicle speed control ambient pressure axis." 0x0002006C sys_amp SSV__UWORD_S 0 u_kPa_0_256 5 0 255.99609375 DEPOSIT ABSOLUTE SYMBOL_LINK "VHSC_X_AMP" 2 /end AXIS_PTS
/begin CHARACTERISTIC VHSC_C_PWR_SP_AMP_FAC "Power setpoint ambient pressure factor." CURVE 0x000200B0 __UWORD_S 0 u_fac_2 0 1.999969482421875 FORMAT "%4.3" SYMBOL_LINK "VHSC_C_PWR_SP_AMP_FAC" 2
 /begin AXIS_DESCR COM_AXIS sys_amp u_kPa_0_256 5 0 255.99609375 AXIS_PTS_REF VHSC_X_AMP /end AXIS_DESCR
/end CHARACTERISTIC
/begin CHARACTERISTIC VHSC_C_EFF_SP "Effort setpoint for vehicle speed." CURVE 0x000200B0 __SWORD_S 0 u_kilo_Newton -128 127.99609375 SYMBOL_LINK "VHSC_C_EFF_SP" 2
 /begin AXIS_DESCR FIX_AXIS NO_INPUT_QUANTITY u_vspd 17 -256 255.9921875
  /begin FIX_AXIS_PAR_LIST -4224 -3840 -3456 -3072 -2688 -2304 -1920 -1536 -1152 -768 -384 0 384 768 1152 1536 1920 /end FIX_AXIS_PAR_LIST
 /end AXIS_DESCR
/end CHARACTERISTIC
/begin CHARACTERISTIC VHSC_C_PROP_FAC "Proportion factor." CURVE 0x000200B0 __UWORD_S 0 u_fac_8 0 7.9998779296875 FORMAT "%3.2" SYMBOL_LINK "VHSC_C_PROP_FAC" 2
 /begin AXIS_DESCR FIX_AXIS sys_cru_vspd u_vspd 12 0 511.9921875
  /begin FIX_AXIS_PAR_LIST 4992 6656 8320 9984 11648 13312 14976 16640 18304 19968 21632 23296 /end FIX_AXIS_PAR_LIST
 /end AXIS_DESCR
/end CHARACTERISTIC
/begin CHARACTERISTIC VHSC_C_RD_LD "Road load compensates for vehicle speed control." CURVE 0x000200B0 __SWORD_S 0 u_kilo_Newton -128 127.99609375 SYMBOL_LINK "VHSC_C_RD_LD" 2
 /begin AXIS_DESCR FIX_AXIS sys_cru_vspd u_vspd 12 0 511.9921875
  /begin FIX_AXIS_PAR_LIST 4992 6656 8320 9984 11648 13312 14976 16640 18304 19968 21632 23296 /end FIX_AXIS_PAR_LIST
 /end AXIS_DESCR
/end CHARACTERISTIC
/begin CHARACTERISTIC VHSC_C_CTRL_TORQ_HYS "Control engine torque hysteresis." CURVE 0x000200B0 __SWORD_S 0 u_tq -2048 2047.9375 SYMBOL_LINK "VHSC_C_CTRL_TORQ_HYS" 2
 /begin AXIS_DESCR FIX_AXIS NO_INPUT_QUANTITY u_tq 17 -2048 2047.9375
  /begin FIX_AXIS_PAR_LIST -1600 -1200 -800 -400 0 400 800 1200 1600 2000 2400 2800 3200 3600 4000 4400 4800 /end FIX_AXIS_PAR_LIST
 /end AXIS_DESCR
/end CHARACTERISTIC
/begin CHARACTERISTIC VHSC_C_TORQ_SP_FILT "Control torque setpoint filter." CURVE 0x000200B0 __UWORD_S 0 u_fac_1 0 0.9999847412109375 FORMAT "%5.4" SYMBOL_LINK "VHSC_C_TORQ_SP_FILT" 2
 /begin AXIS_DESCR FIX_AXIS sys_cru_vspd u_vspd 12 0 511.9921875
  /begin FIX_AXIS_PAR_LIST 4992 6656 8320 9984 11648 13312 14976 16640 18304 19968 21632 23296 /end FIX_AXIS_PAR_LIST
 /end AXIS_DESCR
/end CHARACTERISTIC
/begin CHARACTERISTIC VHSC_C_TORQ_SP_FILT_SHFT "Control torque setpoint filter when shifting." CURVE 0x000200B0 __UWORD_S 0 u_fac_1 0 0.9999847412109375 FORMAT "%5.4" SYMBOL_LINK "VHSC_C_TORQ_SP_FILT_SHFT" 2
 /begin AXIS_DESCR FIX_AXIS sys_cru_vspd u_vspd 12 0 511.9921875
  /begin FIX_AXIS_PAR_LIST 4992 6656 8320 9984 11648 13312 14976 16640 18304 19968 21632 23296 /end FIX_AXIS_PAR_LIST
 /end AXIS_DESCR
/end CHARACTERISTIC
/begin CHARACTERISTIC VHSC_V_ACC_SP_FAC_UP "Acceleration setpoint factor for up direction." VALUE 0x0002038C __UWORD_S 0 u_fac_4 0 3.99993896484375 FORMAT "%3.2" /end CHARACTERISTIC
/begin CHARACTERISTIC VHSC_V_ACC_SP_FAC_DN "Acceleration setpoint factor for down direction." VALUE 0x0002038C __UWORD_S 0 u_fac_4 0 3.99993896484375 FORMAT "%3.2" /end CHARACTERISTIC
/begin CHARACTERISTIC VHSC_V_INT_FAC_DEC "Decrease integrator factor." VALUE 0x0002038C __UWORD_S 0 u_fac_2 0 1.999969482421875 FORMAT "%4.3" /end CHARACTERISTIC
/begin CHARACTERISTIC VHSC_V_INT_FAC_INC "Increase integrator factor." VALUE 0x0002038C __UWORD_S 0 u_fac_2 0 1.999969482421875 FORMAT "%4.3" /end CHARACTERISTIC
/begin CHARACTERISTIC VHSC_V_INT_FAC_ACC "Acceleration integrator factor." VALUE 0x0002038C __UWORD_S 0 u_fac_2 0 1.999969482421875 FORMAT "%4.3" /end CHARACTERISTIC
/begin CHARACTERISTIC VHSC_V_HYS_STP "The maximum change in Vehicle Speed Control Hysteresis allowed in one step." VALUE 0x0002038C __UWORD_S 0 u_fac_512 0 511.9921875 FORMAT "%4.1" /end CHARACTERISTIC
/begin CHARACTERISTIC VHSC_V_DIS_DLY_ABS "Disengage vehicle speed control delay after ABS active." VALUE 0x0002038C __UWORD_S 0 u_2x_tmr 0 1023.984375 /end CHARACTERISTIC
/begin CHARACTERISTIC VHSC_V_DN_SHFT_LVL "Estimated road load level for down shifting control." VALUE 0x0002038C __SWORD_S 0 u_pct_r_lo_s -256 255.9921875 /end CHARACTERISTIC
/begin CHARACTERISTIC VHSC_V_VEH_FRIC "The estimated friction in the driveline from the engine to the wheels in terms of tractive effort." VALUE 0x0002038C __SWORD_S 0 u_kilo_Newton -128 127.99609375 /end CHARACTERISTIC
/begin CHARACTERISTIC VHSC_V_DL_EFFI "Vehicle driveline efficiency from engine to road surface." VALUE 0x0002038C __UWORD_S 0 u_fac_2 0 1.999969482421875 FORMAT "%4.3" /end CHARACTERISTIC
/begin CHARACTERISTIC VHSC_V_TORQ_SP_FILT_FAC_DEC "Torque setpoint filter's factor when torque decreasing." VALUE 0x0002038C __UWORD_S 0 u_fac_2 0 1.999969482421875 FORMAT "%4.3" /end CHARACTERISTIC
/begin CHARACTERISTIC VHSC_V_TORQ_MX "Torque max limit for vehicle speed control." VALUE 0x0002038C __SWORD_S 0 u_tq -2048 2047.9375 FORMAT "%5.2" /end CHARACTERISTIC
/begin CHARACTERISTIC VHSC_V_TORQ_MN "Torque min limit for vehicle speed control." VALUE 0x0002038C __SWORD_S 0 u_tq -2048 2047.9375 FORMAT "%5.2" /end CHARACTERISTIC
/begin CHARACTERISTIC VHSC_V_TORQ_MX_THRSH "Vehicle speed control torque below this threshold,then the max torque flag will reset false." VALUE 0x0002038C __SWORD_S 0 u_tq -2048 2047.9375 FORMAT "%5.2" /end CHARACTERISTIC
/begin CHARACTERISTIC VHSC_V_TORQ_MN_THRSH "Vehicle speed control torque above this threshold,then the min torque flag will reset false." VALUE 0x0002038C __SWORD_S 0 u_tq -2048 2047.9375 FORMAT "%5.2" /end CHARACTERISTIC
/begin CHARACTERISTIC VHSC_V_TORQ_MX_DLT "Vehicle speed control torque setpoint add this cal larger than actual flywheel torque,then the max torque flag will set true." VALUE 0x0002038C __SWORD_S 0 u_tq -2048 2047.9375 FORMAT "%5.2" /end CHARACTERISTIC
/begin CHARACTERISTIC VHSC_V_TORQ_MN_DLT "Vehicle speed control torque setpoint add this cal less than actual flywheel torque,then the min torque flag will set true." VALUE 0x0002038C __SWORD_S 0 u_tq -2048 2047.9375 FORMAT "%5.2" /end CHARACTERISTIC
/begin CHARACTERISTIC VHSC_V_TORQ_ACT_MN_THRSH "If actual flywheel torque add actual friction torque is less than this threshold,then the min torque flag will set true." VALUE 0x0002038C __SWORD_S 0 u_tq -2048 2047.9375 FORMAT "%5.2" /end CHARACTERISTIC
/begin CHARACTERISTIC VHSC_V_CLS_THRO "The throttle position below which the engine is considered to be at closed throttle,then the min torque flag will set true." VALUE 0x0002038C __UWORD_S 0 u_pct 0 199.996948242187 /end CHARACTERISTIC
/begin CHARACTERISTIC VHSC_V_SPD_RT_FAC "Engine speed to vehicle speed ratio factor when no shifting." VALUE 0x0002038C __UWORD_S 0 u_fac_1 0 0.999984741210937 /end CHARACTERISTIC
/begin CHARACTERISTIC VHSC_V_SPD_RT_FAC_SHFT "Engine speed to vehicle speed ratio factor when shifting." VALUE 0x0002038C __UWORD_S 0 u_fac_1 0 0.999984741210937 /end CHARACTERISTIC
/begin CHARACTERISTIC VHSC_V_EFF2TORQ_FAC "Vehicle speed control effort setpoint to torque setpoint factor." VALUE 0x0002038C __UWORD_S 0 u_fac_2048 0 2047.96875 /end CHARACTERISTIC
/begin CHARACTERISTIC VHSC_V_MX_PPS_INT "Updates vehicle speed integrator are inhibited above this maximum allowable virtual pedal position." VALUE 0x0002038C __UWORD_S 0 u_pct 0 199.996948242187 /end CHARACTERISTIC
/begin CHARACTERISTIC VHSC_V_CTRL_CAN "Vehicle speed control from CAN." VALUE 0x0002038C __UBYTE_S 0 b_true 0 1 FORMAT "%1.0" /end CHARACTERISTIC
/begin CHARACTERISTIC VHSC_V_RES2TAP_ENBL "Resume to Tap mode control is enable." VALUE 0x0002038C __UBYTE_S 0 b_true 0 1 FORMAT "%1.0" /end CHARACTERISTIC
/begin CHARACTERISTIC AC_V_EN_AC_T_MIN_HI "ac enable evap temp min" VALUE 0x0002038C __SWORD_S 0 u_deg_C -256 255.9921875 /end CHARACTERISTIC
/begin CHARACTERISTIC AC_V_EN_AC_T_MIN_LO "ac enable evap temp min" VALUE 0x0002038C __SWORD_S 0 u_deg_C -256 255.9921875 /end CHARACTERISTIC
/begin CHARACTERISTIC AC_V_EN_VSPD_MAX_HI "ac enable vehicle speed max" VALUE 0x0002038C __UWORD_S 0 u_vspd 0.0 511.9921875 /end CHARACTERISTIC
/begin CHARACTERISTIC AC_V_EN_VSPD_MAX_LO "ac enable vehicle speed max" VALUE 0x0002038C __UWORD_S 0 u_vspd 0.0 511.9921875 /end CHARACTERISTIC
/begin CHARACTERISTIC AC_V_DIS_PPS_MIN_LO "ac disable pps min" VALUE 0x0002038C __UWORD_S 0 u_pct 0.0 199.996948 /end CHARACTERISTIC
/begin CHARACTERISTIC AC_V_DIS_PPS_MIN_HI "ac disable pps min" VALUE 0x0002038C __UWORD_S 0 u_pct 0.0 199.996948 /end CHARACTERISTIC
/begin CHARACTERISTIC AC_V_DIS_PPS_EXT_ESPD "ac high pps disable engine speed max" VALUE 0x0002038C __UWORD_S 0 u_espd 0.0 8191.875 FORMAT "%5.1" /end CHARACTERISTIC
/begin CHARACTERISTIC AC_V_DIS_PPS_DUR "ac disable duration min due to high pps" VALUE 0x0002038C __UWORD_S 0 u_8x_tmr 0.0 4095.9375 FORMAT "%5.1" /end CHARACTERISTIC
/begin CHARACTERISTIC AC_V_DIS_HI_LOAD_DUR "ac disable duration min due to high load" VALUE 0x0002038C __UWORD_S 0 u_8x_tmr 0.0 4095.9375 FORMAT "%5.2" /end CHARACTERISTIC
/begin CHARACTERISTIC AC_C_HI_LOAD_VSPD_DLT "fan key off run pwm" CURVE 0x000200B0 __SWORD_S 0 u_vspd -256 255.9921875 FORMAT "%4.1" SYMBOL_LINK "AC_C_HI_LOAD_VSPD_DLT" 2
 /begin AXIS_DESCR FIX_AXIS ac_hi_pps_actv_vspd u_vspd 5 10 90 /begin FIX_AXIS_PAR_LIST 1280 3840 6400 8960 11520 /end FIX_AXIS_PAR_LIST /end AXIS_DESCR
/end CHARACTERISTIC
/begin CHARACTERISTIC AC_V_DIS_PS_ESPD_MAX_HI "ac ps disable engine speed max" VALUE 0x0002038C __UWORD_S 0 u_espd 0.0 8191.875 FORMAT "%5.1" /end CHARACTERISTIC
/begin CHARACTERISTIC AC_V_DIS_PS_ESPD_MAX_LO "ac ps disable engine speed max" VALUE 0x0002038C __UWORD_S 0 u_espd 0.0 8191.875 FORMAT "%5.1" /end CHARACTERISTIC
/begin CHARACTERISTIC AC_V_DIS_HI_ESPD_MIN_HI "ac high speed disable engine speed min" VALUE 0x0002038C __UWORD_S 0 u_espd 0.0 8191.875 FORMAT "%5.1" /end CHARACTERISTIC
/begin CHARACTERISTIC AC_V_DIS_HI_ESPD_MIN_LO "ac high speed disable engine speed min" VALUE 0x0002038C __UWORD_S 0 u_espd 0.0 8191.875 FORMAT "%5.1" /end CHARACTERISTIC
/begin CHARACTERISTIC AC_V_DIS_HI_ESPD_ACTV_DLY "ac high speed disable active delay" VALUE 0x0002038C __UWORD_S 0 u_8x_tmr 0.0 4095.9375 FORMAT "%5.2" /end CHARACTERISTIC
/begin CHARACTERISTIC AC_V_DIS_HI_ESPD_EXT_DLY "ac high speed disable exit delay" VALUE 0x0002038C __UWORD_S 0 u_8x_tmr 0.0 4095.9375 FORMAT "%5.2" /end CHARACTERISTIC
/begin CHARACTERISTIC AC_V_DIS_LO_ESPD_MAX_LO "ac low speed disable engine speed max" VALUE 0x0002038C __UWORD_S 0 u_espd 0.0 8191.875 FORMAT "%5.1" /end CHARACTERISTIC
/begin CHARACTERISTIC AC_V_DIS_LO_ESPD_MAX_HI "ac low speed disable engine speed max" VALUE 0x0002038C __UWORD_S 0 u_espd 0.0 8191.875 FORMAT "%5.1" /end CHARACTERISTIC
/begin CHARACTERISTIC AC_V_DIS_LO_ESPD_EXT_DLY "ac low speed disable exit delay" VALUE 0x0002038C __UWORD_S 0 u_8x_tmr 0.0 4095.9375 FORMAT "%5.2" /end CHARACTERISTIC
/begin CHARACTERISTIC AC_V_DIS_LNCH_PPS_HI "ac disable launch pps high" VALUE 0x0002038C __UWORD_S 0 u_pct 0.0 199.996948 /end CHARACTERISTIC
/begin CHARACTERISTIC AC_V_DIS_LNCH_PPS_LO "ac disable launch pps high" VALUE 0x0002038C __UWORD_S 0 u_pct 0.0 199.996948 /end CHARACTERISTIC
/begin CHARACTERISTIC AC_V_DIS_LNCH_VSPD_LO "ac launch disable vehicle speed low" VALUE 0x0002038C __UWORD_S 0 u_vspd 0.0 511.9921875 /end CHARACTERISTIC
/begin CHARACTERISTIC AC_V_DIS_LNCH_VSPD_HI "ac launch disable vehicle speed high" VALUE 0x0002038C __UWORD_S 0 u_vspd 0.0 511.9921875 /end CHARACTERISTIC
/begin CHARACTERISTIC AC_V_DIS_ECT_HI "ac disable ect hi" VALUE 0x0002038C __SWORD_S 0 u_deg_C -256 255.9921875 /end CHARACTERISTIC
/begin CHARACTERISTIC AC_V_DIS_ECT_LO "ac disable ect hi" VALUE 0x0002038C __SWORD_S 0 u_deg_C -256 255.9921875 /end CHARACTERISTIC
/begin CHARACTERISTIC AC_V_DIS_ECT_DLY "ac disable ect delay" VALUE 0x0002038C __UWORD_S 0 u_1s_tmr 0.0 65535 FORMAT "%5.2" /end CHARACTERISTIC
/begin CHARACTERISTIC AC_V_DIS_AC_PRES_HI "ac high press disable" VALUE 0x0002038C __SWORD_S 0 u_kPa_4096n_4096p -4096 4095.875 FORMAT "%5.2" /end CHARACTERISTIC
/begin CHARACTERISTIC AC_V_DIS_AC_PRES_HI_HYS "ac high press disable hys" VALUE 0x0002038C __SWORD_S 0 u_kPa_4096n_4096p -4096 4095.875 FORMAT "%5.2" /end CHARACTERISTIC
/begin CHARACTERISTIC AC_V_DIS_AC_PRES_LO "ac low press disable" VALUE 0x0002038C __SWORD_S 0 u_kPa_4096n_4096p -4096 4095.875 FORMAT "%5.2" /end CHARACTERISTIC
/begin CHARACTERISTIC AC_V_DIS_AC_PRES_LO_HYS "ac low press disable hys" VALUE 0x0002038C __SWORD_S 0 u_kPa_4096n_4096p -4096 4095.875 FORMAT "%5.2" /end CHARACTERISTIC
/begin CHARACTERISTIC AC_V_TRSM_UP_KP_DUR "gear shift up keep duration" VALUE 0x0002038C __UWORD_S 0 u_8x_tmr 0.0 4095.9375 FORMAT "%5.2" /end CHARACTERISTIC
/begin CHARACTERISTIC AC_V_TRSM_DWN_KP_DUR "gear down up keep duration" VALUE 0x0002038C __UWORD_S 0 u_8x_tmr 0.0 4095.9375 FORMAT "%5.2" /end CHARACTERISTIC
/begin CHARACTERISTIC AC_V_EN_HRST_RUN_MIN "ac enable hot restart run min" VALUE 0x0002038C __UWORD_S 0 u_1s_tmr 0.0 65535 /end CHARACTERISTIC
/begin CHARACTERISTIC AC_C_EN_RUN_MIN "fan key off run pwm" CURVE 0x000200B0 __UWORD_S 0 u_1s_tmr 0.0 65535 SYMBOL_LINK "AC_C_EN_RUN_MIN" 2
 /begin AXIS_DESCR FIX_AXIS sys_ect u_deg_C 8 -40 128 /begin FIX_AXIS_PAR_LIST -5120 -2048 1024 4096 7168 10240 13312 16384 /end FIX_AXIS_PAR_LIST /end AXIS_DESCR
/end CHARACTERISTIC
/begin CHARACTERISTIC AC_V_EN_OFF_MIN "ac enable condition of ac off time min" VALUE 0x0002038C __UWORD_S 0 u_8x_tmr 0.0 4095.9375 FORMAT "%5.2" /end CHARACTERISTIC
/begin CHARACTERISTIC AC_C_OFF_DLY "ac off delay" CURVE 0x000200B0 __UWORD_S 0 u_8x_tmr 0.0 4095.9375 FORMAT "%5.2" SYMBOL_LINK "AC_C_OFF_DLY" 2
 /begin AXIS_DESCR FIX_AXIS sys_eng_spd u_espd 11 0.0 8191.875 /begin FIX_AXIS_PAR_LIST 0 3200 6400 9600 12800 16000 19200 22400 25600 28800 32000 /end FIX_AXIS_PAR_LIST /end AXIS_DESCR
/end CHARACTERISTIC
/begin CHARACTERISTIC AC_C_OFF_DLY_IAT_FAC "ac off delay iat factor" CURVE 0x000200B0 __UWORD_S 0 u_fac_2 0.0 1.999969482421875 FORMAT "%4.3" SYMBOL_LINK "AC_C_OFF_DLY_FAC" 2
 /begin AXIS_DESCR FIX_AXIS sys_iat u_deg_C 11 -20 80 /begin FIX_AXIS_PAR_LIST -2560 -1280 0 1280 2560 3840 5120 6400 7680 8960 10240 /end FIX_AXIS_PAR_LIST /end AXIS_DESCR
/end CHARACTERISTIC
/begin CHARACTERISTIC AC_C_OFF_DLY_AC_P_FAC "ac off delay ac press factor" CURVE 0x000200B0 __UWORD_S 0 u_fac_2 0.0 1.999969482421875 FORMAT "%4.3" SYMBOL_LINK "AC_C_OFF_DLY_FAC" 2
 /begin AXIS_DESCR FIX_AXIS sys_iat u_kPa_4096n_4096p 11 0 4095.875 /begin FIX_AXIS_PAR_LIST 0 2400 4800 7200 9600 12000 14400 16800 19200 21600 24000 /end FIX_AXIS_PAR_LIST /end AXIS_DESCR
/end CHARACTERISTIC
/begin CHARACTERISTIC AC_C_ON_DLY_IAT_FAC "ac off delay iat factor" CURVE 0x000200B0 __UWORD_S 0 u_fac_2 0.0 1.999969482421875 FORMAT "%4.3" SYMBOL_LINK "AC_C_ON_DLY_FAC" 2
 /begin AXIS_DESCR FIX_AXIS sys_iat u_deg_C 11 -20 80 /begin FIX_AXIS_PAR_LIST -2560 -1280 0 1280 2560 3840 5120 6400 7680 8960 10240 /end FIX_AXIS_PAR_LIST /end AXIS_DESCR
/end CHARACTERISTIC
/begin CHARACTERISTIC AC_C_ON_DLY_AC_P_FAC "ac off delay ac press factor" CURVE 0x000200B0 __UWORD_S 0 u_fac_2 0.0 1.999969482421875 FORMAT "%4.3" SYMBOL_LINK "AC_C_ON_DLY_FAC" 2
 /begin AXIS_DESCR FIX_AXIS sys_iat u_kPa_4096n_4096p 11 0 4095.875 /begin FIX_AXIS_PAR_LIST 0 2400 4800 7200 9600 12000 14400 16800 19200 21600 24000 /end FIX_AXIS_PAR_LIST /end AXIS_DESCR
/end CHARACTERISTIC
/begin CHARACTERISTIC AC_V_DIS_ACC_DUR "max duration AC can be disable when large pps delta acceleration" VALUE 0x0002038C __UWORD_S 0 u_8x_tmr 0.0 4095.9375 FORMAT "%5.1" /end CHARACTERISTIC
/begin CHARACTERISTIC AC_V_DIS_ACC_PPS_HI_THR "pps threshold above which AC can be disable when large pps delta acceleration" VALUE 0x0002038C __UWORD_S 0 u_pct 0.0 199.996948 /end CHARACTERISTIC
/begin CHARACTERISTIC AC_V_DIS_ACC_PPS_DLT_MIN "min pps delta in 125ms threshold AC can be disable when large pps delta acceleration" VALUE 0x0002038C __UWORD_S 0 u_pct 0.0 199.996948 /end CHARACTERISTIC
/begin CHARACTERISTIC AC_V_DIS_ACC_ESPD_MAX "max engine speed threshold AC can be disable when large pps delta acceleration" VALUE 0x0002038C __UWORD_S 0 u_espd 0.0 8191.875 FORMAT "%5.1" /end CHARACTERISTIC
/begin CHARACTERISTIC AC_V_DIS_ACC_VSPD_MAX "max vehicle speed threshold AC can be disable when large pps delta acceleration" VALUE 0x0002038C __UWORD_S 0 u_vspd 0.0 511.9921875 /end CHARACTERISTIC
/begin CHARACTERISTIC AC_V_DIS_ACC_PPS_LO_THR "pps threshold above which AC can be extra disable after large pps delta acceleration" VALUE 0x0002038C __UWORD_S 0 u_pct 0.0 199.996948 /end CHARACTERISTIC
/begin CHARACTERISTIC AC_V_DIS_ACC_EXTRA_DUR "extra duration AC can be disable after large pps delta acceleration" VALUE 0x0002038C __UWORD_S 0 u_8x_tmr 0.0 4095.9375 FORMAT "%5.1" /end CHARACTERISTIC
/begin CHARACTERISTIC AC_C_ON_DLY "ac on delay" CURVE 0x000200B0 __UWORD_S 0 u_8x_tmr 0.0 4095.9375 FORMAT "%5.2" SYMBOL_LINK "AC_C_ON_DLY" 2
 /begin AXIS_DESCR FIX_AXIS sys_eng_spd u_espd 11 0.0 8191.875 /begin FIX_AXIS_PAR_LIST 0 3200 6400 9600 12800 16000 19200 22400 25600 28800 32000 /end FIX_AXIS_PAR_LIST /end AXIS_DESCR
/end CHARACTERISTIC
/begin CHARACTERISTIC MF_V_CRK_DUR_CFG "misfire calculate seg config" VALUE 0x0002038C __UBYTE_S 0 u_mf_crk_typ 0 1 FORMAT "%1.0" /end CHARACTERISTIC
/begin CHARACTERISTIC MF_V_DTC_CFG "misfire DTC config" VALUE 0x0002038C __UBYTE_S 0 u_mf_dtc_typ 0 1 FORMAT "%1.0" /end CHARACTERISTIC
/begin CHARACTERISTIC MF_V_TRNS_COND_CFG "misfire transient condition determine config" VALUE 0x0002038C __UBYTE_S 0 u_mf_trs_cfg 0 1 FORMAT "%1.0" /end CHARACTERISTIC
/begin CHARACTERISTIC MF_V_TRNS_POS_THR "positive transient condition thr" VALUE 0x0002038C __UBYTE_S 0 u_cnts 0 255 /end CHARACTERISTIC
/begin CHARACTERISTIC MF_V_TRNS_NEG_THR "negtive transient condition thr" VALUE 0x0002038C __UBYTE_S 0 u_cnts 0 255 /end CHARACTERISTIC
/begin CHARACTERISTIC MF_V_TRNS_COMP_EN "misfire transient condition compensation enable" VALUE 0x0002038C __UBYTE_S 0 b_true 0 1 FORMAT "%1.0" /end CHARACTERISTIC
/begin CHARACTERISTIC MF_V_NEG_THRT_TRQ_FAC "misfire negtive torq,torq mode factor caused by low throttle" VALUE 0x0002038C __UWORD_S 0 u_fac_2 0 1.999969482421875 FORMAT "%4.3" /end CHARACTERISTIC
/begin CHARACTERISTIC MF_V_NEG_THRT_ACC_FAC "misfire negtive torq,acc mode factor caused by low throttle" VALUE 0x0002038C __UWORD_S 0 u_fac_2 0 1.999969482421875 FORMAT "%4.3" /end CHARACTERISTIC
/begin CHARACTERISTIC MF_V_THRT_CHG_TRQ_FAC "misfire throttle change,torq mode factor" VALUE 0x0002038C __UWORD_S 0 u_fac_2 0 1.999969482421875 FORMAT "%4.3" /end CHARACTERISTIC
/begin CHARACTERISTIC MF_V_THRT_CHG_ACC_FAC "misfire throttle change,acc mode factor" VALUE 0x0002038C __UWORD_S 0 u_fac_2 0 1.999969482421875 FORMAT "%4.3" /end CHARACTERISTIC
/begin CHARACTERISTIC MF_V_NEG_THRT_FAC_DUR "low throttle negtive torq factor duration" VALUE 0x0002038C __UWORD_S 0 u_cnts 0 65535 FORMAT "%5.0" /end CHARACTERISTIC
/begin CHARACTERISTIC MF_V_THRT_CHG_FAC_DUR "throttle change factor duration" VALUE 0x0002038C __UWORD_S 0 u_cnts 0 65535 FORMAT "%5.0" /end CHARACTERISTIC
/begin CHARACTERISTIC MF_V_POS_TRQ_FAC "misfire positive torq,torq mode factor" VALUE 0x0002038C __UWORD_S 0 u_fac_2 0 1.999969482421875 FORMAT "%4.3" /end CHARACTERISTIC
/begin CHARACTERISTIC MF_V_POS_ACC_FAC "misfire positive torq,acc mode factor" VALUE 0x0002038C __UWORD_S 0 u_fac_2 0 1.999969482421875 FORMAT "%4.3" /end CHARACTERISTIC
/begin CHARACTERISTIC MF_V_POS_FAC_DUR "positive torq factor duration" VALUE 0x0002038C __UWORD_S 0 u_cnts 0 65535 FORMAT "%5.0" /end CHARACTERISTIC
/begin CHARACTERISTIC MF_V_NEG_TRQ_FAC "misfire negtive torq,torq mode factor" VALUE 0x0002038C __UWORD_S 0 u_fac_2 0 1.999969482421875 FORMAT "%4.3" /end CHARACTERISTIC
/begin CHARACTERISTIC MF_V_NEG_ACC_FAC "misfire negtive torq,acc mode factor" VALUE 0x0002038C __UWORD_S 0 u_fac_2 0 1.999969482421875 FORMAT "%4.3" /end CHARACTERISTIC
/begin CHARACTERISTIC MF_V_NEG_FAC_DUR "negtive torq factor duration" VALUE 0x0002038C __UWORD_S 0 u_cnts 0 65535 FORMAT "%5.0" /end CHARACTERISTIC
/begin CHARACTERISTIC MF_V_AC_TRQ_FAC "misfire AC change,torq mode factor" VALUE 0x0002038C __UWORD_S 0 u_fac_2 0 1.999969482421875 FORMAT "%4.3" /end CHARACTERISTIC
/begin CHARACTERISTIC MF_V_AC_ACC_FAC "misfire AC change,acc mode factor" VALUE 0x0002038C __UWORD_S 0 u_fac_2 0 1.999969482421875 FORMAT "%4.3" /end CHARACTERISTIC
/begin CHARACTERISTIC MF_V_AC_FAC_DUR "AC change factor duration" VALUE 0x0002038C __UWORD_S 0 u_cnts 0 65535 FORMAT "%5.0" /end CHARACTERISTIC
/begin CHARACTERISTIC MF_V_CLTCH_TRQ_FAC "misfire clutch change,torq mode factor" VALUE 0x0002038C __UWORD_S 0 u_fac_2 0 1.999969482421875 FORMAT "%4.3" /end CHARACTERISTIC
/begin CHARACTERISTIC MF_V_CLTCH_ACC_FAC "misfire clutch change,acc mode factor" VALUE 0x0002038C __UWORD_S 0 u_fac_2 0 1.999969482421875 FORMAT "%4.3" /end CHARACTERISTIC
/begin CHARACTERISTIC MF_V_CLTCH_FAC_DUR "clutch change factor duration" VALUE 0x0002038C __UWORD_S 0 u_cnts 0 65535 FORMAT "%5.0" /end CHARACTERISTIC
/begin CHARACTERISTIC MF_V_SHFT_TRQ_FAC "misfire trans shift,torq mode factor" VALUE 0x0002038C __UWORD_S 0 u_fac_2 0 1.999969482421875 FORMAT "%4.3" /end CHARACTERISTIC
/begin CHARACTERISTIC MF_V_SHFT_ACC_FAC "misfire trans shift,acc mode factor" VALUE 0x0002038C __UWORD_S 0 u_fac_2 0 1.999969482421875 FORMAT "%4.3" /end CHARACTERISTIC
/begin CHARACTERISTIC MF_V_SHFT_FAC_DUR "trans shift factor duration" VALUE 0x0002038C __UWORD_S 0 u_cnts 0 65535 FORMAT "%5.0" /end CHARACTERISTIC
/begin CHARACTERISTIC MF_V_POWON_ACC_FAC "misfire power on,acc mode factor" VALUE 0x0002038C __UWORD_S 0 u_fac_2 0 1.999969482421875 FORMAT "%4.3" /end CHARACTERISTIC
/begin CHARACTERISTIC MF_V_POWON_TRQ_FAC "misfire power on,torq mode factor" VALUE 0x0002038C __UWORD_S 0 u_fac_2 0 1.999969482421875 FORMAT "%4.3" /end CHARACTERISTIC
/begin CHARACTERISTIC MF_V_POWON_FAC_DUR "power on factor duration" VALUE 0x0002038C __UWORD_S 0 u_cnts 0 65535 FORMAT "%5.0" /end CHARACTERISTIC
/begin CHARACTERISTIC MF_V_TC_FAC_EN_LD "torq converter factor enable load min" VALUE 0x0002038C __UWORD_S 0 u_pct_1 0 99.9984741210937 FORMAT "%4.2" /end CHARACTERISTIC
/begin CHARACTERISTIC MF_V_TC_FAC_VSPD "torq converter factor vehicle speed thr" VALUE 0x0002038C __UWORD_S 0 u_vspd 0 511.9921875 FORMAT "%4.1" /end CHARACTERISTIC
/begin CHARACTERISTIC MF_V_TC_TRQ_HI_FAC "torq converter active,high vehicle speed torq mode factor" VALUE 0x0002038C __UWORD_S 0 u_fac_2 0 1.999969482421875 FORMAT "%4.3" /end CHARACTERISTIC
/begin CHARACTERISTIC MF_V_TC_ACC_HI_FAC "torq converter active,high vehicle speed acc mode factor" VALUE 0x0002038C __UWORD_S 0 u_fac_2 0 1.999969482421875 FORMAT "%4.3" /end CHARACTERISTIC
/begin CHARACTERISTIC MF_V_TC_TRQ_LO_FAC "torq converter active,low vehicle speed torq mode factor" VALUE 0x0002038C __UWORD_S 0 u_fac_2 0 1.999969482421875 FORMAT "%4.3" /end CHARACTERISTIC
/begin CHARACTERISTIC MF_V_TC_ACC_LO_FAC "torq converter active,low vehicle speed acc mode factor" VALUE 0x0002038C __UWORD_S 0 u_fac_2 0 1.999969482421875 FORMAT "%4.3" /end CHARACTERISTIC
/begin CHARACTERISTIC MF_V_TC_FAC_ACTV_DTY "torq converter factor active duty min" VALUE 0x0002038C __UWORD_S 0 u_pct 0 199.996948 FORMAT "%4.1" /end CHARACTERISTIC
/begin CHARACTERISTIC MF_V_TC_FAC_DUR "torq converter factor duration" VALUE 0x0002038C __UWORD_S 0 u_cnts 0 65535 FORMAT "%5.0" /end CHARACTERISTIC
/begin CHARACTERISTIC MF_M_CRKL_ACC_FAC "crank tooth not learn acc mode factor,when vehicle in plant" MAP 0x00020320 __UWORD_S 0 u_fac_2 0 1.999969482421875 FORMAT "%4.3" SYMBOL_LINK "MF_M_CRKL_ACC_FAC" 4
 /begin AXIS_DESCR FIX_AXIS sys_eng_spd u_espd 21 400 6500
  /begin FIX_AXIS_PAR_LIST 3200 4800 6400 8000 9600 11200 12800 14400 16000 17600 19200 20800 22400 24000 28000 32000 36000 40000 44000 48000 52000 /end FIX_AXIS_PAR_LIST
 /end AXIS_DESCR
 /begin AXIS_DESCR FIX_AXIS sys_map u_kPa_0_256 7 50 110 /begin FIX_AXIS_PAR_LIST 12800 15360 17920 20480 23040 25600 28160 /end FIX_AXIS_PAR_LIST /end AXIS_DESCR
/end CHARACTERISTIC
/begin CHARACTERISTIC MF_V_CRKL_FAC_DUR "crank tooth learn factor duration" VALUE 0x0002038C __UWORD_S 0 u_cnts 0 65535 FORMAT "%5.0" /end CHARACTERISTIC
/begin CHARACTERISTIC MF_M_TC_UNLCK_TRQ_FAC "torq converter unlock torq mode factor" MAP 0x00020320 __UBYTE_S 0 u_fac_2_b 0 1.9921875 FORMAT "%4.3" SYMBOL_LINK "MF_M_TC_UNLCK_TRQ_FAC" 3
 /begin AXIS_DESCR FIX_AXIS sys_eng_spd u_espd 16 600 4500
  /begin FIX_AXIS_PAR_LIST 4800 6400 8000 9600 11200 12800 14400 16000 17600 19200 20800 22400 24000 28000 32000 36000 /end FIX_AXIS_PAR_LIST
 /end AXIS_DESCR
 /begin AXIS_DESCR FIX_AXIS mf_eng_load u_pct_1 17 0 100
  /begin FIX_AXIS_PAR_LIST 0 4096 8192 12288 16384 20480 24576 28672 32768 36864 40960 45056 49152 53248 57344 61440 65535 /end FIX_AXIS_PAR_LIST
 /end AXIS_DESCR
/end CHARACTERISTIC
/begin CHARACTERISTIC MF_M_TC_UNLCK_ACC_FAC "torq converter unlock acc mode factor" MAP 0x00020320 __UBYTE_S 0 u_fac_2_b 0 1.9921875 FORMAT "%4.3" SYMBOL_LINK "MF_M_TC_UNLCK_ACC_FAC" 3
 /begin AXIS_DESCR FIX_AXIS sys_eng_spd u_espd 16 600 4500
  /begin FIX_AXIS_PAR_LIST 4800 6400 8000 9600 11200 12800 14400 16000 17600 19200 20800 22400 24000 28000 32000 36000 /end FIX_AXIS_PAR_LIST
 /end AXIS_DESCR
 /begin AXIS_DESCR FIX_AXIS mf_eng_load u_pct_1 17 0 100
  /begin FIX_AXIS_PAR_LIST 0 4096 8192 12288 16384 20480 24576 28672 32768 36864 40960 45056 49152 53248 57344 61440 65535 /end FIX_AXIS_PAR_LIST
 /end AXIS_DESCR
/end CHARACTERISTIC
/begin CHARACTERISTIC MF_V_TC_UNLCK_FAC_DUR "torq converter unlock factor duration" VALUE 0x0002038C __UWORD_S 0 u_cnts 0 65535 FORMAT "%5.0" /end CHARACTERISTIC
/begin CHARACTERISTIC MF_V_STK_FLW_MAX "stroke airflow max for load percent calculation" VALUE 0x0002038C __UWORD_S 0 u_stk_flw 0 1.99996948242187 /end CHARACTERISTIC
/begin CHARACTERISTIC MF_V_LD_FIL "misfore load filter" VALUE 0x2886C __UWORD_S 0 u_filter 0 0.9999847412109375 FORMAT "%10.9" /end CHARACTERISTIC
/begin CHARACTERISTIC MF_V_DLY_POW_ON "misfire diag enable power on delay" VALUE 0x0002038C __UWORD_S 0 u_cnts 0 65535 FORMAT "%5.0" /end CHARACTERISTIC
/begin CHARACTERISTIC MF_V_DLY_ENG_SYN "misfire diag enable engine resynchronization delay" VALUE 0x0002038C __UBYTE_S 0 u_cnts 0 255 /end CHARACTERISTIC
/begin CHARACTERISTIC MF_V_DLY_OTHER_DIAG "misfire diag enable other diag active delay" VALUE 0x0002038C __UWORD_S 0 u_cnts 0 65535 FORMAT "%5.0" /end CHARACTERISTIC
/begin CHARACTERISTIC MF_V_DLY_MISC "misfire diag enable misc delay" VALUE 0x0002038C __UWORD_S 0 u_cnts 0 65535 FORMAT "%5.0" /end CHARACTERISTIC
/begin CHARACTERISTIC MF_V_DLY_BYPASS_TM "misfire diag delay bypass runtime max" VALUE 0x0002038C __UWORD_S 0 u_1s_tmr 0 65535 /end CHARACTERISTIC
/begin CHARACTERISTIC MF_V_EN_VLT_MIN "diag enable battery voltage min" VALUE 0x0002038C __UWORD_S 0 u_volt_32 0 31.99951171875 FORMAT "%4.2" /end CHARACTERISTIC
/begin CHARACTERISTIC MF_V_EN_VLT_MAX "diag enable battery voltage max" VALUE 0x0002038C __UWORD_S 0 u_volt_32 0 31.99951171875 FORMAT "%4.2" /end CHARACTERISTIC
/begin CHARACTERISTIC MF_V_EN_ESPD_MIN "diag enable engine speed min" VALUE 0x0002038C __UWORD_S 0 u_volt_32 0 31.99951171875 FORMAT "%4.2" /end CHARACTERISTIC
/begin CHARACTERISTIC MF_V_EN_ESPD_MAX "diag enable engine speed max" VALUE 0x0002038C __UWORD_S 0 u_volt_32 0 31.99951171875 FORMAT "%4.2" /end CHARACTERISTIC
/begin CHARACTERISTIC MF_V_EN_ECT_MAX "diag enable engine speed max" VALUE 0x0002038C __SWORD_S 0 u_deg_C -256 255.9921875 /end CHARACTERISTIC
/begin CHARACTERISTIC MF_V_EN_ECT_MIN "diag enable engine speed min" VALUE 0x0002038C __SWORD_S 0 u_deg_C -256 255.9921875 /end CHARACTERISTIC
/begin CHARACTERISTIC MF_V_CLD_STRT_KEYON_ECT "cold start keyon ect thr" VALUE 0x0002038C __SWORD_S 0 u_deg_C -256 255.9921875 /end CHARACTERISTIC
/begin CHARACTERISTIC MF_V_EN_CLD_STRT_ECT_MIN "cold start diag enable ect min" VALUE 0x0002038C __SWORD_S 0 u_deg_C -256 255.9921875 /end CHARACTERISTIC
/begin CHARACTERISTIC MF_V_DLY_TC_UNLOCK "misfire diag enable torq converter unlock delay" VALUE 0x0002038C __UWORD_S 0 u_cnts 0 65535 FORMAT "%5.0" /end CHARACTERISTIC
/begin CHARACTERISTIC MF_V_DLY_LO_FUEL "misfire diag enable low fuel level delay" VALUE 0x0002038C __UWORD_S 0 u_cnts 0 65535 FORMAT "%5.0" /end CHARACTERISTIC
/begin CHARACTERISTIC MF_V_EN_FLV_MIN "misfire diag enable fuel level min" VALUE 0x0002038C __UWORD_S 0 u_pct_1 0 99.9984741210937 FORMAT "%4.2" /end CHARACTERISTIC
/begin CHARACTERISTIC MF_V_DLY_NEG_THRT "misfire diag enable throttle low negtive torq delay" VALUE 0x0002038C __UWORD_S 0 u_cnts 0 65535 FORMAT "%5.0" /end CHARACTERISTIC
/begin CHARACTERISTIC MF_V_NEG_TRQ_TPS "low throttle negtive torq tps thr" VALUE 0x0002038C __UWORD_S 0 u_pct 0 199.996948 FORMAT "%4.2" /end CHARACTERISTIC
/begin CHARACTERISTIC MF_V_NEG_TRQ_VSPD "low throttle negtive torq vehicle speed thr" VALUE 0x0002038C __UWORD_S 0 u_vspd 0 511.9921875 FORMAT "%4.1" /end CHARACTERISTIC
/begin CHARACTERISTIC MF_V_DLY_THRT_CHG "misfire diag enable throttle change delay" VALUE 0x0002038C __UWORD_S 0 u_cnts 0 65535 FORMAT "%5.0" /end CHARACTERISTIC
/begin CHARACTERISTIC MF_V_THRT_CHG_INC_THR "throttle change increase thr" VALUE 0x0002038C __UWORD_S 0 u_pct 0 199.996948 FORMAT "%4.2" /end CHARACTERISTIC
/begin CHARACTERISTIC MF_V_THRT_CHG_DEC_THR "throttle change decrease thr" VALUE 0x0002038C __UWORD_S 0 u_pct 0 199.996948 FORMAT "%4.2" /end CHARACTERISTIC
/begin CHARACTERISTIC MF_V_DLY_POS_TRNS "misfire diag enable positive torq trans delay" VALUE 0x0002038C __UWORD_S 0 u_cnts 0 65535 FORMAT "%5.0" /end CHARACTERISTIC
/begin CHARACTERISTIC MF_V_DLY_NEG_TRNS "misfire diag enable negtive torq trans delay" VALUE 0x0002038C __UWORD_S 0 u_cnts 0 65535 FORMAT "%5.0" /end CHARACTERISTIC
/begin CHARACTERISTIC MF_M_ZERO_TRQ "zero torq load" MAP 0x00020320 __UWORD_S 0 u_pct_1 0 99.9984741210937 FORMAT "%4.2" SYMBOL_LINK "MF_M_ZERO_TRQ" 4
 /begin AXIS_DESCR FIX_AXIS sys_eng_spd u_espd 21 400 6500
  /begin FIX_AXIS_PAR_LIST 3200 4800 6400 8000 9600 11200 12800 14400 16000 17600 19200 20800 22400 24000 28000 32000 36000 40000 44000 48000 52000 /end FIX_AXIS_PAR_LIST
 /end AXIS_DESCR
 /begin AXIS_DESCR FIX_AXIS sys_amp u_kPa_0_256 7 50 110 /begin FIX_AXIS_PAR_LIST 12800 15360 17920 20480 23040 25600 28160 /end FIX_AXIS_PAR_LIST /end AXIS_DESCR
/end CHARACTERISTIC
/begin CHARACTERISTIC MF_C_ZERO_TRQ_ECT_FAC "zero torq load ect factor" CURVE 0x000200B0 __UWORD_S 0 u_fac_4 0 3.99993896484375 FORMAT "%4.3" SYMBOL_LINK "MF_C_ZERO_TRQ_ECT_FAC" 2
 /begin AXIS_DESCR FIX_AXIS sys_ect u_deg_C 17 -40 152
  /begin FIX_AXIS_PAR_LIST -5120 -3584 -2048 -512 1024 2560 4096 5632 7168 8704 10240 11776 13312 14848 16384 17920 19456 /end FIX_AXIS_PAR_LIST
 /end AXIS_DESCR
/end CHARACTERISTIC
/begin CHARACTERISTIC MF_V_DLY_ZERO_TRQ "misfire diag enable below zero torq delay" VALUE 0x0002038C __UWORD_S 0 u_cnts 0 65535 FORMAT "%5.0" /end CHARACTERISTIC
/begin CHARACTERISTIC MF_V_DLY_AC_CHG "misfire diag enable AC change delay" VALUE 0x0002038C __UWORD_S 0 u_cnts 0 65535 FORMAT "%5.0" /end CHARACTERISTIC
/begin CHARACTERISTIC MF_V_DLY_TRNS_SHFT "misfire diag enable trans shift delay" VALUE 0x0002038C __UWORD_S 0 u_cnts 0 65535 FORMAT "%5.0" /end CHARACTERISTIC
/begin CHARACTERISTIC MF_V_SHFT_DLY_EN_TPS "trans shift delay enable tps min" VALUE 0x0002038C __UWORD_S 0 u_pct 0 199.996948 FORMAT "%4.2" /end CHARACTERISTIC
/begin CHARACTERISTIC MF_V_DLY_FUEL_CUT "misfire diag enable fuel cut delay" VALUE 0x0002038C __UWORD_S 0 u_cnts 0 65535 FORMAT "%5.0" /end CHARACTERISTIC
/begin CHARACTERISTIC MF_V_DLY_HI_ESPD "misfire diag enable engine speed high delay" VALUE 0x0002038C __UWORD_S 0 u_cnts 0 65535 FORMAT "%5.0" /end CHARACTERISTIC
/begin CHARACTERISTIC MF_V_HI_ESPD_THR "misfire diag disable engine speed high thr" VALUE 0x0002038C __UWORD_S 0 u_espd 0 8191.875 FORMAT "%5.1" /end CHARACTERISTIC
/begin CHARACTERISTIC MF_V_DLY_IG_EFF_CHG "misfire diag enable ignition effective change delay" VALUE 0x0002038C __UWORD_S 0 u_cnts 0 65535 FORMAT "%5.0" /end CHARACTERISTIC
/begin CHARACTERISTIC MF_V_IG_EFF_DLT_THR "ignition effective change delta thr" VALUE 0x0002038C __UWORD_S 0 u_pct 0 199.996948 FORMAT "%4.2" /end CHARACTERISTIC
/begin CHARACTERISTIC MF_V_OPS_CYL_MD_EN "misfire opposing cylinder mode enable" VALUE 0x0002038C __UBYTE_S 0 b_true 0 1 FORMAT "%1.0" /end CHARACTERISTIC
/begin CHARACTERISTIC MF_V_ADJ_CYL_MD_EN "misfire adjacent cylinder mode enable" VALUE 0x0002038C __UBYTE_S 0 b_true 0 1 FORMAT "%1.0" /end CHARACTERISTIC
/begin CHARACTERISTIC MF_V_STRT_THR_FAC_EN "use start emission damage thr factor" VALUE 0x0002038C __UBYTE_S 0 b_true 0 1 FORMAT "%1.0" /end CHARACTERISTIC
/begin CHARACTERISTIC MF_V_STRT_THR_FAC_DUR "start emission damage thr factor duration" VALUE 0x0002038C __UWORD_S 0 u_cnts 0 65535 FORMAT "%5.0" /end CHARACTERISTIC
/begin CHARACTERISTIC MF_M_ACC_THR "acc mode misfire thr" MAP 0x00020320 __ULONG_S 0 u_cnts 0 4294967295 FORMAT "%10.0" SYMBOL_LINK "MF_M_ACC_THR" 4
 /begin AXIS_DESCR FIX_AXIS sys_eng_spd u_espd 22 400 7000
  /begin FIX_AXIS_PAR_LIST 3200 4800 6400 8000 9600 11200 12800 14400 16000 17600 19200 20800 22400 24000 28000 32000 36000 40000 44000 48000 52000 56000 /end FIX_AXIS_PAR_LIST
 /end AXIS_DESCR
 /begin AXIS_DESCR FIX_AXIS mf_eng_load u_pct_1 17 0 100
  /begin FIX_AXIS_PAR_LIST 0 4096 8192 12288 16384 20480 24576 28672 32768 36864 40960 45056 49152 53248 57344 61440 65535 /end FIX_AXIS_PAR_LIST
 /end AXIS_DESCR
/end CHARACTERISTIC
/begin CHARACTERISTIC MF_M_TRQ_THR "torq mode misfire thr" MAP 0x00020320 __ULONG_S 0 u_cnts 0 4294967295 FORMAT "%10.0" SYMBOL_LINK "MF_M_TRQ_THR" 4
 /begin AXIS_DESCR FIX_AXIS sys_eng_spd u_espd 22 400 7000
  /begin FIX_AXIS_PAR_LIST 3200 4800 6400 8000 9600 11200 12800 14400 16000 17600 19200 20800 22400 24000 28000 32000 36000 40000 44000 48000 52000 56000 /end FIX_AXIS_PAR_LIST
 /end AXIS_DESCR
 /begin AXIS_DESCR FIX_AXIS mf_eng_load u_pct_1 17 0 100
  /begin FIX_AXIS_PAR_LIST 0 4096 8192 12288 16384 20480 24576 28672 32768 36864 40960 45056 49152 53248 57344 61440 65535 /end FIX_AXIS_PAR_LIST
 /end AXIS_DESCR
/end CHARACTERISTIC
/begin CHARACTERISTIC MF_V_BYPASS_CRKL_ESPD "if crank not learned, factor can be bypassed engine speed max" VALUE 0x0002038C __UWORD_S 0 u_espd 0 8191.875 FORMAT "%5.1" /end CHARACTERISTIC
/begin CHARACTERISTIC MF_V_DET_TMS_MIN "misfire exceed detective thr times to confirm misfire" VALUE 0x0002038C __UBYTE_S 0 u_cnts 0 255 /end CHARACTERISTIC
/begin CHARACTERISTIC MF_V_NO_DET_TMS_MIN "no misfire detected times to rest detect times" VALUE 0x0002038C __UBYTE_S 0 u_cnts 0 255 /end CHARACTERISTIC
/begin CHARACTERISTIC MF_M_OPS_CYL_THR "opposing cylinder misfire thr" MAP 0x00020320 __UBYTE_S 0 u_cnts 0 255 SYMBOL_LINK "MF_M_OPS_CYL_THR" 3
 /begin AXIS_DESCR FIX_AXIS sys_eng_spd u_espd 13 500 6500
  /begin FIX_AXIS_PAR_LIST 4000 8000 12000 16000 20000 24000 28000 32000 36000 40000 44000 48000 52000 /end FIX_AXIS_PAR_LIST
 /end AXIS_DESCR
 /begin AXIS_DESCR FIX_AXIS mf_eng_load u_pct_1 9 0 100 /begin FIX_AXIS_PAR_LIST 0 8192 16384 24576 32768 40960 49152 57344 65535 /end FIX_AXIS_PAR_LIST /end AXIS_DESCR
/end CHARACTERISTIC
/begin CHARACTERISTIC MF_M_ADJ_CYL_THR "adjacent cylinder misfire thr" MAP 0x00020320 __UBYTE_S 0 u_cnts 0 255 SYMBOL_LINK "MF_M_ADJ_CYL_THR" 3
 /begin AXIS_DESCR FIX_AXIS sys_eng_spd u_espd 13 500 6500
  /begin FIX_AXIS_PAR_LIST 4000 8000 12000 16000 20000 24000 28000 32000 36000 40000 44000 48000 52000 /end FIX_AXIS_PAR_LIST
 /end AXIS_DESCR
 /begin AXIS_DESCR FIX_AXIS mf_eng_load u_pct_1 9 0 100 /begin FIX_AXIS_PAR_LIST 0 8192 16384 24576 32768 40960 49152 57344 65535 /end FIX_AXIS_PAR_LIST /end AXIS_DESCR
/end CHARACTERISTIC
/begin CHARACTERISTIC MF_M_CAT_DMG_THR "cat damage misfire thr" MAP 0x00020320 __UBYTE_S 0 u_cnts 0 255 SYMBOL_LINK "MF_M_CAT_DMG_THR" 3
 /begin AXIS_DESCR FIX_AXIS sys_eng_spd u_espd 13 500 6500
  /begin FIX_AXIS_PAR_LIST 4000 8000 12000 16000 20000 24000 28000 32000 36000 40000 44000 48000 52000 /end FIX_AXIS_PAR_LIST
 /end AXIS_DESCR
 /begin AXIS_DESCR FIX_AXIS mf_eng_load u_pct_1 9 0 100 /begin FIX_AXIS_PAR_LIST 0 8192 16384 24576 32768 40960 49152 57344 65535 /end FIX_AXIS_PAR_LIST /end AXIS_DESCR
/end CHARACTERISTIC
/begin CHARACTERISTIC MF_M_CAT_DMG_BLK "cat damage block thr" MAP 0x00020320 __UBYTE_S 0 u_cnts 0 255 SYMBOL_LINK "MF_M_CAT_DMG_BLK" 3
 /begin AXIS_DESCR FIX_AXIS sys_eng_spd u_espd 8 0 7000 /begin FIX_AXIS_PAR_LIST 0 8000 16000 24000 32000 40000 48000 56000 /end FIX_AXIS_PAR_LIST /end AXIS_DESCR
 /begin AXIS_DESCR FIX_AXIS mf_eng_load u_pct_1 5 0 100 /begin FIX_AXIS_PAR_LIST 0 16384 32768 49152 65535 /end FIX_AXIS_PAR_LIST /end AXIS_DESCR
/end CHARACTERISTIC
/begin CHARACTERISTIC MF_V_EMI_DMG_THR "emission damage misfire thr" VALUE 0x0002038C __UWORD_S 0 u_cnts 0 65535 FORMAT "%5.0" /end CHARACTERISTIC
/begin CHARACTERISTIC MF_V_STRT_THR_FAC "emission damage start misfire thr factor" VALUE 0x0002038C __UWORD_S 0 u_fac_2 0 1.999969482421875 FORMAT "%4.3" /end CHARACTERISTIC
/begin CHARACTERISTIC MF_V_CAT_DMG_CNFM_HYS "cat damage hys added on base thr,when exceed damage is confirmed bypass RR state" VALUE 0x0002038C __UBYTE_S 0 u_cnts 0 255 /end CHARACTERISTIC
/begin CHARACTERISTIC MF_V_EMI_DMG_CNFM_THR "emission damage thr,when exceed damage is confirmed bypass RR state" VALUE 0x0002038C __UBYTE_S 0 u_cnts 0 255 /end CHARACTERISTIC
/begin CHARACTERISTIC MF_V_EMI_DMG_BLK "emission damage block" VALUE 0x0002038C __UBYTE_S 0 u_cnts 0 255 /end CHARACTERISTIC
/begin CHARACTERISTIC MF_V_SPEC_CYL_RT "specific cylinder misfire ratio" VALUE 0x0002038C __UWORD_S 0 u_fac_1 0 0.999984741210937 /end CHARACTERISTIC
/begin CHARACTERISTIC MF_V_EN_AMP_MIN "misfire enable amp" VALUE 0x0002038C __UWORD_S 0 u_kPa_0_256 0 255.99609375 FORMAT "%4.1" /end CHARACTERISTIC
/begin CHARACTERISTIC MF_V_DLY_AMP "misfire diag enable amp low delay" VALUE 0x0002038C __UWORD_S 0 u_cnts 0 65535 FORMAT "%5.0" /end CHARACTERISTIC
/begin CHARACTERISTIC MF_V_DLY_CLTCH_RLS "misfire diag enable cltuch release delay" VALUE 0x0002038C __UWORD_S 0 u_cnts 0 65535 FORMAT "%5.0" /end CHARACTERISTIC
/begin CHARACTERISTIC MF_V_FTP_LD_MAX "misfire FTP load max" VALUE 0x0002038C __UWORD_S 0 u_pct_1 0 99.9984741210937 FORMAT "%4.2" /end CHARACTERISTIC
/begin CHARACTERISTIC MF_V_FTP_ESPD_MAX "misfire FTP engine speed max" VALUE 0x0002038C __UWORD_S 0 u_espd 0 8191.875 FORMAT "%5.1" /end CHARACTERISTIC
/begin CHARACTERISTIC MF_V_FTP_CAT_DMG_BLK "FTP cat damage block" VALUE 0x0002038C __UBYTE_S 0 u_cnts 0 255 /end CHARACTERISTIC
/begin CHARACTERISTIC MF_V_FTP_EMI_DMG_BLK "FTP emission damage block" VALUE 0x0002038C __UBYTE_S 0 u_cnts 0 255 /end CHARACTERISTIC
/begin CHARACTERISTIC MF_V_ZERO_TQ_ESPD_MAX "zero negtive torq active engine speed max at start delay bypass duration" VALUE 0x0002038C __UWORD_S 0 u_espd 0 8191.875 FORMAT "%5.1" /end CHARACTERISTIC
/begin CHARACTERISTIC MF_V_DLY_DIAG_OFF "misfire diag enable off region delay" VALUE 0x0002038C __UWORD_S 0 u_cnts 0 65535 FORMAT "%5.0" /end CHARACTERISTIC
/begin CHARACTERISTIC MF_V_DLY_CAM_SYN "misfire diag enable cam syn error delay" VALUE 0x0002038C __UWORD_S 0 u_cnts 0 65535 FORMAT "%5.0" /end CHARACTERISTIC
/begin CHARACTERISTIC MF_V_CAT_UNLCK_TC_THR "cat damage block thr tp unlock torq converter" VALUE 0x0002038C __UBYTE_S 0 u_cnts 0 255 /end CHARACTERISTIC
/begin CHARACTERISTIC MF_V_EMI_UNLCK_TC_THR "emission damage block thr tp unlock torq converter" VALUE 0x0002038C __UBYTE_S 0 u_cnts 0 255 /end CHARACTERISTIC
/begin CHARACTERISTIC MF_V_TRNS_THR_STRT_FAC "trans thr start factor" VALUE 0x0002038C __UWORD_S 0 u_fac_8 0 7.9998779296875 FORMAT "%3.2" /end CHARACTERISTIC
/begin CHARACTERISTIC MF_V_INIT_EVL_DUR "initial eval duration" VALUE 0x0002038C __UWORD_S 0 u_cnts 0 65535 FORMAT "%5.0" /end CHARACTERISTIC
/begin CHARACTERISTIC TEL_V_EOL_LOG_MAX "end of line log times max" VALUE 0x0002038C __UBYTE_S 0 u_cnts 0 255 /end CHARACTERISTIC
/begin CHARACTERISTIC TEL_V_EOL_EN_TPS_MAX "end of line learn enable throttle max" VALUE 0x0002038C __UWORD_S 0 u_pct 0 199.996948 FORMAT "%4.2" /end CHARACTERISTIC
/begin CHARACTERISTIC TEL_V_EOL_CUT_ESPD "end of line fuel cut off engine speed" VALUE 0x0002038C __UWORD_S 0 u_espd 0 8191.875 FORMAT "%5.1" /end CHARACTERISTIC
/begin CHARACTERISTIC TEL_V_EOL_RCVR_ESPD "end of line fuel recover engine speed" VALUE 0x0002038C __UWORD_S 0 u_espd 0 8191.875 FORMAT "%5.1" /end CHARACTERISTIC
/begin CHARACTERISTIC TEL_V_EOL_EN_VSPD "end of line enable vehicle speed" VALUE 0x0002038C __UWORD_S 0 u_vspd 0 511.9921875 /end CHARACTERISTIC
/begin CHARACTERISTIC TEL_V_EOL_DEC_EXT_ESPD_DLT "end of line deceleration stage exit engine speed increase delta" VALUE 0x0002038C __UWORD_S 0 u_espd 0 8191.875 FORMAT "%5.1" /end CHARACTERISTIC
/begin CHARACTERISTIC TEL_V_DRV_LOG_MAX "in driving learn log times max" VALUE 0x0002038C __UBYTE_S 0 u_cnts 0 255 /end CHARACTERISTIC
/begin CHARACTERISTIC TEL_V_DRV_TYP "in driving learn type" VALUE 0x0002038C __UBYTE_S 0 u_tel_drv_typ 0 3 FORMAT "%1.0" /end CHARACTERISTIC
/begin CHARACTERISTIC TEL_V_DRV_EN_LD_MIN "in driving learn enable load min" VALUE 0x0002038C __UWORD_S 0 u_pct_1 0 99.9984741210937 FORMAT "%4.2" /end CHARACTERISTIC
/begin CHARACTERISTIC TEL_V_DRV_EN_LD_MAX "in driving learn enable load max" VALUE 0x0002038C __UWORD_S 0 u_pct_1 0 99.9984741210937 FORMAT "%4.2" /end CHARACTERISTIC
/begin CHARACTERISTIC TEL_V_DRV_EN_ESPD_MIN "in driving learn enable engine speed min" VALUE 0x0002038C __UWORD_S 0 u_espd 0 8191.875 FORMAT "%5.1" /end CHARACTERISTIC
/begin CHARACTERISTIC TEL_V_DRV_EN_ESPD_MAX "in driving learn enable engine speed max" VALUE 0x0002038C __UWORD_S 0 u_espd 0 8191.875 FORMAT "%5.1" /end CHARACTERISTIC
/begin CHARACTERISTIC TEL_V_DRV_EN_VSPD_MIN "in driving learn enable vehicle speed min" VALUE 0x0002038C __UWORD_S 0 u_vspd 0 511.9921875 /end CHARACTERISTIC
/begin CHARACTERISTIC TEL_C_DRV_EN_GEAR "in driving learn enable gear" CURVE 0x000200B0 __UBYTE_S 0 b_true 0 1 FORMAT "%1.0"
 /begin AXIS_DESCR FIX_AXIS NO_INPUT_QUANTITY u_tq_gr_typ 11 0 10 /begin FIX_AXIS_PAR_LIST 0 1 2 3 4 5 6 7 8 9 10 /end FIX_AXIS_PAR_LIST /end AXIS_DESCR
/end CHARACTERISTIC
/begin CHARACTERISTIC TEL_V_DRV_EN_PUC_DLY "in driving learn fuel cut off delay" VALUE 0x0002038C __UBYTE_S 0 u_cnts 0 255 /end CHARACTERISTIC
/begin CHARACTERISTIC TEL_V_EN_RUN_MIN "learn enable runtime min" VALUE 0x0002038C __UWORD_S 0 u_1s_tmr 0 65535 /end CHARACTERISTIC
/begin CHARACTERISTIC TEL_V_EN_ECT_MIN "learn enable ect min" VALUE 0x0002038C __SWORD_S 0 u_deg_C -256 255.9921875 /end CHARACTERISTIC
/begin CHARACTERISTIC TEL_V_EN_ECT_MAX "learn enable ect max" VALUE 0x0002038C __SWORD_S 0 u_deg_C -256 255.9921875 /end CHARACTERISTIC
/begin CHARACTERISTIC TEL_V_EN_VLT_MIN "learn enable voltage min" VALUE 0x0002038C __UWORD_S 0 u_volt_32 0 31.99951171875 FORMAT "%5.0" /end CHARACTERISTIC
/begin CHARACTERISTIC TEL_V_EN_VLT_MAX "learn enable voltage max" VALUE 0x0002038C __UWORD_S 0 u_volt_32 0 31.99951171875 FORMAT "%5.0" /end CHARACTERISTIC
/begin CHARACTERISTIC TEL_V_DRV_SS_DLT_MAX "steady state in driving learn error delta max" VALUE 0x0002038C __ULONG_S 0 u_cnts 0 4294967295 FORMAT "%10.0" /end CHARACTERISTIC
/begin CHARACTERISTIC TEL_V_DRV_DEV_LRN_EN "in driving learn development enable to allow continue learn" VALUE 0x0002038C __UBYTE_S 0 b_true 0 1 FORMAT "%1.0" /end CHARACTERISTIC
/begin CHARACTERISTIC TEL_V_FAC_VLD_MIN "learn factor valid min" VALUE 0x0002038C __UWORD_S 0 u_fac_2 0 1.999969482421875 FORMAT "%5.4" /end CHARACTERISTIC
/begin CHARACTERISTIC TEL_V_FAC_VLD_MAX "learn factor valid max" VALUE 0x0002038C __UWORD_S 0 u_fac_2 0 1.999969482421875 FORMAT "%5.4" /end CHARACTERISTIC
/begin CHARACTERISTIC TEL_V_FAC_DLT_SUM_MIN "learn factor delta sum valid min" VALUE 0x0002038C __SLONG_S 0 u_fac_2 -2 1.999969482421875 FORMAT "%5.4" /end CHARACTERISTIC
/begin CHARACTERISTIC TEL_V_FAC_DLT_SUM_MAX "learn factor delta sum valid min" VALUE 0x0002038C __SLONG_S 0 u_fac_2 -2 1.999969482421875 FORMAT "%5.4" /end CHARACTERISTIC
/begin CHARACTERISTIC TEL_V_DRV_FAC_FIL "driving learn factor filter when factor is bad" VALUE 0x2886C __UWORD_S 0 u_filter 0 0.9999847412109375 FORMAT "%10.9" /end CHARACTERISTIC
/begin CHARACTERISTIC TEL_V_EOL_EN_ESPD_MAX "end of line learn enable engine speed max" VALUE 0x0002038C __UWORD_S 0 u_espd 0 8191.875 FORMAT "%5.1" /end CHARACTERISTIC
/begin CHARACTERISTIC TEL_V_DRV_ODM_MAX "driving learn enable odometer max" VALUE 0x0002038C __UWORD_S 0 u_km 0 65535 /end CHARACTERISTIC
/begin CHARACTERISTIC TEL_V_DRV_OPS_FAC_DLT "driving learn opposing cylinder factor delta max" VALUE 0x0002038C __UWORD_S 0 u_fac_2 0 1.999969482421875 FORMAT "%5.4" /end CHARACTERISTIC
/begin CHARACTERISTIC TEL_V_DRV_SS1_EN_ESPD_MIN "driving learn steady state area1 enable engine speed min" VALUE 0x0002038C __UWORD_S 0 u_espd 0 8191.875 FORMAT "%5.1" /end CHARACTERISTIC
/begin CHARACTERISTIC TEL_V_DRV_SS1_EN_ESPD_MAX "driving learn steady state area1 enable engine speed max" VALUE 0x0002038C __UWORD_S 0 u_espd 0 8191.875 FORMAT "%5.1" /end CHARACTERISTIC
/begin CHARACTERISTIC TEL_V_DRV_SS2_EN_ESPD_MIN "driving learn steady state area2 enable engine speed min" VALUE 0x0002038C __UWORD_S 0 u_espd 0 8191.875 FORMAT "%5.1" /end CHARACTERISTIC
/begin CHARACTERISTIC TEL_V_DRV_SS2_EN_ESPD_MAX "driving learn steady state area2 enable engine speed max" VALUE 0x0002038C __UWORD_S 0 u_espd 0 8191.875 FORMAT "%5.1" /end CHARACTERISTIC
/begin CHARACTERISTIC TEL_V_DRV_SS_EN_ESPD_DLT "driving learn steady state enable engine speed delta max" VALUE 0x0002038C __UWORD_S 0 u_espd 0 8191.875 FORMAT "%5.1" /end CHARACTERISTIC
/begin CHARACTERISTIC TEL_V_DRV_SS_EN_TPS_DLT "driving learn steady state enable tps delta max" VALUE 0x0002038C __UWORD_S 0 u_pct 0 199.996948 FORMAT "%5.1" /end CHARACTERISTIC
/begin CHARACTERISTIC TEL_V_DRV_SS_EN_DLY "driving learn steady state enable delay" VALUE 0x0002038C __UWORD_S 0 u_16x_tmr 0 8191.875 /end CHARACTERISTIC
/begin CHARACTERISTIC TEL_V_LOG_MIN "learn effective log times min" VALUE 0x0002038C __UBYTE_S 0 u_cnts 0 255 /end CHARACTERISTIC
/begin CHARACTERISTIC CFD_C_AF_LEAN_BIAS "af lean bias" CURVE 0x000200B0 __UWORD_S 0 u_afr 0 31.99951171875 FORMAT "%4.2"
 /begin AXIS_DESCR FIX_AXIS cfd_diag_typ u_cfd_diag_typ 3 0 2 /begin FIX_AXIS_PAR_LIST 0 1 2 /end FIX_AXIS_PAR_LIST /end AXIS_DESCR
/end CHARACTERISTIC
/begin CHARACTERISTIC CFD_C_AF_RICH_BIAS "af rich bias" CURVE 0x000200B0 __UWORD_S 0 u_afr 0 31.99951171875 FORMAT "%4.2"
 /begin AXIS_DESCR FIX_AXIS cfd_diag_typ u_cfd_diag_typ 3 0 2 /begin FIX_AXIS_PAR_LIST 0 1 2 /end FIX_AXIS_PAR_LIST /end AXIS_DESCR
/end CHARACTERISTIC
/begin CHARACTERISTIC CFD_C_AF_LEAN_RMP_STP "af lean ramp step" CURVE 0x000200B0 __UWORD_S 0 u_afr 0 31.99951171875 FORMAT "%4.2"
 /begin AXIS_DESCR FIX_AXIS cfd_diag_typ u_cfd_diag_typ 3 0 2 /begin FIX_AXIS_PAR_LIST 0 1 2 /end FIX_AXIS_PAR_LIST /end AXIS_DESCR
/end CHARACTERISTIC
/begin CHARACTERISTIC CFD_C_AF_RICH_RMP_STP "af rich ramp step" CURVE 0x000200B0 __UWORD_S 0 u_afr 0 31.99951171875 FORMAT "%4.2"
 /begin AXIS_DESCR FIX_AXIS cfd_diag_typ u_cfd_diag_typ 3 0 2 /begin FIX_AXIS_PAR_LIST 0 1 2 /end FIX_AXIS_PAR_LIST /end AXIS_DESCR
/end CHARACTERISTIC
/begin CHARACTERISTIC CFD_C_AF_STG_RMP_STP "af stage change ramp step" CURVE 0x000200B0 __UWORD_S 0 u_afr 0 31.99951171875 FORMAT "%4.2"
 /begin AXIS_DESCR FIX_AXIS cfd_diag_typ u_cfd_diag_typ 3 0 2 /begin FIX_AXIS_PAR_LIST 0 1 2 /end FIX_AXIS_PAR_LIST /end AXIS_DESCR
/end CHARACTERISTIC
/begin CHARACTERISTIC CFD_V_EN_IDL_DLY "diag enable idle delay" VALUE 0x0002038C __UWORD_S 0 u_2x_tmr 0 1023.984375 /end CHARACTERISTIC
/begin CHARACTERISTIC CFD_C_STG1_DUR_MIN "stage1 duration min" CURVE 0x000200B0 __UWORD_S 0 u_2x_tmr 0 1023.984375 FORMAT "%5.2"
 /begin AXIS_DESCR FIX_AXIS cfd_diag_typ u_cfd_diag_typ 3 0 2 /begin FIX_AXIS_PAR_LIST 0 1 2 /end FIX_AXIS_PAR_LIST /end AXIS_DESCR
/end CHARACTERISTIC
/begin CHARACTERISTIC CFD_C_STG1_DUR_MAX "stage1 duration max" CURVE 0x000200B0 __UWORD_S 0 u_2x_tmr 0 1023.984375
 /begin AXIS_DESCR FIX_AXIS cfd_diag_typ u_cfd_diag_typ 3 0 2 /begin FIX_AXIS_PAR_LIST 0 1 2 /end FIX_AXIS_PAR_LIST /end AXIS_DESCR
/end CHARACTERISTIC
/begin CHARACTERISTIC CFD_C_STG2_DUR_MAX "stage2 duration max" CURVE 0x000200B0 __UWORD_S 0 u_2x_tmr 0 1023.984375
 /begin AXIS_DESCR FIX_AXIS cfd_diag_typ u_cfd_diag_typ 3 0 2 /begin FIX_AXIS_PAR_LIST 0 1 2 /end FIX_AXIS_PAR_LIST /end AXIS_DESCR
/end CHARACTERISTIC
/begin CHARACTERISTIC CFD_V_OSC_MAX "osc default" VALUE 0x0002038C __UWORD_S 0 u_millisec_65535 0 65.535 /end CHARACTERISTIC
/begin CHARACTERISTIC CFD_V_RPT_EN_DIAG_MIN "report enable diag run times min" VALUE 0x0002038C __UBYTE_S 0 u_cnts 0 255 /end CHARACTERISTIC
/begin CHARACTERISTIC CFD_V_INIT_TRIP_DIAG_NUM "initial diag numbers per trip before initial diag times reached" VALUE 0x0002038C __UBYTE_S 0 u_cnts 0 255 /end CHARACTERISTIC
/begin CHARACTERISTIC CFD_V_TRIP_DIAG_MAX "max attempt diag numbers per trip" VALUE 0x0002038C __UBYTE_S 0 u_cnts 0 255 /end CHARACTERISTIC
/begin CHARACTERISTIC CFD_V_INIT_DIAG_NUM_MIN "initial diag numbers min" VALUE 0x0002038C __UBYTE_S 0 u_cnts 0 255 /end CHARACTERISTIC
/begin CHARACTERISTIC CFD_C_EN_FLW_MIN "diag enable air flow min" CURVE 0x000200B0 __UWORD_S 0 u_g_per_sec 0 511.9921875
 /begin AXIS_DESCR FIX_AXIS cfd_diag_typ u_cfd_diag_typ 3 0 2 /begin FIX_AXIS_PAR_LIST 0 1 2 /end FIX_AXIS_PAR_LIST /end AXIS_DESCR
/end CHARACTERISTIC
/begin CHARACTERISTIC CFD_C_EN_FLW_MAX "diag enable air flow max" CURVE 0x000200B0 __UWORD_S 0 u_g_per_sec 0 511.9921875
 /begin AXIS_DESCR FIX_AXIS cfd_diag_typ u_cfd_diag_typ 3 0 2 /begin FIX_AXIS_PAR_LIST 0 1 2 /end FIX_AXIS_PAR_LIST /end AXIS_DESCR
/end CHARACTERISTIC
/begin CHARACTERISTIC CFD_V_EN_ECT_MIN "diag enable ect min" VALUE 0x0002038C __SWORD_S 0 u_deg_C -256 255.9921875 /end CHARACTERISTIC
/begin CHARACTERISTIC CFD_V_EN_ECT_MAX "diag enable ect max" VALUE 0x0002038C __SWORD_S 0 u_deg_C -256 255.9921875 /end CHARACTERISTIC
/begin CHARACTERISTIC CFD_V_EN_IAT_MIN "diag enable iat min" VALUE 0x0002038C __SWORD_S 0 u_deg_C -256 255.9921875 /end CHARACTERISTIC
/begin CHARACTERISTIC CFD_V_EN_IAT_MAX "diag enable iat max" VALUE 0x0002038C __SWORD_S 0 u_deg_C -256 255.9921875 /end CHARACTERISTIC
/begin CHARACTERISTIC CFD_V_EN_CAT_T_MAX "diag enable cat temp max" VALUE 0x0002038C __SWORD_S 0 u_deg_C_n2048_p2048 -2048 2047.9375 /end CHARACTERISTIC
/begin CHARACTERISTIC CFD_V_EN_CAT_T_MIN "diag enable cat temp min" VALUE 0x0002038C __SWORD_S 0 u_deg_C_n2048_p2048 -2048 2047.9375 /end CHARACTERISTIC
/begin CHARACTERISTIC CFD_V_EN_IDL_DUR_MAX "diag enable idle duration max" VALUE 0x0002038C __UWORD_S 0 u_2x_tmr 0 1023.984375 /end CHARACTERISTIC
/begin CHARACTERISTIC CFD_V_PRE_FLW_MIN "diag start air flow min" VALUE 0x0002038C __UWORD_S 0 u_g_per_sec 0 511.9921875 /end CHARACTERISTIC
/begin CHARACTERISTIC CFD_V_PRE_FLW_DUR_MIN "diag start pre-airflow duration min" VALUE 0x0002038C __UWORD_S 0 u_2x_tmr 0 1023.984375 /end CHARACTERISTIC
/begin CHARACTERISTIC CFD_V_EN_RUN_MIN "diag enable engine runtime min" VALUE 0x0002038C __UWORD_S 0 u_1s_tmr 0 65535 /end CHARACTERISTIC
/begin CHARACTERISTIC CFD_C_FAIL_OSC_THR "diag fail osc thr" CURVE 0x000200B0 __UWORD_S 0 u_millisec_65535 0 65.535
 /begin AXIS_DESCR FIX_AXIS NO_INPUT_QUANTITY u_cfd_fail 2 0 1 /begin FIX_AXIS_PAR_LIST 0 1 /end FIX_AXIS_PAR_LIST /end AXIS_DESCR
/end CHARACTERISTIC
/begin CHARACTERISTIC CFD_V_FAIL_OSC_FIL "osc filter when diag fail" VALUE 0x2886C __UWORD_S 0 u_filter 0 0.9999847412109375 FORMAT "%10.9" /end CHARACTERISTIC
/begin CHARACTERISTIC CFD_V_PASS_OSC_FIL "osc filter when diag pass" VALUE 0x2886C __UWORD_S 0 u_filter 0 0.9999847412109375 FORMAT "%10.9" /end CHARACTERISTIC
/begin CHARACTERISTIC CFD_V_HI_CHG_OSC_FIL "osc filter when high change" VALUE 0x2886C __UWORD_S 0 u_filter 0 0.9999847412109375 FORMAT "%10.9" /end CHARACTERISTIC
/begin CHARACTERISTIC CFD_V_OSC_INIT "osc initial" VALUE 0x0002038C __UWORD_S 0 u_millisec_65535 0 65.535 /end CHARACTERISTIC
/begin CHARACTERISTIC CFD_V_IDL_MET_VSPD_MAX "vehicle speed max for idle met" VALUE 0x0002038C __UWORD_S 0 u_vspd 0 511.9921875 FORMAT "%5.3" /end CHARACTERISTIC
/begin CHARACTERISTIC CFD_V_STG1_AF_CFG "diag stage1 af config" VALUE 0x0002038C __UBYTE_S 0 u_o2_st 0 1 FORMAT "%3.0" /end CHARACTERISTIC
/begin CHARACTERISTIC CFD_V_EN_O2_HT_SS_MIN "diag enable o2 heat steady state duration min" VALUE 0x0002038C __UWORD_S 0 u_2x_tmr 0 1023.984375 /end CHARACTERISTIC
/begin CHARACTERISTIC CFD_V_EN_AMP "diag enable amp" VALUE 0x0002038C __UWORD_S 0 u_kPa_0_256 0 255.99609375 /end CHARACTERISTIC
/begin CHARACTERISTIC CFD_V_HYB_ENG_STOP_DUR "cfd engine runtime rest duration min of hybrid engine stop" VALUE 0x0002038C __UWORD_S 0 u_16x_tmr 0 8191.875 /end CHARACTERISTIC
/begin CHARACTERISTIC CFD_V_EN_FUEL_INT_MIN "diag enable fuel int min" VALUE 0x0002038C __ULONG_S 0 u_gram_l_65536 0 65535.9999847412109375 FORMAT "%6.1" /end CHARACTERISTIC
/begin CHARACTERISTIC CFD_V_O2_LR_HYS "cfd o2 lean rich hys" VALUE 0x0002038C __UWORD_S 0 u_volt_32 0 31.99951171875 FORMAT "%4.2" /end CHARACTERISTIC
/begin CHARACTERISTIC CFD_V_O2_LR_THR "cfd o2 lean rich thr" VALUE 0x0002038C __UWORD_S 0 u_volt_32 0 31.99951171875 FORMAT "%4.2" /end CHARACTERISTIC
/begin CHARACTERISTIC CFD_C_OSC_CAT_T_FAC "osc factor based on catalyst temp" CURVE 0x000200B0 __UWORD_S 0 u_fac_4 0 3.99993896484375 FORMAT "%4.3" SYMBOL_LINK "CFD_C_OSC_CAT_T_FAC" 2
 /begin AXIS_DESCR FIX_AXIS extc_cat_t_nv u_deg_K_s 21 300 800
  /begin FIX_AXIS_PAR_LIST 4800 5200 5600 6000 6400 6800 7200 7600 8000 8400 8800 9200 9600 10000 10400 10800 11200 11600 12000 12400 12800 /end FIX_AXIS_PAR_LIST
 /end AXIS_DESCR
/end CHARACTERISTIC
/begin CHARACTERISTIC CFD_C_OSC_FLW_FAC "osc factor based on airflow" CURVE 0x000200B0 __UWORD_S 0 u_fac_4 0 3.99993896484375 FORMAT "%4.3" SYMBOL_LINK "CFD_C_OSC_FLW_FAC" 2
 /begin AXIS_DESCR COM_AXIS cfd_air_flw_avg u_g_per_sec 21 0 511.9921875 AXIS_PTS_REF CFD_X_AIR_FLW_A /end AXIS_DESCR
/end CHARACTERISTIC
/begin AXIS_PTS CFD_X_AIR_FLW_A "" 0x0002006C cfd_air_flw_avg SSV__UWORD_S 0 u_g_per_sec 21 0 511.9921875 DEPOSIT ABSOLUTE SYMBOL_LINK "CFD_X_AIR_FLW_A" 2 /end AXIS_PTS
/begin CHARACTERISTIC CFD_C_STG2_UO2_CHG_MAX "stage2 up o2 change delay max" CURVE 0x000200B0 __UWORD_S 0 u_2x_tmr 0 1023.984375
 /begin AXIS_DESCR FIX_AXIS cfd_diag_typ u_cfd_diag_typ 3 0 2 /begin FIX_AXIS_PAR_LIST 0 1 2 /end FIX_AXIS_PAR_LIST /end AXIS_DESCR
/end CHARACTERISTIC
/begin CHARACTERISTIC CFD_C_STG1_UO2_CHG_MAX "stage1 up o2 change delay max" CURVE 0x000200B0 __UWORD_S 0 u_2x_tmr 0 1023.984375
 /begin AXIS_DESCR FIX_AXIS cfd_diag_typ u_cfd_diag_typ 3 0 2 /begin FIX_AXIS_PAR_LIST 0 1 2 /end FIX_AXIS_PAR_LIST /end AXIS_DESCR
/end CHARACTERISTIC
/begin CHARACTERISTIC CFD_C_EN_ESPD_MAX "diag enable engine speed max" CURVE 0x000200B0 __UWORD_S 0 u_espd 0 8191.875 FORMAT "%5.1"
 /begin AXIS_DESCR FIX_AXIS cfd_diag_typ u_cfd_diag_typ 3 0 2 /begin FIX_AXIS_PAR_LIST 0 1 2 /end FIX_AXIS_PAR_LIST /end AXIS_DESCR
/end CHARACTERISTIC
/begin CHARACTERISTIC CFD_C_EN_ESPD_MIN "diag enable engine speed min" CURVE 0x000200B0 __UWORD_S 0 u_espd 0 8191.875
 /begin AXIS_DESCR FIX_AXIS cfd_diag_typ u_cfd_diag_typ 3 0 2 /begin FIX_AXIS_PAR_LIST 0 1 2 /end FIX_AXIS_PAR_LIST /end AXIS_DESCR
/end CHARACTERISTIC
/begin CHARACTERISTIC CFD_C_EN_VSPD_MAX "diag enable vehicle speed max" CURVE 0x000200B0 __UWORD_S 0 u_vspd 0 511.9921875
 /begin AXIS_DESCR FIX_AXIS cfd_diag_typ u_cfd_diag_typ 3 0 2 /begin FIX_AXIS_PAR_LIST 0 1 2 /end FIX_AXIS_PAR_LIST /end AXIS_DESCR
/end CHARACTERISTIC
/begin CHARACTERISTIC CFD_C_EN_VSPD_MIN "diag enable vehicle speed max" CURVE 0x000200B0 __UWORD_S 0 u_vspd 0 511.9921875
 /begin AXIS_DESCR FIX_AXIS cfd_diag_typ u_cfd_diag_typ 3 0 2 /begin FIX_AXIS_PAR_LIST 0 1 2 /end FIX_AXIS_PAR_LIST /end AXIS_DESCR
/end CHARACTERISTIC
/begin CHARACTERISTIC CFD_V_DIAG_CFG "diag config" VALUE 0x0002038C __UBYTE_S 0 u_cfd_diag_cfg 0 2 FORMAT "%1.0" /end CHARACTERISTIC
/begin CHARACTERISTIC CFD_C_STG2_DLY "stage1 to stage2 delay" CURVE 0x000200B0 __UWORD_S 0 u_2x_tmr 0 1023.984375
 /begin AXIS_DESCR FIX_AXIS cfd_diag_typ u_cfd_diag_typ 3 0 2 /begin FIX_AXIS_PAR_LIST 0 1 2 /end FIX_AXIS_PAR_LIST /end AXIS_DESCR
/end CHARACTERISTIC
/begin CHARACTERISTIC CFD_V_HI_CHG_OSC_MAX "osc high change enble max" VALUE 0x0002038C __UWORD_S 0 u_millisec_65535 0 65.535 /end CHARACTERISTIC
/begin CHARACTERISTIC CFD_V_HI_CHG_OSC_DLT "osc high change enable delta" VALUE 0x0002038C __UWORD_S 0 u_millisec_65535 0 65.535 /end CHARACTERISTIC
/begin CHARACTERISTIC CFD_V_HI_CHG_TST_MAX "osc high change test max" VALUE 0x0002038C __UBYTE_S 0 u_cnts 0 255 /end CHARACTERISTIC
/begin CHARACTERISTIC CFD_V_HI_CHG_TRP_TST "osc high change test per trip" VALUE 0x0002038C __UBYTE_S 0 u_cnts 0 255 /end CHARACTERISTIC
/begin CHARACTERISTIC CFD_V_EN_CL_MAX "diag enable close loop max" VALUE 0x0002038C __UWORD_S 0 u_fac_2 0 1.999969482421875 FORMAT "%4.3" /end CHARACTERISTIC
/begin CHARACTERISTIC CFD_V_EN_IDL_ERR_MIN "diag enable idle speed error min" VALUE 0x0002038C __UWORD_S 0 u_espd 0 8191.875 FORMAT "%5.1" /end CHARACTERISTIC
/begin CHARACTERISTIC CFD_V_TRS_ESPD_DLT "transient condition engine speed delta" VALUE 0x0002038C __UWORD_S 0 u_espd 0 8191.875 FORMAT "%5.1" /end CHARACTERISTIC
/begin CHARACTERISTIC CFD_V_TRS_FLW_DLT "transient condition airflow delta" VALUE 0x0002038C __UWORD_S 0 u_g_per_sec 0 511.9921875 FORMAT "%5.1" /end CHARACTERISTIC
/begin CHARACTERISTIC CFD_V_TRS_ESPD_FIL "transient condition engine speed filter" VALUE 0x2886C __UWORD_S 0 u_filter 0 0.9999847412109375 FORMAT "%10.9" /end CHARACTERISTIC
/begin CHARACTERISTIC CFD_V_TRS_FLW_FIL "transient condition airflow filter" VALUE 0x2886C __UWORD_S 0 u_filter 0 0.9999847412109375 FORMAT "%10.9" /end CHARACTERISTIC
/begin CHARACTERISTIC OSD_V_EN_BAT_VLT_MAX "o2 sensor diag enable battery volt max" VALUE 0x0002038C __UWORD_S 0 u_volt_32 0 31.99951171875 FORMAT "%4.2" /end CHARACTERISTIC
/begin CHARACTERISTIC OSD_V_EN_BAT_VLT_MIN "o2 sensor diag enable battery volt min" VALUE 0x0002038C __UWORD_S 0 u_volt_32 0 31.99951171875 FORMAT "%4.2" /end CHARACTERISTIC
/begin CHARACTERISTIC OSD_V_UO2_HI_THR "uo2 short to high voltage threshold" VALUE 0x21C28 __UWORD_S 0 u_volt_32 0 31.99951171875 FORMAT "%4.2" /end CHARACTERISTIC
/begin CHARACTERISTIC OSD_V_UO2_LO_THR "uo2 short to low voltage threshold" VALUE 0x21C28 __UWORD_S 0 u_volt_32 0 31.99951171875 FORMAT "%4.2" /end CHARACTERISTIC
/begin CHARACTERISTIC OSD_V_UO2_INIT_HI_THR "uo2 high threshold during initialization indicate that uo2 may be short to high " VALUE 0x21C28 __UWORD_S 0 u_volt_32 0 31.99951171875 FORMAT "%4.2" /end CHARACTERISTIC
/begin CHARACTERISTIC OSD_V_UO2_CLD_HT_DTY_THR "uo2 heat duty threshold below which osd_uo2_cld_cnt can be increased" VALUE 0x0002038C __UWORD_S 0 u_pct 0 199.996948 /end CHARACTERISTIC
/begin CHARACTERISTIC OSD_V_UO2_CLD_CNT_THR "counter threshold above which osd_uo2_cld_stat will be set to true" VALUE 0x0002038C __UWORD_S 0 u_cnts 0 65535 FORMAT "%5.0" /end CHARACTERISTIC
/begin CHARACTERISTIC OSD_V_UO2_CLD_CNT_STP_INC "increase step of osd_uo2_cld_cnt" VALUE 0x0002038C __UWORD_S 0 u_cnts 0 65535 FORMAT "%5.0" /end CHARACTERISTIC
/begin CHARACTERISTIC OSD_V_UO2_CLD_CNT_STP_DEC "decrease step of osd_uo2_cld_cnt" VALUE 0x0002038C __UWORD_S 0 u_cnts 0 65535 FORMAT "%5.0" /end CHARACTERISTIC
/begin CHARACTERISTIC OSD_V_UO2_CLD_HLD_DUR "hold duration of osd_uo2_cld_stat" VALUE 0x0002038C __UWORD_S 0 u_16x_tmr 0.0 8191.875 FORMAT "%6.2" /end CHARACTERISTIC
/begin CHARACTERISTIC OSD_V_UO2_CLD_AIR_FLW_THR "air flow threshold above which osd_uo2_cld_cnt can be decreased" VALUE 0x0002038C __UWORD_S 0 u_g_per_sec 0 511.9921875 /end CHARACTERISTIC
/begin CHARACTERISTIC OSD_C_UO2_OPN_ECT_THR "min engine coolant threshold to enable uo2 open diag" CURVE 0x000200B0 __SWORD_S 0 u_deg_C -256 255.9921875 SYMBOL_LINK "OSD_C_UO2_OPN_ECT_THR" 2
 /begin AXIS_DESCR FIX_AXIS sys_keyon_ect u_deg_C 5 -40 40 /begin FIX_AXIS_PAR_LIST -5120 -2560 0 2560 5120 /end FIX_AXIS_PAR_LIST /end AXIS_DESCR
/end CHARACTERISTIC
/begin CHARACTERISTIC OSD_V_UO2_OPN_EN_DLY "delay time to enable uo2 open diag" VALUE 0x0002038C __UWORD_S 0 u_16x_tmr 0.0 8191.875 FORMAT "%6.2" /end CHARACTERISTIC
/begin CHARACTERISTIC OSD_V_UO2_OPN_RUN_MIN "min engine runtime threshold to enable uo2 open diag" VALUE 0x0002038C __UWORD_S 0 u_1s_tmr 0 65535 /end CHARACTERISTIC
/begin CHARACTERISTIC OSD_V_UO2_LO_EN_DLY "delay time to enable uo2 short low diag" VALUE 0x0002038C __UWORD_S 0 u_16x_tmr 0.0 8191.875 FORMAT "%6.2" /end CHARACTERISTIC
/begin CHARACTERISTIC OSD_V_UO2_LO_FLV_THR "min fuel level threshold to enable uo2 short low diag" VALUE 0x0002038C __UWORD_S 0 u_pct_1 0.0 99.9984741210937 FORMAT "%4.2" /end CHARACTERISTIC
/begin CHARACTERISTIC OSD_V_UO2_POW_LN_EN_DLY "delay time to enable uo2 lean at power state diag" VALUE 0x0002038C __UWORD_S 0 u_16x_tmr 0.0 8191.875 FORMAT "%6.2" /end CHARACTERISTIC
/begin CHARACTERISTIC OSD_C_UO2_PUC_RCH_ECT_THR "min engine coolant threshold to enable uo2 rich at PUC state diag" CURVE 0x000200B0 __SWORD_S 0 u_deg_C -256 255.9921875 SYMBOL_LINK "OSD_C_UO2_PUC_RCH_ECT_THR" 2
 /begin AXIS_DESCR FIX_AXIS sys_keyon_ect u_deg_C 5 -40 40 /begin FIX_AXIS_PAR_LIST -5120 -2560 0 2560 5120 /end FIX_AXIS_PAR_LIST /end AXIS_DESCR
/end CHARACTERISTIC
/begin CHARACTERISTIC OSD_V_UO2_PUC_RCH_EN_DLY "delay time to enable uo2 rich at PUC state diag" VALUE 0x0002038C __UWORD_S 0 u_16x_tmr 0.0 8191.875 FORMAT "%6.2" /end CHARACTERISTIC
/begin CHARACTERISTIC OSD_V_UO2_PUC_RCH_RUN_MIN "min engine runtime threshold to enable uo2 rich at PUC state diag" VALUE 0x0002038C __UWORD_S 0 u_1s_tmr 0 65535 /end CHARACTERISTIC
/begin CHARACTERISTIC OSD_V_UO2_OPN_LO_THR "low voltage threshold of uo2 open diag" VALUE 0x21C28 __UWORD_S 0 u_volt_32 0 31.99951171875 FORMAT "%4.2" /end CHARACTERISTIC
/begin CHARACTERISTIC OSD_V_UO2_OPN_HI_THR "high voltage threshold of uo2 open diag" VALUE 0x21C28 __UWORD_S 0 u_volt_32 0 31.99951171875 FORMAT "%4.2" /end CHARACTERISTIC
/begin CHARACTERISTIC OSD_V_UO2_PMP_OPN_LO_THR "low voltage threshold of uo2 with pump current open diag" VALUE 0x21C28 __UWORD_S 0 u_volt_32 0 31.99951171875 FORMAT "%4.2" /end CHARACTERISTIC
/begin CHARACTERISTIC OSD_V_UO2_PMP_OPN_HI_THR "high voltage threshold of uo2 with pump current open diag" VALUE 0x21C28 __UWORD_S 0 u_volt_32 0 31.99951171875 FORMAT "%4.2" /end CHARACTERISTIC
/begin CHARACTERISTIC OSD_V_UO2_OPN_CNT_THR "counter threshold above which osd_uo2_opn_fl_met will be set to true" VALUE 0x0002038C __UBYTE_S 0 u_cnts 0 255 /end CHARACTERISTIC
/begin CHARACTERISTIC OSD_V_UO2_PMP_OPN_FL_THR "fail counter threshold above set osd_uo2_opn_fl to true when uo2 with pump current" VALUE 0x0002038C __UWORD_S 0 u_cnts 0 65535 FORMAT "%5.0" /end CHARACTERISTIC
/begin CHARACTERISTIC OSD_V_UO2_PMP_OPN_DIAG_THR "diag counter threshold above set osd_uo2_opn_fn to true when uo2 with pump current" VALUE 0x0002038C __UWORD_S 0 u_cnts 0 65535 FORMAT "%5.0" /end CHARACTERISTIC
/begin CHARACTERISTIC OSD_V_UO2_OPN_FL_THR "fail counter threshold above set osd_uo2_opn_fl to true" VALUE 0x0002038C __UWORD_S 0 u_cnts 0 65535 FORMAT "%5.0" /end CHARACTERISTIC
/begin CHARACTERISTIC OSD_V_UO2_OPN_DIAG_THR "diag counter threshold above set osd_uo2_opn_fn to true" VALUE 0x0002038C __UWORD_S 0 u_cnts 0 65535 FORMAT "%5.0" /end CHARACTERISTIC
/begin CHARACTERISTIC OSD_V_UO2_HI_DIAG_THR "diag counter threshold of uo2 short high diag" VALUE 0x0002038C __UWORD_S 0 u_cnts 0 65535 FORMAT "%5.0" /end CHARACTERISTIC
/begin CHARACTERISTIC OSD_V_UO2_HI_FL_THR "fail counter threshold of uo2 short high diag" VALUE 0x0002038C __UWORD_S 0 u_cnts 0 65535 FORMAT "%5.0" /end CHARACTERISTIC
/begin CHARACTERISTIC OSD_V_UO2_LO_DIAG_THR "diag counter threshold of uo2 short low diag" VALUE 0x0002038C __UWORD_S 0 u_cnts 0 65535 FORMAT "%5.0" /end CHARACTERISTIC
/begin CHARACTERISTIC OSD_V_UO2_LO_FL_THR "fail counter threshold of uo2 short low diag" VALUE 0x0002038C __UWORD_S 0 u_cnts 0 65535 FORMAT "%5.0" /end CHARACTERISTIC
/begin CHARACTERISTIC OSD_V_UO2_POW_LN_FL_THR "fail counter threshold of uo2 lean at power state diag" VALUE 0x0002038C __UWORD_S 0 u_cnts 0 65535 FORMAT "%5.0" /end CHARACTERISTIC
/begin CHARACTERISTIC OSD_V_UO2_POW_LN_DIAG_THR "diag counter threshold of uo2 lean at power state diag" VALUE 0x0002038C __UWORD_S 0 u_cnts 0 65535 FORMAT "%5.0" /end CHARACTERISTIC
/begin CHARACTERISTIC OSD_V_UO2_PUC_RCH_FL_THR "fail counter threshold of uo2 rich at PUC state diag" VALUE 0x0002038C __UWORD_S 0 u_cnts 0 65535 FORMAT "%5.0" /end CHARACTERISTIC
/begin CHARACTERISTIC OSD_V_UO2_PUC_RCH_DIAG_THR "diag counter threshold of uo2 rich at PUC state diag" VALUE 0x0002038C __UWORD_S 0 u_cnts 0 65535 FORMAT "%5.0" /end CHARACTERISTIC
/begin CHARACTERISTIC OSD_V_UO2_POW_LN_THR "uo2 lean at power state diag voltage threshold" VALUE 0x21C28 __UWORD_S 0 u_volt_32 0 31.99951171875 FORMAT "%4.2" /end CHARACTERISTIC
/begin CHARACTERISTIC OSD_V_UO2_PUC_RCH_THR "uo2 rich at PUC state diag voltage threshold" VALUE 0x21C28 __UWORD_S 0 u_volt_32 0 31.99951171875 FORMAT "%4.2" /end CHARACTERISTIC
/begin CHARACTERISTIC OSD_V_DO2_CLD_HT_DTY_THR "do2 heat duty threshold below which osd_do2_cld_cnt can be increased" VALUE 0x0002038C __UWORD_S 0 u_pct 0 199.996948 /end CHARACTERISTIC
/begin CHARACTERISTIC OSD_V_DO2_CLD_CNT_THR "counter threshold above which osd_do2_cld_stat will be set to true" VALUE 0x0002038C __UWORD_S 0 u_cnts 0 65535 FORMAT "%5.0" /end CHARACTERISTIC
/begin CHARACTERISTIC OSD_V_DO2_CLD_CNT_STP_INC "increase step of osd_do2_cld_cnt" VALUE 0x0002038C __UWORD_S 0 u_cnts 0 65535 FORMAT "%5.0" /end CHARACTERISTIC
/begin CHARACTERISTIC OSD_V_DO2_CLD_CNT_STP_DEC "decrease step of osd_do2_cld_cnt" VALUE 0x0002038C __UWORD_S 0 u_cnts 0 65535 FORMAT "%5.0" /end CHARACTERISTIC
/begin CHARACTERISTIC OSD_V_DO2_CLD_HLD_DUR "hold duration of osd_do2_cld_stat" VALUE 0x0002038C __UWORD_S 0 u_16x_tmr 0.0 8191.875 FORMAT "%6.2" /end CHARACTERISTIC
/begin CHARACTERISTIC OSD_V_DO2_CLD_AIR_FLW_THR "air flow threshold above which osd_do2_cld_cnt can be decreased" VALUE 0x0002038C __UWORD_S 0 u_g_per_sec 0 511.9921875 /end CHARACTERISTIC
/begin CHARACTERISTIC OSD_C_DO2_OPN_ECT_THR "min engine coolant threshold to enable do2 open diag" CURVE 0x000200B0 __SWORD_S 0 u_deg_C -256 255.9921875 SYMBOL_LINK "OSD_C_DO2_OPN_ECT_THR" 2
 /begin AXIS_DESCR FIX_AXIS sys_keyon_ect u_deg_C 5 -40 40 /begin FIX_AXIS_PAR_LIST -5120 -2560 0 2560 5120 /end FIX_AXIS_PAR_LIST /end AXIS_DESCR
/end CHARACTERISTIC
/begin CHARACTERISTIC OSD_V_DO2_OPN_EN_DLY "delay time to enable do2 open diag" VALUE 0x0002038C __UWORD_S 0 u_16x_tmr 0.0 8191.875 FORMAT "%6.2" /end CHARACTERISTIC
/begin CHARACTERISTIC OSD_V_DO2_OPN_RUN_MIN "min engine runtime threshold to enable do2 open diag" VALUE 0x0002038C __UWORD_S 0 u_1s_tmr 0 65535 /end CHARACTERISTIC
/begin CHARACTERISTIC OSD_C_DO2_HI_ECT_THR "min engine coolant threshold to enable do2 short high diag" CURVE 0x000200B0 __SWORD_S 0 u_deg_C -256 255.9921875 SYMBOL_LINK "OSD_C_DO2_HI_ECT_THR" 2
 /begin AXIS_DESCR FIX_AXIS sys_keyon_ect u_deg_C 5 -40 40 /begin FIX_AXIS_PAR_LIST -5120 -2560 0 2560 5120 /end FIX_AXIS_PAR_LIST /end AXIS_DESCR
/end CHARACTERISTIC
/begin CHARACTERISTIC OSD_V_DO2_HI_EN_DLY "delay time to enable do2 short high diag" VALUE 0x0002038C __UWORD_S 0 u_16x_tmr 0.0 8191.875 FORMAT "%6.2" /end CHARACTERISTIC
/begin CHARACTERISTIC OSD_V_DO2_HI_RUN_MIN "min engine runtime threshold to enable do2 short high diag" VALUE 0x0002038C __UWORD_S 0 u_1s_tmr 0 65535 /end CHARACTERISTIC
/begin CHARACTERISTIC OSD_V_DO2_LO_EN_DLY "delay time to enable do2 short low diag" VALUE 0x0002038C __UWORD_S 0 u_16x_tmr 0.0 8191.875 FORMAT "%6.2" /end CHARACTERISTIC
/begin CHARACTERISTIC OSD_V_DO2_POW_LN_EN_DLY "delay time to enable do2 lean at power state diag" VALUE 0x0002038C __UWORD_S 0 u_16x_tmr 0.0 8191.875 FORMAT "%6.2" /end CHARACTERISTIC
/begin CHARACTERISTIC OSD_C_DO2_PUC_RCH_ECT_THR "min engine coolant threshold to enable do2 rich at PUC state diag" CURVE 0x000200B0 __SWORD_S 0 u_deg_C -256 255.9921875 SYMBOL_LINK "OSD_C_DO2_PUC_RCH_ECT_THR" 2
 /begin AXIS_DESCR FIX_AXIS sys_keyon_ect u_deg_C 5 -40 40 /begin FIX_AXIS_PAR_LIST -5120 -2560 0 2560 5120 /end FIX_AXIS_PAR_LIST /end AXIS_DESCR
/end CHARACTERISTIC
/begin CHARACTERISTIC OSD_V_DO2_PUC_RCH_EN_DLY "delay time to enable do2 rich at PUC state diag" VALUE 0x0002038C __UWORD_S 0 u_16x_tmr 0.0 8191.875 FORMAT "%6.2" /end CHARACTERISTIC
/begin CHARACTERISTIC OSD_V_DO2_PUC_RCH_RUN_MIN "min engine runtime threshold to enable do2 rich at PUC state diag" VALUE 0x0002038C __UWORD_S 0 u_1s_tmr 0 65535 /end CHARACTERISTIC
/begin CHARACTERISTIC OSD_V_DO2_OPN_LO_THR "low voltage threshold of do2 open diag" VALUE 0x21C28 __UWORD_S 0 u_volt_32 0 31.99951171875 FORMAT "%4.2" /end CHARACTERISTIC
/begin CHARACTERISTIC OSD_V_DO2_OPN_HI_THR "high voltage threshold of do2 open diag" VALUE 0x21C28 __UWORD_S 0 u_volt_32 0 31.99951171875 FORMAT "%4.2" /end CHARACTERISTIC
/begin CHARACTERISTIC OSD_V_DO2_PMP_OPN_LO_THR "low voltage threshold of do2 with pump current open diag" VALUE 0x21C28 __UWORD_S 0 u_volt_32 0 31.99951171875 FORMAT "%4.2" /end CHARACTERISTIC
/begin CHARACTERISTIC OSD_V_DO2_PMP_OPN_HI_THR "high voltage threshold of do2 with pump current open diag" VALUE 0x21C28 __UWORD_S 0 u_volt_32 0 31.99951171875 FORMAT "%4.2" /end CHARACTERISTIC
/begin CHARACTERISTIC OSD_V_DO2_OPN_CNT_THR "counter threshold above which osd_do2_opn_fl_met will be set to true" VALUE 0x0002038C __UBYTE_S 0 u_cnts 0 255 /end CHARACTERISTIC
/begin CHARACTERISTIC OSD_V_DO2_PMP_OPN_FL_THR "fail counter threshold above set osd_do2_opn_fl to true when do2 with pump current" VALUE 0x0002038C __UWORD_S 0 u_cnts 0 65535 FORMAT "%5.0" /end CHARACTERISTIC
/begin CHARACTERISTIC OSD_V_DO2_PMP_OPN_DIAG_THR "diag counter threshold above set osd_do2_opn_fn to true when do2 with pump current" VALUE 0x0002038C __UWORD_S 0 u_cnts 0 65535 FORMAT "%5.0" /end CHARACTERISTIC
/begin CHARACTERISTIC OSD_V_DO2_OPN_FL_THR "fail counter threshold above set osd_do2_opn_fl to true" VALUE 0x0002038C __UWORD_S 0 u_cnts 0 65535 FORMAT "%5.0" /end CHARACTERISTIC
/begin CHARACTERISTIC OSD_V_DO2_OPN_DIAG_THR "diag counter threshold above set osd_do2_opn_fn to true" VALUE 0x0002038C __UWORD_S 0 u_cnts 0 65535 FORMAT "%5.0" /end CHARACTERISTIC
/begin CHARACTERISTIC OSD_V_DO2_HI_THR "do2 short to high voltage threshold" VALUE 0x21C28 __UWORD_S 0 u_volt_32 0 31.99951171875 FORMAT "%4.2" /end CHARACTERISTIC
/begin CHARACTERISTIC OSD_V_DO2_LO_THR "do2 short to low voltage threshold" VALUE 0x21C28 __UWORD_S 0 u_volt_32 0 31.99951171875 FORMAT "%4.2" /end CHARACTERISTIC
/begin CHARACTERISTIC OSD_V_DO2_POW_LN_THR "do2 lean at power state diag voltage threshold" VALUE 0x21C28 __UWORD_S 0 u_volt_32 0 31.99951171875 FORMAT "%4.2" /end CHARACTERISTIC
/begin CHARACTERISTIC OSD_V_DO2_PUC_RCH_THR "do2 rich at PUC state diag voltage threshold" VALUE 0x21C28 __UWORD_S 0 u_volt_32 0 31.99951171875 FORMAT "%4.2" /end CHARACTERISTIC
/begin CHARACTERISTIC OSD_V_DO2_HI_DIAG_THR "diag counter threshold of do2 short high diag" VALUE 0x0002038C __UWORD_S 0 u_cnts 0 65535 FORMAT "%5.0" /end CHARACTERISTIC
/begin CHARACTERISTIC OSD_V_DO2_HI_FL_THR "fail counter threshold of do2 short high diag" VALUE 0x0002038C __UWORD_S 0 u_cnts 0 65535 FORMAT "%5.0" /end CHARACTERISTIC
/begin CHARACTERISTIC OSD_V_DO2_LO_DIAG_THR "diag counter threshold of do2 short low diag" VALUE 0x0002038C __UWORD_S 0 u_cnts 0 65535 FORMAT "%5.0" /end CHARACTERISTIC
/begin CHARACTERISTIC OSD_V_DO2_LO_FL_THR "fail counter threshold of do2 short low diag" VALUE 0x0002038C __UWORD_S 0 u_cnts 0 65535 FORMAT "%5.0" /end CHARACTERISTIC
/begin CHARACTERISTIC OSD_V_DO2_POW_LN_FL_THR "fail counter threshold of do2 lean at power state diag" VALUE 0x0002038C __UWORD_S 0 u_cnts 0 65535 FORMAT "%5.0" /end CHARACTERISTIC
/begin CHARACTERISTIC OSD_V_DO2_POW_LN_DIAG_THR "diag counter threshold of do2 lean at power state diag" VALUE 0x0002038C __UWORD_S 0 u_cnts 0 65535 FORMAT "%5.0" /end CHARACTERISTIC
/begin CHARACTERISTIC OSD_V_DO2_PUC_RCH_FL_THR "fail counter threshold of do2 rich at PUC state diag" VALUE 0x0002038C __UWORD_S 0 u_cnts 0 65535 FORMAT "%5.0" /end CHARACTERISTIC
/begin CHARACTERISTIC OSD_V_DO2_PUC_RCH_DIAG_THR "diag counter threshold of do2 rich at PUC state diag" VALUE 0x0002038C __UWORD_S 0 u_cnts 0 65535 FORMAT "%5.0" /end CHARACTERISTIC
/begin CHARACTERISTIC OSD_V_AGED_AMP_MIN "min sys_amp to enable o2 aged diag" VALUE 0x0002038C __UWORD_S 0 u_kPa_0_256 0 255.99609375 FORMAT "%4.1" /end CHARACTERISTIC
/begin CHARACTERISTIC OSD_V_AGED_FLV_MIN "min fuel level to enable o2 aged diag" VALUE 0x0002038C __UWORD_S 0 u_pct_1 0.0 99.9984741210937 FORMAT "%4.2" /end CHARACTERISTIC
/begin CHARACTERISTIC OSD_V_AGED_EVAC_CFG "True will skip EVAC related conditions to enable o2 aged diag" VALUE 0x0002038C __UBYTE_S 0 b_true 0 1 FORMAT "%1.0" /end CHARACTERISTIC
/begin CHARACTERISTIC OSD_V_AGED_CELL_CHG_CFG "true means o2 aged diag can be enabled when ADP cell changed" VALUE 0x0002038C __UBYTE_S 0 b_true 0 1 FORMAT "%1.0" /end CHARACTERISTIC
/begin CHARACTERISTIC OSD_C_AGED_ADP_CELL_EN "fuel ADP cell selected to enable o2 aged diag" CURVE 0x000200B0 __UBYTE_S 0 b_enable 0 1 FORMAT "%5.2"
 /begin AXIS_DESCR FIX_AXIS fmsp_adp_area u_cnts 26 0 25
  /begin FIX_AXIS_PAR_LIST 0 1 2 3 4 5 6 7 8 9 10 11 12 13 14 15 16 17 18 19 20 21 22 23 24 25 /end FIX_AXIS_PAR_LIST
 /end AXIS_DESCR
/end CHARACTERISTIC
/begin CHARACTERISTIC OSD_V_AGED_AIR_FLW_MIN "min air flow to enable o2 aged diag" VALUE 0x0002038C __UWORD_S 0 u_g_per_sec 0 511.9921875 /end CHARACTERISTIC
/begin CHARACTERISTIC OSD_V_AGED_AIR_FLW_MAX "max air flow to enable o2 aged diag" VALUE 0x0002038C __UWORD_S 0 u_g_per_sec 0 511.9921875 /end CHARACTERISTIC
/begin CHARACTERISTIC OSD_V_AGED_EN_DLY "delay time to enable o2 aged diag" VALUE 0x0002038C __UWORD_S 0 u_1x_tmr 0.0 511.9921875 FORMAT "%5.2" /end CHARACTERISTIC
/begin AXIS_PTS OSD_X_ESPD_AVG "" 0x0002006C NO_INPUT_QUANTITY SSV__UWORD_S 0 u_espd 9 0.000000 8191.875000 FORMAT "%6.2" DEPOSIT ABSOLUTE SYMBOL_LINK "OSD_X_ESPD_AVG" 2 /end AXIS_PTS
/begin CHARACTERISTIC OSD_V_AGED_DATA_TIM "data collect time when o2 aged diag enabled" VALUE 0x0002038C __UWORD_S 0 u_1x_tmr 0.0 511.9921875 FORMAT "%5.2" /end CHARACTERISTIC
/begin CHARACTERISTIC OSD_M_AGED_VLT_THR "o2 voltage threshold to determinate rich lean status" MAP 0x00020320 __UWORD_S 0 u_volt_8 0 7.9998779296875 FORMAT "%5.4"
 /begin AXIS_DESCR FIX_AXIS NO_INPUT_QUANTITY u_osd_bnk 1 0 1 /begin FIX_AXIS_PAR_LIST 0 /end FIX_AXIS_PAR_LIST /end AXIS_DESCR
 /begin AXIS_DESCR FIX_AXIS NO_INPUT_QUANTITY u_osd_volt_thr 2 0 1 /begin FIX_AXIS_PAR_LIST 0 1 /end FIX_AXIS_PAR_LIST /end AXIS_DESCR
/end CHARACTERISTIC
/begin CHARACTERISTIC OSD_M_AGED_SW_TMS_FL_THR "LtoR RtoL switch times fail threshold of uo2 aged diag" MAP 0x00020320 __UWORD_S 0 u_cnts 0 65535 FORMAT "%5.0"
 /begin AXIS_DESCR FIX_AXIS NO_INPUT_QUANTITY u_osd_sw 2 0 1 /begin FIX_AXIS_PAR_LIST 0 1 /end FIX_AXIS_PAR_LIST /end AXIS_DESCR
 /begin AXIS_DESCR COM_AXIS NO_INPUT_QUANTITY u_espd 9 0.000000 8191.875000 AXIS_PTS_REF OSD_X_ESPD_AVG /end AXIS_DESCR
/end CHARACTERISTIC
/begin CHARACTERISTIC OSD_M_AGED_AVG_TM_FL_THR "LtoR RtoL average time fail threshold of uo2 aged diag" MAP 0x00020320 __UWORD_S 0 u_1x_tmr 0.0 511.9921875 FORMAT "%5.2"
 /begin AXIS_DESCR FIX_AXIS NO_INPUT_QUANTITY u_osd_sw 2 0 1 /begin FIX_AXIS_PAR_LIST 0 1 /end FIX_AXIS_PAR_LIST /end AXIS_DESCR
 /begin AXIS_DESCR COM_AXIS NO_INPUT_QUANTITY u_espd 9 0.000000 8191.875000 AXIS_PTS_REF OSD_X_ESPD_AVG /end AXIS_DESCR
/end CHARACTERISTIC
/begin CHARACTERISTIC OSD_C_AGED_RAT_AVG_TM_FL_THR "ratio average time fail threshold of uo2 aged diag" CURVE 0x000200B0 __UWORD_S 0 u_1x_tmr 0.0 511.9921875 FORMAT "%5.2"
 /begin AXIS_DESCR COM_AXIS NO_INPUT_QUANTITY u_espd 9 0.000000 8191.875000 AXIS_PTS_REF OSD_X_ESPD_AVG /end AXIS_DESCR
/end CHARACTERISTIC
/begin CHARACTERISTIC OSD_V_AGED_RAT_LO_BIAS_FL_THR "low bias to calculate rattio fail threshold of uo2 aged diag" VALUE 0x0002038C __UWORD_S 0 u_fac_256 0 255.99609375 FORMAT "%6.3" /end CHARACTERISTIC
/begin CHARACTERISTIC OSD_V_AGED_RAT_HI_BIAS_FL_THR "high bias to calculate rattio fail threshold of uo2 aged diag" VALUE 0x0002038C __UWORD_S 0 u_fac_256 0 255.99609375 FORMAT "%6.3" /end CHARACTERISTIC
/begin CHARACTERISTIC OSD_V_HT_CURR_FIL "filter coefficient of o2 heater current" VALUE 0x2886C __UWORD_S 0 u_filter 0 0.9999847412109375 FORMAT "%10.9" /end CHARACTERISTIC
/begin CHARACTERISTIC OSD_V_HT_CURR_FIL_CNT_THR "counts threshold of heater current filtered to determinate diag condition met" VALUE 0x0002038C __UWORD_S 0 u_cnts 0 65535 FORMAT "%5.0" /end CHARACTERISTIC
/begin CHARACTERISTIC OSD_V_HT_CURR_RUN_MIN "min engine runtime to enable o2 heater current diag" VALUE 0x232DC __UWORD_S 0 u_1s_tmr 0 65535 /end CHARACTERISTIC
/begin CHARACTERISTIC OSD_V_HT_CURR_EN_DLY "delay time to enable o2 heater current diag" VALUE 0x232DC __UWORD_S 0 u_1s_tmr 0 65535 /end CHARACTERISTIC
/begin AXIS_PTS OSD_X_HT_DTY "exhaust temp breakpoint" 0x0002006C NO_INPUT_QUANTITY SSV__UWORD_S 0 u_pct 9 0 199.996948 FORMAT "%4.1" DEPOSIT ABSOLUTE SYMBOL_LINK "OSD_X_HT_DTY" 2 /end AXIS_PTS
/begin CHARACTERISTIC OSD_M_HT_CURR_UNDR_FL_THR "fail threshold of o2 heater current under diag" MAP 0x00020320 __UWORD_S 0 u_amp_65 0.0 65.535
 /begin AXIS_DESCR FIX_AXIS NO_INPUT_QUANTITY u_osd_o2 2 0 1 /begin FIX_AXIS_PAR_LIST 0 1 /end FIX_AXIS_PAR_LIST /end AXIS_DESCR
 /begin AXIS_DESCR COM_AXIS NO_INPUT_QUANTITY u_pct 9 0.000000 199.996948 AXIS_PTS_REF OSD_X_HT_DTY /end AXIS_DESCR
/end CHARACTERISTIC
/begin CHARACTERISTIC OSD_M_HT_CURR_OVR_FL_THR "fail threshold of o2 heater current over diag" MAP 0x00020320 __UWORD_S 0 u_amp_65 0.0 65.535
 /begin AXIS_DESCR FIX_AXIS NO_INPUT_QUANTITY u_osd_o2 2 0 1 /begin FIX_AXIS_PAR_LIST 0 1 /end FIX_AXIS_PAR_LIST /end AXIS_DESCR
 /begin AXIS_DESCR COM_AXIS NO_INPUT_QUANTITY u_pct 9 0.000000 199.996948 AXIS_PTS_REF OSD_X_HT_DTY /end AXIS_DESCR
/end CHARACTERISTIC
/begin CHARACTERISTIC OSD_V_HT_UO2_CURR_UNDR_FL_THR "fail counter threshold of uo2 heater current under diag" VALUE 0x0002038C __UWORD_S 0 u_cnts 0 65535 FORMAT "%5.0" /end CHARACTERISTIC
/begin CHARACTERISTIC OSD_V_HT_UO2_CURR_UNDR_DIAG_THR "diag counter threshold of uo2 heater current under diag" VALUE 0x0002038C __UWORD_S 0 u_cnts 0 65535 FORMAT "%5.0" SYMBOL_LINK "OSD_V_HT_UO2_CURR_UNDR_DIAG_THR" 2 /end CHARACTERISTIC
/begin CHARACTERISTIC OSD_V_HT_DO2_CURR_UNDR_FL_THR "fail counter threshold of do2 heater current under diag" VALUE 0x0002038C __UWORD_S 0 u_cnts 0 65535 FORMAT "%5.0" SYMBOL_LINK "OSD_V_HT_DO2_CURR_UNDR_FL_THR" 4 /end CHARACTERISTIC
/begin CHARACTERISTIC OSD_V_HT_DO2_CURR_UNDR_DIAG_THR "diag counter threshold of do2 heater current under diag" VALUE 0x0002038C __UWORD_S 0 u_cnts 0 65535 FORMAT "%5.0" SYMBOL_LINK "OSD_V_HT_DO2_CURR_UNDR_DIAG_THR" 6 /end CHARACTERISTIC
/begin CHARACTERISTIC OSD_V_HT_UO2_CURR_OVR_FL_THR "fail counter threshold of uo2 heater current over diag" VALUE 0x0002038C __UWORD_S 0 u_cnts 0 65535 FORMAT "%5.0" /end CHARACTERISTIC
/begin CHARACTERISTIC OSD_V_HT_UO2_CURR_OVR_DIAG_THR "diag counter threshold of uo2 heater current over diag" VALUE 0x0002038C __UWORD_S 0 u_cnts 0 65535 FORMAT "%5.0" SYMBOL_LINK "OSD_V_HT_UO2_CURR_OVR_DIAG_THR" 2 /end CHARACTERISTIC
/begin CHARACTERISTIC OSD_V_HT_DO2_CURR_OVR_FL_THR "fail counter threshold of do2 heater current over diag" VALUE 0x0002038C __UWORD_S 0 u_cnts 0 65535 FORMAT "%5.0" SYMBOL_LINK "OSD_V_HT_DO2_CURR_OVR_FL_THR" 4 /end CHARACTERISTIC
/begin CHARACTERISTIC OSD_V_HT_DO2_CURR_OVR_DIAG_THR "diag counter threshold of do2 heater current over diag" VALUE 0x0002038C __UWORD_S 0 u_cnts 0 65535 FORMAT "%5.0" SYMBOL_LINK "OSD_V_HT_DO2_CURR_OVR_DIAG_THR" 6 /end CHARACTERISTIC
/begin CHARACTERISTIC OSD_V_RSP_PUC_TM_INIT "initial value of osd_rsp_puc_tm when NVRAM reset" VALUE 0x0002038C __UWORD_S 0 u_tmr_8 0 7.9998779296875 /end CHARACTERISTIC
/begin CHARACTERISTIC OSD_V_RSP_PUC_VLT_THR "min do2 voltage threshold to enable do2 PUC response diag" VALUE 0x0002038C __UWORD_S 0 u_volt_32 0 31.99951171875 FORMAT "%5.3" /end CHARACTERISTIC
/begin CHARACTERISTIC OSD_V_RSP_PUC_RUN_MIN "min engine runtime to enable do2 PUC response diag" VALUE 0x0002038C __UWORD_S 0 u_1s_tmr 0.0 65535 /end CHARACTERISTIC
/begin CHARACTERISTIC OSD_V_RSP_PUC_ECT_THR "min engine coolant threshold to enable do2 PUC response diag" VALUE 0x0002038C __SWORD_S 0 u_deg_C -256 255.9921875 FORMAT "%4.2" /end CHARACTERISTIC
/begin CHARACTERISTIC OSD_V_RSP_PUC_RST_CNT_THR "counter threshold of do2 volt increase segments to reset do2 PUC response diag" VALUE 0x0002038C __UBYTE_S 0 u_cnts 0 255 /end CHARACTERISTIC
/begin CHARACTERISTIC OSD_V_RSP_PUC_RST_VLT_DEV_THR "do2 volt increase deviation threshold above which to reset do2 PUC response diag" VALUE 0x0002038C __UWORD_S 0 u_volt_32 0 31.99951171875 FORMAT "%5.3" /end CHARACTERISTIC
/begin CHARACTERISTIC OSD_V_RSP_PUC_VLT_HI "high do2 voltage below which begin to calculate response time" VALUE 0x0002038C __UWORD_S 0 u_volt_32 0 31.99951171875 FORMAT "%5.3" /end CHARACTERISTIC
/begin CHARACTERISTIC OSD_V_RSP_PUC_VLT_LO "low do2 voltage below which calculation of response time is ended" VALUE 0x0002038C __UWORD_S 0 u_volt_32 0 31.99951171875 FORMAT "%5.3" /end CHARACTERISTIC
/begin CHARACTERISTIC OSD_V_RSP_PUC_TM_FL_THR "fail threshold of do2 PUC response time" VALUE 0x0002038C __UWORD_S 0 u_tmr_8 0 7.9998779296875 /end CHARACTERISTIC
/begin CHARACTERISTIC OSD_V_RSP_PUC_TM_FIL "filter coefficient of do2 PUC response time" VALUE 0x0002038C __UWORD_S 0 u_filter 0 0.9999847412109375 FORMAT "%4.3" /end CHARACTERISTIC
/begin CHARACTERISTIC OSD_V_RSP_PUC_TM_MAX "max response time below which consider do2 PUC response diag reasonable" VALUE 0x0002038C __UWORD_S 0 u_1x_tmr 0.0 511.9921875 FORMAT "%5.2" /end CHARACTERISTIC
/begin CHARACTERISTIC OSD_V_RSP_POW_TM_INIT "initial value of osd_rsp_pow_tm when NVRAM reset" VALUE 0x0002038C __UWORD_S 0 u_tmr_8 0 7.9998779296875 /end CHARACTERISTIC
/begin CHARACTERISTIC OSD_V_RSP_POW_VLT_THR "max do2 voltage threshold to enable do2 POW response diag" VALUE 0x0002038C __UWORD_S 0 u_volt_32 0 31.99951171875 FORMAT "%5.3" /end CHARACTERISTIC
/begin CHARACTERISTIC OSD_V_RSP_POW_RUN_MIN "min engine runtime to enable do2 POW response diag" VALUE 0x0002038C __UWORD_S 0 u_1s_tmr 0.0 65535 /end CHARACTERISTIC
/begin CHARACTERISTIC OSD_V_RSP_POW_ECT_THR "min engine coolant threshold to enable do2 POW response diag" VALUE 0x0002038C __SWORD_S 0 u_deg_C -256 255.9921875 FORMAT "%4.2" /end CHARACTERISTIC
/begin CHARACTERISTIC OSD_V_RSP_POW_AIR_FLW_THR "min air flow threshold to enable do2 POW response diag" VALUE 0x0002038C __UWORD_S 0 u_g_per_sec 0 511.9921875 /end CHARACTERISTIC
/begin CHARACTERISTIC OSD_V_RSP_POW_AFR_THR "max air fuel ratio threshold to enable do2 POW response diag" VALUE 0x0002038C __UWORD_S 0 u_afr 0 31.99951171875 FORMAT "%4.2" /end CHARACTERISTIC
/begin CHARACTERISTIC OSD_V_RSP_POW_RST_CNT_THR "counter threshold of do2 volt decrease segments to reset do2 POW response diag" VALUE 0x0002038C __UBYTE_S 0 u_cnts 0 255 /end CHARACTERISTIC
/begin CHARACTERISTIC OSD_V_RSP_POW_RST_VLT_DEV_THR "do2 volt decrease deviation threshold above which to reset do2 POW response diag" VALUE 0x0002038C __UWORD_S 0 u_volt_32 0 31.99951171875 FORMAT "%5.3" /end CHARACTERISTIC
/begin CHARACTERISTIC OSD_V_RSP_POW_VLT_HI "high do2 voltage below which calculation of response time is ended" VALUE 0x0002038C __UWORD_S 0 u_volt_32 0 31.99951171875 FORMAT "%5.3" /end CHARACTERISTIC
/begin CHARACTERISTIC OSD_V_RSP_POW_VLT_LO "low do2 voltage below which begin to calculate response time" VALUE 0x0002038C __UWORD_S 0 u_volt_32 0 31.99951171875 FORMAT "%5.3" /end CHARACTERISTIC
/begin CHARACTERISTIC OSD_V_RSP_POW_TM_FIL "filter coefficient of do2 POW response time" VALUE 0x0002038C __UWORD_S 0 u_filter 0 0.9999847412109375 FORMAT "%4.3" /end CHARACTERISTIC
/begin CHARACTERISTIC OSD_V_RSP_POW_TM_MAX "max response time below which consider do2 POW response diag reasonable" VALUE 0x0002038C __UWORD_S 0 u_1x_tmr 0.0 511.9921875 FORMAT "%5.2" /end CHARACTERISTIC
/begin CHARACTERISTIC OSD_C_RSP_POW_TM_FL_THR "fail threshold of do2 POW response time" CURVE 0x000200B0 __UWORD_S 0 u_tmr_8 0 7.9998779296875 SYMBOL_LINK "OSD_C_RSP_POW_TM_FL_THR" 2
 /begin AXIS_DESCR COM_AXIS NO_INPUT_QUANTITY u_millisec_65535 9 0 65.535 AXIS_PTS_REF OSD_X_CAT_OSC /end AXIS_DESCR
/end CHARACTERISTIC
/begin AXIS_PTS OSD_X_CAT_OSC "" 0x0002006C NO_INPUT_QUANTITY SSV__UWORD_S 0 u_millisec_65535 9 0.000000 65.535 DEPOSIT ABSOLUTE SYMBOL_LINK "OSD_X_CAT_OSC" 2 /end AXIS_PTS
/begin CHARACTERISTIC FS_V_IDL_EN_AMP "idle fuel system enable amp min" VALUE 0x0002038C __UWORD_S 0 u_kPa_0_256 0 255.99609375 FORMAT "%4.1" /end CHARACTERISTIC
/begin CHARACTERISTIC FS_V_IDL_EN_IAT "idle fuel system enable iat min" VALUE 0x0002038C __SWORD_S 0 u_deg_C -256 255.9921875 FORMAT "%4.1" /end CHARACTERISTIC
/begin CHARACTERISTIC FS_V_IDL_EN_VLT "idle fuel system enable voltage min" VALUE 0x0002038C __UWORD_S 0 u_volt_32 0 31.99951171875 FORMAT "%5.3" /end CHARACTERISTIC
/begin CHARACTERISTIC FS_C_IDL_EN_AR "idle fuel system enable cell" CURVE 0x000200B0 __UBYTE_S 0 b_enable 0 1 FORMAT "%5.2"
 /begin AXIS_DESCR FIX_AXIS fmsp_adp_area u_cnts 8 18 25 /begin FIX_AXIS_PAR_LIST 18 19 20 21 22 23 24 25 /end FIX_AXIS_PAR_LIST /end AXIS_DESCR
/end CHARACTERISTIC
/begin CHARACTERISTIC FS_C_IDL_DIAG_CNTS "idle fuel system diag counts" CURVE 0x000200B0 __UBYTE_S 0 u_cnts 0 255
 /begin AXIS_DESCR FIX_AXIS fmsp_adp_area u_cnts 8 18 25 /begin FIX_AXIS_PAR_LIST 18 19 20 21 22 23 24 25 /end FIX_AXIS_PAR_LIST /end AXIS_DESCR
/end CHARACTERISTIC
/begin CHARACTERISTIC FS_C_IDL_LEAN_FL_CNTS "idle fuel system lean fail counts" CURVE 0x000200B0 __UBYTE_S 0 u_cnts 0 255
 /begin AXIS_DESCR FIX_AXIS fmsp_adp_area u_cnts 8 18 25 /begin FIX_AXIS_PAR_LIST 18 19 20 21 22 23 24 25 /end FIX_AXIS_PAR_LIST /end AXIS_DESCR
/end CHARACTERISTIC
/begin CHARACTERISTIC FS_C_IDL_RICH_FL_CNTS "idle fuel system rich fail counts" CURVE 0x000200B0 __UBYTE_S 0 u_cnts 0 255
 /begin AXIS_DESCR FIX_AXIS fmsp_adp_area u_cnts 8 18 25 /begin FIX_AXIS_PAR_LIST 18 19 20 21 22 23 24 25 /end FIX_AXIS_PAR_LIST /end AXIS_DESCR
/end CHARACTERISTIC
/begin CHARACTERISTIC FS_C_IDL_LEAN_MET_DLY "idle fuel system lean met delay" CURVE 0x000200B0 __UWORD_S 0 u_250m_tmr 0 16383.75 FORMAT "%7.2"
 /begin AXIS_DESCR FIX_AXIS fmsp_adp_area u_cnts 8 18 25 /begin FIX_AXIS_PAR_LIST 18 19 20 21 22 23 24 25 /end FIX_AXIS_PAR_LIST /end AXIS_DESCR
/end CHARACTERISTIC
/begin CHARACTERISTIC FS_C_IDL_RICH_MET_DLY "idle fuel system rich met delay" CURVE 0x000200B0 __UWORD_S 0 u_250m_tmr 0 16383.75 FORMAT "%7.2"
 /begin AXIS_DESCR FIX_AXIS fmsp_adp_area u_cnts 8 18 25 /begin FIX_AXIS_PAR_LIST 18 19 20 21 22 23 24 25 /end FIX_AXIS_PAR_LIST /end AXIS_DESCR
/end CHARACTERISTIC
/begin CHARACTERISTIC FS_V_IDL_PASS_AR_CNTS "idle fuel system pass area counts min" VALUE 0x0002038C __UBYTE_S 0 u_cnts 0 255 /end CHARACTERISTIC
/begin CHARACTERISTIC FS_V_IDL_FL_ADP_MIN "idle fuel system fail adpation min" VALUE 0x0002038C __UWORD_S 0 u_fac_2 0 1.999969482421875 FORMAT "%4.3" /end CHARACTERISTIC
/begin CHARACTERISTIC FS_V_IDL_FL_ADP_MAX "idle fuel system fail adpation max" VALUE 0x0002038C __UWORD_S 0 u_fac_2 0 1.999969482421875 FORMAT "%4.3" /end CHARACTERISTIC
/begin CHARACTERISTIC FS_V_FL_ADP_MIN "fuel system fail adpation min" VALUE 0x0002038C __UWORD_S 0 u_fac_2 0 1.999969482421875 FORMAT "%4.3" /end CHARACTERISTIC
/begin CHARACTERISTIC FS_V_FL_ADP_MAX "fuel system fail adpation max" VALUE 0x0002038C __UWORD_S 0 u_fac_2 0 1.999969482421875 FORMAT "%4.3" /end CHARACTERISTIC
/begin COMPU_METHOD u_volt_32 "voltage" RAT_FUNC "%6.4" "V" COEFFS 0.0 1.0 0.000000 0.0 0.0 0.00048828125 /end COMPU_METHOD
/begin COMPU_METHOD u_kPa_0_256 "press" RAT_FUNC "%5.2" "kPa" COEFFS 0.0 1.0 0.000000 0.0 0.0 0.00390625 /end COMPU_METHOD
/begin COMPU_METHOD u_kPa_4096n_4096p "press" RAT_FUNC "%5.1" "kPa" COEFFS 0.0 1.0 0.000000 0.0 0.0 0.125 /end COMPU_METHOD
/begin COMPU_METHOD u_fac_2048 "factor" RAT_FUNC "%5.1" "fac" COEFFS 0.0 1.0 0.000000 0.0 0.0 0.03125 /end COMPU_METHOD
/begin COMPU_METHOD u_fac_512 "factor" RAT_FUNC "%5.1" "fac" COEFFS 0.0 1.0 0.000000 0.0 0.0 0.0078125 /end COMPU_METHOD
/begin COMPU_METHOD u_fac_16 "factor" RAT_FUNC "%5.3" "fac" COEFFS 0.0 1.0 0.000000 0.0 0.0 0.000244140625 /end COMPU_METHOD
/begin COMPU_METHOD u_fac_8 "factor" RAT_FUNC "%8.7" "fac" COEFFS 0.0 1.0 0.000000 0.0 0.0 0.0001220703125 /end COMPU_METHOD
/begin COMPU_METHOD u_fac_4 "factor" RAT_FUNC "%5.4" "fac" COEFFS 0.0 1.0 0.000000 0.0 0.0 0.00006103515625 /end COMPU_METHOD
/begin COMPU_METHOD u_fac_2 "factor" RAT_FUNC "%3.2" "fac" COEFFS 0.0 1.0 0.000000 0.0 0.0 0.000030517578125 /end COMPU_METHOD
/begin COMPU_METHOD u_fac_1 "factor" RAT_FUNC "%4.3" "fac" COEFFS 0.0 1.0 0.000000 0.0 0.0 0.0000152587890625 /end COMPU_METHOD
/begin COMPU_METHOD u_fac_2_b "factor" RAT_FUNC "%3.2" "fac" COEFFS 0.0 1.0 0.000000 0.0 0.0 0.0078125 /end COMPU_METHOD
/begin COMPU_METHOD u_km "kilometers" RAT_FUNC "%5.0" "km" COEFFS 0.0 1.0 0.000000 0.0 0.0 1.0 /end COMPU_METHOD
/begin COMPU_METHOD u_fac_n32_p32 "factor" RAT_FUNC "%4.2" "fac" COEFFS 0.0 1.0 0.000000 0.0 0.0 0.0009765625 /end COMPU_METHOD
/begin COMPU_METHOD u_deg_K "degK" RAT_FUNC "%6.2" "K" COEFFS 0.0 1.0 0.0 0.0 0.0 0.03125 /end COMPU_METHOD
/begin COMPU_METHOD u_deg_K_s "degK" RAT_FUNC "%6.2" "K" COEFFS 0.0 1.0 0.0 0.0 0.0 0.0625 /end COMPU_METHOD
/begin COMPU_METHOD u_deg_C "degC" RAT_FUNC "%5.2" "¡æ" COEFFS 0.0 1.0 0.0 0.0 0.0 0.0078125 /end COMPU_METHOD
/begin COMPU_METHOD u_deg_C_n2048_p2048 "degC" RAT_FUNC "%5.1" "¡æ" COEFFS 0.0 1.0 0.0 0.0 0.0 0.0625 /end COMPU_METHOD
/begin COMPU_METHOD u_filter "filter" RAT_FUNC "%11.10" "coef" COEFFS 0.0 1.0 0.0 0.0 0.0 0.0000152587890625 /end COMPU_METHOD
/begin COMPU_METHOD u_cnts "counts" RAT_FUNC "%3.0" "cnts" COEFFS 0.0 1.0 0.0 0.0 0.0 1.0 /end COMPU_METHOD
/begin COMPU_METHOD u_1x_tmr "7.81 timer" RAT_FUNC "%4.3" "s" COEFFS 0.0 1.0 0.0 0.0 0.0 0.0078125 /end COMPU_METHOD
/begin COMPU_METHOD u_2x_tmr "15.6 timer" RAT_FUNC "%6.2" "s" COEFFS 0.0 1.0 0.0 0.0 0.0 0.015625 /end COMPU_METHOD
/begin COMPU_METHOD u_8x_tmr "62.5 timer" RAT_FUNC "%6.2" "s" COEFFS 0.0 1.0 0.0 0.0 0.0 0.0625 /end COMPU_METHOD
/begin COMPU_METHOD u_16x_tmr "125 timer" RAT_FUNC "%5.1" "s" COEFFS 0.0 1.0 0.0 0.0 0.0 0.125 /end COMPU_METHOD
/begin COMPU_METHOD u_1s_tmr "1 sec timer" RAT_FUNC "%5.0" "s" COEFFS 0.0 1.0 0.0 0.0 0.0 1.0 /end COMPU_METHOD
/begin COMPU_METHOD u_250m_tmr "250ms timer" RAT_FUNC "%5.0" "s" COEFFS 0.0 1.0 0.0 0.0 0.0 0.25 /end COMPU_METHOD
/begin COMPU_METHOD u_millisec_65535 "millisec" RAT_FUNC "%5.3" "s" COEFFS 0.0 1.0 0.0 0.0 0.0 0.001 /end COMPU_METHOD
/begin COMPU_METHOD b_true "" TAB_VERB "%6.3" "" COMPU_TAB_REF b_true /end COMPU_METHOD
/begin COMPU_VTAB b_true "" TAB_VERB 2 0 "FALSE" 1 "TRUE" /end COMPU_VTAB
/begin COMPU_METHOD b_enable "" TAB_VERB "%6.3" "" COMPU_TAB_REF b_enable /end COMPU_METHOD
/begin COMPU_VTAB b_enable "" TAB_VERB 2 0 "DISABLE" 1 "ENABLE" /end COMPU_VTAB
/begin COMPU_METHOD u_mf_fac_rsn "" TAB_VERB "%6.3" "" COMPU_TAB_REF u_mf_fac_rsn /end COMPU_METHOD
/begin COMPU_VTAB u_mf_fac_rsn "" TAB_VERB 12 0 "NO_REASON" 1 "POWER_UP" 2 "NEG_TORQ_DRIVING" 3 "NEG_REF_DELTA" 4 "POS_REF_DELTA" 5 "AC_CLUTCH_TRANS" 6 "AUTO_TRANS_SHIFT" 7 "AUTO_TRANS_TCC" 8 "LARGE_THROT_CHANGE" 9 "TOOTH_ERROR_NOT_LEARNED" 10 "MULTI_FUEL_LEARNING" 11 "CLUTCH_RLS" /end COMPU_VTAB
/begin COMPU_METHOD u_mf_dly_rsn "" TAB_VERB "%6.3" "" COMPU_TAB_REF u_mf_dly_rsn /end COMPU_METHOD
/begin COMPU_VTAB u_mf_dly_rsn "" TAB_VERB 32 0 "NO_DELAY" 1 "POWER_UP_DELAY" 2 "OTHER_TEST_RUN" 3 "KEY_ON_FAULT" 4 "ACTIVE_FAULT" 5 "BAT_VOLTAGE" 6 "ENGINE_SPEED" 7 "COOLANT_TEMPERATURE" 8 "TCC_LOCKED" 9 "FUEL_LEVEL_LOW" 10 "NEGATIVE_TORQ_DRIVING" 11 "LARGE_THROT_CHANGE" 12 "POSITIVE_REF_DELTA" 13 "NEGATIVE_REF_DELTA" 14 "NEGATIVE_TORQUE_LOAD" 15 "UNDETECTABLE_REGION" 16 "TORQUE_REDUCTION_ACTIVE" 17 "AC_CLUTCH_TRANSITION" 18 "AUTO_TRANS_SHIFT" 19 "FUEL_PULSE_WIDTH_IS_ZERO" 20 "FUEL_CUT_OFF" 21 "CAM_SYNCH_FAULT_ACTIVE" 22 "ENGINE_SPEED_HIGH" 23 "ENG_SPEED_HI_AND_TEC_NOT_LEARNED" 24 "CQ_NOT_READY" 25 "RETURNLESS_SYSTEM_PRIME_DLY" 26 "LPI_panic_switch" 27 "AMP_LOW" 28 "CYLINDER_CDAS_TRANSITION" 29 "ENG_RESYNCH" 30 "IG_EFF_CHNG" 31 "CLUTCH_RLS" /end COMPU_VTAB
/begin COMPU_METHOD u_mf_crk_typ "" TAB_VERB "%4.0" "" COMPU_TAB_REF u_mf_crk_typ /end COMPU_METHOD
/begin COMPU_VTAB u_mf_crk_typ "" TAB_VERB 2 0 "REF_SEG" 1 "TDC_SEG" /end COMPU_VTAB
/begin COMPU_METHOD u_mf_dtc_typ "" TAB_VERB "%4.0" "" COMPU_TAB_REF u_mf_dtc_typ /end COMPU_METHOD
/begin COMPU_VTAB u_mf_dtc_typ "" TAB_VERB 2 0 "P0300" 1 "P0300_OR_P030X" /end COMPU_VTAB
/begin COMPU_METHOD u_mf_trs_cfg "" TAB_VERB "%4.0" "" COMPU_TAB_REF u_mf_trs_cfg /end COMPU_METHOD
/begin COMPU_VTAB u_mf_trs_cfg "" TAB_VERB 2 0 "ACC_MODE" 1 "TRQ_MODE" /end COMPU_VTAB
/begin COMPU_METHOD u_cru_lrn_typ "" TAB_VERB "%4.0" "" COMPU_TAB_REF u_cru_lrn_typ /end COMPU_METHOD
/begin COMPU_VTAB u_cru_lrn_typ "" TAB_VERB 4 0 "UNUSE" 1 "CRUZ" 2 "ACC" 255 "UNKNOWN" /end COMPU_VTAB
/begin COMPU_METHOD u_espd "engine speed" RAT_FUNC "%5.2" "rpm" COEFFS 0.0 1.0 0.000000 0.0 0.0 0.125 /end COMPU_METHOD
/begin COMPU_METHOD u_vspd "vehicle speed" RAT_FUNC "%5.2" "kph" COEFFS 0.0 1.0 0.000000 0.0 0.0 0.0078125 /end COMPU_METHOD
/begin COMPU_METHOD u_vspd_err "vehicle speed error" RAT_FUNC "%5.2" "kph" COEFFS 0.0 1.0 0.000000 0.0 0.0 0.015625 /end COMPU_METHOD
/begin COMPU_METHOD u_vspd_per_sec "vehicle speed acc" RAT_FUNC "%5.3" "kph/s" COEFFS 0.0 1.0 0.000000 0.0 0.0 0.001953125 /end COMPU_METHOD
/begin COMPU_METHOD u_pct "percentage" RAT_FUNC "%5.2" "%" COEFFS 0.0 1.0 0.000000 0.0 0.0 0.0030517578125 /end COMPU_METHOD
/begin COMPU_METHOD u_pct_1 "percentage" RAT_FUNC "%5.2" "%" COEFFS 0.0 1.0 0.000000 0.0 0.0 0.00152587890625 /end COMPU_METHOD
/begin COMPU_METHOD u_pct_8 "percentage" RAT_FUNC "%5.2" "%" COEFFS 0.0 1.0 0.000000 0.0 0.0 0.01220703125 /end COMPU_METHOD
/begin COMPU_METHOD u_pct_r_lo_s "real pct" RAT_FUNC "%5.2" "%" COEFFS 0.0 1.0 0.000000 0.0 0.0 0.0078125 /end COMPU_METHOD
/begin COMPU_METHOD u_stk_flw "stroke flow" RAT_FUNC "%5.4" "g/stk" COEFFS 0.0 1.0 0.000000 0.0 0.0 0.000030517578125 /end COMPU_METHOD
/begin COMPU_METHOD u_g_per_sec "g per second" RAT_FUNC "%5.2" "g/s" COEFFS 0.0 1.0 0.000000 0.0 0.0 0.0078125 /end COMPU_METHOD
/begin COMPU_METHOD u_afr "airfuel" RAT_FUNC "%3.1" "Ratio" COEFFS 0.0 1.0 0.000000 0.0 0.0 0.00048828125 /end COMPU_METHOD
/begin COMPU_METHOD u_kPa_0_4096 "IMEP" RAT_FUNC "%6.2" "kPa" COEFFS 0.0 1.0 0.000000 0.0 0.0 0.0625 /end COMPU_METHOD
/begin COMPU_METHOD u_tq "torque" RAT_FUNC "%5.1" "Nm" COEFFS 0.0 1.0 0.000000 0.0 0.0 0.0625 /end COMPU_METHOD
/begin COMPU_METHOD u_gram_l_65536 "gram" RAT_FUNC "%8.3" "g" COEFFS 0.0 1.0 0.000000 0.0 0.0 0.0000152587890625 /end COMPU_METHOD
/begin COMPU_METHOD u_tq_gr_typ "" TAB_VERB "%5.0" "" COMPU_TAB_REF u_tq_gr_typ /end COMPU_METHOD
/begin COMPU_VTAB u_tq_gr_typ "" TAB_VERB 11 0 "GEAR_1" 1 "GEAR_2" 2 "GEAR_3" 3 "GEAR_4" 4 "GEAR_5" 5 "GEAR_6" 6 "GEAR_7" 7 "GEAR_8" 8 "UNKNOWN" 9 "PN" 10 "R" /end COMPU_VTAB
/begin COMPU_METHOD u_rpt_st "" TAB_VERB "%5.0" "" COMPU_TAB_REF u_rpt_st /end COMPU_METHOD
/begin COMPU_VTAB u_rpt_st "" TAB_VERB 3 0 "NO_REPORT" 1 "PASS" 2 "FAIL" /end COMPU_VTAB
/begin COMPU_METHOD u_cfd_diag_typ "" TAB_VERB "%5.0" "" COMPU_TAB_REF u_cfd_diag_typ /end COMPU_METHOD
/begin COMPU_VTAB u_cfd_diag_typ "" TAB_VERB 3 0 "IDL" 1 "VSPD_1" 2 "VSPD_2" /end COMPU_VTAB
/begin COMPU_METHOD u_cfd_diag_cfg "" TAB_VERB "%5.0" "" COMPU_TAB_REF u_cfd_diag_cfg /end COMPU_METHOD
/begin COMPU_VTAB u_cfd_diag_cfg "" TAB_VERB 3 0 "IDLE" 1 "ONE_VSPD" 2 "TWO_VSPD" /end COMPU_VTAB
/begin COMPU_METHOD u_cfd_fail "" TAB_VERB "%5.0" "" COMPU_TAB_REF u_cfd_fail /end COMPU_METHOD
/begin COMPU_VTAB u_cfd_fail "" TAB_VERB 2 0 "FAIL" 1 "PASS" /end COMPU_VTAB
/begin COMPU_METHOD u_o2_st "" TAB_VERB "%5.0" "" COMPU_TAB_REF u_o2_st /end COMPU_METHOD
/begin COMPU_VTAB u_o2_st "" TAB_VERB 2 0 "LEAN" 1 "RICH" /end COMPU_VTAB
/begin COMPU_METHOD u_cfd_diag_dis "" TAB_VERB "%5.0" "" COMPU_TAB_REF u_cfd_diag_dis /end COMPU_METHOD
/begin COMPU_VTAB u_cfd_diag_dis "" TAB_VERB 25 0 "NONE" 1 "RUN_TIME" 3 "AIRFLOW" 4 "OPEN_THROT" 5 "ECT" 6 "IAT" 7 "AMP" 8 "DIAG_TRY_MAX" 9 "FUEL_OPEN_LOOP" 10 "TORQUE_MANAGE" 11 "CAT_TEMP" 12 "FUEL_CL_OUT" 13 "VEHICLE_SPD" 14 "TRS_IN_PN" 16 "PRE_AIRFLOW" 17 "AF_RAMP" 18 "IDLE_TIME_EXCD" 19 "TRIP_TEST_FN" 20 "FAULT_ACTV" 21 "F_ACTV" 22 "GEOL_CTRL_ACTV" 23 "FUEL_SUM" 26 "ENGINE_SPD" 27 "ENGINE_TRANS" 28 "O2_HT" /end COMPU_VTAB
/begin COMPU_METHOD u_cfd_diag_ext "" TAB_VERB "%5.0" "" COMPU_TAB_REF u_cfd_diag_ext /end COMPU_METHOD
/begin COMPU_VTAB u_cfd_diag_ext "" TAB_VERB 15 0 "NONE" 1 "IDL_SPD_ERR" 2 "STG1_HIGH_OSC" 3 "STG1_UO2_NOT_SWTCH" 4 "STG1_UO2_CHG_LO" 5 "STG2_UO2_NOT_SWITCHED" 6 "STG2_UO2_CHG_LO" 7 "FAN1_CHG" 8 "FAN2_CHG" 9 "AC_CHG" 11 "EN_CONDS_CHG" 13 "AT_ST_CHG" 14 "PURGE_ACTV" 17 "FUEL_SYS" 18 "DO2_UNSTABLE" /end COMPU_VTAB
/begin COMPU_METHOD u_osd_dis_rsn "" TAB_VERB "%5.0" "" COMPU_TAB_REF u_osd_dis_rsn /end COMPU_METHOD
/begin COMPU_VTAB u_osd_dis_rsn "" TAB_VERB 19 0 "UNKONWN" 1 "DIAG_OFF" 2 "TRIP_DIAG_MAX" 3 "DIS_FAULT_ACTV" 4 "GEOL_ACTV" 5 "FUEL_LVL_LO" 6 "AMP" 7 "PURGE_ACTV" 10 "ADP_CELL" 11 "ADP_CELL_CHG" 12 "FUEL_OPEN_LOOP" 13 "FUEL_CUT" 14 "AFR_NOT_STOICH" 15 "FUEL_CL_OUT" 17 "AIR_FLW_LO" 18 "AIR_FLW_HI" 20 "STBL_DLY" 21 "GEOL_EVAM_DIAG_EN" 22 "DIAG_EN" /end COMPU_VTAB
/begin COMPU_METHOD u_ico_typ "" TAB_VERB "%6.3" "" COMPU_TAB_REF u_ico_typ /end COMPU_METHOD
/begin COMPU_VTAB u_ico_typ "" TAB_VERB 4 0 "PWM" 1 "DISCRETE" 2 "LIN" 3 "UNUSE" /end COMPU_VTAB
/begin COMPU_METHOD u_ico_amb_t "" TAB_VERB "%6.3" "" COMPU_TAB_REF u_ico_amb_t /end COMPU_METHOD
/begin COMPU_VTAB u_ico_amb_t "" TAB_VERB 2 0 "AMB_TEMP" 1 "IAT" /end COMPU_VTAB
/begin COMPU_METHOD u_fan_t_src "" TAB_VERB "%6.3" "" COMPU_TAB_REF u_fan_t_src /end COMPU_METHOD
/begin COMPU_VTAB u_fan_t_src "" TAB_VERB 2 0 "ECT" 1 "ECT_THEM_DLT" /end COMPU_VTAB
/begin COMPU_METHOD u_vhsc_lmt "" TAB_VERB "%6.3" "" COMPU_TAB_REF u_vhsc_lmt /end COMPU_METHOD
/begin COMPU_VTAB u_vhsc_lmt "" TAB_VERB 2 0 "INTERNAL" 1 "EXTERNAL" /end COMPU_VTAB
/begin COMPU_METHOD u_vhsc_sw_cfg "" TAB_VERB "%6.3" "" COMPU_TAB_REF u_vhsc_sw_cfg /end COMPU_METHOD
/begin COMPU_VTAB u_vhsc_sw_cfg "" TAB_VERB 2 0 "SET/COAST/DOWN RES/ACC/UP" 1 "SET/ACC/UP RES/COAST/DOWN" /end COMPU_VTAB
/begin COMPU_METHOD u_tel_drv_typ "" TAB_VERB "%6.3" "" COMPU_TAB_REF u_tel_drv_typ /end COMPU_METHOD
/begin COMPU_VTAB u_tel_drv_typ "" TAB_VERB 4 0 "UNUSE" 1 "FUEL_CUT" 2 "STEADY_STATE" 3 "CUT_AND_SS" /end COMPU_VTAB
/begin COMPU_METHOD u_volt_8 "voltage" RAT_FUNC "%6.5" "V" COEFFS 0.0 1.0 0.000000 0.0 0.0 0.0001220703125 /end COMPU_METHOD
/begin COMPU_METHOD u_osd_bnk "" TAB_VERB "%6.3" "" COMPU_TAB_REF u_osd_bnk /end COMPU_METHOD
/begin COMPU_VTAB u_osd_bnk "" TAB_VERB 1 0 "BANK1" /end COMPU_VTAB
/begin COMPU_METHOD u_osd_volt_thr "" TAB_VERB "%6.3" "" COMPU_TAB_REF u_osd_volt_thr /end COMPU_METHOD
/begin COMPU_VTAB u_osd_volt_thr "" TAB_VERB 2 0 "Lean" 1 "Rich" /end COMPU_VTAB
/begin COMPU_METHOD u_osd_sw "" TAB_VERB "%6.3" "" COMPU_TAB_REF u_osd_sw /end COMPU_METHOD
/begin COMPU_VTAB u_osd_sw "" TAB_VERB 2 0 "LeanToRich" 1 "RichToLean" /end COMPU_VTAB
/begin COMPU_METHOD u_fac_256 "ratio" RAT_FUNC "%5.2" "ratio" COEFFS 0.0 1.0 0.000000 0.0 0.0 0.00390625 /end COMPU_METHOD
/begin COMPU_METHOD u_amp_65 "current" RAT_FUNC "%5.3" "A" COEFFS 0.0 1.0 0.000000 0.0 0.0 0.001 /end COMPU_METHOD
/begin COMPU_METHOD u_osd_o2 "" TAB_VERB "%6.3" "" COMPU_TAB_REF u_osd_o2 /end COMPU_METHOD
/begin COMPU_VTAB u_osd_o2 "" TAB_VERB 2 0 "upstream" 1 "downstream" /end COMPU_VTAB
/begin COMPU_METHOD u_tmr_8 "8s timer" RAT_FUNC "%4.3" "s" COEFFS 0.0 1.0 0.0 0.0 0.0 0.0001220703125 /end COMPU_METHOD
/begin COMPU_METHOD u_cru_lrn_typ "" TAB_VERB "%6.3" "" COMPU_TAB_REF u_cru_lrn_typ /end COMPU_METHOD
/begin COMPU_VTAB u_cru_lrn_typ "" TAB_VERB 3 0 "SWITCH" 1 "EOL_COM" 2 "SW_EOL" /end COMPU_VTAB
/begin COMPU_METHOD u_cru_ctrl_typ "" TAB_VERB "%6.3" "" COMPU_TAB_REF u_cru_ctrl_typ /end COMPU_METHOD
/begin COMPU_VTAB u_cru_ctrl_typ "" TAB_VERB 4 0 "UNUSE" 1 "CRUISE" 2 "ACC" 3 "LEARN" /end COMPU_VTAB
/begin COMPU_METHOD u_tq_fault "" TAB_VERB "%6.3" "" COMPU_TAB_REF u_tq_fault /end COMPU_METHOD
/begin COMPU_VTAB u_tq_fault "" TAB_VERB 8 0 "MAP_Short" 1 "MAF" 2 "EST" 3 "IAT_Short" 4 "INJ" 5 "Misfire" 6 "ECT" 7 "LPI" /end COMPU_VTAB
/begin COMPU_METHOD u_vspd_err_n2_p2 "vehicle speed error" RAT_FUNC "%6.5" "kph" COEFFS 0.0 1.0 0.000000 0.0 0.0 0.00006103515625 /end COMPU_METHOD
/begin COMPU_METHOD u_kilo_Newton "Kilo Newton" RAT_FUNC "%6.2" "kN" COEFFS 0.0 1.0 0.000000 0.0 0.0 0.00390625 /end COMPU_METHOD
/begin COMPU_METHOD u_tel_dis_rsn "" TAB_VERB "%4.0" "" COMPU_TAB_REF u_tel_dis_rsn /end COMPU_METHOD
/begin COMPU_VTAB u_tel_dis_rsn "" TAB_VERB 21 0 "NO_REASON" 1 "NO_REQUEST" 2 "DRV_LOAD_OUT" 3 "DRV_ENGINE_SPEED_OUT" 4 "DRV_VEHICLE_SPEED_LOW" 5 "EOL_TEST_FAILED" 6 "TOOTH_LEARNED" 7 "EOL_NOT_IN_PN" 8 "EOL_VEHICLE_MOVING" 9 "EOL_ENGINE_SPEED_ACCEL" 10 "EOL_LEARN_TIMES_EXCD" 11 "ENGINE_RUN_TIME" 12 "COOLANT_TEMP_OUT" 13 "BAT_VOLTAGE_OUT" 14 "FAULT_ACTIVE" 15 "FAULT_TRIP" 16 "DRV_STABILITY_NOT_MET" 17 "TOOTH_LEARNED_BY_EOL" 18 "" 19 "DRV_GEAR_DISABLE" 20 "DRV_DFCO_DELAY" /end COMPU_VTAB
/begin COMPU_METHOD p_t_GPF_PCT_0_1 "" RAT_FUNC "%7.6" "1/%" COEFFS 0.0 1.0 0.0 0.0 0.0 0.0000152587890625 /end COMPU_METHOD
/begin COMPU_METHOD p_t_GPF_ADSLOPE_N512_512 "" RAT_FUNC "%6.3" "Ratio" COEFFS 0.0 1.0 0.0 0.0 0.0 0.015625 /end COMPU_METHOD
/begin COMPU_METHOD p_t_GPF_FILTER_0_1 "" RAT_FUNC "%7.6" "coef" COEFFS 0.0 1.0 0.0 0.0 0.0 0.0000152587890625 /end COMPU_METHOD
/begin FUNCTION ente_ico "intercool control"
 /begin DEF_CHARACTERISTIC ENTE_V_EXH_T_DEC_FIL ENTE_V_EXH_T_INC_FIL ENTE_V_ICO_DTY_SP_DEC_FIL ENTE_V_ICO_DTY_SP_INC_FIL ENTE_V_ICO_T_FIL ENTE_M_ICO_T_SP ENTE_X_AMB_T ENTE_M_ICO_IMEP_AXIS ENTE_X_ESPD_A ENTE_C_ICO_RAD_DTY_FAC ENTE_X_PUMP_DTY ENTE_C_ICO_RAD_VSPD_FAC ENTE_X_VSPD_A ENTE_M_ICO_DTY_BS ENTE_X_ICO_OUT_T_SP ENTE_X_ICO_RAD_T ENTE_C_ICO_DTY_LD_FAC ENTE_X_STK_FLW ENTE_V_ICO_DTY_I_GN ENTE_C_ICO_DTY_P ENTE_X_ICO_T_DLT_A ENTE_M_ICO_DTY_D ENTE_X_ICO_OUT_T_SP_CHG ENTE_X_ICO_T_DLT_B ENTE_C_ICO_DTY_MIN ENTE_X_EXH_T ENTE_V_ICO_DTY_MAX ENTE_V_ICO_TYP ENTE_V_ICO_ACTV_DTY ENTE_V_ICO_INACTV_DTY ENTE_V_ICO_OFFR_VLT ENTE_C_ICO_OFFR_DTY ENTE_X_ICO_OFFR_TM ENTE_V_ICO_INT_MAX ENTE_V_ICO_INT_MIN ENTE_V_ICO_OFFR_AMBT_CFG ENTE_M_ICO_OFFR_DUR ENTE_X_EXH_T_B ENTE_X_AMB_T_B ENTE_V_FAN_OFFR_TEMP_DUR ENTE_V_FAN_T_SRC /end DEF_CHARACTERISTIC
 /begin OUT_MEASUREMENT ente_ico_offr_tmr ente_exh_t_filt ente_ico_rad_t ente_ico_out_t_sp ente_ico_dty_sp /end OUT_MEASUREMENT
/end FUNCTION
/begin FUNCTION ente "engine temp" /begin SUB_FUNCTION ente_fan ente_ico /end SUB_FUNCTION /end FUNCTION
/begin FUNCTION vhsc "vehicle speed control"
 /begin DEF_CHARACTERISTIC VHSC_V_LMT_SRC VHSC_V_LMT_EN VHSC_V_LMT_EN_ESPD_MIN VHSC_V_LMT_SW_CFG VHSC_V_LMT_PINC_HLD_MIN VHSC_V_LMT_PRD_RND_BS VHSC_V_LMT_PRD_DEC_STP VHSC_V_LMT_PRD_INC_STP VHSC_V_LMT_TAP_DEC_STP VHSC_V_LMT_TAP_INC_STP VHSC_V_LMT_SPD_EXC_HYS VHSC_V_LMT_PEDL_OVR_HI VHSC_V_LMT_PEDL_OVR_LO VHSC_V_LMT_INC_MAX VHSC_V_LMT_DEC_MAX VHSC_V_LMT_RMP_ACTV_DLT VHSC_V_LMT_DEC_PRD VHSC_V_LMT_INC_PRD VHSC_V_LMT_PDEC_HLD_MIN VHSC_V_LMT_MAX VHSC_V_LMT_MIN VHSC_V_LMT_RES_EN VHSC_V_CRU_LRN_TYP VHSC_V_CRU_TYP VHSC_V_CRU_EN_ESPD_MIN VHSC_V_CRU_SW_CFG VHSC_C_CRU_EN_ERR_MIN VHSC_X_CRU_VSPD_A VHSC_V_CRU_EN_ERR_MAX VHSC_V_CRU_EXT_VSPD_MAX VHSC_V_CRU_EXT_VSPD_MIN VHSC_C_CRU_EN_ACC_MAX VHSC_C_CRU_EN_ACC_MIN VHSC_C_CRU_BIAS_RES_DLT VHSC_C_CRU_BIAS_ACC_DLT VHSC_V_CRU_BIAS_CST_DLT VHSC_V_CRU_BIAS_PLS_DLT VHSC_V_CRU_BIAS_TRS_DLT VHSC_V_CRU_BIAS_MNS_DLT VHSC_V_CRU_SP_CHG_CST_DUR VHSC_V_CRU_BIAS_ACC_FAC VHSC_V_CRU_ACTV_EN_DUR VHSC_C_CRU_ACC_INIT_DLT VHSC_V_CRU_BIAS_RES_FAC VHSC_V_CRU_MNS_ERR_HI VHSC_V_CRU_MNS_SW_OFF_DUR VHSC_V_CRU_PLS_ERR_HI VHSC_V_CRU_PLS_ERR_LO VHSC_V_CRU_SP_CHG_ACC_DUR VHSC_V_CRU_ACC_SW_DUR VHSC_V_CRU_RES_SW_DUR VHSC_V_CRU_MNS_CST_DUR VHSC_V_CRU_EN_VSPD_MAX VHSC_V_CRU_EN_VSPD_MIN VHSC_V_CRU_TAP_DLT VHSC_V_CRU_BIAS_ACC_MAX VHSC_V_CRU_RES2ACTV_SW_DUR VHSC_V_MX_EFF_VSPD_DLT VHSC_V_CTRL_HYS VHSC_V_CTRL_HYS_MN VHSC_V_INT_MX VHSC_V_INT_MN VHSC_V_LCK_INT_MX VHSC_V_LCK_INT_MN VHSC_V_VSPD_STP_MX VHSC_V_VSPD_STP_MN VHSC_C_PWR_SP_AMP_FAC VHSC_C_EFF_SP VHSC_C_PROP_FAC VHSC_C_RD_LD VHSC_C_CTRL_TORQ_HYS VHSC_C_TORQ_SP_FILT VHSC_C_TORQ_SP_FILT_SHFT VHSC_V_ACC_SP_FAC_UP VHSC_V_ACC_SP_FAC_DN VHSC_V_INT_FAC_DEC VHSC_V_INT_FAC_INC VHSC_V_INT_FAC_ACC VHSC_V_HYS_STP VHSC_V_DIS_DLY_ABS VHSC_V_DN_SHFT_LVL VHSC_V_VEH_FRIC VHSC_V_DL_EFFI VHSC_V_TORQ_SP_FILT_FAC_DEC VHSC_V_TORQ_MX VHSC_V_TORQ_MN VHSC_V_TORQ_MX_THRSH VHSC_V_TORQ_MN_THRSH VHSC_V_TORQ_MX_DLT VHSC_V_TORQ_MN_DLT VHSC_V_TORQ_ACT_MN_THRSH VHSC_V_CLS_THRO VHSC_V_SPD_RT_FAC VHSC_V_SPD_RT_FAC_SHFT VHSC_V_EFF2TORQ_FAC VHSC_V_MX_PPS_INT VHSC_V_CTRL_CAN VHSC_V_RES2TAP_ENBL VHSC_X_VSPD_DLT VHSC_X_AMP /end DEF_CHARACTERISTIC
 /begin OUT_MEASUREMENT vhsc_cru_vspd_dlt vhsc_cru_lrn_typ /end OUT_MEASUREMENT
/end FUNCTION
/begin FUNCTION ac ""
 /begin DEF_CHARACTERISTIC AC_V_EN_AC_T_MIN_HI AC_V_EN_AC_T_MIN_LO AC_V_EN_VSPD_MAX_HI AC_V_EN_VSPD_MAX_LO AC_V_DIS_PPS_MIN_LO AC_V_DIS_PPS_MIN_HI AC_V_DIS_PPS_DUR AC_V_DIS_HI_LOAD_DUR AC_C_HI_LOAD_VSPD_DLT AC_V_DIS_PS_ESPD_MAX_HI AC_V_DIS_PS_ESPD_MAX_LO AC_V_DIS_HI_ESPD_MIN_HI AC_V_DIS_HI_ESPD_MIN_LO AC_V_DIS_HI_ESPD_ACTV_DLY AC_V_DIS_HI_ESPD_EXT_DLY AC_V_DIS_LO_ESPD_MAX_LO AC_V_DIS_LO_ESPD_MAX_HI AC_V_DIS_LO_ESPD_EXT_DLY AC_V_DIS_LNCH_PPS_HI AC_V_DIS_LNCH_PPS_LO AC_V_DIS_LNCH_VSPD_LO AC_V_DIS_LNCH_VSPD_HI AC_V_DIS_ECT_HI AC_V_DIS_ECT_LO AC_V_DIS_ECT_DLY AC_V_DIS_AC_PRES_HI AC_V_DIS_AC_PRES_HI_HYS AC_V_DIS_AC_PRES_LO AC_V_DIS_AC_PRES_LO_HYS AC_V_TRSM_UP_KP_DUR AC_V_TRSM_DWN_KP_DUR AC_V_EN_HRST_RUN_MIN AC_C_EN_RUN_MIN AC_V_EN_OFF_MIN AC_C_OFF_DLY AC_C_OFF_DLY_IAT_FAC AC_C_OFF_DLY_AC_P_FAC AC_C_ON_DLY_IAT_FAC AC_C_ON_DLY_AC_P_FAC AC_V_DIS_PPS_EXT_ESPD AC_V_DIS_ACC_DUR AC_V_DIS_ACC_PPS_HI_THR AC_V_DIS_ACC_PPS_DLT_MIN AC_V_DIS_ACC_ESPD_MAX AC_V_DIS_ACC_VSPD_MAX AC_V_DIS_ACC_PPS_LO_THR AC_V_DIS_ACC_EXTRA_DUR AC_C_ON_DLY /end DEF_CHARACTERISTIC
 /begin OUT_MEASUREMENT ac_evap_t_dis ac_vspd_hi_dis ac_pps_hi_dis ac_hi_pps_actv_vspd ac_ps_espd_dis ac_espd_hi_dis ac_espd_lo_dis ac_veh_lnch_dis ac_ect_hi_dis ac_press_hi_dis ac_ctrl_hld ac_dis_conds_not_met ac_on_conds_met ac_ctrl_on ac_ctrl_chg ac_trip_1st_on ac_sys_detced /end OUT_MEASUREMENT
/end FUNCTION
/begin FUNCTION mf ""
 /begin DEF_CHARACTERISTIC MF_V_CRK_DUR_CFG MF_V_DTC_CFG MF_V_TRNS_COND_CFG MF_V_TRNS_POS_THR MF_V_TRNS_NEG_THR MF_V_TRNS_COMP_EN MF_V_NEG_THRT_TRQ_FAC MF_V_NEG_THRT_ACC_FAC MF_V_THRT_CHG_TRQ_FAC MF_V_THRT_CHG_ACC_FAC MF_V_NEG_THRT_FAC_DUR MF_V_THRT_CHG_FAC_DUR MF_V_POS_TRQ_FAC MF_V_POS_ACC_FAC MF_V_POS_FAC_DUR MF_V_NEG_TRQ_FAC MF_V_NEG_ACC_FAC MF_V_NEG_FAC_DUR MF_V_AC_TRQ_FAC MF_V_AC_ACC_FAC MF_V_AC_FAC_DUR MF_V_CLTCH_TRQ_FAC MF_V_CLTCH_ACC_FAC MF_V_CLTCH_FAC_DUR MF_V_SHFT_TRQ_FAC MF_V_SHFT_ACC_FAC MF_V_SHFT_FAC_DUR MF_V_TC_FAC_EN_LD MF_V_TC_FAC_VSPD MF_V_TC_TRQ_HI_FAC MF_V_TC_ACC_HI_FAC MF_V_TC_TRQ_LO_FAC MF_V_TC_ACC_LO_FAC MF_V_TC_FAC_DUR MF_M_CRKL_ACC_FAC MF_V_CRKL_FAC_DUR MF_V_TC_FAC_ACTV_DTY MF_M_TC_UNLCK_TRQ_FAC MF_M_TC_UNLCK_ACC_FAC MF_V_TC_UNLCK_FAC_DUR MF_V_STK_FLW_MAX MF_V_LD_FIL MF_V_DLY_POW_ON MF_V_DLY_ENG_SYN MF_V_DLY_OTHER_DIAG MF_V_DLY_MISC MF_V_DLY_BYPASS_TM MF_V_EN_VLT_MIN MF_V_EN_VLT_MAX MF_V_EN_ESPD_MIN MF_V_EN_ESPD_MAX MF_V_EN_ECT_MAX MF_V_EN_ECT_MIN MF_V_CLD_STRT_KEYON_ECT MF_V_EN_CLD_STRT_ECT_MIN MF_V_DLY_TC_UNLOCK MF_V_DLY_LO_FUEL MF_V_EN_FLV_MIN MF_V_DLY_NEG_THRT MF_V_NEG_TRQ_TPS MF_V_NEG_TRQ_VSPD MF_V_DLY_THRT_CHG MF_V_THRT_CHG_INC_THR MF_V_THRT_CHG_DEC_THR MF_V_DLY_POS_TRNS MF_V_DLY_NEG_TRNS MF_M_ZERO_TRQ MF_C_ZERO_TRQ_ECT_FAC MF_V_DLY_ZERO_TRQ MF_V_DLY_AC_CHG MF_V_DLY_TRNS_SHFT MF_V_SHFT_DLY_EN_TPS MF_V_DLY_FUEL_CUT MF_V_DLY_HI_ESPD MF_V_HI_ESPD_THR MF_V_DLY_IG_EFF_CHG MF_V_IG_EFF_DLT_THR MF_V_OPS_CYL_MD_EN MF_V_ADJ_CYL_MD_EN MF_V_STRT_THR_FAC_EN MF_V_STRT_THR_FAC_DUR MF_M_ACC_THR MF_M_TRQ_THR MF_V_BYPASS_CRKL_ESPD MF_V_DET_TMS_MIN MF_V_NO_DET_TMS_MIN MF_M_OPS_CYL_THR MF_M_ADJ_CYL_THR MF_M_CAT_DMG_THR MF_M_CAT_DMG_BLK MF_V_EMI_DMG_THR MF_V_STRT_THR_FAC MF_V_CAT_DMG_CNFM_HYS MF_V_EMI_DMG_CNFM_THR MF_V_EMI_DMG_BLK MF_V_SPEC_CYL_RT MF_V_EN_AMP_MIN MF_V_DLY_AMP MF_V_DLY_CLTCH_RLS MF_V_FTP_LD_MAX MF_V_FTP_ESPD_MAX MF_V_FTP_CAT_DMG_BLK MF_V_FTP_EMI_DMG_BLK MF_V_ZERO_TQ_ESPD_MAX MF_V_POWON_ACC_FAC MF_V_POWON_TRQ_FAC MF_V_POWON_FAC_DUR MF_V_DLY_DIAG_OFF MF_V_DLY_CAM_SYN MF_V_CAT_UNLCK_TC_THR MF_V_EMI_UNLCK_TC_THR MF_V_TRNS_THR_STRT_FAC MF_V_INIT_EVL_DUR /end DEF_CHARACTERISTIC
 /begin OUT_MEASUREMENT mf_eng_load mf_trq_idx mf_trq_idx_thr mf_eng_cyl mf_acl_dev_max1 mf_acl_dev_max2 mf_misf_tms mf_acl_idx_thr mf_misf_cyl_tms mf_acl_tm_dlt mf_trq_tm_dlt mf_log_idx mf_cycle_bg mf_trs_pos_tms mf_trs_neg_tms mf_trs_pos_actv mf_trs_neg_actv mf_init_eval_fn mf_init_eval_cycle mf_trq_trs_fac mf_acl_trs_fac mf_trs_fac_dur mf_fac_rsn mf_trs_actv mf_trq_tcc_fac mf_acl_tcc_fac mf_tcc_fac_dur mf_trq_fn_fac mf_acl_fn_fac mf_cam_resyn mf_en_dly mf_dly_rsn mf_trip_dis_fl mf_actv_dis_fl mf_tcc_unlck_req mf_throt_dlt mf_trq_undetct mf_acl_undetct mf_cam_syn_err mf_fast_trq_chg mf_trq_actv mf_acl_actv mf_opps_acl_met mf_adj_acl_met mf_strt_thr_fac_actv mf_strt_cycle mf_cons_misf_cnts mf_cons_no_misf_cnts mf_misf_det mf_acl_dev1_det mf_acl_dev2_det mf_adj_acl_actv mf_trq_det mf_opps_acl_actv mf_acl_dev1_id mf_acl_dev2_id mf_opps_cyl_tms mf_opps_acl_det mf_adj_cyl_tms mf_adj_acl_det mf_opps_misf_det mf_adj_misf_det mf_cat_dmg_tms_thr mf_cat_dmg_blk_det mf_rr_det mf_emi_dmg_tms_thr mf_emi_dmg_blk_det mf_emi_dmg_blk_cnts mf_emi_dmg_fl mf_emi_dmg_log_cnts mf_emi_dmg_rpt_st mf_emi_rr_misf_det mf_cat_rr_misf_det mf_cat_dmg_blk_cnts mf_cat_dmg_blk_thr mf_cat_dmg_rpt_st mf_cat_dmg_fl mf_cat_dmg_log_cnts mf_total_emi_misf_tms mf_total_cat_misf_tms /end OUT_MEASUREMENT
/end FUNCTION
/begin FUNCTION tel "tooth error learn"
 /begin DEF_CHARACTERISTIC TEL_V_EOL_LOG_MAX TEL_V_EOL_EN_TPS_MAX TEL_V_EOL_CUT_ESPD TEL_V_EOL_RCVR_ESPD TEL_V_EOL_EN_VSPD TEL_V_EOL_DEC_EXT_ESPD_DLT TEL_V_DRV_LOG_MAX TEL_V_DRV_TYP TEL_V_DRV_EN_LD_MIN TEL_V_DRV_EN_LD_MAX TEL_V_DRV_EN_ESPD_MIN TEL_V_DRV_EN_ESPD_MAX TEL_V_DRV_EN_VSPD_MIN TEL_C_DRV_EN_GEAR TEL_V_DRV_EN_PUC_DLY TEL_V_EN_RUN_MIN TEL_V_EN_ECT_MIN TEL_V_EN_ECT_MAX TEL_V_EN_VLT_MIN TEL_V_EN_VLT_MAX TEL_V_DRV_SS_DLT_MAX TEL_V_DRV_DEV_LRN_EN TEL_V_FAC_VLD_MIN TEL_V_FAC_VLD_MAX TEL_V_FAC_DLT_SUM_MIN TEL_V_FAC_DLT_SUM_MAX TEL_V_DRV_FAC_FIL TEL_V_EOL_EN_ESPD_MAX TEL_V_DRV_ODM_MAX TEL_V_DRV_OPS_FAC_DLT TEL_V_DRV_SS1_EN_ESPD_MIN TEL_V_DRV_SS1_EN_ESPD_MAX TEL_V_DRV_SS2_EN_ESPD_MIN TEL_V_DRV_SS2_EN_ESPD_MAX TEL_V_DRV_SS_EN_ESPD_DLT TEL_V_DRV_SS_EN_TPS_DLT TEL_V_DRV_SS_EN_DLY TEL_V_LOG_MIN /end DEF_CHARACTERISTIC
 /begin OUT_MEASUREMENT tel_eol_actv tel_fco_req tel_fac_avl tel_dis_rsn tel_trip_lrnd tel_eol_trip_lrnd tel_drv_stbl_met tel_eol_lrn_tms tel_eol_lrn_ext tel_eol_fac_fl tel_lrn_en tel_drv_stbl_dly tel_log_tms tel_acc_unstbl tel_fac_raw tel_opps_fac_dlt_hi tel_fac_opps_avg tel_fac_avg tel_fac_sum tel_fac_mmv_req tel_fac_dlt_sum tel_fac_raw_avl tel_fac_mmv tel_fac_mmv_dlt_sum tel_lrn_fn tel_lrn_fl tel_strt_odo tel_log_prd_fl_cnts /end OUT_MEASUREMENT
/end FUNCTION
/begin FUNCTION cfd ""
 /begin DEF_CHARACTERISTIC CFD_C_AF_LEAN_BIAS CFD_C_AF_RICH_BIAS CFD_C_AF_LEAN_RMP_STP CFD_C_AF_RICH_RMP_STP CFD_C_AF_STG_RMP_STP CFD_V_EN_IDL_DLY CFD_C_STG1_DUR_MIN CFD_C_STG1_DUR_MAX CFD_C_STG2_DUR_MAX CFD_V_OSC_MAX CFD_V_RPT_EN_DIAG_MIN CFD_V_INIT_TRIP_DIAG_NUM CFD_V_TRIP_DIAG_MAX CFD_V_INIT_DIAG_NUM_MIN CFD_C_EN_FLW_MIN CFD_C_EN_FLW_MAX CFD_V_EN_ECT_MIN CFD_V_EN_ECT_MAX CFD_V_EN_CAT_T_MAX CFD_V_EN_CAT_T_MIN CFD_V_EN_IDL_DUR_MAX CFD_V_PRE_FLW_MIN CFD_V_PRE_FLW_DUR_MIN CFD_V_EN_RUN_MIN CFD_C_FAIL_OSC_THR CFD_V_FAIL_OSC_FIL CFD_V_PASS_OSC_FIL CFD_V_HI_CHG_OSC_FIL CFD_V_OSC_INIT CFD_V_IDL_MET_VSPD_MAX CFD_V_STG1_AF_CFG CFD_V_EN_O2_HT_SS_MIN CFD_V_EN_AMP CFD_V_HYB_ENG_STOP_DUR CFD_V_EN_FUEL_INT_MIN CFD_V_O2_LR_HYS CFD_V_O2_LR_THR CFD_C_OSC_CAT_T_FAC CFD_C_OSC_FLW_FAC CFD_X_AIR_FLW_A CFD_C_STG2_UO2_CHG_MAX CFD_C_STG1_UO2_CHG_MAX CFD_V_EN_IAT_MIN CFD_V_EN_IAT_MAX CFD_C_EN_ESPD_MAX CFD_C_EN_ESPD_MIN CFD_C_EN_VSPD_MAX CFD_C_EN_VSPD_MIN CFD_V_DIAG_CFG CFD_C_STG2_DLY CFD_V_HI_CHG_OSC_MAX CFD_V_HI_CHG_OSC_DLT CFD_V_HI_CHG_TST_MAX CFD_V_HI_CHG_TRP_TST CFD_V_EN_CL_MAX CFD_V_EN_IDL_ERR_MIN CFD_V_TRS_ESPD_DLT CFD_V_TRS_FLW_DLT CFD_V_TRS_ESPD_FIL CFD_V_TRS_FLW_FIL /end DEF_CHARACTERISTIC
 /begin OUT_MEASUREMENT cfd_osc_raw cfd_osc cfd_air_flw_avg cfd_stg2_uo2_resp_dur cfd_diag_typ cfd_diag_dis_rsn cfd_eng_stbl cfd_diag_try_cnts cfd_dis_fault_actv cfd_conds_met cfd_idl_tm_excd cfd_diag_fn cfd_ext_rsn /end OUT_MEASUREMENT
/end FUNCTION
/begin FUNCTION osd "o2 sensor diag"
 /begin DEF_CHARACTERISTIC OSD_V_EN_BAT_VLT_MAX OSD_V_EN_BAT_VLT_MIN OSD_V_UO2_HI_THR OSD_V_UO2_LO_THR OSD_V_UO2_INIT_HI_THR OSD_V_UO2_CLD_HT_DTY_THR OSD_V_UO2_CLD_CNT_THR OSD_V_UO2_CLD_HLD_DUR OSD_V_UO2_CLD_CNT_STP_INC OSD_V_UO2_CLD_AIR_FLW_THR OSD_V_UO2_CLD_CNT_STP_DEC OSD_C_UO2_OPN_ECT_THR OSD_V_UO2_OPN_RUN_MIN OSD_V_UO2_OPN_EN_DLY OSD_V_UO2_LO_EN_DLY OSD_V_UO2_LO_FLV_THR OSD_V_UO2_POW_LN_EN_DLY OSD_C_UO2_PUC_RCH_ECT_THR OSD_V_UO2_PUC_RCH_EN_DLY OSD_V_UO2_PUC_RCH_RUN_MIN OSD_V_UO2_OPN_LO_THR OSD_V_UO2_OPN_HI_THR OSD_V_UO2_PMP_OPN_LO_THR OSD_V_UO2_PMP_OPN_HI_THR OSD_V_UO2_OPN_CNT_THR OSD_V_UO2_PMP_OPN_FL_THR OSD_V_UO2_PMP_OPN_DIAG_THR OSD_V_UO2_OPN_FL_THR OSD_V_UO2_OPN_DIAG_THR OSD_V_UO2_HI_DIAG_THR OSD_V_UO2_HI_FL_THR OSD_V_UO2_POW_LN_THR OSD_V_UO2_PUC_RCH_THR OSD_V_UO2_LO_DIAG_THR OSD_V_UO2_LO_FL_THR OSD_V_UO2_POW_LN_FL_THR OSD_V_UO2_POW_LN_DIAG_THR OSD_V_UO2_PUC_RCH_FL_THR OSD_V_UO2_PUC_RCH_DIAG_THR OSD_V_DO2_CLD_HT_DTY_THR OSD_V_DO2_CLD_CNT_THR OSD_V_DO2_CLD_CNT_STP_INC OSD_V_DO2_CLD_AIR_FLW_THR OSD_V_DO2_CLD_CNT_STP_DEC OSD_V_DO2_CLD_HLD_DUR OSD_C_DO2_OPN_ECT_THR OSD_V_DO2_OPN_RUN_MIN OSD_V_DO2_OPN_EN_DLY OSD_C_DO2_HI_ECT_THR OSD_V_DO2_HI_EN_DLY OSD_V_DO2_HI_RUN_MIN OSD_V_DO2_LO_EN_DLY OSD_V_DO2_POW_LN_EN_DLY OSD_C_DO2_PUC_RCH_ECT_THR OSD_V_DO2_PUC_RCH_EN_DLY OSD_V_DO2_PUC_RCH_RUN_MIN OSD_V_DO2_OPN_LO_THR OSD_V_DO2_OPN_HI_THR OSD_V_DO2_PMP_OPN_LO_THR OSD_V_DO2_PMP_OPN_HI_THR OSD_V_DO2_OPN_CNT_THR OSD_V_DO2_PMP_OPN_FL_THR OSD_V_DO2_PMP_OPN_DIAG_THR OSD_V_DO2_OPN_FL_THR OSD_V_DO2_OPN_DIAG_THR OSD_V_DO2_LO_THR OSD_V_DO2_HI_THR OSD_V_DO2_POW_LN_THR OSD_V_DO2_PUC_RCH_THR OSD_V_DO2_LO_DIAG_THR OSD_V_DO2_LO_FL_THR OSD_V_DO2_HI_DIAG_THR OSD_V_DO2_HI_FL_THR OSD_V_DO2_POW_LN_FL_THR OSD_V_DO2_POW_LN_DIAG_THR OSD_V_DO2_PUC_RCH_FL_THR OSD_V_DO2_PUC_RCH_DIAG_THR OSD_V_AGED_AMP_MIN OSD_V_AGED_FLV_MIN OSD_V_AGED_EVAC_CFG OSD_V_AGED_CELL_CHG_CFG OSD_V_AGED_AIR_FLW_MIN OSD_C_AGED_ADP_CELL_EN OSD_V_AGED_AIR_FLW_MAX OSD_V_AGED_EN_DLY OSD_X_ESPD_AVG OSD_V_AGED_DATA_TIM OSD_M_AGED_VLT_THR OSD_M_AGED_SW_TMS_FL_THR OSD_M_AGED_AVG_TM_FL_THR OSD_C_AGED_RAT_AVG_TM_FL_THR OSD_V_AGED_RAT_LO_BIAS_FL_THR OSD_V_AGED_RAT_HI_BIAS_FL_THR OSD_V_HT_CURR_FIL OSD_V_HT_CURR_FIL_CNT_THR OSD_V_HT_CURR_RUN_MIN OSD_V_HT_CURR_EN_DLY OSD_X_HT_DTY OSD_M_HT_CURR_UNDR_FL_THR OSD_M_HT_CURR_OVR_FL_THR OSD_V_HT_UO2_CURR_UNDR_FL_THR OSD_V_HT_UO2_CURR_UNDR_DIAG_THR OSD_V_HT_DO2_CURR_UNDR_FL_THR OSD_V_HT_DO2_CURR_UNDR_DIAG_THR OSD_V_HT_UO2_CURR_OVR_FL_THR OSD_V_HT_UO2_CURR_OVR_DIAG_THR OSD_V_HT_DO2_CURR_OVR_FL_THR OSD_V_HT_DO2_CURR_OVR_DIAG_THR OSD_V_RSP_PUC_TM_INIT OSD_V_RSP_PUC_VLT_THR OSD_V_RSP_PUC_RUN_MIN OSD_V_RSP_PUC_ECT_THR OSD_V_RSP_PUC_RST_CNT_THR OSD_V_RSP_PUC_RST_VLT_DEV_THR OSD_V_RSP_PUC_VLT_HI OSD_V_RSP_PUC_VLT_LO OSD_V_RSP_PUC_TM_FL_THR OSD_V_RSP_PUC_TM_FIL OSD_V_RSP_PUC_TM_MAX OSD_V_RSP_POW_TM_INIT OSD_V_RSP_POW_VLT_THR OSD_V_RSP_POW_RUN_MIN OSD_V_RSP_POW_ECT_THR OSD_V_RSP_POW_AIR_FLW_THR OSD_V_RSP_POW_AFR_THR OSD_V_RSP_POW_RST_CNT_THR OSD_V_RSP_POW_RST_VLT_DEV_THR OSD_V_RSP_POW_VLT_HI OSD_V_RSP_POW_VLT_LO OSD_C_RSP_POW_TM_FL_THR OSD_V_RSP_POW_TM_FIL OSD_V_RSP_POW_TM_MAX OSD_X_CAT_OSC /end DEF_CHARACTERISTIC
 /begin OUT_MEASUREMENT osd_uo2_pow_ln_diag_cnt osd_uo2_pow_ln_fl_cnt osd_uo2_pow_ln_en osd_uo2_pow_ln_fl_met osd_uo2_pow_ln_fn osd_uo2_pow_ln_fl osd_uo2_puc_rch_diag_cnt osd_uo2_puc_rch_fl_cnt osd_uo2_puc_rch_en osd_uo2_puc_rch_fl_met osd_uo2_puc_rch_fn osd_uo2_puc_rch_fl osd_uo2_vlt osd_uo2_filt_espd osd_uo2_hi_diag_cnt osd_uo2_hi_fl_cnt osd_uo2_hi_en osd_uo2_hi_fl_met osd_uo2_hi_fn osd_uo2_hi_fl osd_uo2_lo_diag_cnt osd_uo2_lo_fl_cnt osd_uo2_lo_en osd_uo2_lo_fl_met osd_uo2_lo_fn osd_uo2_lo_fl osd_uo2_opn_diag_cnt osd_uo2_opn_fl_cnt osd_uo2_opn_en osd_uo2_opn_fl_met osd_uo2_opn_fn osd_uo2_opn_fl osd_do2_hi_diag_cnt osd_do2_hi_fl_cnt osd_do2_hi_en osd_do2_hi_fl_met osd_do2_hi_fl osd_do2_lo_diag_cnt osd_do2_lo_fl_cnt osd_do2_lo_en osd_do2_lo_fl_met osd_do2_lo_fl osd_do2_opn_diag_cnt osd_do2_opn_fl_cnt osd_do2_opn_en osd_do2_opn_fl_met osd_do2_opn_fn osd_do2_opn_fl osd_do2_pow_ln_diag_cnt osd_do2_pow_ln_fl_cnt osd_do2_pow_ln_en osd_do2_pow_ln_fl_met osd_do2_pow_ln_fn osd_do2_pow_ln_fl osd_do2_puc_rch_diag_cnt osd_do2_puc_rch_fl_cnt osd_do2_puc_rch_en osd_do2_puc_rch_fl_met osd_do2_puc_rch_fn osd_do2_puc_rch_fl osd_aged_diag_tm osd_aged_lr_sw_tms osd_aged_rl_sw_tms osd_aged_lr_tm osd_aged_rl_tm osd_aged_lr_sw_tms_nv osd_aged_rl_sw_tms_nv osd_aged_lr_avg_tm_nv osd_aged_rl_avg_tm_nv osd_aged_en osd_aged_en_dly osd_aged_dis_rsn osd_uo2_cld_cnt osd_uo2_cld_stat osd_uo2_conds_met osd_uo2_pmp_opn_fl_met osd_uo2_pmp_opn_diag_cnt osd_uo2_pmp_opn_fl_cnt osd_do2_vlt osd_do2_cld_cnt osd_do2_cld_stat osd_do2_conds_met osd_do2_pmp_opn_fl_met osd_do2_pmp_opn_diag_cnt osd_do2_pmp_opn_fl_cnt osd_aged_avg_rat osd_aged_rat_avg_tm osd_ht_uo2_curr_fil osd_ht_do2_curr_fil osd_ht_uo2_curr_conds_met osd_ht_do2_curr_conds_met osd_ht_uo2_curr_en osd_ht_do2_curr_en osd_ht_uo2_curr_undr_diag_cnt osd_ht_do2_curr_undr_diag_cnt osd_ht_uo2_curr_ovr_diag_cnt osd_ht_do2_curr_ovr_diag_cnt osd_ht_uo2_curr_undr_fl_met osd_ht_do2_curr_undr_fl_met osd_ht_uo2_curr_undr_fl_cnt osd_ht_do2_curr_undr_fl_cnt osd_ht_uo2_curr_undr_fl osd_ht_do2_curr_undr_fl osd_ht_uo2_curr_undr_fn osd_ht_do2_curr_undr_fn osd_ht_uo2_curr_ovr_fl_cnt osd_ht_do2_curr_ovr_fl_cnt osd_ht_uo2_curr_ovr_fl_met osd_ht_do2_curr_ovr_fl_met osd_ht_uo2_curr_ovr_fl osd_ht_do2_curr_ovr_fl osd_ht_uo2_curr_ovr_fn osd_ht_do2_curr_ovr_fn osd_rsp_puc_en osd_rsp_puc_rst osd_rsp_puc_tm osd_rsp_puc_tm_raw osd_rsp_puc_fn osd_rsp_puc_fl osd_rsp_pow_en osd_rsp_pow_rst osd_rsp_pow_tm osd_rsp_puc_tm_raw osd_rsp_puc_fn osd_rsp_puc_fl /end OUT_MEASUREMENT
/end FUNCTION
/begin FUNCTION fs "fuel system"
 /begin DEF_CHARACTERISTIC FS_V_IDL_EN_AMP FS_V_IDL_EN_IAT FS_V_IDL_EN_VLT FS_C_IDL_EN_AR FS_C_IDL_DIAG_CNTS FS_C_IDL_LEAN_FL_CNTS FS_C_IDL_RICH_FL_CNTS FS_C_IDL_LEAN_MET_DLY FS_C_IDL_RICH_MET_DLY FS_V_IDL_PASS_AR_CNTS FS_V_IDL_FL_ADP_MIN FS_V_IDL_FL_ADP_MAX FS_V_FL_ADP_MIN FS_V_FL_ADP_MAX /end DEF_CHARACTERISTIC
 /begin OUT_MEASUREMENT /end OUT_MEASUREMENT
/end FUNCTION
/begin RECORD_LAYOUT __UBYTE_S FNC_VALUES 1 UBYTE COLUMN_DIR DIRECT /end RECORD_LAYOUT
/begin RECORD_LAYOUT __UWORD_S FNC_VALUES 1 UWORD COLUMN_DIR DIRECT /end RECORD_LAYOUT
/begin RECORD_LAYOUT __ULONG_S FNC_VALUES 1 ULONG COLUMN_DIR DIRECT /end RECORD_LAYOUT
/begin RECORD_LAYOUT __SWORD_S FNC_VALUES 1 SWORD COLUMN_DIR DIRECT /end RECORD_LAYOUT
/begin RECORD_LAYOUT __SLONG_S FNC_VALUES 1 SLONG COLUMN_DIR DIRECT /end RECORD_LAYOUT
/begin RECORD_LAYOUT SSV__UWORD_S AXIS_PTS_X 1 UWORD INDEX_INCR DIRECT /end RECORD_LAYOUT
/begin RECORD_LAYOUT SSV__SWORD_S AXIS_PTS_X 1 SWORD INDEX_INCR DIRECT /end RECORD_LAYOUT
/end MODULE
/end PROJECT
