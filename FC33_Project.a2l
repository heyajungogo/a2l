ASAP2_VERSION 1 60
/begin PROJECT FC33 ""
/begin HEADER "" VERSION "1.0" /end HEADER
/begin MODULE FC33 ""
/begin MOD_COMMON "" BYTE_ORDER MSB_FIRST ALIGNMENT_LONG 2 ALIGNMENT_WORD 1 /end MOD_COMMON
/begin MEASUREMENT egr_pos_sp "EGR position setpoint" UWORD u_pct 0 0 0.0 199.996948242187 ECU_ADDRESS 0x4000DA4E /end MEASUREMENT
/begin MEASUREMENT egr_conds_met "condition of EGR control met" UBYTE b_true 0 0 0.00 1.00 BIT_MASK 0x1 ECU_ADDRESS 0x400050DA FORMAT "%1.0" /end MEASUREMENT
/begin MEASUREMENT egr_pos_err "error between actual and setpoint EGR position" SWORD u_pct_s 0 0 -200 199.993896484375 ECU_ADDRESS 0x4000DA4E /end MEASUREMENT
/begin MEASUREMENT egr_ratio_sp "EGR ratio setpoint" UWORD u_fac_2 0 0 0.0 1.999969482421875 ECU_ADDRESS 0x4000DA4E FORMAT "%4.3" /end MEASUREMENT
/begin MEASUREMENT egr_dc_i "int term of EGR DC" UWORD u_pct 0 0 0.0 199.996948242187 ECU_ADDRESS 0x4000DA4E /end MEASUREMENT
/begin MEASUREMENT egr_dc_p_i "combined int and prop term of EGR DC" UWORD u_pct 0 0 0.0 199.996948242187 ECU_ADDRESS 0x4000DA4E /end MEASUREMENT
/begin MEASUREMENT egr_pwm_dc "EGR duty cycle" UWORD u_pct 0 0 0.0 199.996948242187 ECU_ADDRESS 0x4000DA4E /end MEASUREMENT
/begin MEASUREMENT egr_hw_rdy_st "determinate EGR HW ready status" UBYTE b_true 0 0 0.00 1.00 BIT_MASK 0x1 ECU_ADDRESS 0x400050DA FORMAT "%1.0" /end MEASUREMENT
/begin MEASUREMENT egr_iat_met "egr iat conditions met" UBYTE b_true 0 0 0.00 1.00 BIT_MASK 0x1 ECU_ADDRESS 0x400050DA FORMAT "%1.0" /end MEASUREMENT
/begin MEASUREMENT evam_diag_dis_rsn "Purge diagnostic inhibit reason" UBYTE u_evam_dis_rsn 0 0 0.00 13.00 ECU_ADDRESS 0x40004168 /end MEASUREMENT
/begin MEASUREMENT evam_dis_flt_actv "Fault active and disabled purge diagnostic." UBYTE b_true 0 0 0.00 1.00 BIT_MASK 0x1 ECU_ADDRESS 0x400033EF FORMAT "%1.0" /end MEASUREMENT
/begin MEASUREMENT evam_trip_dis_flt_actv "Fault actived and disabled purge diagnostic in this key cycle." UBYTE b_true 0 0 0.00 1.00 BIT_MASK 0x1 ECU_ADDRESS 0x400033EF FORMAT "%1.0" /end MEASUREMENT
/begin MEASUREMENT evam_eol_diag_req "Purge force control diagnostic active." UBYTE b_true 0 0 0.00 1.00 BIT_MASK 0x1 ECU_ADDRESS 0x400033EF FORMAT "%1.0" /end MEASUREMENT
/begin MEASUREMENT evam_diag_fn "Purge diagnostic finish." UBYTE b_true 0 0 0.00 1.00 BIT_MASK 0x1 ECU_ADDRESS 0x400033EF FORMAT "%1.0" /end MEASUREMENT
/begin MEASUREMENT evam_bat_vlt_dis "Battery voltage is out of range to enable purge diagnostic." UBYTE b_true 0 0 0.00 1.00 BIT_MASK 0x1 ECU_ADDRESS 0x400033EF FORMAT "%1.0" /end MEASUREMENT
/begin MEASUREMENT evam_flv_mmv "Filtered fuel level for purge diagnostic." UWORD u_pct_1 0 0 0 99.9984741210937 ECU_ADDRESS 0x40004EA0 FORMAT "%4.2" /end MEASUREMENT
/begin MEASUREMENT evam_cst_temp_st "Cold test purge diagnostic temperature state." UBYTE u_evam_cld_tmp_chk 0 0 0.00 2.00 ECU_ADDRESS 0x40004168 FORMAT "%1.0" /end MEASUREMENT
/begin MEASUREMENT evam_sml_flv_en "Small leak fuel level range enable." UBYTE b_true 0 0 0.00 1.00 BIT_MASK 0x1 ECU_ADDRESS 0x400033EF FORMAT "%1.0" /end MEASUREMENT
/begin MEASUREMENT evam_refuel_actv "Refuel condition is detected active." UBYTE b_true 0 0 0.00 1.00 BIT_MASK 0x1 ECU_ADDRESS 0x400033EF FORMAT "%1.0" /end MEASUREMENT
/begin MEASUREMENT evam_cld_tst_met "Purge cold test condition met." UBYTE b_true 0 0 0.00 1.00 BIT_MASK 0x1 ECU_ADDRESS 0x400033EF FORMAT "%1.0" /end MEASUREMENT
/begin MEASUREMENT evam_cld_lk_en "Purge cold leak test enable." UBYTE b_true 0 0 0.00 1.00 BIT_MASK 0x1 ECU_ADDRESS 0x400033EF FORMAT "%1.0" /end MEASUREMENT
/begin MEASUREMENT evam_lk_idl_en "Purge leak test idle enable." UBYTE b_true 0 0 0.00 1.00 BIT_MASK 0x1 ECU_ADDRESS 0x400033EF FORMAT "%1.0" /end MEASUREMENT
/begin MEASUREMENT evam_lk_dly_actv "Purge leak test delaying." UBYTE b_true 0 0 0.00 1.00 BIT_MASK 0x1 ECU_ADDRESS 0x400033EF FORMAT "%1.0" /end MEASUREMENT
/begin MEASUREMENT evam_lk_en "Purge leak test enable." UBYTE b_true 0 0 0.00 1.00 BIT_MASK 0x1 ECU_ADDRESS 0x400033EF FORMAT "%1.0" /end MEASUREMENT
/begin MEASUREMENT evam_cld_lk_fn "Purge cold leak test finish." UBYTE b_true 0 0 0.00 1.00 BIT_MASK 0x1 ECU_ADDRESS 0x400033EF FORMAT "%1.0" /end MEASUREMENT
/begin MEASUREMENT evam_slosh_flv_max "Max creep fuel level for purge test." UWORD u_pct_1 0 0 0 99.9984741210937 ECU_ADDRESS 0x40004EA0 FORMAT "%4.1" /end MEASUREMENT
/begin MEASUREMENT evam_slosh_flv_min "Min creep fuel level for purge test." UWORD u_pct_1 0 0 0 99.9984741210937 ECU_ADDRESS 0x40004EA0 FORMAT "%4.1" /end MEASUREMENT
/begin MEASUREMENT evam_slosh_flv "Purge creep fuel slosh detected." UBYTE b_true 0 0 0.00 1.00 BIT_MASK 0x1 ECU_ADDRESS 0x400033EF FORMAT "%1.0" /end MEASUREMENT
/begin MEASUREMENT evam_slosh_mov "Vehicle speed slosh detected." UBYTE b_true 0 0 0.00 1.00 BIT_MASK 0x1 ECU_ADDRESS 0x400033EF FORMAT "%1.0" /end MEASUREMENT
/begin MEASUREMENT evam_slosh_fuel "Purge leak test fuel slosh condition met." UBYTE b_true 0 0 0.00 1.00 BIT_MASK 0x1 ECU_ADDRESS 0x400033EF FORMAT "%1.0" /end MEASUREMENT
/begin MEASUREMENT evam_cld_en "Purge diagnostic cold test enable." UBYTE b_true 0 0 0.00 1.00 BIT_MASK 0x1 ECU_ADDRESS 0x400033EF FORMAT "%1.0" /end MEASUREMENT
/begin MEASUREMENT evam_pv_lk_fn "Purge flow test finish." UBYTE b_true 0 0 0.00 1.00 BIT_MASK 0x1 ECU_ADDRESS 0x400033EF FORMAT "%1.0" /end MEASUREMENT
/begin MEASUREMENT evam_vnt_vlv_tggl_fn "Vent valve cycling finished." UBYTE b_true 0 0 0.00 1.00 BIT_MASK 0x1 ECU_ADDRESS 0x400033EF FORMAT "%1.0" /end MEASUREMENT
/begin MEASUREMENT evam_vnt_vlv_tggl_req "Vent valve cycling active." UBYTE b_true 0 0 0.00 1.00 BIT_MASK 0x1 ECU_ADDRESS 0x400033EF FORMAT "%1.0" /end MEASUREMENT
/begin MEASUREMENT evam_pv_lk_init "Purge flow diagnostic vacuum track initial." UBYTE b_true 0 0 0.00 1.00 BIT_MASK 0x1 ECU_ADDRESS 0x400033EF FORMAT "%1.0" /end MEASUREMENT
/begin MEASUREMENT evam_pv_lk_init_fn "Purge flow vent valve cycling init finished." UBYTE b_true 0 0 0.00 1.00 BIT_MASK 0x1 ECU_ADDRESS 0x400033EF FORMAT "%1.0" /end MEASUREMENT
/begin MEASUREMENT evam_pv_lk_excd "Purge flow test time exceeded." UBYTE b_true 0 0 0.00 1.00 BIT_MASK 0x1 ECU_ADDRESS 0x400033EF FORMAT "%1.0" /end MEASUREMENT
/begin MEASUREMENT evam_pv_lk_dly_fn "Purge flow test delay finished." UBYTE b_true 0 0 0.00 1.00 BIT_MASK 0x1 ECU_ADDRESS 0x400033EF FORMAT "%1.0" /end MEASUREMENT
/begin MEASUREMENT evam_tank_vac_mmv "Filtered fuel tank vacuum." SWORD u_kPa_8n_8p 0 0 -8 7.999755859375 ECU_ADDRESS 0x40004EBC FORMAT "%3.2" /end MEASUREMENT
/begin MEASUREMENT evam_pv_lk_int_req "Purge flow test vacuum index tracking." UBYTE b_true 0 0 0.00 1.00 BIT_MASK 0x1 ECU_ADDRESS 0x400033EF FORMAT "%1.0" /end MEASUREMENT
/begin MEASUREMENT evam_pv_lk_slp_tm "Purge flow slope timer." UWORD u_16x_tmr 0 0 0 8191.875 ECU_ADDRESS 0x40004EBC SYMBOL_LINK "evam_pv_lk_slp_tm" 16 /end MEASUREMENT
/begin MEASUREMENT evam_pv_lk_strt_vac "Purge flow diagnostic begin vacuum." SWORD u_kPa_8n_8p 0 0 -8 7.999755859375 ECU_ADDRESS 0x40004EBC FORMAT "%3.2" /end MEASUREMENT
/begin MEASUREMENT evam_pv_lk_vac_idx_thr "Purge flow diagnostic vacuum index threshold." ULONG u_cnts 0 0 0 4294967295 ECU_ADDRESS 0x40004EBC FORMAT "%3.2" /end MEASUREMENT
/begin MEASUREMENT evam_pv_lk_fl "Purge flow diagnostic failed." UBYTE b_true 0 0 0.00 1.00 BIT_MASK 0x1 ECU_ADDRESS 0x400033EF FORMAT "%1.0" /end MEASUREMENT
/begin MEASUREMENT evam_pf_vac_fnl "Purge flow diagnostic final tank vacuum." SWORD u_kPa_8n_8p 0 0 -8 7.999755859375 ECU_ADDRESS 0x40004EBC FORMAT "%3.2" /end MEASUREMENT
/begin MEASUREMENT evam_pf_hivac_dur "Purge flow diagnostic high vacuum timer." UWORD u_16x_tmr 0 0 0 8191.875 ECU_ADDRESS 0x40004EBC FORMAT "%3.2" SYMBOL_LINK "evam_pf_hivac_dur" 14 /end MEASUREMENT
/begin MEASUREMENT evam_vac_inc_int_cor "Purge integral vacuum index." UWORD u_cnts 0 0 0 65535 ECU_ADDRESS 0x40004EBC FORMAT "%3.2" /end MEASUREMENT
/begin MEASUREMENT evam_pv_lk_vac_slp "Purge flow vacuum slope." SWORD u_kPaSec_c 0 0 -8 7.999755859375 ECU_ADDRESS 0x40004EBC FORMAT "%3.2" /end MEASUREMENT
/begin MEASUREMENT evam_pv_tst_sm_abrt "Purge flow slope stop small leak test." UBYTE b_true 0 0 0.00 1.00 BIT_MASK 0x1 ECU_ADDRESS 0x400033EF FORMAT "%1.0" /end MEASUREMENT
/begin MEASUREMENT evam_pv_tst_vsm_abrt "Purge flow slope stop very small leak test." UBYTE b_true 0 0 0.00 1.00 BIT_MASK 0x1 ECU_ADDRESS 0x400033EF FORMAT "%1.0" /end MEASUREMENT
/begin MEASUREMENT evam_cld_lk_abrt "Purge cold leak test stopped." UBYTE b_true 0 0 0.00 1.00 BIT_MASK 0x1 ECU_ADDRESS 0x400033EF FORMAT "%1.0" /end MEASUREMENT
/begin MEASUREMENT evam_cld_lk_dur "Purge cold leak test timer." UWORD u_16x_tmr 0 0 0 8191.875 ECU_ADDRESS 0x40004EBC FORMAT "%3.2" /end MEASUREMENT
/begin MEASUREMENT evam_cld_lk_dur_excd "Cold test time exceed the threshold." UBYTE b_true 0 0 0.00 1.00 BIT_MASK 0x1 ECU_ADDRESS 0x400033EF FORMAT "%1.0" /end MEASUREMENT
/begin MEASUREMENT evam_vsml_lk_dur_excd "Purge very small leak test time exceed the threshold." UBYTE b_true 0 0 0.00 1.00 BIT_MASK 0x1 ECU_ADDRESS 0x400033EF FORMAT "%1.0" /end MEASUREMENT
/begin MEASUREMENT evam_cld_lrg_lk_dur_excd "Purge cold large leak test time exceed the threshold." UBYTE b_true 0 0 0.00 1.00 BIT_MASK 0x1 ECU_ADDRESS 0x400033EF FORMAT "%1.0" /end MEASUREMENT
/begin MEASUREMENT evam_prst_vacdrw_actv "Purge tank vacuum draw active." UBYTE b_true 0 0 0.00 1.00 BIT_MASK 0x1 ECU_ADDRESS 0x400033EF FORMAT "%1.0" /end MEASUREMENT
/begin MEASUREMENT evam_prst_mintm_fn "Purge preset min time finish." UBYTE b_true 0 0 0.00 1.00 BIT_MASK 0x1 ECU_ADDRESS 0x400033EF FORMAT "%1.0" /end MEASUREMENT
/begin MEASUREMENT evam_prst_init_fn "Purge preset initial finish." UBYTE b_true 0 0 0.00 1.00 BIT_MASK 0x1 ECU_ADDRESS 0x400033EF FORMAT "%1.0" /end MEASUREMENT
/begin MEASUREMENT evam_sml_lk_vacdrw_fn "Purge small leak vacuum draw finish." UBYTE b_true 0 0 0.00 1.00 BIT_MASK 0x1 ECU_ADDRESS 0x400033EF FORMAT "%1.0" /end MEASUREMENT
/begin MEASUREMENT evam_cld_lrg_lk_pass "Purge cold large leak test passed." UBYTE b_true 0 0 0.00 1.00 BIT_MASK 0x1 ECU_ADDRESS 0x400033EF FORMAT "%1.0" /end MEASUREMENT
/begin MEASUREMENT evam_prst_init "Purge preset vacuum track initial." UBYTE b_true 0 0 0.00 1.00 BIT_MASK 0x1 ECU_ADDRESS 0x400033EF FORMAT "%1.0" /end MEASUREMENT
/begin MEASUREMENT evam_prst_int_req "Purge preset vacuum index tracking." UBYTE b_true 0 0 0.00 1.00 BIT_MASK 0x1 ECU_ADDRESS 0x400033EF FORMAT "%1.0" /end MEASUREMENT
/begin MEASUREMENT evam_sml_lk_dcy_req "Purge small leak decay active." UBYTE b_true 0 0 0.00 1.00 BIT_MASK 0x1 ECU_ADDRESS 0x400033EF FORMAT "%1.0" /end MEASUREMENT
/begin MEASUREMENT evam_vsml_lk_dcy_req "Purge very small leak decay active." UBYTE b_true 0 0 0.00 1.00 BIT_MASK 0x1 ECU_ADDRESS 0x400033EF FORMAT "%1.0" /end MEASUREMENT
/begin MEASUREMENT evam_sm_lk_vap_req "Purge small leak vapor test active." UBYTE b_true 0 0 0.00 1.00 BIT_MASK 0x1 ECU_ADDRESS 0x400033EF FORMAT "%1.0" /end MEASUREMENT
/begin MEASUREMENT evam_vsml_lk_vap_req "Purge very small leak vapor test active." UBYTE b_true 0 0 0.00 1.00 BIT_MASK 0x1 ECU_ADDRESS 0x400033EF FORMAT "%1.0" /end MEASUREMENT
/begin MEASUREMENT evam_vsml_lk_slp_inc_hi "Purge very small leak decay slope convex fault." UBYTE b_true 0 0 0.00 1.00 BIT_MASK 0x1 ECU_ADDRESS 0x400033EF FORMAT "%1.0" /end MEASUREMENT
/begin MEASUREMENT evam_vsml_lk_hivap "Purge very small leak test high vaporation detected." UBYTE b_true 0 0 0.00 1.00 BIT_MASK 0x1 ECU_ADDRESS 0x400033EF FORMAT "%1.0" /end MEASUREMENT
/begin MEASUREMENT evam_vsml_lk_vap_abrt "Purge very small leak test stopped." UBYTE b_true 0 0 0.00 1.00 BIT_MASK 0x1 ECU_ADDRESS 0x400033EF FORMAT "%1.0" /end MEASUREMENT
/begin MEASUREMENT evam_sml_lk_dcy_fn "Purge small leak decay finish." UBYTE b_true 0 0 0.00 1.00 BIT_MASK 0x1 ECU_ADDRESS 0x400033EF FORMAT "%1.0" /end MEASUREMENT
/begin MEASUREMENT evam_vsml_lk_dsbl "Purge very small leak test disable." UBYTE b_true 0 0 0.00 1.00 BIT_MASK 0x1 ECU_ADDRESS 0x400033EF FORMAT "%1.0" /end MEASUREMENT
/begin MEASUREMENT evam_sml_lk_tst_req "Purge small leak test active." UBYTE b_true 0 0 0.00 1.00 BIT_MASK 0x1 ECU_ADDRESS 0x400033EF FORMAT "%1.0" /end MEASUREMENT
/begin MEASUREMENT evam_cld_lrg_lk_req "Purge cold large leak active." UBYTE b_true 0 0 0.00 1.00 BIT_MASK 0x1 ECU_ADDRESS 0x400033EF FORMAT "%1.0" /end MEASUREMENT
/begin MEASUREMENT evam_cld_lrg_lk_init_fn "Purge cold large leak initial finish." UBYTE b_true 0 0 0.00 1.00 BIT_MASK 0x1 ECU_ADDRESS 0x400033EF FORMAT "%1.0" /end MEASUREMENT
/begin MEASUREMENT evam_cld_lrg_lk_int_req "Purge cold large leak vacuum index tracking." UBYTE b_true 0 0 0.00 1.00 BIT_MASK 0x1 ECU_ADDRESS 0x400033EF FORMAT "%1.0" /end MEASUREMENT
/begin MEASUREMENT evam_cld_lrg_lk_init "Purge cold large leak vacuum track initial." UBYTE b_true 0 0 0.00 1.00 BIT_MASK 0x1 ECU_ADDRESS 0x400033EF FORMAT "%1.0" /end MEASUREMENT
/begin MEASUREMENT evam_cld_llk_vac_idx_thrsh "Purge cold large leak vacuum index threshold." UWORD u_cnts 0 0 0 65535 ECU_ADDRESS 0x40004EBC FORMAT "%3.2" /end MEASUREMENT
/begin MEASUREMENT evam_cld_llk_fl "Purge cold large leak test failed." UBYTE b_true 0 0 0.00 1.00 BIT_MASK 0x1 ECU_ADDRESS 0x400033EF FORMAT "%1.0" /end MEASUREMENT
/begin MEASUREMENT evam_cld_llk_fn "Purge cold large leak test finished." UBYTE b_true 0 0 0.00 1.00 BIT_MASK 0x1 ECU_ADDRESS 0x400033EF FORMAT "%1.0" /end MEASUREMENT
/begin MEASUREMENT evam_sml_lk_vap_fn "Purge small leak vapor test finished." UBYTE b_true 0 0 0.00 1.00 BIT_MASK 0x1 ECU_ADDRESS 0x400033EF FORMAT "%1.0" /end MEASUREMENT
/begin MEASUREMENT evam_vsml_lk_vap_fn "Purge very small leak vapor test finished." UBYTE b_true 0 0 0.00 1.00 BIT_MASK 0x1 ECU_ADDRESS 0x400033EF FORMAT "%1.0" /end MEASUREMENT
/begin MEASUREMENT evam_vsml_lk_dcy_fn "Purge very small leak decayt test finished." UBYTE b_true 0 0 0.00 1.00 BIT_MASK 0x1 ECU_ADDRESS 0x400033EF FORMAT "%1.0" /end MEASUREMENT
/begin MEASUREMENT evam_vsml_lk_dcy_pass "Purge very small leak decay test passed." UBYTE b_true 0 0 0.00 1.00 BIT_MASK 0x1 ECU_ADDRESS 0x400033EF FORMAT "%1.0" /end MEASUREMENT
/begin MEASUREMENT evam_vsml_lk_pass "Purge very small leak test passed." UBYTE b_true 0 0 0.00 1.00 BIT_MASK 0x1 ECU_ADDRESS 0x400033EF FORMAT "%1.0" /end MEASUREMENT
/begin MEASUREMENT evam_sml_lk_pass "Purge small leak test passed." UBYTE b_true 0 0 0.00 1.00 BIT_MASK 0x1 ECU_ADDRESS 0x400033EF FORMAT "%1.0" /end MEASUREMENT
/begin MEASUREMENT evam_sml_lk_dcy_dly_tm "Purge small leak decay delay timer." UWORD u_16x_tmr 0 0 0 8191.875 ECU_ADDRESS 0x40004EBC FORMAT "%3.2" SYMBOL_LINK "evam_sml_lk_dcy_dly_tm" 24 /end MEASUREMENT
/begin MEASUREMENT evam_sml_lk_dcy_tm "Purge small leak decay timer." UWORD u_16x_tmr 0 0 0 8191.875 ECU_ADDRESS 0x40004EBC FORMAT "%3.2" SYMBOL_LINK "evam_sml_lk_dcy_tm" 26 /end MEASUREMENT
/begin MEASUREMENT evam_sml_lk_idx_pss "Purge small leak decay segment slope passed." UBYTE b_true 0 0 0.00 1.00 BIT_MASK 0x1 ECU_ADDRESS 0x400033EF FORMAT "%1.0" /end MEASUREMENT
/begin MEASUREMENT evam_sml_lk_slp_inc_hi "Purge small leak decay slope convex fault." UBYTE b_true 0 0 0.00 1.00 BIT_MASK 0x1 ECU_ADDRESS 0x400033EF FORMAT "%1.0" /end MEASUREMENT
/begin MEASUREMENT evam_sml_lk_dcy_slp "Purge small leak decay slope." SWORD u_kPaSec_c 0 0 -8 7.999755859375 ECU_ADDRESS 0x40004EBC FORMAT "%3.2" /end MEASUREMENT
/begin MEASUREMENT evam_vsml_lk_dcy_tm "Purge very small leak decay timer." UWORD u_16x_tmr 0 0 0 8191.875 ECU_ADDRESS 0x40004EBC FORMAT "%3.2" SYMBOL_LINK "evam_vsml_lk_dcy_tm" 42 /end MEASUREMENT
/begin MEASUREMENT evam_vsml_lk_idx_pss "Purge very small leak decay segment slope passed." UBYTE b_true 0 0 0.00 1.00 BIT_MASK 0x1 ECU_ADDRESS 0x400033EF FORMAT "%1.0" /end MEASUREMENT
/begin MEASUREMENT evam_vsml_lk_dcy_slp "Purge very small leak decay slope." SWORD u_kPaSec_c 0 0 -8 7.999755859375 ECU_ADDRESS 0x40004EBC FORMAT "%3.2" /end MEASUREMENT
/begin MEASUREMENT evam_sml_lk_fl "Purge small leak test failed." UBYTE b_true 0 0 0.00 1.00 BIT_MASK 0x1 ECU_ADDRESS 0x400033EF FORMAT "%1.0" /end MEASUREMENT
/begin MEASUREMENT evam_sml_lk_fn "Purge small leak test finished." UBYTE b_true 0 0 0.00 1.00 BIT_MASK 0x1 ECU_ADDRESS 0x400033EF FORMAT "%1.0" /end MEASUREMENT
/begin MEASUREMENT evam_vsml_lk_fl "Purge very small leak test failed." UBYTE b_true 0 0 0.00 1.00 BIT_MASK 0x1 ECU_ADDRESS 0x400033EF FORMAT "%1.0" /end MEASUREMENT
/begin MEASUREMENT evam_vsml_lk_fn "Purge very small leak test finished." UBYTE b_true 0 0 0.00 1.00 BIT_MASK 0x1 ECU_ADDRESS 0x400033EF FORMAT "%1.0" /end MEASUREMENT
/begin MEASUREMENT evam_stat "Purge diagnostic states." UBYTE u_evam_stat 0 0 0.00 6.00 ECU_ADDRESS 0x40004168 /end MEASUREMENT
/begin MEASUREMENT evam_tank_prot "Purge diagnostic tank protect mode active." UBYTE b_true 0 0 0.00 1.00 BIT_MASK 0x1 ECU_ADDRESS 0x400050DA FORMAT "%1.0" /end MEASUREMENT
/begin MEASUREMENT evam_pg_vlv_off_req "purge valve control off req" UBYTE b_true 0 0 0.00 1.00 BIT_MASK 0x1 ECU_ADDRESS 0x400050DA FORMAT "%1.0" /end MEASUREMENT
/begin MEASUREMENT evam_diag_ctrl_mod "Purge control diagnostic control mode." UWORD u_purge_diag_ctrl_mod 0 0 0 3 ECU_ADDRESS 0x4000DA4E FORMAT "%1.0" /end MEASUREMENT
/begin MEASUREMENT evam_cp_msflw_sp "Purge diagnostic mass flow setpoint." UWORD u_g_per_sec_16 0 0 0 15.999756 ECU_ADDRESS 0x4000DA4E /end MEASUREMENT
/begin MEASUREMENT evam_tank_vac_err "Fuel tank vacuum error,tank vacuum setpoint - actual tank vacuum." SWORD u_kPa_8n_8p 0 0 -8 7.999755859375 ECU_ADDRESS 0x40004EBC FORMAT "%3.2" /end MEASUREMENT
/begin MEASUREMENT evam_tank_vac_rt "Fuel tank vacuum change rate." SWORD u_kPaSec_c 0 0 -8 7.999755859375 ECU_ADDRESS 0x40004EBC FORMAT "%3.2" /end MEASUREMENT
/begin MEASUREMENT evam_prst_sp_rch "Preset vacuum setpoint reached." UBYTE b_true 0 0 0.00 1.00 BIT_MASK 0x1 ECU_ADDRESS 0x400050DA FORMAT "%1.0" /end MEASUREMENT
/begin MEASUREMENT evam_flv_mmv_dly "fuel level mmv delay timer" UWORD u_16x_tmr 0 0 0 8191.875 ECU_ADDRESS 0x40004EBC SYMBOL_LINK "evam_diag_tmr" 62 /end MEASUREMENT
/begin MEASUREMENT evam_refuel_dly "refuel detect delay timer" UWORD u_16x_tmr 0 0 0 8191.875 ECU_ADDRESS 0x40004EBC SYMBOL_LINK "evam_diag_tmr" 64 /end MEASUREMENT
/begin MEASUREMENT evam_vsm_flv_out_dly "very small leak fuel level out delay timer" UWORD u_16x_tmr 0 0 0 8191.875 ECU_ADDRESS 0x40004EBC SYMBOL_LINK "evam_diag_tmr" 40 /end MEASUREMENT
/begin MEASUREMENT evam_sm_flv_out_dly "small leak fuel level out delay timer" UWORD u_16x_tmr 0 0 0 8191.875 ECU_ADDRESS 0x40004EBC SYMBOL_LINK "evam_diag_tmr" 28 /end MEASUREMENT
/begin MEASUREMENT evam_amb_t_stbl_dur "fuel level mmv delay timer" UWORD u_16x_tmr 0 0 0 8191.875 ECU_ADDRESS 0x40004EBC SYMBOL_LINK "evam_diag_tmr" 76 /end MEASUREMENT
/begin MEASUREMENT evam_flv_dlt "fuel level delta used by refuel detect" UWORD u_pct_1 0 0 0 99.9984741210937 ECU_ADDRESS 0x40004EA0 FORMAT "%4.2" /end MEASUREMENT
/begin MEASUREMENT evam_refuel_flv_bs "base fuel level used by refuel detect" UWORD u_pct_1 0 0 0 99.9984741210937 ECU_ADDRESS 0x40004EA0 FORMAT "%4.2" /end MEASUREMENT
/begin MEASUREMENT evam_trip_refuel_tms "refuel times this trip" UBYTE u_cnts 0 0 0 255 ECU_ADDRESS 0x40004EA0 FORMAT "%5.0" /end MEASUREMENT
/begin MEASUREMENT evam_fuel_cap_opn "fuel cap open" UBYTE b_true 0 0 0.00 1.00 ECU_ADDRESS 0x40004EA0 FORMAT "%1.0" /end MEASUREMENT
/begin MEASUREMENT evam_cap_opn_fc "fuel cap open fuel consumption" ULONG u_ul_long 0 0 0 536870911.875 ECU_ADDRESS 0x40004EA0 FORMAT "%10.1" /end MEASUREMENT
/begin MEASUREMENT evam_trip_cap_opn_fc "fuel cap open fuel consumption this trip" ULONG u_ul 0 0 0 134217727.96875 ECU_ADDRESS 0x40004EA0 FORMAT "%10.1" /end MEASUREMENT
/begin MEASUREMENT evam_vsm_cst_temp_out "very small leak cold start temp conditon out" UBYTE b_true 0 0 0.00 1.00 ECU_ADDRESS 0x40004EA0 FORMAT "%1.0" /end MEASUREMENT
/begin MEASUREMENT evam_wrm_tst_req "warm test request" UBYTE b_true 0 0 0.00 1.00 ECU_ADDRESS 0x40004EA0 FORMAT "%1.0" /end MEASUREMENT
/begin MEASUREMENT evam_cap_opn_tst_req "fuel cap open test request" UBYTE b_true 0 0 0.00 1.00 ECU_ADDRESS 0x40004EA0 FORMAT "%1.0" /end MEASUREMENT
/begin MEASUREMENT evam_vsm_flv_out "very small leak fuel level out" UBYTE b_true 0 0 0.00 1.00 ECU_ADDRESS 0x40004EA0 FORMAT "%1.0" /end MEASUREMENT
/begin MEASUREMENT evam_sm_flv_met "small leak fuel level out" UBYTE b_true 0 0 0.00 1.00 ECU_ADDRESS 0x40004EA0 FORMAT "%1.0" /end MEASUREMENT
/begin MEASUREMENT evam_cap_opn_tms_met "fuel cap open times met" UBYTE b_true 0 0 0.00 1.00 ECU_ADDRESS 0x40004EA0 FORMAT "%1.0" /end MEASUREMENT
/begin MEASUREMENT evam_cap_opn_tms "fuel cap open times" UBYTE u_cnts 0 0 0.00 255.00 ECU_ADDRESS 0x40004EA0 /end MEASUREMENT
/begin MEASUREMENT evam_amb_t_stb_st "amb temp stable state" UBYTE u_amb_stb_st 0 0 0.00 3.00 ECU_ADDRESS 0x40004EA0 FORMAT "%1.0" /end MEASUREMENT
/begin MEASUREMENT evam_amb_t_unstb_cnt "amb temp unstable count" UWORD u_cnts 0 0 0 65535 ECU_ADDRESS 0x40004EBC FORMAT "%5.0" /end MEASUREMENT
/begin MEASUREMENT evam_iat_dec_met "iat decrease met" UBYTE b_true 0 0 0.00 1.00 ECU_ADDRESS 0x40004EA0 FORMAT "%1.0" /end MEASUREMENT
/begin MEASUREMENT evam_bat_vlt_out "battery voltage out of range" UBYTE b_true 0 0 0.00 1.00 ECU_ADDRESS 0x40004EA0 FORMAT "%1.0" /end MEASUREMENT
/begin MEASUREMENT evam_pg_ctrl_out_dur "refuel detect delay timer" UWORD u_16x_tmr 0 0 0 8191.875 ECU_ADDRESS 0x40004EBC SYMBOL_LINK "evam_diag_tmr" 52 /end MEASUREMENT
/begin MEASUREMENT evam_lk_dly_tmr "leak test delay timer" UWORD u_16x_tmr 0 0 0 8191.875 ECU_ADDRESS 0x40004EBC SYMBOL_LINK "evam_diag_tmr" 6 /end MEASUREMENT
/begin MEASUREMENT evam_slosh_chk_req "fuel slosh check request" UBYTE b_true 0 0 0.00 1.00 ECU_ADDRESS 0x40004EA0 FORMAT "%1.0" /end MEASUREMENT
/begin MEASUREMENT evam_slosh_chk_ext_dly "slosh check exit delay timer" UWORD u_16x_tmr 0 0 0 8191.875 ECU_ADDRESS 0x40004EBC SYMBOL_LINK "evam_diag_tmr" 48 /end MEASUREMENT
/begin MEASUREMENT evam_slosh_mov_tmr "slosh check exit delay timer" UWORD u_16x_tmr 0 0 0 8191.875 ECU_ADDRESS 0x40004EBC SYMBOL_LINK "evam_diag_tmr" 46 /end MEASUREMENT
/begin MEASUREMENT evam_slosh_mov_pct "vehicle move duration percent" UWORD u_pct_1 0 0 0 99.9984741210937 ECU_ADDRESS 0x40004EA0 FORMAT "%4.1" /end MEASUREMENT
/begin MEASUREMENT evam_slosh_mov_excd "slosh move duration exceed" UBYTE b_true 0 0 0.00 1.00 ECU_ADDRESS 0x40004EA0 FORMAT "%1.0" /end MEASUREMENT
/begin MEASUREMENT evam_slosh_ext_dly "slosh fuel exit delay timer" UWORD u_16x_tmr 0 0 0 8191.875 ECU_ADDRESS 0x40004EBC SYMBOL_LINK "evam_diag_tmr" 50 /end MEASUREMENT
/begin MEASUREMENT evam_pg_vlv_lk_tmr "purge valve leak timer" UWORD u_16x_tmr 0 0 0 8191.875 ECU_ADDRESS 0x40004EBC SYMBOL_LINK "evam_diag_tmr" 18 /end MEASUREMENT
/begin MEASUREMENT evam_pv_lk_cool_met "purge valve leak cooling condition met" UBYTE b_true 0 0 0.00 1.00 ECU_ADDRESS 0x40004EA0 FORMAT "%1.0" /end MEASUREMENT
/begin MEASUREMENT evam_pv_lk_veh_mov "purge valve leak vehicle move" UBYTE b_true 0 0 0.00 1.00 ECU_ADDRESS 0x40004EA0 FORMAT "%1.0" /end MEASUREMENT
/begin MEASUREMENT evam_pv_lk_mov_vac "purge valve leak move event tank vac" SWORD u_kPa_8n_8p 0 0 -8 7.999755859375 ECU_ADDRESS 0x4000DA4E FORMAT "%3.2" /end MEASUREMENT
/begin MEASUREMENT evam_pv_lk_mov_tmr "purge valve leak move timer" UWORD u_16x_tmr 0 0 0 8191.875 ECU_ADDRESS 0x40004EBC SYMBOL_LINK "evam_diag_tmr" 68 /end MEASUREMENT
/begin MEASUREMENT evam_pv_lk_mov_strt_vac "purge valve leak slope calculate start tank vac" SWORD u_kPa_8n_8p 0 0 -8 7.999755859375 ECU_ADDRESS 0x4000DA4E FORMAT "%3.2" /end MEASUREMENT
/begin MEASUREMENT evam_pv_lk_mov_slp "purge valve leak slope after vehicle move" SWORD u_kPaSec_c 0 0 -8 7.999755859375 ECU_ADDRESS 0x40004EBC FORMAT "%3.2" /end MEASUREMENT
/begin MEASUREMENT evam_pv_lk_mov_slp_max "purge valve leak slope after vehicle move" SWORD u_kPaSec_c 0 0 -8 7.999755859375 ECU_ADDRESS 0x40004EBC FORMAT "%3.2" /end MEASUREMENT
/begin MEASUREMENT evam_pv_lk_mov_slp_rat "purge valve leak move slope ratio" UWORD u_fac_128 0 0 0 127.998046875 ECU_ADDRESS 0x40004EBC /end MEASUREMENT
/begin MEASUREMENT evam_pv_lk_mov_no_rpt "purge valve leak no report due to vehicle move" UBYTE b_true 0 0 0.00 1.00 ECU_ADDRESS 0x40004EA0 FORMAT "%1.0" /end MEASUREMENT
/begin MEASUREMENT evam_pv_lk_amb_tst_tmr "purge valve leak ambient temp test timer" UWORD u_16x_tmr 0 0 0 8191.875 ECU_ADDRESS 0x40004EBC SYMBOL_LINK "evam_diag_tmr" 44 /end MEASUREMENT
/begin MEASUREMENT evam_pv_lk_amb_stb_tmr "purge valve leak ambient temp stable timer" UWORD u_16x_tmr 0 0 0 8191.875 ECU_ADDRESS 0x40004EBC SYMBOL_LINK "evam_diag_tmr" 12 /end MEASUREMENT
/begin MEASUREMENT evam_pv_lk_amb_stb "purge valve leak ambient temp stable" UBYTE b_true 0 0 0.00 1.00 ECU_ADDRESS 0x40004EA0 FORMAT "%1.0" /end MEASUREMENT
/begin MEASUREMENT evam_cld_lk_tst_fn "cold leak test finish" UBYTE b_true 0 0 0.00 1.00 ECU_ADDRESS 0x40004EA0 FORMAT "%1.0" /end MEASUREMENT
/begin MEASUREMENT evam_cld_lk_conc_hi "cold leak test concentration high" UBYTE b_true 0 0 0.00 1.00 ECU_ADDRESS 0x40004EA0 FORMAT "%1.0" /end MEASUREMENT
/begin MEASUREMENT evam_vac_drw_tmr "preset tank vac draw timer" UWORD u_16x_tmr 0 0 0 8191.875 ECU_ADDRESS 0x40004EBC SYMBOL_LINK "evam_diag_tmr" 30 /end MEASUREMENT
/begin MEASUREMENT evam_pre_vac_met "preset vac met" UBYTE b_true 0 0 0.00 1.00 ECU_ADDRESS 0x40004EA0 FORMAT "%1.0" /end MEASUREMENT
/begin MEASUREMENT evam_lrg_lk_pre_pass "large leak test preset pass" UBYTE b_true 0 0 0.00 1.00 ECU_ADDRESS 0x40004EA0 FORMAT "%1.0" /end MEASUREMENT
/begin MEASUREMENT evam_cld_lrg_lk_strt_tm "cold large leak start timer" UWORD u_16x_tmr 0 0 0 8191.875 ECU_ADDRESS 0x40004EBC /end MEASUREMENT
/begin MEASUREMENT evam_srv_vsm_flv_out "eol fuel level out of range" UBYTE b_true 0 0 0.00 1.00 ECU_ADDRESS 0x40004EA0 FORMAT "%1.0" /end MEASUREMENT
/begin MEASUREMENT evam_eol_tst_actv "eol test active" UBYTE b_true 0 0 0.00 1.00 ECU_ADDRESS 0x40004EA0 FORMAT "%1.0" /end MEASUREMENT
/begin MEASUREMENT evam_eol_tst_pg_dty "eol test purge duty" UWORD u_pct 0 0 0 199.996948242187 ECU_ADDRESS 0x4000DA4E FORMAT "%4.1" /end MEASUREMENT
/begin MEASUREMENT evam_sm_lk_vac_init "small leak decay test vac init" SWORD u_kPa_8n_8p 0 0 -8 7.999755859375 ECU_ADDRESS 0x4000DA4E FORMAT "%3.2" /end MEASUREMENT
/begin MEASUREMENT evam_sm_lk_vac_lst "small leak decay test vac last" SWORD u_kPa_8n_8p 0 0 -8 7.999755859375 ECU_ADDRESS 0x4000DA4E FORMAT "%3.2" /end MEASUREMENT
/begin MEASUREMENT evam_sm_lk_vac_idx "small leak decay test slope index" UBYTE u_cnts 0 0 0 255 ECU_ADDRESS 0x4000DA4E /end MEASUREMENT
/begin MEASUREMENT evam_sml_lk_idx_slp "Purge small leak decay vacuum index slope" SWORD u_kPaSec_c 0 0 -8 7.999755859375 ARRAY_SIZE 9 ECU_ADDRESS 0x40004EBC FORMAT "%3.2" /end MEASUREMENT
/begin MEASUREMENT evam_sm_lk_vac_intrv "small leak decay vacuum slope calculate interval" UWORD u_16x_tmr 0 0 0 8191.875 ECU_ADDRESS 0x40004EBC /end MEASUREMENT
/begin MEASUREMENT evam_sm_lk_slp_thr "Purge small leak decay vacuum slope thr" SWORD u_kPaSec_c 0 0 -8 7.999755859375 ARRAY_SIZE 9 ECU_ADDRESS 0x40004EBC FORMAT "%3.2" /end MEASUREMENT
/begin MEASUREMENT evam_vsm_lk_vac_init "small leak decay test vac init" SWORD u_kPa_8n_8p 0 0 -8 7.999755859375 ECU_ADDRESS 0x4000DA4E FORMAT "%3.2" /end MEASUREMENT
/begin MEASUREMENT evam_vsm_lk_vac_lst "very small leak decay test vac last" SWORD u_kPa_8n_8p 0 0 -8 7.999755859375 ECU_ADDRESS 0x4000DA4E FORMAT "%3.2" /end MEASUREMENT
/begin MEASUREMENT evam_vsm_lk_vac_intrv "very small leak decay vacuum slope calculate interval" UWORD u_16x_tmr 0 0 0 8191.875 ECU_ADDRESS 0x40004EBC /end MEASUREMENT
/begin MEASUREMENT evam_vsml_lk_idx_slp "very small leak decay vacuum index slope" SWORD u_kPaSec_c 0 0 -8 7.999755859375 ARRAY_SIZE 9 ECU_ADDRESS 0x40004EBC FORMAT "%3.2" /end MEASUREMENT
/begin MEASUREMENT evam_vsm_lk_slp_thr "very small leak decay vacuum slope thr" SWORD u_kPaSec_c 0 0 -8 7.999755859375 ARRAY_SIZE 9 ECU_ADDRESS 0x40004EBC FORMAT "%3.2" /end MEASUREMENT
/begin MEASUREMENT evam_vap_tst_en "vapor generation test enable" UBYTE b_true 0 0 0.00 1.00 ECU_ADDRESS 0x40004EA0 FORMAT "%1.0" /end MEASUREMENT
/begin MEASUREMENT evam_vac_low "tank vacuum low" UBYTE b_true 0 0 0.00 1.00 ECU_ADDRESS 0x40004EA0 FORMAT "%1.0" /end MEASUREMENT
/begin MEASUREMENT evam_vap_gen_dly "vapor generation delay" UWORD u_16x_tmr 0 0 0 8191.875 ECU_ADDRESS 0x40004EBC SYMBOL_LINK "evam_diag_tmr" 34 /end MEASUREMENT
/begin MEASUREMENT evam_vac_low_dly "vac low condition delay" UWORD u_16x_tmr 0 0 0 8191.875 ECU_ADDRESS 0x40004EBC SYMBOL_LINK "evam_diag_tmr" 54 /end MEASUREMENT
/begin MEASUREMENT evam_vap_est_temp "vapor system estimated temp" SWORD u_deg_C 0 0 -256 255.9921875 ECU_ADDRESS 0x4000DA4E FORMAT "%5.1" /end MEASUREMENT
/begin MEASUREMENT evam_vap_stbl_dly "vapor stable delay" UWORD u_16x_tmr 0 0 0 8191.875 ECU_ADDRESS 0x40004EBC SYMBOL_LINK "evam_diag_tmr" 36 /end MEASUREMENT
/begin MEASUREMENT evam_vap_slp_tm "vapor slope log timer" UWORD u_16x_tmr 0 0 0 8191.875 ECU_ADDRESS 0x40004EBC SYMBOL_LINK "evam_diag_tmr" 32 /end MEASUREMENT
/begin MEASUREMENT evam_vap_tst_abrt "vap test abort" UBYTE b_true 0 0 0.00 1.00 ECU_ADDRESS 0x40004EA0 FORMAT "%1.0" /end MEASUREMENT
/begin MEASUREMENT evam_sm_vap_slp_req "small leak vap test slope cal req" UBYTE b_true 0 0 0.00 1.00 ECU_ADDRESS 0x40004EA0 FORMAT "%1.0" /end MEASUREMENT
/begin MEASUREMENT evam_sm_vap_vac_init "small leak vapor test vac init" SWORD u_kPa_8n_8p 0 0 -8 7.999755859375 ECU_ADDRESS 0x4000DA4E FORMAT "%3.2" /end MEASUREMENT
/begin MEASUREMENT evam_sm_vap_vac_end "small leak vapor test vac end" SWORD u_kPa_8n_8p 0 0 -8 7.999755859375 ECU_ADDRESS 0x4000DA4E FORMAT "%3.2" /end MEASUREMENT
/begin MEASUREMENT evam_sm_vap_vac_slp "small leak vapor vacuum slope" SWORD u_kPaSec_c 0 0 -8 7.999755859375 ECU_ADDRESS 0x40004EBC FORMAT "%3.2" /end MEASUREMENT
/begin MEASUREMENT evam_vsm_vap_slp_req "small leak vap test slope cal req" UBYTE b_true 0 0 0.00 1.00 ECU_ADDRESS 0x40004EA0 FORMAT "%1.0" /end MEASUREMENT
/begin MEASUREMENT evam_vsm_vap_vac_init "very small leak vapor test vac init" SWORD u_kPa_8n_8p 0 0 -8 7.999755859375 ECU_ADDRESS 0x4000DA4E FORMAT "%3.2" /end MEASUREMENT
/begin MEASUREMENT evam_vsm_vap_vac_end "very small leak vapor test vac end" SWORD u_kPa_8n_8p 0 0 -8 7.999755859375 ECU_ADDRESS 0x4000DA4E FORMAT "%3.2" /end MEASUREMENT
/begin MEASUREMENT evam_sm_vap_hi "small leak vap high" UBYTE b_true 0 0 0.00 1.00 ECU_ADDRESS 0x40004EA0 FORMAT "%1.0" /end MEASUREMENT
/begin MEASUREMENT evam_sm_vap_tst_pss "small leak vap test pass" UBYTE b_true 0 0 0.00 1.00 ECU_ADDRESS 0x40004EA0 FORMAT "%1.0" /end MEASUREMENT
/begin MEASUREMENT evam_sm_dcy_slp_cor "small leak corrected vac decay slope" SWORD u_kPaSec_c 0 0 -8 7.999755859375 ECU_ADDRESS 0x40004EBC FORMAT "%3.2" /end MEASUREMENT
/begin MEASUREMENT evam_sm_vap_tst_ext "small leak vap test exit" UBYTE b_true 0 0 0.00 1.00 ECU_ADDRESS 0x40004EA0 FORMAT "%1.0" /end MEASUREMENT
/begin MEASUREMENT evam_vsm_vap_hi "very small leak vap high" UBYTE b_true 0 0 0.00 1.00 ECU_ADDRESS 0x40004EA0 FORMAT "%1.0" /end MEASUREMENT
/begin MEASUREMENT evam_vsm_vap_tst_pss "very small leak vap test pass" UBYTE b_true 0 0 0.00 1.00 ECU_ADDRESS 0x40004EA0 FORMAT "%1.0" /end MEASUREMENT
/begin MEASUREMENT evam_vsm_dcy_slp_cor "very small leak corrected vac decay slope" SWORD u_kPaSec_c 0 0 -8 7.999755859375 ECU_ADDRESS 0x40004EBC FORMAT "%3.2" /end MEASUREMENT
/begin MEASUREMENT evam_vsm_vap_tst_ext "very small leak vap test exit" UBYTE b_true 0 0 0.00 1.00 ECU_ADDRESS 0x40004EA0 FORMAT "%1.0" /end MEASUREMENT
/begin MEASUREMENT evam_cld_lrg_strt_excd "cold large leak test start time exceed" UBYTE b_true 0 0 0.00 1.00 ECU_ADDRESS 0x40004EA0 FORMAT "%1.0" /end MEASUREMENT
/begin MEASUREMENT evam_lrg_lk_tst_fn "large leak test finish" UBYTE b_true 0 0 0.00 1.00 ECU_ADDRESS 0x40004EA0 FORMAT "%1.0" /end MEASUREMENT
/begin MEASUREMENT evam_lrg_lk_init_fn "large leak test initial finish" UBYTE b_true 0 0 0.00 1.00 ECU_ADDRESS 0x40004EA0 FORMAT "%1.0" /end MEASUREMENT
/begin MEASUREMENT evam_lrg_lk_vnt_tggl_req "large leak toggle finish" UBYTE b_true 0 0 0.00 1.00 ECU_ADDRESS 0x40004EA0 FORMAT "%1.0" /end MEASUREMENT
/begin MEASUREMENT evam_wrm_lrg_lk_rst_cnt "warm large leak rest counts" UWORD u_cnts 0 0 0.00 65535.00 ECU_ADDRESS 0x40004EA0 FORMAT "%5.0" /end MEASUREMENT
/begin MEASUREMENT evam_lrg_lk_pss_dly "large leak vac pass delay timer" UWORD u_16x_tmr 0 0 0 8191.875 ECU_ADDRESS 0x40004EBC SYMBOL_LINK "evam_diag_tmr" 8 /end MEASUREMENT
/begin MEASUREMENT evam_lrg_lk_tst_dur "large leak test timer" UWORD u_16x_tmr 0 0 0 8191.875 ECU_ADDRESS 0x40004EBC SYMBOL_LINK "evam_diag_tmr" 10 /end MEASUREMENT
/begin MEASUREMENT evam_vnt_blk_tst_fn "vent block test finish" UBYTE b_true 0 0 0.00 1.00 ECU_ADDRESS 0x40004EA0 FORMAT "%1.0" /end MEASUREMENT
/begin MEASUREMENT evam_vnt_blk_tst_excd "vent block test exceed" UBYTE b_true 0 0 0.00 1.00 ECU_ADDRESS 0x40004EA0 FORMAT "%1.0" /end MEASUREMENT
/begin MEASUREMENT evam_vnt_blk_tst_tmr "vent block test timer" UWORD u_16x_tmr 0 0 0 8191.875 ECU_ADDRESS 0x40004EBC SYMBOL_LINK "evam_diag_tmr" 20 /end MEASUREMENT
/begin MEASUREMENT evam_vnt_blk_tst_fl "vent block test fail" UBYTE b_true 0 0 0.00 1.00 ECU_ADDRESS 0x40004EA0 FORMAT "%1.0" /end MEASUREMENT
/begin MEASUREMENT evam_vnt_blk_dly_fn "vent block delay finish" UBYTE b_true 0 0 0.00 1.00 ECU_ADDRESS 0x40004EA0 FORMAT "%1.0" /end MEASUREMENT
/begin MEASUREMENT evam_vnt_blk_init "vent block init" UBYTE b_true 0 0 0.00 1.00 ECU_ADDRESS 0x40004EA0 FORMAT "%1.0" /end MEASUREMENT
/begin MEASUREMENT evam_vnt_blk_vac_dly "vent block vac high delay" UWORD u_16x_tmr 0 0 0 8191.875 ECU_ADDRESS 0x40004EBC SYMBOL_LINK "evam_diag_tmr" 22 /end MEASUREMENT
/begin MEASUREMENT evam_vnt_blk_int_req "vent block int req" UBYTE b_true 0 0 0.00 1.00 ECU_ADDRESS 0x40004EA0 FORMAT "%1.0" /end MEASUREMENT
/begin MEASUREMENT evam_vac_inc_int "vac increase count" UWORD u_cnts 0 0 0 65535 ECU_ADDRESS 0x40004EBC FORMAT "%5.0" /end MEASUREMENT
/begin MEASUREMENT evam_vac_inc_cor_int_dlt "corrected vac increase int delta" UWORD u_cnts 0 0 0 65535 ECU_ADDRESS 0x40004EBC FORMAT "%5.0" /end MEASUREMENT
/begin MEASUREMENT evam_vac_inc_int_dlt "vac increase int delta" UWORD u_cnts 0 0 0 65535 ECU_ADDRESS 0x40004EBC FORMAT "%5.0" /end MEASUREMENT
/begin MEASUREMENT evam_stat_lst "Purge diagnostic states last" UBYTE u_evam_stat 0 0 0.00 6.00 ECU_ADDRESS 0x40004168 /end MEASUREMENT
/begin MEASUREMENT evam_pv_lk_tst_tms "purge valve leak test times" UBYTE u_cnts 0 0 0 255 ECU_ADDRESS 0x40004EBC /end MEASUREMENT
/begin MEASUREMENT evam_hyb_dis "hybrid stop test disable" UBYTE b_true 0 0 0.00 1.00 ECU_ADDRESS 0x40004EA0 FORMAT "%1.0" /end MEASUREMENT
/begin MEASUREMENT evam_tank_vac_sp "tank vac setpoint" SWORD u_kPa_8n_8p 0 0 -8 7.999755859375 ECU_ADDRESS 0x4000DA4E FORMAT "%3.2" /end MEASUREMENT
/begin MEASUREMENT evam_vnt_vlv_tggl_tmr "vent valve toggle timer" UWORD u_16x_tmr 0 0 0 8191.875 ECU_ADDRESS 0x40004EBC SYMBOL_LINK "evam_diag_tmr" 38 /end MEASUREMENT
/begin MEASUREMENT evam_vnt_ctrl_st "vent valve control state" UBYTE u_vnt_ctrl_st 0 0 0.00 2.00 ECU_ADDRESS 0x40004168 FORMAT "%1.0" /end MEASUREMENT
/begin MEASUREMENT evam_vnt_tggl_tms "vent valve toggle times" UBYTE u_cnts 0 0 0.00 255.00 ECU_ADDRESS 0x40004168 /end MEASUREMENT
/begin MEASUREMENT evam_vnt_tggl_st "vent valve toggle state" UBYTE u_vnt_ctrl_st 0 0 0.00 2.00 ECU_ADDRESS 0x40004168 FORMAT "%1.0" /end MEASUREMENT
/begin MEASUREMENT evam_vnt_blk_rprt "vent block test report" UBYTE b_true 0 0 0.00 1.00 ECU_ADDRESS 0x40004EA0 FORMAT "%1.0" /end MEASUREMENT
/begin MEASUREMENT evam_vsm_lk_rprt "very small leak test report" UBYTE b_true 0 0 0.00 1.00 ECU_ADDRESS 0x40004EA0 FORMAT "%1.0" /end MEASUREMENT
/begin MEASUREMENT evam_amb_t_hi "amb temp high" UBYTE b_true 0 0 0.00 1.00 ECU_ADDRESS 0x40004EA0 FORMAT "%1.0" /end MEASUREMENT
/begin MEASUREMENT evam_vsm_lk_rprt_hld "very small leak report hold" UBYTE b_true 0 0 0.00 1.00 ECU_ADDRESS 0x40004EA0 FORMAT "%1.0" /end MEASUREMENT
/begin MEASUREMENT evam_vsm_lk_rprt_dis "very small leak report disable" UBYTE b_true 0 0 0.00 1.00 ECU_ADDRESS 0x40004EA0 FORMAT "%1.0" /end MEASUREMENT
/begin MEASUREMENT evam_sm_lk_rprt "small leak report" UBYTE b_true 0 0 0.00 1.00 ECU_ADDRESS 0x40004EA0 FORMAT "%1.0" /end MEASUREMENT
/begin MEASUREMENT evam_lrg_lk_rprt "large leak report" UBYTE b_true 0 0 0.00 1.00 ECU_ADDRESS 0x40004EA0 FORMAT "%1.0" /end MEASUREMENT
/begin MEASUREMENT evam_cap_opn_fl_tms "fuel cap open fail times" UBYTE u_cnts 0 0 0.00 255.00 ECU_ADDRESS 0x40004168 /end MEASUREMENT
/begin MEASUREMENT evam_cap_opn_fl_trp "fuel cap open fail trip times" UBYTE u_cnts 0 0 0.00 255.00 ECU_ADDRESS 0x40004168 /end MEASUREMENT
/begin MEASUREMENT evam_cap_cld_fl_tms "cold fuel cap open fail times" UBYTE u_cnts 0 0 0.00 255.00 ECU_ADDRESS 0x40004168 /end MEASUREMENT
/begin MEASUREMENT evam_cld_lrg_lk_rprt "cold large leak report" UBYTE b_true 0 0 0.00 1.00 ECU_ADDRESS 0x40004EA0 FORMAT "%1.0" /end MEASUREMENT
/begin MEASUREMENT evam_trip_llk_pass "trip large leak pass" UBYTE b_true 0 0 0.00 1.00 ECU_ADDRESS 0x40004EA0 FORMAT "%1.0" /end MEASUREMENT
/begin MEASUREMENT evam_pv_lk_rprt "purge valve leak report" UBYTE b_true 0 0 0.00 1.00 ECU_ADDRESS 0x40004EA0 FORMAT "%1.0" /end MEASUREMENT
/begin MEASUREMENT evam_srv_vsm_ect_dis "serverice very small leak disable due to ect" UBYTE b_true 0 0 0.00 1.00 ECU_ADDRESS 0x40004EA0 FORMAT "%1.0" /end MEASUREMENT
/begin MEASUREMENT evam_srv_tst_en "serverice test enable" UBYTE b_true 0 0 0.00 1.00 ECU_ADDRESS 0x40004EA0 FORMAT "%1.0" /end MEASUREMENT
/begin MEASUREMENT evam_vac_nois_lrn_fn "tank vac noise learn finish" UBYTE b_true 0 0 0.00 1.00 ECU_ADDRESS 0x40004EA0 FORMAT "%1.0" /end MEASUREMENT
/begin MEASUREMENT evam_tnk_prot_tmr "tank protect timer" UWORD u_16x_tmr 0 0 0 8191.875 ECU_ADDRESS 0x40004EBC SYMBOL_LINK "evam_diag_tmr" 58 /end MEASUREMENT
/begin MEASUREMENT evam_tnk_prot_en "tank protect enable" UBYTE b_true 0 0 0.00 1.00 ECU_ADDRESS 0x40004EA0 FORMAT "%1.0" /end MEASUREMENT
/begin MEASUREMENT evam_vac_hi_vnt_opn "tank vac high vent open request" UBYTE b_true 0 0 0.00 1.00 ECU_ADDRESS 0x40004EA0 FORMAT "%1.0" /end MEASUREMENT
/begin MEASUREMENT evam_tnk_prot_flt_tmr "tank protect timer use filter tank press" UWORD u_16x_tmr 0 0 0 8191.875 ECU_ADDRESS 0x40004EBC SYMBOL_LINK "evam_diag_tmr" 74 /end MEASUREMENT
/begin MEASUREMENT evam_tnk_prot_pss_tmr "tank protect pass delay timer" UWORD u_16x_tmr 0 0 0 8191.875 ECU_ADDRESS 0x40004EBC SYMBOL_LINK "evam_diag_tmr" 60 /end MEASUREMENT
/begin MEASUREMENT evam_prot_vnt_opn_req "tank protect vent open request" UBYTE b_true 0 0 0.00 1.00 ECU_ADDRESS 0x40004EA0 FORMAT "%1.0" /end MEASUREMENT
/begin MEASUREMENT evam_vnt_vlv_st "vent valve state" UBYTE u_mot_dir 0 0 0.00 1.00 ECU_ADDRESS 0x40004EA0 FORMAT "%1.0" /end MEASUREMENT
/begin MEASUREMENT evam_tnk_vac_lrn_tmr "tank vac learn timer" UWORD u_16x_tmr 0 0 0 8191.875 ECU_ADDRESS 0x40004EBC SYMBOL_LINK "evam_diag_tmr" 56 /end MEASUREMENT
/begin MEASUREMENT evam_keyon_tnk_vac "keyon tank vac" SWORD u_kPa_8n_8p 0 0 -8 7.999755859375 ECU_ADDRESS 0x4000DA4E FORMAT "%3.2" /end MEASUREMENT
/begin MEASUREMENT evam_tnk_vac_adp "tank vac adaption" SWORD u_kPa_8n_8p 0 0 -8 7.999755859375 ECU_ADDRESS 0x4000DA4E FORMAT "%3.2" /end MEASUREMENT
/begin MEASUREMENT evam_cap_opn_tst_rstrt "cap open test restart" UBYTE b_true 0 0 0.00 1.00 ECU_ADDRESS 0x40004EA0 FORMAT "%1.0" /end MEASUREMENT
/begin MEASUREMENT evam_cap_opn_rstrt_dly "cap open test restart delay" UWORD u_16x_tmr 0 0 0 8191.875 ECU_ADDRESS 0x40004EBC SYMBOL_LINK "evam_diag_tmr" 70 /end MEASUREMENT
/begin MEASUREMENT evam_cap_opn_vspd_met "cap open test vehicle speed met" UBYTE b_true 0 0 0.00 1.00 ECU_ADDRESS 0x40004EA0 FORMAT "%1.0" /end MEASUREMENT
/begin MEASUREMENT evam_pg_en_tmr "purge enable timer" UWORD u_16x_tmr 0 0 0 8191.875 ECU_ADDRESS 0x40004EBC SYMBOL_LINK "evam_diag_tmr" 72 /end MEASUREMENT
/begin MEASUREMENT evam_cap_opn_tst_rst "cap open test rest" UBYTE b_true 0 0 0.00 1.00 ECU_ADDRESS 0x40004EA0 FORMAT "%1.0" /end MEASUREMENT
/begin MEASUREMENT evam_con_lrn_actv "concerntration learn active" UBYTE b_true 0 0 0.00 1.00 ECU_ADDRESS 0x40004EA0 FORMAT "%1.0" /end MEASUREMENT
/begin MEASUREMENT evam_tnk_vac_lrn_fn "tank vac bias learn finish" UBYTE b_true 0 0 0.00 1.00 ECU_ADDRESS 0x40004EA0 FORMAT "%1.0" /end MEASUREMENT
/begin MEASUREMENT com_fan_ctrl_req_st "fan request state from can" UBYTE u_fan_ctrl_typ 0 0 0.00 3.00 ECU_ADDRESS 0x4000440A FORMAT "%1.0" /end MEASUREMENT
/begin MEASUREMENT com_tcu_tcc_actv "tcu tcc active" UBYTE b_true 0 0 0.0 1.0 BIT_MASK 0x1 ECU_ADDRESS 0x400050DA FORMAT "%1.0" /end MEASUREMENT
/begin MEASUREMENT com_ac_t "ac temperature" SWORD u_deg_C 0 0 -256 255.9921875 ECU_ADDRESS 0x40004EBC /end MEASUREMENT
/begin MEASUREMENT com_ac_t_vld "ac temperature valid" UBYTE b_true 0 0 0.0 1.0 BIT_MASK 0x1 ECU_ADDRESS 0x400050DA FORMAT "%1.0" /end MEASUREMENT
/begin MEASUREMENT com_vspd_invld "vehicle speed invalid" UBYTE b_true 0 0 0.0 1.0 BIT_MASK 0x1 ECU_ADDRESS 0x400050DA FORMAT "%1.0" /end MEASUREMENT
/begin CHARACTERISTIC ERRM_V_IUPR_ENG_STRT_ESPD "engine start speed min should be set to normal idle speed minus 150rpm" VALUE 0x0002038C __UWORD_S 0 u_espd 0 8191.875 FORMAT "%5.1" /end CHARACTERISTIC
/begin CHARACTERISTIC ERRM_V_IUPR_DSPLY_IDX "iupr display index" VALUE 0x0002038C __UBYTE_S 0 u_iupr_idx 0 255 FORMAT "%1.0" /end CHARACTERISTIC
/begin CHARACTERISTIC ERRM_V_PD_CLR_MF_EN "Permanent DTC clear in manufacture enable" VALUE 0x2886C __UWORD_S 0 b_true 0 1 FORMAT "%1.0" BIT_MASK 0x0800 /end CHARACTERISTIC
/begin CHARACTERISTIC ERRM_V_PD_STR_MF_EN "Permanent DTC store in manufacture enable" VALUE 0x2886C __UWORD_S 0 b_true 0 1 FORMAT "%1.0" BIT_MASK 0x0800 /end CHARACTERISTIC
/begin CHARACTERISTIC ERRM_V_FF_PRITY_EN "freeze frame store priorty enable" VALUE 0x2886C __UWORD_S 0 b_true 0 1 FORMAT "%1.0" BIT_MASK 0x0800 /end CHARACTERISTIC
/begin CHARACTERISTIC ERRM_CAN_GW_TYP "can gateway communication type" VALUE 0x2886C __UWORD_S 0 u_diag_typ 0 8 FORMAT "%1.0" BIT_MASK 0xF000 SYMBOL_LINK "ERRM_CFG_ARRY" 240 /end CHARACTERISTIC
/begin CHARACTERISTIC ERRM_CAN_GW_MIL_ON "can gateway communication MIL on enable" VALUE 0x2886C __UWORD_S 0 b_true 0 1 FORMAT "%1.0" BIT_MASK 0x0800 SYMBOL_LINK "ERRM_CFG_ARRY" 240 /end CHARACTERISTIC
/begin CHARACTERISTIC ERRM_CAN_GW_DEN_GRP "can gateway communication denom group" VALUE 0x2886C __UWORD_S 0 u_den_grp 0 63 FORMAT "%1.0" BIT_MASK 0x003F SYMBOL_LINK "ERRM_CFG_ARRY" 240 /end CHARACTERISTIC
/begin CHARACTERISTIC ERRM_CAN_GW_DTC "can gateway communication DTC" VALUE 0x2886C __UWORD_S 0 u_cnts 0 65535 FORMAT "%5.0" SYMBOL_LINK "ERRM_CFG_ARRY" 240 /end CHARACTERISTIC
/begin CHARACTERISTIC ERRM_BRK_PRESS_LO_TYP "break pump press low type" VALUE 0x2886C __UWORD_S 0 u_diag_typ 0 8 FORMAT "%1.0" BIT_MASK 0xF000 SYMBOL_LINK "ERRM_CFG_ARRY" 2106 SYMBOL_LINK "ERRM_CFG_ARRY" 1854 /end CHARACTERISTIC
/begin CHARACTERISTIC ERRM_BRK_PRESS_LO_MIL_ON "break pump press low MIL on enable" VALUE 0x2886C __UWORD_S 0 b_true 0 1 FORMAT "%1.0" BIT_MASK 0x0800 SYMBOL_LINK "ERRM_CFG_ARRY" 2106 SYMBOL_LINK "ERRM_CFG_ARRY" 1854 /end CHARACTERISTIC
/begin CHARACTERISTIC ERRM_BRK_PRESS_LO_DEN_GRP "break pump press low denom group" VALUE 0x2886C __UWORD_S 0 u_den_grp 0 63 FORMAT "%1.0" BIT_MASK 0x003F SYMBOL_LINK "ERRM_CFG_ARRY" 2106 SYMBOL_LINK "ERRM_CFG_ARRY" 1854 /end CHARACTERISTIC
/begin CHARACTERISTIC ERRM_BRK_PRESS_LO_DTC "break pump press low DTC" VALUE 0x2886C __UWORD_S 0 u_cnts 0 65535 FORMAT "%5.0" SYMBOL_LINK "ERRM_CFG_ARRY" 2108 SYMBOL_LINK "ERRM_CFG_ARRY" 1856 /end CHARACTERISTIC
/begin CHARACTERISTIC ERRM_BRK_PRESS_HI_TYP "break pump press high type" VALUE 0x2886C __UWORD_S 0 u_diag_typ 0 8 FORMAT "%1.0" BIT_MASK 0xF000 SYMBOL_LINK "ERRM_CFG_ARRY" 2112 SYMBOL_LINK "ERRM_CFG_ARRY" 1860 /end CHARACTERISTIC
/begin CHARACTERISTIC ERRM_BRK_PRESS_HI_MIL_ON "break pump press high MIL on enable" VALUE 0x2886C __UWORD_S 0 b_true 0 1 FORMAT "%1.0" BIT_MASK 0x0800 SYMBOL_LINK "ERRM_CFG_ARRY" 2112 SYMBOL_LINK "ERRM_CFG_ARRY" 1860 /end CHARACTERISTIC
/begin CHARACTERISTIC ERRM_BRK_PRESS_HI_DEN_GRP "break pump press high denom group" VALUE 0x2886C __UWORD_S 0 u_den_grp 0 63 FORMAT "%1.0" BIT_MASK 0x003F SYMBOL_LINK "ERRM_CFG_ARRY" 2112 SYMBOL_LINK "ERRM_CFG_ARRY" 1860 /end CHARACTERISTIC
/begin CHARACTERISTIC ERRM_BRK_PRESS_HI_DTC "break pump press high DTC" VALUE 0x2886C __UWORD_S 0 u_cnts 0 65535 FORMAT "%5.0" SYMBOL_LINK "ERRM_CFG_ARRY" 2114 SYMBOL_LINK "ERRM_CFG_ARRY" 1862 /end CHARACTERISTIC
/begin CHARACTERISTIC ERRM_REF_VOLT3_TYP "sensor ref volt3 type" VALUE 0x2886C __UWORD_S 0 u_diag_typ 0 8 FORMAT "%1.0" BIT_MASK 0xF000 SYMBOL_LINK "ERRM_CFG_ARRY" 2964 SYMBOL_LINK "ERRM_CFG_ARRY" 2646 /end CHARACTERISTIC
/begin CHARACTERISTIC ERRM_REF_VOLT3_MIL_ON "sensor ref volt3 MIL on enable" VALUE 0x2886C __UWORD_S 0 b_true 0 1 FORMAT "%1.0" BIT_MASK 0x0800 SYMBOL_LINK "ERRM_CFG_ARRY" 2964 SYMBOL_LINK "ERRM_CFG_ARRY" 2646 /end CHARACTERISTIC
/begin CHARACTERISTIC ERRM_REF_VOLT3_DEN_GRP "sensor ref volt3 denom group" VALUE 0x2886C __UWORD_S 0 u_den_grp 0 63 FORMAT "%1.0" BIT_MASK 0x003F SYMBOL_LINK "ERRM_CFG_ARRY" 2964 SYMBOL_LINK "ERRM_CFG_ARRY" 2646 /end CHARACTERISTIC
/begin CHARACTERISTIC ERRM_REF_VOLT3_DTC "sensor ref volt3 DTC" VALUE 0x2886C __UWORD_S 0 u_cnts 0 65535 FORMAT "%5.0" SYMBOL_LINK "ERRM_CFG_ARRY" 2966 SYMBOL_LINK "ERRM_CFG_ARRY" 2648 /end CHARACTERISTIC
/begin CHARACTERISTIC ERRM_ECT_STUK_TYP "ECT stuck type" VALUE 0x2886C __UWORD_S 0 u_diag_typ 0 8 FORMAT "%1.0" BIT_MASK 0xF000 SYMBOL_LINK "ERRM_CFG_ARRY" 342 /end CHARACTERISTIC
/begin CHARACTERISTIC ERRM_ECT_STUK_MIL_ON "ECT stuck MIL on enable" VALUE 0x2886C __UWORD_S 0 b_true 0 1 FORMAT "%1.0" BIT_MASK 0x0800 SYMBOL_LINK "ERRM_CFG_ARRY" 342 /end CHARACTERISTIC
/begin CHARACTERISTIC ERRM_ECT_STUK_DEN_GRP "ECT stuck denom group" VALUE 0x2886C __UWORD_S 0 u_den_grp 0 63 FORMAT "%1.0" BIT_MASK 0x003F SYMBOL_LINK "ERRM_CFG_ARRY" 342 /end CHARACTERISTIC
/begin CHARACTERISTIC ERRM_ECT_STUK_DTC "ECT stuck DTC" VALUE 0x2886C __UWORD_S 0 u_cnts 0 65535 FORMAT "%5.0" SYMBOL_LINK "ERRM_CFG_ARRY" 344 /end CHARACTERISTIC
/begin CHARACTERISTIC ERRM_TNK_P_RAT_LO_TYP "tank press rationality low type" VALUE 0x2886C __UWORD_S 0 u_diag_typ 0 8 FORMAT "%1.0" BIT_MASK 0xF000 SYMBOL_LINK "ERRM_CFG_ARRY" 2520 SYMBOL_LINK "ERRM_CFG_ARRY" 2202 /end CHARACTERISTIC
/begin CHARACTERISTIC ERRM_TNK_P_RAT_LO_MIL_ON "tank press rationality low MIL on enable" VALUE 0x2886C __UWORD_S 0 b_true 0 1 FORMAT "%1.0" BIT_MASK 0x0800 SYMBOL_LINK "ERRM_CFG_ARRY" 2520 SYMBOL_LINK "ERRM_CFG_ARRY" 2202 /end CHARACTERISTIC
/begin CHARACTERISTIC ERRM_TNK_P_RAT_LO_DEN_GRP "tank press rationality low denom group" VALUE 0x2886C __UWORD_S 0 u_den_grp 0 63 FORMAT "%1.0" BIT_MASK 0x003F SYMBOL_LINK "ERRM_CFG_ARRY" 2520 SYMBOL_LINK "ERRM_CFG_ARRY" 2202 /end CHARACTERISTIC
/begin CHARACTERISTIC ERRM_TNK_P_RAT_LO_DTC "tank press rationality low DTC" VALUE 0x2886C __UWORD_S 0 u_cnts 0 65535 FORMAT "%5.0" SYMBOL_LINK "ERRM_CFG_ARRY" 2522 SYMBOL_LINK "ERRM_CFG_ARRY" 2204 /end CHARACTERISTIC
/begin CHARACTERISTIC ERRM_TNK_P_RAT_HI_TYP "tank press rationality high type" VALUE 0x2886C __UWORD_S 0 u_diag_typ 0 8 FORMAT "%1.0" BIT_MASK 0xF000 SYMBOL_LINK "ERRM_CFG_ARRY" 2526 SYMBOL_LINK "ERRM_CFG_ARRY" 2208 /end CHARACTERISTIC
/begin CHARACTERISTIC ERRM_TNK_P_RAT_HI_MIL_ON "tank press rationality high MIL on enable" VALUE 0x2886C __UWORD_S 0 b_true 0 1 FORMAT "%1.0" BIT_MASK 0x0800 SYMBOL_LINK "ERRM_CFG_ARRY" 2526 SYMBOL_LINK "ERRM_CFG_ARRY" 2208 /end CHARACTERISTIC
/begin CHARACTERISTIC ERRM_TNK_P_RAT_HI_DEN_GRP "tank press rationality high denom group" VALUE 0x2886C __UWORD_S 0 u_den_grp 0 63 FORMAT "%1.0" BIT_MASK 0x003F SYMBOL_LINK "ERRM_CFG_ARRY" 2526 SYMBOL_LINK "ERRM_CFG_ARRY" 2208 /end CHARACTERISTIC
/begin CHARACTERISTIC ERRM_TNK_P_RAT_HI_DTC "tank press rationality high DTC" VALUE 0x2886C __UWORD_S 0 u_cnts 0 65535 FORMAT "%5.0" SYMBOL_LINK "ERRM_CFG_ARRY" 2528 SYMBOL_LINK "ERRM_CFG_ARRY" 2210 /end CHARACTERISTIC
/begin CHARACTERISTIC ERRM_BRKP_LLEAK_TYP "break pump press large leak type" VALUE 0x2886C __UWORD_S 0 u_diag_typ 0 8 FORMAT "%1.0" BIT_MASK 0xF000 SYMBOL_LINK "ERRM_CFG_ARRY" 2118 SYMBOL_LINK "ERRM_CFG_ARRY" 1866 /end CHARACTERISTIC
/begin CHARACTERISTIC ERRM_BRKP_LLEAK_MIL_ON "break pump press large leak MIL on enable" VALUE 0x2886C __UWORD_S 0 b_true 0 1 FORMAT "%1.0" BIT_MASK 0x0800 SYMBOL_LINK "ERRM_CFG_ARRY" 2118 SYMBOL_LINK "ERRM_CFG_ARRY" 1866 /end CHARACTERISTIC
/begin CHARACTERISTIC ERRM_BRKP_LLEAK_DEN_GRP "break pump press large leak denom group" VALUE 0x2886C __UWORD_S 0 u_den_grp 0 63 FORMAT "%1.0" BIT_MASK 0x003F SYMBOL_LINK "ERRM_CFG_ARRY" 2118 SYMBOL_LINK "ERRM_CFG_ARRY" 1866 /end CHARACTERISTIC
/begin CHARACTERISTIC ERRM_BRKP_LLEAK_DTC "break pump press large leak DTC" VALUE 0x2886C __UWORD_S 0 u_cnts 0 65535 FORMAT "%5.0" SYMBOL_LINK "ERRM_CFG_ARRY" 2120 SYMBOL_LINK "ERRM_CFG_ARRY" 1868 /end CHARACTERISTIC
/begin CHARACTERISTIC ERRM_BRKP_SLEAK_TYP "break pump press small leak type" VALUE 0x2886C __UWORD_S 0 u_diag_typ 0 8 FORMAT "%1.0" BIT_MASK 0xF000 SYMBOL_LINK "ERRM_CFG_ARRY" 2124 SYMBOL_LINK "ERRM_CFG_ARRY" 1872 /end CHARACTERISTIC
/begin CHARACTERISTIC ERRM_BRKP_SLEAK_MIL_ON "break pump press small leak MIL on enable" VALUE 0x2886C __UWORD_S 0 b_true 0 1 FORMAT "%1.0" BIT_MASK 0x0800 SYMBOL_LINK "ERRM_CFG_ARRY" 2124 SYMBOL_LINK "ERRM_CFG_ARRY" 1872 /end CHARACTERISTIC
/begin CHARACTERISTIC ERRM_BRKP_SLEAK_DEN_GRP "break pump press small leak denom group" VALUE 0x2886C __UWORD_S 0 u_den_grp 0 63 FORMAT "%1.0" BIT_MASK 0x003F SYMBOL_LINK "ERRM_CFG_ARRY" 2124 SYMBOL_LINK "ERRM_CFG_ARRY" 1872 /end CHARACTERISTIC
/begin CHARACTERISTIC ERRM_BRKP_SLEAK_DTC "break pump press small leak DTC" VALUE 0x2886C __UWORD_S 0 u_cnts 0 65535 FORMAT "%5.0" SYMBOL_LINK "ERRM_CFG_ARRY" 2126 SYMBOL_LINK "ERRM_CFG_ARRY" 1874 /end CHARACTERISTIC
/begin CHARACTERISTIC ERRM_BRKP_RLY_HI_TYP "break pump relay high type" VALUE 0x2886C __UWORD_S 0 u_diag_typ 0 8 FORMAT "%1.0" BIT_MASK 0xF000 SYMBOL_LINK "ERRM_CFG_ARRY" 2130 SYMBOL_LINK "ERRM_CFG_ARRY" 1878 /end CHARACTERISTIC
/begin CHARACTERISTIC ERRM_BRKP_RLY_HI_MIL_ON "break pump relay high MIL on enable" VALUE 0x2886C __UWORD_S 0 b_true 0 1 FORMAT "%1.0" BIT_MASK 0x0800 SYMBOL_LINK "ERRM_CFG_ARRY" 2130 SYMBOL_LINK "ERRM_CFG_ARRY" 1878 /end CHARACTERISTIC
/begin CHARACTERISTIC ERRM_BRKP_RLY_HI_DEN_GRP "break pump relay high denom group" VALUE 0x2886C __UWORD_S 0 u_den_grp 0 63 FORMAT "%1.0" BIT_MASK 0x003F SYMBOL_LINK "ERRM_CFG_ARRY" 2130 SYMBOL_LINK "ERRM_CFG_ARRY" 1878 /end CHARACTERISTIC
/begin CHARACTERISTIC ERRM_BRKP_RLY_HI_DTC "break pump relay high DTC" VALUE 0x2886C __UWORD_S 0 u_cnts 0 65535 FORMAT "%5.0" SYMBOL_LINK "ERRM_CFG_ARRY" 2132 SYMBOL_LINK "ERRM_CFG_ARRY" 1880 /end CHARACTERISTIC
/begin CHARACTERISTIC ERRM_BRKP_RLY_LO_TYP "break pump relay low type" VALUE 0x2886C __UWORD_S 0 u_diag_typ 0 8 FORMAT "%1.0" BIT_MASK 0xF000 SYMBOL_LINK "ERRM_CFG_ARRY" 2136 SYMBOL_LINK "ERRM_CFG_ARRY" 1884 /end CHARACTERISTIC
/begin CHARACTERISTIC ERRM_BRKP_RLY_LO_MIL_ON "break pump relay low MIL on enable" VALUE 0x2886C __UWORD_S 0 b_true 0 1 FORMAT "%1.0" BIT_MASK 0x0800 SYMBOL_LINK "ERRM_CFG_ARRY" 2136 SYMBOL_LINK "ERRM_CFG_ARRY" 1884 /end CHARACTERISTIC
/begin CHARACTERISTIC ERRM_BRKP_RLY_LO_DEN_GRP "break pump relay low denom group" VALUE 0x2886C __UWORD_S 0 u_den_grp 0 63 FORMAT "%1.0" BIT_MASK 0x003F SYMBOL_LINK "ERRM_CFG_ARRY" 2136 SYMBOL_LINK "ERRM_CFG_ARRY" 1884 /end CHARACTERISTIC
/begin CHARACTERISTIC ERRM_BRKP_RLY_LO_DTC "break pump relay low DTC" VALUE 0x2886C __UWORD_S 0 u_cnts 0 65535 FORMAT "%5.0" SYMBOL_LINK "ERRM_CFG_ARRY" 2138 SYMBOL_LINK "ERRM_CFG_ARRY" 1890 /end CHARACTERISTIC
/begin CHARACTERISTIC EGR_V_CTRL_EN "calibration to enable EGR software control" VALUE 0x0002038C __UBYTE_S 0 b_enable 0 1 FORMAT "%5.2" /end CHARACTERISTIC
/begin CHARACTERISTIC EGR_M_EGR_RAT_SP "setpoint of EGR ratio" MAP 0x00020320 __UWORD_S 0 u_pct 0 199.996948 SYMBOL_LINK "EGR_M_EGR_RAT_SP" 4
 /begin AXIS_DESCR FIX_AXIS sys_eng_spd u_espd 15 800 6400
  /begin FIX_AXIS_PAR_LIST 6400 9600 12800 16000 19200 22400 25600 28800 32000 35200 38400 41600 44800 48000 51200 /end FIX_AXIS_PAR_LIST
 /end AXIS_DESCR
 /begin AXIS_DESCR COM_AXIS tq_imep_sp u_kPa_0_4096 17 0 4095.937500 AXIS_PTS_REF EGR_X_IMEP /end AXIS_DESCR
/end CHARACTERISTIC
/begin AXIS_PTS EGR_X_IMEP "" 0x0002006C tq_imep_sp SSV__UWORD_S 0 u_kPa_0_4096 17 0 4095.937500 DEPOSIT ABSOLUTE SYMBOL_LINK "EGR_X_IMEP" 2 /end AXIS_PTS
/begin CHARACTERISTIC EGR_C_DC_INT_BAS "Base Int term of EGR DC when EGR position goes from 0 to setpoint" CURVE 0x375CE __UWORD_S 0 u_pct 0 199.996948 SYMBOL_LINK "EGR_C_DC_INT_BAS" 2
 /begin AXIS_DESCR FIX_AXIS egr_pos_sp u_pct 5 0 100 /begin FIX_AXIS_PAR_LIST 0 8192 16384 24576 32768 /end FIX_AXIS_PAR_LIST /end AXIS_DESCR
/end CHARACTERISTIC
/begin CHARACTERISTIC EGR_C_DC_INT_FAC "int factor multiply egr_pos_err to get int term correction of EGR DC" CURVE 0x000200B0 __UWORD_S 0 u_fac_2 0 1.999969482421875 FORMAT "%4.3" SYMBOL_LINK "EGR_C_DC_INT_FAC" 2
 /begin AXIS_DESCR COM_AXIS NO_INPUT_QUANTITY u_pct 10 0 100 AXIS_PTS_REF EGR_X_POS_ERR_A /end AXIS_DESCR
/end CHARACTERISTIC
/begin AXIS_PTS EGR_X_POS_ERR_A "" 0x0002006C NO_INPUT_QUANTITY SSV__UWORD_S 0 u_pct 10 0 100 DEPOSIT ABSOLUTE SYMBOL_LINK "EGR_X_POS_ERR_A" 2 /end AXIS_PTS
/begin CHARACTERISTIC EGR_C_DC_PROP_FAC "prop factor multiply egr_pos_err to get prop term correction of EGR DC" CURVE 0x000200B0 __UWORD_S 0 u_fac_4 0 3.99993896484375 FORMAT "%4.3" SYMBOL_LINK "EGR_C_DC_PROP_FAC" 2
 /begin AXIS_DESCR COM_AXIS NO_INPUT_QUANTITY u_pct 10 0 100 AXIS_PTS_REF EGR_X_POS_ERR /end AXIS_DESCR
/end CHARACTERISTIC
/begin AXIS_PTS EGR_X_POS_ERR "" 0x0002006C NO_INPUT_QUANTITY SSV__UWORD_S 0 u_pct 10 0 100 DEPOSIT ABSOLUTE SYMBOL_LINK "EGR_X_POS_ERR" 2 /end AXIS_PTS
/begin CHARACTERISTIC EGR_V_POS_MIN "minimum desired EGR position" VALUE 0x0002038C __UWORD_S 0 u_pct 0 199.996948 /end CHARACTERISTIC
/begin CHARACTERISTIC EGR_V_EN_IAT_MAX_LO "EGR control enable IAT max low" VALUE 0x0002038C __SWORD_S 0 u_deg_C -256 255.9921875 /end CHARACTERISTIC
/begin CHARACTERISTIC EGR_V_EN_IAT_MAX_HI "EGR control enable IAT max high" VALUE 0x0002038C __SWORD_S 0 u_deg_C -256 255.9921875 /end CHARACTERISTIC
/begin CHARACTERISTIC EGR_V_EN_IAT_MIN_HI "EGR control enable IAT min high" VALUE 0x0002038C __SWORD_S 0 u_deg_C -256 255.9921875 /end CHARACTERISTIC
/begin CHARACTERISTIC EGR_V_EN_IAT_MIN_LO "EGR control enable IAT min low" VALUE 0x0002038C __SWORD_S 0 u_deg_C -256 255.9921875 /end CHARACTERISTIC
/begin CHARACTERISTIC EGR_V_EN_BAT_MAX_LO "EGR control enable battery voltage max low" VALUE 0x0002038C __UWORD_S 0 u_volt_32 0 31.99951171875 FORMAT "%4.2" /end CHARACTERISTIC
/begin CHARACTERISTIC EGR_V_EN_BAT_MAX_HI "EGR control enable battery voltage max high" VALUE 0x0002038C __UWORD_S 0 u_volt_32 0 31.99951171875 FORMAT "%4.2" /end CHARACTERISTIC
/begin CHARACTERISTIC EGR_V_EN_BAT_MIN_HI "EGR control enable battery voltage min high" VALUE 0x0002038C __UWORD_S 0 u_volt_32 0 31.99951171875 FORMAT "%4.2" /end CHARACTERISTIC
/begin CHARACTERISTIC EGR_V_EN_BAT_MIN_LO "EGR control enable battery voltage min low" VALUE 0x0002038C __UWORD_S 0 u_volt_32 0 31.99951171875 FORMAT "%4.2" /end CHARACTERISTIC
/begin CHARACTERISTIC EGR_V_EN_KEYON_ECT "EGR control enable key on ECT min" VALUE 0x0002038C __SWORD_S 0 u_deg_C -256 255.9921875 /end CHARACTERISTIC
/begin CHARACTERISTIC EGR_V_EN_ECT_MIN_HI "EGR control enable ECT min high" VALUE 0x0002038C __SWORD_S 0 u_deg_C -256 255.9921875 /end CHARACTERISTIC
/begin CHARACTERISTIC EGR_V_EN_ECT_MIN_LO "EGR control enable ECT min low" VALUE 0x0002038C __SWORD_S 0 u_deg_C -256 255.9921875 /end CHARACTERISTIC
/begin CHARACTERISTIC EGR_V_EN_AF_MAX "EGR control enable airfuel max" VALUE 0x0002038C __UWORD_S 0 u_afr 0 31.99951171875 FORMAT "%4.2" /end CHARACTERISTIC
/begin CHARACTERISTIC EGR_V_EN_AF_MIN "EGR control enable airfuel min" VALUE 0x0002038C __UWORD_S 0 u_afr 0 31.99951171875 FORMAT "%4.2" /end CHARACTERISTIC
/begin CHARACTERISTIC EGR_V_EN_IMEP_MIN_HI "EGR control enable IMEP min high" VALUE 0x0002038C __UWORD_S 0 u_kPa_0_256 0 255.99609375 /end CHARACTERISTIC
/begin CHARACTERISTIC EGR_V_EN_IMEP_MIN_LO "EGR control enable IMEP min low" VALUE 0x0002038C __UWORD_S 0 u_kPa_0_256 0 255.99609375 /end CHARACTERISTIC
/begin CHARACTERISTIC EGR_V_EN_TPS_MAX_LO "EGR control enable TPS max low" VALUE 0x0002038C __UWORD_S 0 u_pct 0 199.996948 /end CHARACTERISTIC
/begin CHARACTERISTIC EGR_V_EN_TPS_MAX_HI "EGR control enable TPS max high" VALUE 0x0002038C __UWORD_S 0 u_pct 0 199.996948 /end CHARACTERISTIC
/begin CHARACTERISTIC EGR_V_EN_TPS_MIN_HI "EGR control enable TPS min high" VALUE 0x0002038C __UWORD_S 0 u_pct 0 199.996948 /end CHARACTERISTIC
/begin CHARACTERISTIC EGR_V_EN_TPS_MIN_LO "EGR control enable TPS min low" VALUE 0x0002038C __UWORD_S 0 u_pct 0 199.996948 /end CHARACTERISTIC
/begin CHARACTERISTIC EGR_V_EN_ESPD_MAX "EGR control enable engine speed max" VALUE 0x0002038C __UWORD_S 0 u_espd 0 8191.875 FORMAT "%5.1" /end CHARACTERISTIC
/begin CHARACTERISTIC EGR_V_EN_ESPD_MIN "EGR control enable engine speed min" VALUE 0x0002038C __UWORD_S 0 u_espd 0 8191.875 FORMAT "%5.1" /end CHARACTERISTIC
/begin CHARACTERISTIC EGR_V_EN_VSPD_MAX "EGR control enable vehicle speed max" VALUE 0x0002038C __UWORD_S 0 u_vspd 0 511.9921875 /end CHARACTERISTIC
/begin CHARACTERISTIC EGR_V_EN_VSPD_MIN "EGR control enable vehicle speed min" VALUE 0x0002038C __UWORD_S 0 u_vspd 0 511.9921875 /end CHARACTERISTIC
/begin CHARACTERISTIC EGR_V_EN_VAC_MIN_HI "EGR control enable vacumm min high" VALUE 0x0002038C __SWORD_S 0 u_kPa_128n_128p -128 127.99609375 /end CHARACTERISTIC
/begin CHARACTERISTIC EGR_V_EN_VAC_MIN_LO "EGR control enable vacumm min low" VALUE 0x0002038C __SWORD_S 0 u_kPa_128n_128p -128 127.99609375 /end CHARACTERISTIC
/begin CHARACTERISTIC EGR_V_SP_FIL "EGR setpoint filter" VALUE 0x0002038C __UWORD_S 0 u_filter 0 0.9999847412109375 FORMAT "%4.3" /end CHARACTERISTIC
/begin CHARACTERISTIC EGR_V_EN_IAT_BYPS_DUR "EGR setpoint active duration min to bypass enable IAT condition" VALUE 0x0002038C __UWORD_S 0 u_2x_tmr 0 1023.984375 /end CHARACTERISTIC
/begin CHARACTERISTIC EGR_C_RAT_SP_ECT_FAC "EGR ratio ECT factor" CURVE 0x000200B0 __UWORD_S 0 u_fac_4 0 3.99993896484375 FORMAT "%4.3" SYMBOL_LINK "EGR_C_RAT_SP_ECT_FAC" 2
 /begin AXIS_DESCR FIX_AXIS sys_ect u_deg_C 9 -256 255.9921875 /begin FIX_AXIS_PAR_LIST 2560 4096 5632 7168 8704 10240 11776 13312 14848 /end FIX_AXIS_PAR_LIST /end AXIS_DESCR
/end CHARACTERISTIC
/begin CHARACTERISTIC EGR_M_RAT_SP_AMP_FAC "EGR ratio amp factor" MAP 0x00020320 __UWORD_S 0 u_fac_4 0 3.99993896484375 FORMAT "%4.3" SYMBOL_LINK "EGR_M_RAT_SP_AMP_FAC" 4
 /begin AXIS_DESCR FIX_AXIS sys_amp u_kPa_0_256 7 75 105 /begin FIX_AXIS_PAR_LIST 19200 20480 21760 23040 24320 25600 26880 /end FIX_AXIS_PAR_LIST /end AXIS_DESCR
 /begin AXIS_DESCR FIX_AXIS sys_map u_kPa_0_256 8 30 100 /begin FIX_AXIS_PAR_LIST 7680 10240 12800 15360 17920 20480 23040 25600 /end FIX_AXIS_PAR_LIST /end AXIS_DESCR
/end CHARACTERISTIC
/begin CHARACTERISTIC EGR_V_CLN_EN_ECT "EGR clean enable ECT min" VALUE 0x0002038C __SWORD_S 0 u_deg_C -256 255.9921875 /end CHARACTERISTIC
/begin CHARACTERISTIC EGR_V_CLN_EN_VSPD "EGR clean enable vehicle speed" VALUE 0x0002038C __UWORD_S 0 u_2x_tmr 0 1023.984375 /end CHARACTERISTIC
/begin CHARACTERISTIC EGR_V_CLN_EN_PUC_INTVL "EGR clean enable puc interval" VALUE 0x0002038C __UBYTE_S 0 u_cnts 0 255 /end CHARACTERISTIC
/begin CHARACTERISTIC EGR_V_CLN_STG1_DUR "EGR clean stage1 duration" VALUE 0x0002038C __UWORD_S 0 u_2x_tmr 0 1023.984375 /end CHARACTERISTIC
/begin CHARACTERISTIC EGR_V_CLN_STG2_DUR "EGR clean stage2 duration" VALUE 0x0002038C __UWORD_S 0 u_2x_tmr 0 1023.984375 /end CHARACTERISTIC
/begin CHARACTERISTIC EGR_V_CLN_STG3_DUR "EGR clean stage3 duration" VALUE 0x0002038C __UWORD_S 0 u_2x_tmr 0 1023.984375 /end CHARACTERISTIC
/begin CHARACTERISTIC CAN_V_TX_00_ID "can tx msg ID" VALUE 0x0002038C __UWORD_S 0 u_cnts 0 65535 FORMAT "%5.0" SYMBOL_LINK "CAN_TX_MSG_CFG" 0 /end CHARACTERISTIC
/begin CHARACTERISTIC CAN_V_TX_00_DLC "can tx msg DLC" VALUE 0x0002038C __UBYTE_S 0 u_cnts 0 255 SYMBOL_LINK "CAN_TX_MSG_CFG" 2 /end CHARACTERISTIC
/begin CHARACTERISTIC CAN_V_TX_00_PERIOD "can tx msg period" VALUE 0x0002038C __UBYTE_S 0 u_can_period 0 13 FORMAT "%1.0" SYMBOL_LINK "CAN_TX_MSG_CFG" 3 /end CHARACTERISTIC
/begin CHARACTERISTIC CAN_V_TX_00_CHN "can tx msg channel" VALUE 0x0002038C __UBYTE_S 0 u_can_chn 0 2 FORMAT "%1.0" SYMBOL_LINK "CAN_TX_MSG_CFG" 4 /end CHARACTERISTIC
/begin CHARACTERISTIC CAN_V_TX_01_ID "can tx msg ID" VALUE 0x0002038C __UWORD_S 0 u_cnts 0 65535 FORMAT "%5.0" SYMBOL_LINK "CAN_TX_MSG_CFG" 6 /end CHARACTERISTIC
/begin CHARACTERISTIC CAN_V_TX_01_DLC "can tx msg DLC" VALUE 0x0002038C __UBYTE_S 0 u_cnts 0 255 SYMBOL_LINK "CAN_TX_MSG_CFG" 8 /end CHARACTERISTIC
/begin CHARACTERISTIC CAN_V_TX_01_PERIOD "can tx msg period" VALUE 0x0002038C __UBYTE_S 0 u_can_period 0 13 FORMAT "%1.0" SYMBOL_LINK "CAN_TX_MSG_CFG" 9 /end CHARACTERISTIC
/begin CHARACTERISTIC CAN_V_TX_01_CHN "can tx msg channel" VALUE 0x0002038C __UBYTE_S 0 u_can_chn 0 2 FORMAT "%1.0" SYMBOL_LINK "CAN_TX_MSG_CFG" 10 /end CHARACTERISTIC
/begin CHARACTERISTIC CAN_V_TX_02_ID "can tx msg ID" VALUE 0x0002038C __UWORD_S 0 u_cnts 0 65535 FORMAT "%5.0" SYMBOL_LINK "CAN_TX_MSG_CFG" 12 /end CHARACTERISTIC
/begin CHARACTERISTIC CAN_V_TX_02_DLC "can tx msg DLC" VALUE 0x0002038C __UBYTE_S 0 u_cnts 0 255 SYMBOL_LINK "CAN_TX_MSG_CFG" 14 /end CHARACTERISTIC
/begin CHARACTERISTIC CAN_V_TX_02_PERIOD "can tx msg period" VALUE 0x0002038C __UBYTE_S 0 u_can_period 0 13 FORMAT "%1.0" SYMBOL_LINK "CAN_TX_MSG_CFG" 15 /end CHARACTERISTIC
/begin CHARACTERISTIC CAN_V_TX_02_CHN "can tx msg channel" VALUE 0x0002038C __UBYTE_S 0 u_can_chn 0 2 FORMAT "%1.0" SYMBOL_LINK "CAN_TX_MSG_CFG" 16 /end CHARACTERISTIC
/begin CHARACTERISTIC CAN_V_TX_03_ID "can tx msg ID" VALUE 0x0002038C __UWORD_S 0 u_cnts 0 65535 FORMAT "%5.0" SYMBOL_LINK "CAN_TX_MSG_CFG" 18 /end CHARACTERISTIC
/begin CHARACTERISTIC CAN_V_TX_03_DLC "can tx msg DLC" VALUE 0x0002038C __UBYTE_S 0 u_cnts 0 255 SYMBOL_LINK "CAN_TX_MSG_CFG" 20 /end CHARACTERISTIC
/begin CHARACTERISTIC CAN_V_TX_03_PERIOD "can tx msg period" VALUE 0x0002038C __UBYTE_S 0 u_can_period 0 13 FORMAT "%1.0" SYMBOL_LINK "CAN_TX_MSG_CFG" 21 /end CHARACTERISTIC
/begin CHARACTERISTIC CAN_V_TX_03_CHN "can tx msg channel" VALUE 0x0002038C __UBYTE_S 0 u_can_chn 0 2 FORMAT "%1.0" SYMBOL_LINK "CAN_TX_MSG_CFG" 22 /end CHARACTERISTIC
/begin CHARACTERISTIC CAN_V_TX_04_ID "can tx msg ID" VALUE 0x0002038C __UWORD_S 0 u_cnts 0 65535 FORMAT "%5.0" SYMBOL_LINK "CAN_TX_MSG_CFG" 24 /end CHARACTERISTIC
/begin CHARACTERISTIC CAN_V_TX_04_DLC "can tx msg DLC" VALUE 0x0002038C __UBYTE_S 0 u_cnts 0 255 SYMBOL_LINK "CAN_TX_MSG_CFG" 26 /end CHARACTERISTIC
/begin CHARACTERISTIC CAN_V_TX_04_PERIOD "can tx msg period" VALUE 0x0002038C __UBYTE_S 0 u_can_period 0 13 FORMAT "%1.0" SYMBOL_LINK "CAN_TX_MSG_CFG" 27 /end CHARACTERISTIC
/begin CHARACTERISTIC CAN_V_TX_04_CHN "can tx msg channel" VALUE 0x0002038C __UBYTE_S 0 u_can_chn 0 2 FORMAT "%1.0" SYMBOL_LINK "CAN_TX_MSG_CFG" 28 /end CHARACTERISTIC
/begin CHARACTERISTIC CAN_V_TX_05_ID "can tx msg ID" VALUE 0x0002038C __UWORD_S 0 u_cnts 0 65535 FORMAT "%5.0" SYMBOL_LINK "CAN_TX_MSG_CFG" 30 /end CHARACTERISTIC
/begin CHARACTERISTIC CAN_V_TX_05_DLC "can tx msg DLC" VALUE 0x0002038C __UBYTE_S 0 u_cnts 0 255 SYMBOL_LINK "CAN_TX_MSG_CFG" 32 /end CHARACTERISTIC
/begin CHARACTERISTIC CAN_V_TX_05_PERIOD "can tx msg period" VALUE 0x0002038C __UBYTE_S 0 u_can_period 0 13 FORMAT "%1.0" SYMBOL_LINK "CAN_TX_MSG_CFG" 33 /end CHARACTERISTIC
/begin CHARACTERISTIC CAN_V_TX_05_CHN "can tx msg channel" VALUE 0x0002038C __UBYTE_S 0 u_can_chn 0 2 FORMAT "%1.0" SYMBOL_LINK "CAN_TX_MSG_CFG" 34 /end CHARACTERISTIC
/begin CHARACTERISTIC CAN_V_TX_06_ID "can tx msg ID" VALUE 0x0002038C __UWORD_S 0 u_cnts 0 65535 FORMAT "%5.0" SYMBOL_LINK "CAN_TX_MSG_CFG" 36 /end CHARACTERISTIC
/begin CHARACTERISTIC CAN_V_TX_06_DLC "can tx msg DLC" VALUE 0x0002038C __UBYTE_S 0 u_cnts 0 255 SYMBOL_LINK "CAN_TX_MSG_CFG" 38 /end CHARACTERISTIC
/begin CHARACTERISTIC CAN_V_TX_06_PERIOD "can tx msg period" VALUE 0x0002038C __UBYTE_S 0 u_can_period 0 13 FORMAT "%1.0" SYMBOL_LINK "CAN_TX_MSG_CFG" 39 /end CHARACTERISTIC
/begin CHARACTERISTIC CAN_V_TX_06_CHN "can tx msg channel" VALUE 0x0002038C __UBYTE_S 0 u_can_chn 0 2 FORMAT "%1.0" SYMBOL_LINK "CAN_TX_MSG_CFG" 40 /end CHARACTERISTIC
/begin CHARACTERISTIC CAN_V_TX_07_ID "can tx msg ID" VALUE 0x0002038C __UWORD_S 0 u_cnts 0 65535 FORMAT "%5.0" SYMBOL_LINK "CAN_TX_MSG_CFG" 42 /end CHARACTERISTIC
/begin CHARACTERISTIC CAN_V_TX_07_DLC "can tx msg DLC" VALUE 0x0002038C __UBYTE_S 0 u_cnts 0 255 SYMBOL_LINK "CAN_TX_MSG_CFG" 44 /end CHARACTERISTIC
/begin CHARACTERISTIC CAN_V_TX_07_PERIOD "can tx msg period" VALUE 0x0002038C __UBYTE_S 0 u_can_period 0 13 FORMAT "%1.0" SYMBOL_LINK "CAN_TX_MSG_CFG" 45 /end CHARACTERISTIC
/begin CHARACTERISTIC CAN_V_TX_07_CHN "can tx msg channel" VALUE 0x0002038C __UBYTE_S 0 u_can_chn 0 2 FORMAT "%1.0" SYMBOL_LINK "CAN_TX_MSG_CFG" 46 /end CHARACTERISTIC
/begin CHARACTERISTIC CAN_V_TX_08_ID "can tx msg ID" VALUE 0x0002038C __UWORD_S 0 u_cnts 0 65535 FORMAT "%5.0" SYMBOL_LINK "CAN_TX_MSG_CFG" 48 /end CHARACTERISTIC
/begin CHARACTERISTIC CAN_V_TX_08_DLC "can tx msg DLC" VALUE 0x0002038C __UBYTE_S 0 u_cnts 0 255 SYMBOL_LINK "CAN_TX_MSG_CFG" 50 /end CHARACTERISTIC
/begin CHARACTERISTIC CAN_V_TX_08_PERIOD "can tx msg period" VALUE 0x0002038C __UBYTE_S 0 u_can_period 0 13 FORMAT "%1.0" SYMBOL_LINK "CAN_TX_MSG_CFG" 51 /end CHARACTERISTIC
/begin CHARACTERISTIC CAN_V_TX_08_CHN "can tx msg channel" VALUE 0x0002038C __UBYTE_S 0 u_can_chn 0 2 FORMAT "%1.0" SYMBOL_LINK "CAN_TX_MSG_CFG" 52 /end CHARACTERISTIC
/begin CHARACTERISTIC CAN_V_TX_09_ID "can tx msg ID" VALUE 0x0002038C __UWORD_S 0 u_cnts 0 65535 FORMAT "%5.0" SYMBOL_LINK "CAN_TX_MSG_CFG" 54 /end CHARACTERISTIC
/begin CHARACTERISTIC CAN_V_TX_09_DLC "can tx msg DLC" VALUE 0x0002038C __UBYTE_S 0 u_cnts 0 255 SYMBOL_LINK "CAN_TX_MSG_CFG" 56 /end CHARACTERISTIC
/begin CHARACTERISTIC CAN_V_TX_09_PERIOD "can tx msg period" VALUE 0x0002038C __UBYTE_S 0 u_can_period 0 13 FORMAT "%1.0" SYMBOL_LINK "CAN_TX_MSG_CFG" 57 /end CHARACTERISTIC
/begin CHARACTERISTIC CAN_V_TX_09_CHN "can tx msg channel" VALUE 0x0002038C __UBYTE_S 0 u_can_chn 0 2 FORMAT "%1.0" SYMBOL_LINK "CAN_TX_MSG_CFG" 58 /end CHARACTERISTIC
/begin CHARACTERISTIC CAN_V_TX_10_ID "can tx msg ID" VALUE 0x0002038C __UWORD_S 0 u_cnts 0 65535 FORMAT "%5.0" SYMBOL_LINK "CAN_TX_MSG_CFG" 60 /end CHARACTERISTIC
/begin CHARACTERISTIC CAN_V_TX_10_DLC "can tx msg DLC" VALUE 0x0002038C __UBYTE_S 0 u_cnts 0 255 SYMBOL_LINK "CAN_TX_MSG_CFG" 62 /end CHARACTERISTIC
/begin CHARACTERISTIC CAN_V_TX_10_PERIOD "can tx msg period" VALUE 0x0002038C __UBYTE_S 0 u_can_period 0 13 FORMAT "%1.0" SYMBOL_LINK "CAN_TX_MSG_CFG" 63 /end CHARACTERISTIC
/begin CHARACTERISTIC CAN_V_TX_10_CHN "can tx msg channel" VALUE 0x0002038C __UBYTE_S 0 u_can_chn 0 2 FORMAT "%1.0" SYMBOL_LINK "CAN_TX_MSG_CFG" 64 /end CHARACTERISTIC
/begin CHARACTERISTIC CAN_V_TX_11_ID "can tx msg ID" VALUE 0x0002038C __UWORD_S 0 u_cnts 0 65535 FORMAT "%5.0" SYMBOL_LINK "CAN_TX_MSG_CFG" 66 /end CHARACTERISTIC
/begin CHARACTERISTIC CAN_V_TX_11_DLC "can tx msg DLC" VALUE 0x0002038C __UBYTE_S 0 u_cnts 0 255 SYMBOL_LINK "CAN_TX_MSG_CFG" 68 /end CHARACTERISTIC
/begin CHARACTERISTIC CAN_V_TX_11_PERIOD "can tx msg period" VALUE 0x0002038C __UBYTE_S 0 u_can_period 0 13 FORMAT "%1.0" SYMBOL_LINK "CAN_TX_MSG_CFG" 69 /end CHARACTERISTIC
/begin CHARACTERISTIC CAN_V_TX_11_CHN "can tx msg channel" VALUE 0x0002038C __UBYTE_S 0 u_can_chn 0 2 FORMAT "%1.0" SYMBOL_LINK "CAN_TX_MSG_CFG" 70 /end CHARACTERISTIC
/begin CHARACTERISTIC CAN_V_TX_12_ID "can tx msg ID" VALUE 0x0002038C __UWORD_S 0 u_cnts 0 65535 FORMAT "%5.0" SYMBOL_LINK "CAN_TX_MSG_CFG" 72 /end CHARACTERISTIC
/begin CHARACTERISTIC CAN_V_TX_12_DLC "can tx msg DLC" VALUE 0x0002038C __UBYTE_S 0 u_cnts 0 255 SYMBOL_LINK "CAN_TX_MSG_CFG" 74 /end CHARACTERISTIC
/begin CHARACTERISTIC CAN_V_TX_12_PERIOD "can tx msg period" VALUE 0x0002038C __UBYTE_S 0 u_can_period 0 13 FORMAT "%1.0" SYMBOL_LINK "CAN_TX_MSG_CFG" 75 /end CHARACTERISTIC
/begin CHARACTERISTIC CAN_V_TX_12_CHN "can tx msg channel" VALUE 0x0002038C __UBYTE_S 0 u_can_chn 0 2 FORMAT "%1.0" SYMBOL_LINK "CAN_TX_MSG_CFG" 76 /end CHARACTERISTIC
/begin CHARACTERISTIC CAN_V_TX_13_ID "can tx msg ID" VALUE 0x0002038C __UWORD_S 0 u_cnts 0 65535 FORMAT "%5.0" SYMBOL_LINK "CAN_TX_MSG_CFG" 78 /end CHARACTERISTIC
/begin CHARACTERISTIC CAN_V_TX_13_DLC "can tx msg DLC" VALUE 0x0002038C __UBYTE_S 0 u_cnts 0 255 SYMBOL_LINK "CAN_TX_MSG_CFG" 80 /end CHARACTERISTIC
/begin CHARACTERISTIC CAN_V_TX_13_PERIOD "can tx msg period" VALUE 0x0002038C __UBYTE_S 0 u_can_period 0 13 FORMAT "%1.0" SYMBOL_LINK "CAN_TX_MSG_CFG" 81 /end CHARACTERISTIC
/begin CHARACTERISTIC CAN_V_TX_13_CHN "can tx msg channel" VALUE 0x0002038C __UBYTE_S 0 u_can_chn 0 2 FORMAT "%1.0" SYMBOL_LINK "CAN_TX_MSG_CFG" 82 /end CHARACTERISTIC
/begin CHARACTERISTIC CAN_V_TX_14_ID "can tx msg ID" VALUE 0x0002038C __UWORD_S 0 u_cnts 0 65535 FORMAT "%5.0" SYMBOL_LINK "CAN_TX_MSG_CFG" 84 /end CHARACTERISTIC
/begin CHARACTERISTIC CAN_V_TX_14_DLC "can tx msg DLC" VALUE 0x0002038C __UBYTE_S 0 u_cnts 0 255 SYMBOL_LINK "CAN_TX_MSG_CFG" 86 /end CHARACTERISTIC
/begin CHARACTERISTIC CAN_V_TX_14_PERIOD "can tx msg period" VALUE 0x0002038C __UBYTE_S 0 u_can_period 0 13 FORMAT "%1.0" SYMBOL_LINK "CAN_TX_MSG_CFG" 87 /end CHARACTERISTIC
/begin CHARACTERISTIC CAN_V_TX_14_CHN "can tx msg channel" VALUE 0x0002038C __UBYTE_S 0 u_can_chn 0 2 FORMAT "%1.0" SYMBOL_LINK "CAN_TX_MSG_CFG" 88 /end CHARACTERISTIC
/begin CHARACTERISTIC CAN_V_TX_15_ID "can tx msg ID" VALUE 0x0002038C __UWORD_S 0 u_cnts 0 65535 FORMAT "%5.0" SYMBOL_LINK "CAN_TX_MSG_CFG" 90 /end CHARACTERISTIC
/begin CHARACTERISTIC CAN_V_TX_15_DLC "can tx msg DLC" VALUE 0x0002038C __UBYTE_S 0 u_cnts 0 255 SYMBOL_LINK "CAN_TX_MSG_CFG" 92 /end CHARACTERISTIC
/begin CHARACTERISTIC CAN_V_TX_15_PERIOD "can tx msg period" VALUE 0x0002038C __UBYTE_S 0 u_can_period 0 13 FORMAT "%1.0" SYMBOL_LINK "CAN_TX_MSG_CFG" 93 /end CHARACTERISTIC
/begin CHARACTERISTIC CAN_V_TX_15_CHN "can tx msg channel" VALUE 0x0002038C __UBYTE_S 0 u_can_chn 0 2 FORMAT "%1.0" SYMBOL_LINK "CAN_TX_MSG_CFG" 94 /end CHARACTERISTIC
/begin CHARACTERISTIC CAN_TX_CRUZ_EN_LAMP_ID "cruise enable lamp state msg number" VALUE 0x0002038C __UBYTE_S 0 u_can_txmsg_num 0 255 FORMAT "%3.0" SYMBOL_LINK "CAN_TX_CRUZ_EN_LAMP" 0 /end CHARACTERISTIC
/begin CHARACTERISTIC CAN_TX_CRUZ_EN_LAMP_BYTE_LOC "cruise enable lamp state msg location number" VALUE 0x0002038C __UBYTE_S 0 u_can_byte_num 0 7 FORMAT "%1.0" SYMBOL_LINK "CAN_TX_CRUZ_EN_LAMP" 1 /end CHARACTERISTIC
/begin CHARACTERISTIC CAN_TX_CRUZ_EN_LAMP_BIT_LOC "cruise enable lamp state msg bit location" VALUE 0x0002038C __UBYTE_S 0 u_can_bit_loc 0 7 FORMAT "%1.0" SYMBOL_LINK "CAN_TX_CRUZ_EN_LAMP" 2 /end CHARACTERISTIC
/begin CHARACTERISTIC CAN_TX_CRUZ_EN_LAMP_BIT_LEN "cruise enable lamp state msg bit length" VALUE 0x0002038C __UBYTE_S 0 u_cnts 0 255 SYMBOL_LINK "CAN_TX_CRUZ_EN_LAMP" 3 /end CHARACTERISTIC
/begin CHARACTERISTIC CAN_TX_CRUZ_EN_LAMP_TABLE "cruise enable lamp state msg table" VAL_BLK 0x0002038C __UBYTE_S 0 u_cnts 0 255 NUMBER 2 SYMBOL_LINK "CAN_TX_CRUZ_EN_LAMP" 4 /end CHARACTERISTIC
/begin CHARACTERISTIC CAN_TX_CRUZ_SW_ID "cruise switch msg number" VALUE 0x0002038C __UBYTE_S 0 u_can_txmsg_num 0 255 FORMAT "%3.0" SYMBOL_LINK "CAN_TX_CRUZ_SW" 0 /end CHARACTERISTIC
/begin CHARACTERISTIC CAN_TX_CRUZ_SW_BYTE_LOC "cruise switch msg location number" VALUE 0x0002038C __UBYTE_S 0 u_can_byte_num 0 7 FORMAT "%1.0" SYMBOL_LINK "CAN_TX_CRUZ_SW" 1 /end CHARACTERISTIC
/begin CHARACTERISTIC CAN_TX_CRUZ_SW_BIT_LOC "cruise switch msg bit location" VALUE 0x0002038C __UBYTE_S 0 u_can_bit_loc 0 7 FORMAT "%1.0" SYMBOL_LINK "CAN_TX_CRUZ_SW" 2 /end CHARACTERISTIC
/begin CHARACTERISTIC CAN_TX_CRUZ_SW_BIT_LEN "cruise switch msg bit length" VALUE 0x0002038C __UBYTE_S 0 u_cnts 0 255 SYMBOL_LINK "CAN_TX_CRUZ_SW" 3 /end CHARACTERISTIC
/begin CHARACTERISTIC CAN_TX_CRUZ_SW_TABLE "cruise switch msg table" VAL_BLK 0x0002038C __UBYTE_S 0 u_cnts 0 255 NUMBER 2 SYMBOL_LINK "CAN_TX_CRUZ_SW" 4 /end CHARACTERISTIC
/begin CHARACTERISTIC CAN_TX_CRUZ_ACTV_ID "cruise active msg number" VALUE 0x0002038C __UBYTE_S 0 u_can_txmsg_num 0 255 FORMAT "%3.0" SYMBOL_LINK "CAN_TX_CRUZ_ACTV" 0 /end CHARACTERISTIC
/begin CHARACTERISTIC CAN_TX_CRUZ_ACTV_BYTE_LOC "cruise active msg location number" VALUE 0x0002038C __UBYTE_S 0 u_can_byte_num 0 7 FORMAT "%1.0" SYMBOL_LINK "CAN_TX_CRUZ_ACTV" 1 /end CHARACTERISTIC
/begin CHARACTERISTIC CAN_TX_CRUZ_ACTV_BIT_LOC "cruise active msg bit location" VALUE 0x0002038C __UBYTE_S 0 u_can_bit_loc 0 7 FORMAT "%1.0" SYMBOL_LINK "CAN_TX_CRUZ_ACTV" 2 /end CHARACTERISTIC
/begin CHARACTERISTIC CAN_TX_CRUZ_ACTV_BIT_LEN "cruise active msg bit length" VALUE 0x0002038C __UBYTE_S 0 u_cnts 0 255 SYMBOL_LINK "CAN_TX_CRUZ_ACTV" 3 /end CHARACTERISTIC
/begin CHARACTERISTIC CAN_TX_CRUZ_ACTV_TABLE "cruise active msg table" VAL_BLK 0x0002038C __UBYTE_S 0 u_cnts 0 255 NUMBER 2 SYMBOL_LINK "CAN_TX_CRUZ_ACTV" 4 /end CHARACTERISTIC
/begin CHARACTERISTIC CAN_TX_ENG_PROT_ACTV_ID "engine protect active msg number" VALUE 0x0002038C __UBYTE_S 0 u_can_txmsg_num 0 255 FORMAT "%3.0" SYMBOL_LINK "CAN_TX_ENG_PROT_ACTV" 0 /end CHARACTERISTIC
/begin CHARACTERISTIC CAN_TX_ENG_PROT_ACTV_BYTE_LOC "engine protect active msg location number" VALUE 0x0002038C __UBYTE_S 0 u_can_byte_num 0 7 FORMAT "%1.0" SYMBOL_LINK "CAN_TX_ENG_PROT_ACTV" 1 /end CHARACTERISTIC
/begin CHARACTERISTIC CAN_TX_ENG_PROT_ACTV_BIT_LOC "engine protect active msg bit location" VALUE 0x0002038C __UBYTE_S 0 u_can_bit_loc 0 7 FORMAT "%1.0" SYMBOL_LINK "CAN_TX_ENG_PROT_ACTV" 2 /end CHARACTERISTIC
/begin CHARACTERISTIC CAN_TX_ENG_PROT_ACTV_BIT_LEN "engine protect active msg bit length" VALUE 0x0002038C __UBYTE_S 0 u_cnts 0 255 SYMBOL_LINK "CAN_TX_ENG_PROT_ACTV" 3 /end CHARACTERISTIC
/begin CHARACTERISTIC CAN_TX_ENG_PROT_ACTV_TABLE "engine protect active msg table" VAL_BLK 0x0002038C __UBYTE_S 0 u_cnts 0 255 NUMBER 2 SYMBOL_LINK "CAN_TX_ENG_PROT_ACTV" 4 /end CHARACTERISTIC
/begin CHARACTERISTIC CAN_TX_SVS_LAMP_ID "engine protect active msg number" VALUE 0x0002038C __UBYTE_S 0 u_can_txmsg_num 0 255 FORMAT "%3.0" SYMBOL_LINK "CAN_TX_SVS_LAMP" 0 /end CHARACTERISTIC
/begin CHARACTERISTIC CAN_TX_SVS_LAMP_BYTE_LOC "engine protect active msg location number" VALUE 0x0002038C __UBYTE_S 0 u_can_byte_num 0 7 FORMAT "%1.0" SYMBOL_LINK "CAN_TX_SVS_LAMP" 1 /end CHARACTERISTIC
/begin CHARACTERISTIC CAN_TX_SVS_LAMP_BIT_LOC "engine protect active msg bit location" VALUE 0x0002038C __UBYTE_S 0 u_can_bit_loc 0 7 FORMAT "%1.0" SYMBOL_LINK "CAN_TX_SVS_LAMP" 2 /end CHARACTERISTIC
/begin CHARACTERISTIC CAN_TX_SVS_LAMP_BIT_LEN "engine protect active msg bit length" VALUE 0x0002038C __UBYTE_S 0 u_cnts 0 255 SYMBOL_LINK "CAN_TX_SVS_LAMP" 3 /end CHARACTERISTIC
/begin CHARACTERISTIC CAN_TX_SVS_LAMP_TABLE "engine protect active msg table" VAL_BLK 0x0002038C __UBYTE_S 0 u_cnts 0 255 NUMBER 2 SYMBOL_LINK "CAN_TX_SVS_LAMP" 4 /end CHARACTERISTIC
/begin CHARACTERISTIC CAN_TX_MIL_LAMP_ID "mil lamp active msg number" VALUE 0x0002038C __UBYTE_S 0 u_can_txmsg_num 0 255 FORMAT "%3.0" SYMBOL_LINK "CAN_TX_MIL_LAMP" 0 /end CHARACTERISTIC
/begin CHARACTERISTIC CAN_TX_MIL_LAMP_BYTE_LOC "mil lamp active msg location number" VALUE 0x0002038C __UBYTE_S 0 u_can_byte_num 0 7 FORMAT "%1.0" SYMBOL_LINK "CAN_TX_MIL_LAMP" 1 /end CHARACTERISTIC
/begin CHARACTERISTIC CAN_TX_MIL_LAMP_BIT_LOC "mil lamp active msg bit location" VALUE 0x0002038C __UBYTE_S 0 u_can_bit_loc 0 7 FORMAT "%1.0" SYMBOL_LINK "CAN_TX_MIL_LAMP" 2 /end CHARACTERISTIC
/begin CHARACTERISTIC CAN_TX_MIL_LAMP_BIT_LEN "mil lamp active msg bit length" VALUE 0x0002038C __UBYTE_S 0 u_cnts 0 255 SYMBOL_LINK "CAN_TX_MIL_LAMP" 3 /end CHARACTERISTIC
/begin CHARACTERISTIC CAN_TX_MIL_LAMP_TABLE "mil lamp active msg table" VAL_BLK 0x0002038C __UBYTE_S 0 u_cnts 0 255 NUMBER 2 SYMBOL_LINK "CAN_TX_MIL_LAMP" 4 /end CHARACTERISTIC
/begin CHARACTERISTIC CAN_TX_LIMP_ACTV_ID "engine limphome active msg number" VALUE 0x0002038C __UBYTE_S 0 u_can_txmsg_num 0 255 FORMAT "%3.0" SYMBOL_LINK "CAN_TX_LIMP_ACTV" 0 /end CHARACTERISTIC
/begin CHARACTERISTIC CAN_TX_LIMP_ACTV_BYTE_LOC "engine limphome active msg location number" VALUE 0x0002038C __UBYTE_S 0 u_can_byte_num 0 7 FORMAT "%1.0" SYMBOL_LINK "CAN_TX_LIMP_ACTV" 1 /end CHARACTERISTIC
/begin CHARACTERISTIC CAN_TX_LIMP_ACTV_BIT_LOC "engine limphome active msg bit location" VALUE 0x0002038C __UBYTE_S 0 u_can_bit_loc 0 7 FORMAT "%1.0" SYMBOL_LINK "CAN_TX_LIMP_ACTV" 2 /end CHARACTERISTIC
/begin CHARACTERISTIC CAN_TX_LIMP_ACTV_BIT_LEN "engine limphome active msg bit length" VALUE 0x0002038C __UBYTE_S 0 u_cnts 0 255 SYMBOL_LINK "CAN_TX_LIMP_ACTV" 3 /end CHARACTERISTIC
/begin CHARACTERISTIC CAN_TX_LIMP_ACTV_TABLE "engine limphome active msg table" VAL_BLK 0x0002038C __UBYTE_S 0 u_cnts 0 255 NUMBER 2 SYMBOL_LINK "CAN_TX_LIMP_ACTV" 4 /end CHARACTERISTIC
/begin CHARACTERISTIC CAN_TX_AC_RLY_ID "ac relay active msg number" VALUE 0x0002038C __UBYTE_S 0 u_can_txmsg_num 0 255 FORMAT "%3.0" SYMBOL_LINK "CAN_TX_AC_RLY" 0 /end CHARACTERISTIC
/begin CHARACTERISTIC CAN_TX_AC_RLY_BYTE_LOC "ac relay active msg location number" VALUE 0x0002038C __UBYTE_S 0 u_can_byte_num 0 7 FORMAT "%1.0" SYMBOL_LINK "CAN_TX_AC_RLY" 1 /end CHARACTERISTIC
/begin CHARACTERISTIC CAN_TX_AC_RLY_BIT_LOC "ac relay active msg bit location" VALUE 0x0002038C __UBYTE_S 0 u_can_bit_loc 0 7 FORMAT "%1.0" SYMBOL_LINK "CAN_TX_AC_RLY" 2 /end CHARACTERISTIC
/begin CHARACTERISTIC CAN_TX_AC_RLY_BIT_LEN "ac relay active msg bit length" VALUE 0x0002038C __UBYTE_S 0 u_cnts 0 255 SYMBOL_LINK "CAN_TX_LIMP_ACTV" 3 /end CHARACTERISTIC
/begin CHARACTERISTIC CAN_TX_AC_RLY_TABLE "ac relay active msg table" VAL_BLK 0x0002038C __UBYTE_S 0 u_cnts 0 255 NUMBER 2 SYMBOL_LINK "CAN_TX_AC_RLY" 4 /end CHARACTERISTIC
/begin CHARACTERISTIC CAN_TX_ECT_FL_ACTV_ID "ect fail active msg number" VALUE 0x0002038C __UBYTE_S 0 u_can_txmsg_num 0 255 FORMAT "%3.0" SYMBOL_LINK "CAN_TX_ECT_FL_ACTV" 0 /end CHARACTERISTIC
/begin CHARACTERISTIC CAN_TX_ECT_FL_ACTV_BYTE_LOC "ect fail active msg location number" VALUE 0x0002038C __UBYTE_S 0 u_can_byte_num 0 7 FORMAT "%1.0" SYMBOL_LINK "CAN_TX_ECT_FL_ACTV" 1 /end CHARACTERISTIC
/begin CHARACTERISTIC CAN_TX_ECT_FL_ACTV_BIT_LOC "ect fail active msg bit location" VALUE 0x0002038C __UBYTE_S 0 u_can_bit_loc 0 7 FORMAT "%1.0" SYMBOL_LINK "CAN_TX_ECT_FL_ACTV" 2 /end CHARACTERISTIC
/begin CHARACTERISTIC CAN_TX_ECT_FL_ACTV_BIT_LEN "ect fail active msg bit length" VALUE 0x0002038C __UBYTE_S 0 u_cnts 0 255 SYMBOL_LINK "CAN_TX_ECT_FL_ACTV" 3 /end CHARACTERISTIC
/begin CHARACTERISTIC CAN_TX_ECT_FL_ACTV_TABLE "ect fail active msg table" VAL_BLK 0x0002038C __UBYTE_S 0 u_cnts 0 255 NUMBER 2 SYMBOL_LINK "CAN_TX_ECT_FL_ACTV" 4 /end CHARACTERISTIC
/begin CHARACTERISTIC CAN_TX_IAT_FL_ACTV_ID "iat fail active msg number" VALUE 0x0002038C __UBYTE_S 0 u_can_txmsg_num 0 255 FORMAT "%3.0" SYMBOL_LINK "CAN_TX_IAT_FL_ACTV" 0 /end CHARACTERISTIC
/begin CHARACTERISTIC CAN_TX_IAT_FL_ACTV_BYTE_LOC "iat fail active msg location number" VALUE 0x0002038C __UBYTE_S 0 u_can_byte_num 0 7 FORMAT "%1.0" SYMBOL_LINK "CAN_TX_IAT_FL_ACTV" 1 /end CHARACTERISTIC
/begin CHARACTERISTIC CAN_TX_IAT_FL_ACTV_BIT_LOC "iat fail active msg bit location" VALUE 0x0002038C __UBYTE_S 0 u_can_bit_loc 0 7 FORMAT "%1.0" SYMBOL_LINK "CAN_TX_IAT_FL_ACTV" 2 /end CHARACTERISTIC
/begin CHARACTERISTIC CAN_TX_IAT_FL_ACTV_BIT_LEN "iat fail active msg bit length" VALUE 0x0002038C __UBYTE_S 0 u_cnts 0 255 SYMBOL_LINK "CAN_TX_IAT_FL_ACTV" 3 /end CHARACTERISTIC
/begin CHARACTERISTIC CAN_TX_IAT_FL_ACTV_TABLE "iat fail active msg table" VAL_BLK 0x0002038C __UBYTE_S 0 u_cnts 0 255 NUMBER 2 SYMBOL_LINK "CAN_TX_IAT_FL_ACTV" 4 /end CHARACTERISTIC
/begin CHARACTERISTIC CAN_TX_MAP_FL_ACTV_ID "map fail active msg number" VALUE 0x0002038C __UBYTE_S 0 u_can_txmsg_num 0 255 FORMAT "%3.0" SYMBOL_LINK "CAN_TX_MAP_FL_ACTV" 0 /end CHARACTERISTIC
/begin CHARACTERISTIC CAN_TX_MAP_FL_ACTV_BYTE_LOC "map fail active msg location number" VALUE 0x0002038C __UBYTE_S 0 u_can_byte_num 0 7 FORMAT "%1.0" SYMBOL_LINK "CAN_TX_MAP_FL_ACTV" 1 /end CHARACTERISTIC
/begin CHARACTERISTIC CAN_TX_MAP_FL_ACTV_BIT_LOC "map fail active msg bit location" VALUE 0x0002038C __UBYTE_S 0 u_can_bit_loc 0 7 FORMAT "%1.0" SYMBOL_LINK "CAN_TX_MAP_FL_ACTV" 2 /end CHARACTERISTIC
/begin CHARACTERISTIC CAN_TX_MAP_FL_ACTV_BIT_LEN "map fail active msg bit length" VALUE 0x0002038C __UBYTE_S 0 u_cnts 0 255 SYMBOL_LINK "CAN_TX_MAP_FL_ACTV" 3 /end CHARACTERISTIC
/begin CHARACTERISTIC CAN_TX_MAP_FL_ACTV_TABLE "map fail active msg table" VAL_BLK 0x0002038C __UBYTE_S 0 u_cnts 0 255 NUMBER 2 SYMBOL_LINK "CAN_TX_MAP_FL_ACTV" 4 /end CHARACTERISTIC
/begin CHARACTERISTIC CAN_TX_TQ_EST_FL_ID "torq estimate fail active msg number" VALUE 0x0002038C __UBYTE_S 0 u_can_txmsg_num 0 255 FORMAT "%3.0" SYMBOL_LINK "CAN_TX_TQ_EST_FL" 0 /end CHARACTERISTIC
/begin CHARACTERISTIC CAN_TX_TQ_EST_FL_BYTE_LOC "torq estimate fail active msg location number" VALUE 0x0002038C __UBYTE_S 0 u_can_byte_num 0 7 FORMAT "%1.0" SYMBOL_LINK "CAN_TX_TQ_EST_FL" 1 /end CHARACTERISTIC
/begin CHARACTERISTIC CAN_TX_TQ_EST_FL_BIT_LOC "torq estimate fail active msg bit location" VALUE 0x0002038C __UBYTE_S 0 u_can_bit_loc 0 7 FORMAT "%1.0" SYMBOL_LINK "CAN_TX_TQ_EST_FL" 2 /end CHARACTERISTIC
/begin CHARACTERISTIC CAN_TX_TQ_EST_FL_BIT_LEN "torq estimate fail active msg bit length" VALUE 0x0002038C __UBYTE_S 0 u_cnts 0 255 SYMBOL_LINK "CAN_TX_TQ_EST_FL" 3 /end CHARACTERISTIC
/begin CHARACTERISTIC CAN_TX_TQ_EST_FL_TABLE "torq estimate fail active msg table" VAL_BLK 0x0002038C __UBYTE_S 0 u_cnts 0 255 NUMBER 2 SYMBOL_LINK "CAN_TX_TQ_EST_FL" 4 /end CHARACTERISTIC
/begin CHARACTERISTIC CAN_TX_TCU_TQ_REQ_AVLB_ID "tcu torq request available msg number" VALUE 0x0002038C __UBYTE_S 0 u_can_txmsg_num 0 255 FORMAT "%3.0" SYMBOL_LINK "CAN_TX_TCU_TQ_REQ_AVLB" 0 /end CHARACTERISTIC
/begin CHARACTERISTIC CAN_TX_TCU_TQ_REQ_AVLB_BYTE_LOC "tcu torq request available msg location number" VALUE 0x0002038C __UBYTE_S 0 u_can_byte_num 0 7 FORMAT "%1.0" SYMBOL_LINK "CAN_TX_TCU_TQ_REQ_AVLB" 1 /end CHARACTERISTIC
/begin CHARACTERISTIC CAN_TX_TCU_TQ_REQ_AVLB_BIT_LOC "tcu torq request available msg bit location" VALUE 0x0002038C __UBYTE_S 0 u_can_bit_loc 0 7 FORMAT "%1.0" SYMBOL_LINK "CAN_TX_TCU_TQ_REQ_AVLB" 2 /end CHARACTERISTIC
/begin CHARACTERISTIC CAN_TX_TCU_TQ_REQ_AVLB_BIT_LEN "tcu torq request available msg bit length" VALUE 0x0002038C __UBYTE_S 0 u_cnts 0 255 SYMBOL_LINK "CAN_TX_TCU_TQ_REQ_AVLB" 3 /end CHARACTERISTIC
/begin CHARACTERISTIC CAN_TX_TCU_TQ_REQ_AVLB_TABLE "tcu torq request available msg table" VAL_BLK 0x0002038C __UBYTE_S 0 u_cnts 0 255 NUMBER 2 SYMBOL_LINK "CAN_TX_TCU_TQ_REQ_AVLB" 4 /end CHARACTERISTIC
/begin CHARACTERISTIC CAN_TX_ESP_TQ_REQ_AVLB_ID "ESP torq request available msg number" VALUE 0x0002038C __UBYTE_S 0 u_can_txmsg_num 0 255 FORMAT "%3.0" SYMBOL_LINK "CAN_TX_ESP_TQ_REQ_AVLB" 0 /end CHARACTERISTIC
/begin CHARACTERISTIC CAN_TX_ESP_TQ_REQ_AVLB_BYTE_LOC "ESP torq request available msg location number" VALUE 0x0002038C __UBYTE_S 0 u_can_byte_num 0 7 FORMAT "%1.0" SYMBOL_LINK "CAN_TX_ESP_TQ_REQ_AVLB" 1 /end CHARACTERISTIC
/begin CHARACTERISTIC CAN_TX_ESP_TQ_REQ_AVLB_BIT_LOC "ESP torq request available msg bit location" VALUE 0x0002038C __UBYTE_S 0 u_can_bit_loc 0 7 FORMAT "%1.0" SYMBOL_LINK "CAN_TX_ESP_TQ_REQ_AVLB" 2 /end CHARACTERISTIC
/begin CHARACTERISTIC CAN_TX_ESP_TQ_REQ_AVLB_BIT_LEN "ESP torq request available msg bit length" VALUE 0x0002038C __UBYTE_S 0 u_cnts 0 255 SYMBOL_LINK "CAN_TX_ESP_TQ_REQ_AVLB" 3 /end CHARACTERISTIC
/begin CHARACTERISTIC CAN_TX_ESP_TQ_REQ_AVLB_TABLE "ESP torq request available msg table" VAL_BLK 0x0002038C __UBYTE_S 0 u_cnts 0 255 NUMBER 2 SYMBOL_LINK "CAN_TX_ESP_TQ_REQ_AVLB" 4 /end CHARACTERISTIC
/begin CHARACTERISTIC CAN_TX_ENG_TQ_RDC_EN_ID "enigne torq redution enable msg number" VALUE 0x0002038C __UBYTE_S 0 u_can_txmsg_num 0 255 FORMAT "%3.0" SYMBOL_LINK "CAN_TX_ENG_TQ_RDC_EN" 0 /end CHARACTERISTIC
/begin CHARACTERISTIC CAN_TX_ENG_TQ_RDC_EN_BYTE_LOC "enigne torq redution enable msg location number" VALUE 0x0002038C __UBYTE_S 0 u_can_byte_num 0 7 FORMAT "%1.0" SYMBOL_LINK "CAN_TX_ENG_TQ_RDC_EN" 1 /end CHARACTERISTIC
/begin CHARACTERISTIC CAN_TX_ENG_TQ_RDC_EN_BIT_LOC "enigne torq redution enable msg bit location" VALUE 0x0002038C __UBYTE_S 0 u_can_bit_loc 0 7 FORMAT "%1.0" SYMBOL_LINK "CAN_TX_ENG_TQ_RDC_EN" 2 /end CHARACTERISTIC
/begin CHARACTERISTIC CAN_TX_ENG_TQ_RDC_EN_BIT_LEN "enigne torq redution enable msg bit length" VALUE 0x0002038C __UBYTE_S 0 u_cnts 0 255 SYMBOL_LINK "CAN_TX_ENG_TQ_RDC_EN" 3 /end CHARACTERISTIC
/begin CHARACTERISTIC CAN_TX_ENG_TQ_RDC_EN_TABLE "enigne run this trip msg table" VAL_BLK 0x0002038C __UBYTE_S 0 u_cnts 0 255 NUMBER 2 SYMBOL_LINK "CAN_TX_ENG_TQ_RDC_EN" 4 /end CHARACTERISTIC
/begin CHARACTERISTIC CAN_TX_TRIP_ENG_RUN_ID "enigne run this trip msg number" VALUE 0x0002038C __UBYTE_S 0 u_can_txmsg_num 0 255 FORMAT "%3.0" SYMBOL_LINK "CAN_TX_TRIP_ENG_RUN" 0 /end CHARACTERISTIC
/begin CHARACTERISTIC CAN_TX_TRIP_ENG_RUN_BYTE_LOC "enigne run this trip msg location number" VALUE 0x0002038C __UBYTE_S 0 u_can_byte_num 0 7 FORMAT "%1.0" SYMBOL_LINK "CAN_TX_TRIP_ENG_RUN" 1 /end CHARACTERISTIC
/begin CHARACTERISTIC CAN_TX_TRIP_ENG_RUN_BIT_LOC "enigne run this trip msg bit location" VALUE 0x0002038C __UBYTE_S 0 u_can_bit_loc 0 7 FORMAT "%1.0" SYMBOL_LINK "CAN_TX_TRIP_ENG_RUN" 2 /end CHARACTERISTIC
/begin CHARACTERISTIC CAN_TX_TRIP_ENG_RUN_BIT_LEN "enigne run this trip msg bit length" VALUE 0x0002038C __UBYTE_S 0 u_cnts 0 255 SYMBOL_LINK "CAN_TX_TRIP_ENG_RUN" 3 /end CHARACTERISTIC
/begin CHARACTERISTIC CAN_TX_TRIP_ENG_RUN_TABLE "enigne run this trip msg table" VAL_BLK 0x0002038C __UBYTE_S 0 u_cnts 0 255 NUMBER 2 SYMBOL_LINK "CAN_TX_TRIP_ENG_RUN" 4 /end CHARACTERISTIC
/begin CHARACTERISTIC CAN_TX_ENG_WARM_UP_ID "enigne warmed up msg number" VALUE 0x0002038C __UBYTE_S 0 u_can_txmsg_num 0 255 FORMAT "%3.0" SYMBOL_LINK "CAN_TX_ENG_WARM_UP" 0 /end CHARACTERISTIC
/begin CHARACTERISTIC CAN_TX_ENG_WARM_UP_BYTE_LOC "enigne warmed up msg location number" VALUE 0x0002038C __UBYTE_S 0 u_can_byte_num 0 7 FORMAT "%1.0" SYMBOL_LINK "CAN_TX_ENG_WARM_UP" 1 /end CHARACTERISTIC
/begin CHARACTERISTIC CAN_TX_ENG_WARM_UP_BIT_LOC "enigne warmed up msg bit location" VALUE 0x0002038C __UBYTE_S 0 u_can_bit_loc 0 7 FORMAT "%1.0" SYMBOL_LINK "CAN_TX_ENG_WARM_UP" 2 /end CHARACTERISTIC
/begin CHARACTERISTIC CAN_TX_ENG_WARM_UP_BIT_LEN "enigne warmed up msg bit length" VALUE 0x0002038C __UBYTE_S 0 u_cnts 0 255 SYMBOL_LINK "CAN_TX_ENG_WARM_UP" 3 /end CHARACTERISTIC
/begin CHARACTERISTIC CAN_TX_ENG_WARM_UP_TABLE "enigne warmed up msg table" VAL_BLK 0x0002038C __UBYTE_S 0 u_cnts 0 255 NUMBER 2 SYMBOL_LINK "CAN_TX_ENG_WARM_UP" 4 /end CHARACTERISTIC
/begin CHARACTERISTIC CAN_TX_BAT_VLT_FL_ACTV_ID "enigne battery voltage fail active msg number" VALUE 0x0002038C __UBYTE_S 0 u_can_txmsg_num 0 255 FORMAT "%3.0" SYMBOL_LINK "CAN_TX_BAT_VLT_FL_ACTV" 0 /end CHARACTERISTIC
/begin CHARACTERISTIC CAN_TX_BAT_VLT_FL_ACTV_BYTE_LOC "enigne battery voltage fail active msg location number" VALUE 0x0002038C __UBYTE_S 0 u_can_byte_num 0 7 FORMAT "%1.0" SYMBOL_LINK "CAN_TX_BAT_VLT_FL_ACTV" 1 /end CHARACTERISTIC
/begin CHARACTERISTIC CAN_TX_BAT_VLT_FL_ACTV_BIT_LOC "enigne battery voltage fail active msg bit location" VALUE 0x0002038C __UBYTE_S 0 u_can_bit_loc 0 7 FORMAT "%1.0" SYMBOL_LINK "CAN_TX_ENG_WARM_UP" 2 /end CHARACTERISTIC
/begin CHARACTERISTIC CAN_TX_BAT_VLT_FL_ACTV_BIT_LEN "enigne battery voltage fail active msg bit length" VALUE 0x0002038C __UBYTE_S 0 u_cnts 0 255 SYMBOL_LINK "CAN_TX_BAT_VLT_FL_ACTV" 3 /end CHARACTERISTIC
/begin CHARACTERISTIC CAN_TX_BAT_VLT_FL_ACTV_TABLE "enigne battery voltage fail active msg table" VAL_BLK 0x0002038C __UBYTE_S 0 u_cnts 0 255 NUMBER 2 SYMBOL_LINK "CAN_TX_BAT_VLT_FL_ACTV" 4 /end CHARACTERISTIC
/begin CHARACTERISTIC CAN_TX_TPS_FL_ACTV_ID "TPS fail active msg number" VALUE 0x0002038C __UBYTE_S 0 u_can_txmsg_num 0 255 FORMAT "%3.0" SYMBOL_LINK "CAN_TX_TPS_FL_ACTV" 0 /end CHARACTERISTIC
/begin CHARACTERISTIC CAN_TX_TPS_FL_ACTV_BYTE_LOC "TPS fail active msg location number" VALUE 0x0002038C __UBYTE_S 0 u_can_byte_num 0 7 FORMAT "%1.0" SYMBOL_LINK "CAN_TX_TPS_FL_ACTV" 1 /end CHARACTERISTIC
/begin CHARACTERISTIC CAN_TX_TPS_FL_ACTV_BIT_LOC "TPS fail active msg bit location" VALUE 0x0002038C __UBYTE_S 0 u_can_bit_loc 0 7 FORMAT "%1.0" SYMBOL_LINK "CAN_TX_TPS_FL_ACTV" 2 /end CHARACTERISTIC
/begin CHARACTERISTIC CAN_TX_TPS_FL_ACTV_BIT_LEN "TPS fail active msg bit length" VALUE 0x0002038C __UBYTE_S 0 u_cnts 0 255 SYMBOL_LINK "CAN_TX_BAT_VLT_FL_ACTV" 3 /end CHARACTERISTIC
/begin CHARACTERISTIC CAN_TX_TPS_FL_ACTV_TABLE "TPS fail active msg table" VAL_BLK 0x0002038C __UBYTE_S 0 u_cnts 0 255 NUMBER 2 SYMBOL_LINK "CAN_TX_TPS_FL_ACTV" 4 /end CHARACTERISTIC
/begin CHARACTERISTIC CAN_TX_PPS_FL_ACTV_ID "PPS fail active msg number" VALUE 0x0002038C __UBYTE_S 0 u_can_txmsg_num 0 255 FORMAT "%3.0" SYMBOL_LINK "CAN_TX_PPS_FL_ACTV" 0 /end CHARACTERISTIC
/begin CHARACTERISTIC CAN_TX_PPS_FL_ACTV_BYTE_LOC "PPS fail active msg location number" VALUE 0x0002038C __UBYTE_S 0 u_can_byte_num 0 7 FORMAT "%1.0" SYMBOL_LINK "CAN_TX_PPS_FL_ACTV" 1 /end CHARACTERISTIC
/begin CHARACTERISTIC CAN_TX_PPS_FL_ACTV_BIT_LOC "PPS fail active msg bit location" VALUE 0x0002038C __UBYTE_S 0 u_can_bit_loc 0 7 FORMAT "%1.0" SYMBOL_LINK "CAN_TX_PPS_FL_ACTV" 2 /end CHARACTERISTIC
/begin CHARACTERISTIC CAN_TX_PPS_FL_ACTV_BIT_LEN "PPS fail active msg bit length" VALUE 0x0002038C __UBYTE_S 0 u_cnts 0 255 SYMBOL_LINK "CAN_TX_PPS_FL_ACTV" 3 /end CHARACTERISTIC
/begin CHARACTERISTIC CAN_TX_PPS_FL_ACTV_TABLE "PPS fail active msg table" VAL_BLK 0x0002038C __UBYTE_S 0 u_cnts 0 255 NUMBER 2 SYMBOL_LINK "CAN_TX_PPS_FL_ACTV" 4 /end CHARACTERISTIC
/begin CHARACTERISTIC CAN_TX_BRK_PEDL_ACTV_ID "brake pedal active msg number" VALUE 0x0002038C __UBYTE_S 0 u_can_txmsg_num 0 255 FORMAT "%3.0" SYMBOL_LINK "CAN_TX_BRK_PEDL_ACTV" 0 /end CHARACTERISTIC
/begin CHARACTERISTIC CAN_TX_BRK_PEDL_ACTV_BYTE_LOC "brake pedal active msg location number" VALUE 0x0002038C __UBYTE_S 0 u_can_byte_num 0 7 FORMAT "%1.0" SYMBOL_LINK "CAN_TX_BRK_PEDL_ACTV" 1 /end CHARACTERISTIC
/begin CHARACTERISTIC CAN_TX_BRK_PEDL_ACTV_BIT_LOC "brake pedal active msg bit location" VALUE 0x0002038C __UBYTE_S 0 u_can_bit_loc 0 7 FORMAT "%1.0" SYMBOL_LINK "CAN_TX_BRK_PEDL_ACTV" 2 /end CHARACTERISTIC
/begin CHARACTERISTIC CAN_TX_BRK_PEDL_ACTV_BIT_LEN "brake pedal active msg bit length" VALUE 0x0002038C __UBYTE_S 0 u_cnts 0 255 SYMBOL_LINK "CAN_TX_BRK_PEDL_ACTV" 3 /end CHARACTERISTIC
/begin CHARACTERISTIC CAN_TX_BRK_PEDL_ACTV_TABLE "brake pedal active msg table" VAL_BLK 0x0002038C __UBYTE_S 0 u_cnts 0 255 NUMBER 2 SYMBOL_LINK "CAN_TX_BRK_PEDL_ACTV" 4 /end CHARACTERISTIC
/begin CHARACTERISTIC CAN_TX_BRK_LAMP_ACTV_ID "brake lamp active msg number" VALUE 0x0002038C __UBYTE_S 0 u_can_txmsg_num 0 255 FORMAT "%3.0" SYMBOL_LINK "CAN_TX_BRK_LAMP_ACTV" 0 /end CHARACTERISTIC
/begin CHARACTERISTIC CAN_TX_BRK_LAMP_ACTV_BYTE_LOC "brake lamp active msg location number" VALUE 0x0002038C __UBYTE_S 0 u_can_byte_num 0 7 FORMAT "%1.0" SYMBOL_LINK "CAN_TX_BRK_LAMP_ACTV" 1 /end CHARACTERISTIC
/begin CHARACTERISTIC CAN_TX_BRK_LAMP_ACTV_BIT_LOC "brake lamp active msg bit location" VALUE 0x0002038C __UBYTE_S 0 u_can_bit_loc 0 7 FORMAT "%1.0" SYMBOL_LINK "CAN_TX_BRK_LAMP_ACTV" 2 /end CHARACTERISTIC
/begin CHARACTERISTIC CAN_TX_BRK_LAMP_ACTV_BIT_LEN "brake lamp active msg bit length" VALUE 0x0002038C __UBYTE_S 0 u_cnts 0 255 SYMBOL_LINK "CAN_TX_BRK_LAMP_ACTV" 3 /end CHARACTERISTIC
/begin CHARACTERISTIC CAN_TX_BRK_LAMP_ACTV_TABLE "brake lamp active msg table" VAL_BLK 0x0002038C __UBYTE_S 0 u_cnts 0 255 NUMBER 2 SYMBOL_LINK "CAN_TX_BRK_LAMP_ACTV" 4 /end CHARACTERISTIC
/begin CHARACTERISTIC CAN_TX_CRK_FL_ACTV_ID "crank fail active msg number" VALUE 0x0002038C __UBYTE_S 0 u_can_txmsg_num 0 255 FORMAT "%3.0" SYMBOL_LINK "CAN_TX_CRK_FL_ACTV" 0 /end CHARACTERISTIC
/begin CHARACTERISTIC CAN_TX_CRK_FL_ACTV_BYTE_LOC "crank fail active msg location number" VALUE 0x0002038C __UBYTE_S 0 u_can_byte_num 0 7 FORMAT "%1.0" SYMBOL_LINK "CAN_TX_CRK_FL_ACTV" 1 /end CHARACTERISTIC
/begin CHARACTERISTIC CAN_TX_CRK_FL_ACTV_BIT_LOC "crank fail active msg bit location" VALUE 0x0002038C __UBYTE_S 0 u_can_bit_loc 0 7 FORMAT "%1.0" SYMBOL_LINK "CAN_TX_CRK_FL_ACTV" 2 /end CHARACTERISTIC
/begin CHARACTERISTIC CAN_TX_CRK_FL_ACTV_BIT_LEN "crank fail active msg bit length" VALUE 0x0002038C __UBYTE_S 0 u_cnts 0 255 SYMBOL_LINK "CAN_TX_CRK_FL_ACTV" 3 /end CHARACTERISTIC
/begin CHARACTERISTIC CAN_TX_CRK_FL_ACTV_TABLE "crank fail active msg table" VAL_BLK 0x0002038C __UBYTE_S 0 u_cnts 0 255 NUMBER 2 SYMBOL_LINK "CAN_TX_CRK_FL_ACTV" 4 /end CHARACTERISTIC
/begin CHARACTERISTIC CAN_TX_VSS_FL_ACTV_ID "vehicle speed sensor fail active msg number" VALUE 0x0002038C __UBYTE_S 0 u_can_txmsg_num 0 255 FORMAT "%3.0" SYMBOL_LINK "CAN_TX_VSS_FL_ACTV" 0 /end CHARACTERISTIC
/begin CHARACTERISTIC CAN_TX_VSS_FL_ACTV_BYTE_LOC "vehicle speed sensor fail active msg location number" VALUE 0x0002038C __UBYTE_S 0 u_can_byte_num 0 7 FORMAT "%1.0" SYMBOL_LINK "CAN_TX_VSS_FL_ACTV" 1 /end CHARACTERISTIC
/begin CHARACTERISTIC CAN_TX_VSS_FL_ACTV_BIT_LOC "vehicle speed sensor fail active msg bit location" VALUE 0x0002038C __UBYTE_S 0 u_can_bit_loc 0 7 FORMAT "%1.0" SYMBOL_LINK "CAN_TX_VSS_FL_ACTV" 2 /end CHARACTERISTIC
/begin CHARACTERISTIC CAN_TX_VSS_FL_ACTV_BIT_LEN "vehicle speed sensor fail active msg bit length" VALUE 0x0002038C __UBYTE_S 0 u_cnts 0 255 SYMBOL_LINK "CAN_TX_VSS_FL_ACTV" 3 /end CHARACTERISTIC
/begin CHARACTERISTIC CAN_TX_VSS_FL_ACTV_TABLE "vehicle speed sensor fail active msg table" VAL_BLK 0x0002038C __UBYTE_S 0 u_cnts 0 255 NUMBER 2 SYMBOL_LINK "CAN_TX_VSS_FL_ACTV" 4 /end CHARACTERISTIC
/begin CHARACTERISTIC CAN_TX_ENG_STRT_EN_ID "engine start enable msg number" VALUE 0x0002038C __UBYTE_S 0 u_can_txmsg_num 0 255 FORMAT "%3.0" SYMBOL_LINK "CAN_TX_ENG_STRT_EN" 0 /end CHARACTERISTIC
/begin CHARACTERISTIC CAN_TX_ENG_STRT_EN_BYTE_LOC "engine start enable msg location number" VALUE 0x0002038C __UBYTE_S 0 u_can_byte_num 0 7 FORMAT "%1.0" SYMBOL_LINK "CAN_TX_ENG_STRT_EN" 1 /end CHARACTERISTIC
/begin CHARACTERISTIC CAN_TX_ENG_STRT_EN_BIT_LOC "engine start enable msg bit location" VALUE 0x0002038C __UBYTE_S 0 u_can_bit_loc 0 7 FORMAT "%1.0" SYMBOL_LINK "CAN_TX_ENG_STRT_EN" 2 /end CHARACTERISTIC
/begin CHARACTERISTIC CAN_TX_ENG_STRT_EN_BIT_LEN "engine start enable msg bit length" VALUE 0x0002038C __UBYTE_S 0 u_cnts 0 255 SYMBOL_LINK "CAN_TX_ENG_STRT_EN" 3 /end CHARACTERISTIC
/begin CHARACTERISTIC CAN_TX_ENG_STRT_EN_TABLE "engine start enable msg table" VAL_BLK 0x0002038C __UBYTE_S 0 u_cnts 0 255 NUMBER 2 SYMBOL_LINK "CAN_TX_ENG_STRT_EN" 4 /end CHARACTERISTIC
/begin CHARACTERISTIC CAN_TX_ENG_STRT_FL_ID "engine start fail msg number" VALUE 0x0002038C __UBYTE_S 0 u_can_txmsg_num 0 255 FORMAT "%3.0" SYMBOL_LINK "CAN_TX_ENG_STRT_FL" 0 /end CHARACTERISTIC
/begin CHARACTERISTIC CAN_TX_ENG_STRT_FL_BYTE_LOC "engine start fail msg location number" VALUE 0x0002038C __UBYTE_S 0 u_can_byte_num 0 7 FORMAT "%1.0" SYMBOL_LINK "CAN_TX_ENG_STRT_FL" 1 /end CHARACTERISTIC
/begin CHARACTERISTIC CAN_TX_ENG_STRT_FL_BIT_LOC "engine start fail msg bit location" VALUE 0x0002038C __UBYTE_S 0 u_can_bit_loc 0 7 FORMAT "%1.0" SYMBOL_LINK "CAN_TX_ENG_STRT_FL" 2 /end CHARACTERISTIC
/begin CHARACTERISTIC CAN_TX_ENG_STRT_FL_BIT_LEN "engine start fail msg bit length" VALUE 0x0002038C __UBYTE_S 0 u_cnts 0 255 SYMBOL_LINK "CAN_TX_ENG_STRT_FL" 3 /end CHARACTERISTIC
/begin CHARACTERISTIC CAN_TX_ENG_STRT_FL_TABLE "engine start fail msg table" VAL_BLK 0x0002038C __UBYTE_S 0 u_cnts 0 255 NUMBER 2 SYMBOL_LINK "CAN_TX_ENG_STRT_FL" 4 /end CHARACTERISTIC
/begin CHARACTERISTIC CAN_TX_IMMO_STRT_EN_ID "immo pass msg number" VALUE 0x0002038C __UBYTE_S 0 u_can_txmsg_num 0 255 FORMAT "%3.0" SYMBOL_LINK "CAN_TX_IMMO_STRT_EN" 0 /end CHARACTERISTIC
/begin CHARACTERISTIC CAN_TX_IMMO_STRT_EN_BYTE_LOC "immo pass msg location number" VALUE 0x0002038C __UBYTE_S 0 u_can_byte_num 0 7 FORMAT "%1.0" SYMBOL_LINK "CAN_TX_IMMO_STRT_EN" 1 /end CHARACTERISTIC
/begin CHARACTERISTIC CAN_TX_IMMO_STRT_EN_BIT_LOC "immo pass msg bit location" VALUE 0x0002038C __UBYTE_S 0 u_can_bit_loc 0 7 FORMAT "%1.0" SYMBOL_LINK "CAN_TX_IMMO_STRT_EN" 2 /end CHARACTERISTIC
/begin CHARACTERISTIC CAN_TX_IMMO_STRT_EN_BIT_LEN "immo pass msg bit length" VALUE 0x0002038C __UBYTE_S 0 u_cnts 0 255 SYMBOL_LINK "CAN_TX_IMMO_STRT_EN" 3 /end CHARACTERISTIC
/begin CHARACTERISTIC CAN_TX_IMMO_STRT_EN_TABLE "immo pass msg table" VAL_BLK 0x0002038C __UBYTE_S 0 u_cnts 0 255 NUMBER 2 SYMBOL_LINK "CAN_TX_IMMO_STRT_EN" 4 /end CHARACTERISTIC
/begin CHARACTERISTIC CAN_TX_IDL_EN_ID "idle enable msg number" VALUE 0x0002038C __UBYTE_S 0 u_can_txmsg_num 0 255 FORMAT "%3.0" SYMBOL_LINK "CAN_TX_IDL_EN" 0 /end CHARACTERISTIC
/begin CHARACTERISTIC CAN_TX_IDL_EN_BYTE_LOC "idle enable msg location number" VALUE 0x0002038C __UBYTE_S 0 u_can_byte_num 0 7 FORMAT "%1.0" SYMBOL_LINK "CAN_TX_IDL_EN" 1 /end CHARACTERISTIC
/begin CHARACTERISTIC CAN_TX_IDL_EN_BIT_LOC "idle enable msg bit location" VALUE 0x0002038C __UBYTE_S 0 u_can_bit_loc 0 7 FORMAT "%1.0" SYMBOL_LINK "CAN_TX_IDL_EN" 2 /end CHARACTERISTIC
/begin CHARACTERISTIC CAN_TX_IDL_EN_BIT_LEN "idle enable msg bit length" VALUE 0x0002038C __UBYTE_S 0 u_cnts 0 255 SYMBOL_LINK "CAN_TX_IDL_EN" 3 /end CHARACTERISTIC
/begin CHARACTERISTIC CAN_TX_IDL_EN_TABLE "idle enable msg table" VAL_BLK 0x0002038C __UBYTE_S 0 u_cnts 0 255 NUMBER 2 SYMBOL_LINK "CAN_TX_IDL_EN" 4 /end CHARACTERISTIC
/begin CHARACTERISTIC CAN_TX_ENG_FCO_ID "engine fuel cut off msg number" VALUE 0x0002038C __UBYTE_S 0 u_can_txmsg_num 0 255 FORMAT "%3.0" SYMBOL_LINK "CAN_TX_ENG_FCO" 0 /end CHARACTERISTIC
/begin CHARACTERISTIC CAN_TX_ENG_FCO_BYTE_LOC "engine fuel cut off msg location number" VALUE 0x0002038C __UBYTE_S 0 u_can_byte_num 0 7 FORMAT "%1.0" SYMBOL_LINK "CAN_TX_ENG_FCO" 1 /end CHARACTERISTIC
/begin CHARACTERISTIC CAN_TX_ENG_FCO_BIT_LOC "engine fuel cut off msg bit location" VALUE 0x0002038C __UBYTE_S 0 u_can_bit_loc 0 7 FORMAT "%1.0" SYMBOL_LINK "CAN_TX_ENG_FCO" 2 /end CHARACTERISTIC
/begin CHARACTERISTIC CAN_TX_ENG_FCO_BIT_LEN "engine fuel cut off msg bit length" VALUE 0x0002038C __UBYTE_S 0 u_cnts 0 255 SYMBOL_LINK "CAN_TX_ENG_FCO" 3 /end CHARACTERISTIC
/begin CHARACTERISTIC CAN_TX_ENG_FCO_TABLE "engine fuel cut off msg table" VAL_BLK 0x0002038C __UBYTE_S 0 u_cnts 0 255 NUMBER 2 SYMBOL_LINK "CAN_TX_ENG_FCO" 4 /end CHARACTERISTIC
/begin CHARACTERISTIC CAN_TX_KEY_ON_ID "key on state msg number" VALUE 0x0002038C __UBYTE_S 0 u_can_txmsg_num 0 255 FORMAT "%3.0" SYMBOL_LINK "CAN_TX_KEY_ON" 0 /end CHARACTERISTIC
/begin CHARACTERISTIC CAN_TX_KEY_ON_BYTE_LOC "key on state msg location number" VALUE 0x0002038C __UBYTE_S 0 u_can_byte_num 0 7 FORMAT "%1.0" SYMBOL_LINK "CAN_TX_KEY_ON" 1 /end CHARACTERISTIC
/begin CHARACTERISTIC CAN_TX_KEY_ON_BIT_LOC "key on state msg bit location" VALUE 0x0002038C __UBYTE_S 0 u_can_bit_loc 0 7 FORMAT "%1.0" SYMBOL_LINK "CAN_TX_KEY_ON" 2 /end CHARACTERISTIC
/begin CHARACTERISTIC CAN_TX_KEY_ON_BIT_LEN "key on state msg bit length" VALUE 0x0002038C __UBYTE_S 0 u_cnts 0 255 SYMBOL_LINK "CAN_TX_KEY_ON" 3 /end CHARACTERISTIC
/begin CHARACTERISTIC CAN_TX_KEY_ON_TABLE "key on state msg table" VAL_BLK 0x0002038C __UBYTE_S 0 u_cnts 0 255 NUMBER 2 SYMBOL_LINK "CAN_TX_KEY_ON" 4 /end CHARACTERISTIC
/begin CHARACTERISTIC CAN_TX_CAT_HT_ACTV_ID "cat heat active msg number" VALUE 0x0002038C __UBYTE_S 0 u_can_txmsg_num 0 255 FORMAT "%3.0" SYMBOL_LINK "CAN_TX_CAT_HT_ACTV" 0 /end CHARACTERISTIC
/begin CHARACTERISTIC CAN_TX_CAT_HT_ACTV_BYTE_LOC "cat heat active msg location number" VALUE 0x0002038C __UBYTE_S 0 u_can_byte_num 0 7 FORMAT "%1.0" SYMBOL_LINK "CAN_TX_CAT_HT_ACTV" 1 /end CHARACTERISTIC
/begin CHARACTERISTIC CAN_TX_CAT_HT_ACTV_BIT_LOC "cat heat active msg bit location" VALUE 0x0002038C __UBYTE_S 0 u_can_bit_loc 0 7 FORMAT "%1.0" SYMBOL_LINK "CAN_TX_CAT_HT_ACTV" 2 /end CHARACTERISTIC
/begin CHARACTERISTIC CAN_TX_CAT_HT_ACTV_BIT_LEN "cat heat active msg bit length" VALUE 0x0002038C __UBYTE_S 0 u_cnts 0 255 SYMBOL_LINK "CAN_TX_KEY_ON" 3 /end CHARACTERISTIC
/begin CHARACTERISTIC CAN_TX_CAT_HT_ACTV_TABLE "cat heat active msg table" VAL_BLK 0x0002038C __UBYTE_S 0 u_cnts 0 255 NUMBER 2 SYMBOL_LINK "CAN_TX_CAT_HT_ACTV" 4 /end CHARACTERISTIC
/begin CHARACTERISTIC CAN_TX_IMMO_INSTL_ID "immo installed msg number" VALUE 0x0002038C __UBYTE_S 0 u_can_txmsg_num 0 255 FORMAT "%3.0" SYMBOL_LINK "CAN_TX_IMMO_INSTL" 0 /end CHARACTERISTIC
/begin CHARACTERISTIC CAN_TX_IMMO_INSTL_BYTE_LOC "immo installed msg location number" VALUE 0x0002038C __UBYTE_S 0 u_can_byte_num 0 7 FORMAT "%1.0" SYMBOL_LINK "CAN_TX_IMMO_INSTL" 1 /end CHARACTERISTIC
/begin CHARACTERISTIC CAN_TX_IMMO_INSTL_BIT_LOC "immo installed msg bit location" VALUE 0x0002038C __UBYTE_S 0 u_can_bit_loc 0 7 FORMAT "%1.0" SYMBOL_LINK "CAN_TX_IMMO_INSTL" 2 /end CHARACTERISTIC
/begin CHARACTERISTIC CAN_TX_IMMO_INSTL_BIT_LEN "immo installed msg bit length" VALUE 0x0002038C __UBYTE_S 0 u_cnts 0 255 SYMBOL_LINK "CAN_TX_IMMO_INSTL" 3 /end CHARACTERISTIC
/begin CHARACTERISTIC CAN_TX_IMMO_INSTL_TABLE "immo installed msg table" VAL_BLK 0x0002038C __UBYTE_S 0 u_cnts 0 255 NUMBER 2 SYMBOL_LINK "CAN_TX_IMMO_INSTL" 4 /end CHARACTERISTIC
/begin CHARACTERISTIC CAN_TX_FULL_PEDAL_ID "full pedal active msg number" VALUE 0x0002038C __UBYTE_S 0 u_can_txmsg_num 0 255 FORMAT "%3.0" SYMBOL_LINK "CAN_TX_FULL_PEDAL" 0 /end CHARACTERISTIC
/begin CHARACTERISTIC CAN_TX_FULL_PEDAL_BYTE_LOC "full pedal active msg location number" VALUE 0x0002038C __UBYTE_S 0 u_can_byte_num 0 7 FORMAT "%1.0" SYMBOL_LINK "CAN_TX_IMMO_INSTL" 1 /end CHARACTERISTIC
/begin CHARACTERISTIC CAN_TX_FULL_PEDAL_BIT_LOC "full pedal active msg bit location" VALUE 0x0002038C __UBYTE_S 0 u_can_bit_loc 0 7 FORMAT "%1.0" SYMBOL_LINK "CAN_TX_FULL_PEDAL" 2 /end CHARACTERISTIC
/begin CHARACTERISTIC CAN_TX_FULL_PEDAL_BIT_LEN "full pedal active msg bit length" VALUE 0x0002038C __UBYTE_S 0 u_cnts 0 255 SYMBOL_LINK "CAN_TX_FULL_PEDAL" 3 /end CHARACTERISTIC
/begin CHARACTERISTIC CAN_TX_FULL_PEDAL_TABLE "full pedal active msg table" VAL_BLK 0x0002038C __UBYTE_S 0 u_cnts 0 255 NUMBER 2 SYMBOL_LINK "CAN_TX_IMMO_INSTL" 4 /end CHARACTERISTIC
/begin CHARACTERISTIC CAN_TX_HYB_STP_ACTV_ID "hybrid idle stop active msg number" VALUE 0x0002038C __UBYTE_S 0 u_can_txmsg_num 0 255 FORMAT "%3.0" SYMBOL_LINK "CAN_TX_HYB_STP_ACTV" 0 /end CHARACTERISTIC
/begin CHARACTERISTIC CAN_TX_HYB_STP_ACTV_BYTE_LOC "hybrid idle stop active msg location number" VALUE 0x0002038C __UBYTE_S 0 u_can_byte_num 0 7 FORMAT "%1.0" SYMBOL_LINK "CAN_TX_HYB_STP_ACTV" 1 /end CHARACTERISTIC
/begin CHARACTERISTIC CAN_TX_HYB_STP_ACTV_BIT_LOC "hybrid idle stop active msg bit location" VALUE 0x0002038C __UBYTE_S 0 u_can_bit_loc 0 7 FORMAT "%1.0" SYMBOL_LINK "CAN_TX_HYB_STP_ACTV" 2 /end CHARACTERISTIC
/begin CHARACTERISTIC CAN_TX_HYB_STP_ACTV_BIT_LEN "hybrid idle stop active msg bit length" VALUE 0x0002038C __UBYTE_S 0 u_cnts 0 255 SYMBOL_LINK "CAN_TX_HYB_STP_ACTV" 3 /end CHARACTERISTIC
/begin CHARACTERISTIC CAN_TX_HYB_STP_ACTV_TABLE "hybrid idle stop active msg table" VAL_BLK 0x0002038C __UBYTE_S 0 u_cnts 0 255 NUMBER 2 SYMBOL_LINK "CAN_TX_HYB_STP_ACTV" 4 /end CHARACTERISTIC
/begin CHARACTERISTIC CAN_TX_SS_LAMP_ACTV_ID "start stop lamp active msg number" VALUE 0x0002038C __UBYTE_S 0 u_can_txmsg_num 0 255 FORMAT "%3.0" SYMBOL_LINK "CAN_TX_SS_LAMP_ACTV" 0 /end CHARACTERISTIC
/begin CHARACTERISTIC CAN_TX_SS_LAMP_ACTV_BYTE_LOC "start stop lamp active msg location number" VALUE 0x0002038C __UBYTE_S 0 u_can_byte_num 0 7 FORMAT "%1.0" SYMBOL_LINK "CAN_TX_SS_LAMP_ACTV" 1 /end CHARACTERISTIC
/begin CHARACTERISTIC CAN_TX_SS_LAMP_ACTV_BIT_LOC "start stop lamp active msg bit location" VALUE 0x0002038C __UBYTE_S 0 u_can_bit_loc 0 7 FORMAT "%1.0" SYMBOL_LINK "CAN_TX_SS_LAMP_ACTV" 2 /end CHARACTERISTIC
/begin CHARACTERISTIC CAN_TX_SS_LAMP_ACTV_BIT_LEN "start stop lamp active msg bit length" VALUE 0x0002038C __UBYTE_S 0 u_cnts 0 255 SYMBOL_LINK "CAN_TX_SS_LAMP_ACTV" 3 /end CHARACTERISTIC
/begin CHARACTERISTIC CAN_TX_SS_LAMP_ACTV_TABLE "start stop lamp active msg table" VAL_BLK 0x0002038C __UBYTE_S 0 u_cnts 0 255 NUMBER 2 SYMBOL_LINK "CAN_TX_SS_LAMP_ACTV" 4 /end CHARACTERISTIC
/begin CHARACTERISTIC CAN_TX_CRUZ_ST_ID "cruise state msg number" VALUE 0x0002038C __UBYTE_S 0 u_can_txmsg_num 0 255 FORMAT "%3.0" SYMBOL_LINK "CAN_TX_CRUZ_ST" 0 /end CHARACTERISTIC
/begin CHARACTERISTIC CAN_TX_CRUZ_ST_BYTE_LOC "cruise state active msg location number" VALUE 0x0002038C __UBYTE_S 0 u_can_byte_num 0 7 FORMAT "%1.0" SYMBOL_LINK "CAN_TX_CRUZ_ST" 1 /end CHARACTERISTIC
/begin CHARACTERISTIC CAN_TX_CRUZ_ST_BIT_LOC "cruise state msg bit location" VALUE 0x0002038C __UBYTE_S 0 u_can_bit_loc 0 7 FORMAT "%1.0" SYMBOL_LINK "CAN_TX_CRUZ_ST" 2 /end CHARACTERISTIC
/begin CHARACTERISTIC CAN_TX_CRUZ_ST_BIT_LEN "cruise state msg bit length" VALUE 0x0002038C __UBYTE_S 0 u_cnts 0 255 SYMBOL_LINK "CAN_TX_CRUZ_ST" 3 /end CHARACTERISTIC
/begin CHARACTERISTIC CAN_TX_CRUZ_ST_TABLE "cruise state msg table" CURVE 0x375CE __UBYTE_S 0 u_cnts 0 255 SYMBOL_LINK "CAN_TX_CRUZ_ST" 4
 /begin AXIS_DESCR FIX_AXIS NO_INPUT_QUANTITY u_can_cruz_st 15 0 14 /begin FIX_AXIS_PAR_LIST 0 1 2 3 4 5 6 7 8 9 10 11 12 13 14 /end FIX_AXIS_PAR_LIST /end AXIS_DESCR
/end CHARACTERISTIC
/begin CHARACTERISTIC CAN_TX_ENG_ST_ID "engine state msg number" VALUE 0x0002038C __UBYTE_S 0 u_can_txmsg_num 0 255 FORMAT "%3.0" SYMBOL_LINK "CAN_TX_ENG_ST" 0 /end CHARACTERISTIC
/begin CHARACTERISTIC CAN_TX_ENG_ST_BYTE_LOC "engine state msg location number" VALUE 0x0002038C __UBYTE_S 0 u_can_byte_num 0 7 FORMAT "%1.0" SYMBOL_LINK "CAN_TX_ENG_ST" 1 /end CHARACTERISTIC
/begin CHARACTERISTIC CAN_TX_ENG_ST_BIT_LOC "engine state msg bit location" VALUE 0x0002038C __UBYTE_S 0 u_can_bit_loc 0 7 FORMAT "%1.0" SYMBOL_LINK "CAN_TX_ENG_ST" 2 /end CHARACTERISTIC
/begin CHARACTERISTIC CAN_TX_ENG_ST_BIT_LEN "engine state msg bit length" VALUE 0x0002038C __UBYTE_S 0 u_cnts 0 255 SYMBOL_LINK "CAN_TX_ENG_ST" 3 /end CHARACTERISTIC
/begin CHARACTERISTIC CAN_TX_ENG_ST_TABLE "engine state msg table" CURVE 0x375CE __UBYTE_S 0 u_cnts 0 255 SYMBOL_LINK "CAN_TX_ENG_ST" 4
 /begin AXIS_DESCR FIX_AXIS NO_INPUT_QUANTITY u_can_eng_st 5 0 4 /begin FIX_AXIS_PAR_LIST 0 1 2 3 4 /end FIX_AXIS_PAR_LIST /end AXIS_DESCR
/end CHARACTERISTIC
/begin CHARACTERISTIC EVAM_V_FLV_MMV_DLY "fuel level filter delay" VALUE 0x0002038C __UWORD_S 0 u_16x_tmr 0 8191.875 /end CHARACTERISTIC
/begin CHARACTERISTIC EVAM_V_FLV_FIL "fuel level filter" VALUE 0x0002038C __UWORD_S 0 u_filter 0 0.9999847412109375 FORMAT "%4.3" /end CHARACTERISTIC
/begin CHARACTERISTIC EVAM_V_IDL_VSPD_LO "idle vehicle speed low" VALUE 0x0002038C __UWORD_S 0 u_vspd 0 511.9921875 FORMAT "%4.1" /end CHARACTERISTIC
/begin CHARACTERISTIC EVAM_V_REFUEL_VAC "refuel condition vacumm thr" VALUE 0x0002038C __SWORD_S 0 u_kPa_8n_8p -8 7.999755859375 FORMAT "%3.2" /end CHARACTERISTIC
/begin CHARACTERISTIC EVAM_V_REFUEL_DLT "refuel detect delta" VALUE 0x379E4 __UWORD_S 0 u_pct_1 0 99.9984741210937 FORMAT "%5.3" /end CHARACTERISTIC
/begin CHARACTERISTIC EVAM_V_CAP_OPN_FC_THR "fuel cap open fuel consumption thr" VALUE 0x0002038C __ULONG_S 0 u_ul_long 0 536870911.875 FORMAT "%10.1" SYMBOL_LINK "EVAM_V_CAP_OPN_FC_THR" 10 /end CHARACTERISTIC
/begin CHARACTERISTIC EVAM_V_VSM_CST_ECT_MIN "very small leak cold start condtion ect min" VALUE 0x0002038C __SWORD_S 0 u_deg_C -256 255.9921875 /end CHARACTERISTIC
/begin CHARACTERISTIC EVAM_V_VSM_CST_ECT_MAX "very small leak cold start condtion ect max" VALUE 0x0002038C __SWORD_S 0 u_deg_C -256 255.9921875 /end CHARACTERISTIC
/begin CHARACTERISTIC EVAM_V_VSM_CST_IAT_MIN "very small leak cold start condtion iat min" VALUE 0x0002038C __SWORD_S 0 u_deg_C -256 255.9921875 /end CHARACTERISTIC
/begin CHARACTERISTIC EVAM_V_VSM_CST_IAT_MAX "very small leak cold start condtion iat max" VALUE 0x0002038C __SWORD_S 0 u_deg_C -256 255.9921875 /end CHARACTERISTIC
/begin CHARACTERISTIC EVAM_V_VSM_CST_IAT_HI_DLT "very small leak cold start condtion iat to ect delta max" VALUE 0x0002038C __SWORD_S 0 u_deg_C -256 255.9921875 /end CHARACTERISTIC
/begin CHARACTERISTIC EVAM_V_VSM_CST_ECT_HI_DLT "very small leak cold start condtion ect to iat delta max" VALUE 0x0002038C __SWORD_S 0 u_deg_C -256 255.9921875 /end CHARACTERISTIC
/begin CHARACTERISTIC EVAM_V_CST_OFFT_MIN "cold start condtion soak time min" VALUE 0x0002038C __UWORD_S 0 u_min 0 65535 /end CHARACTERISTIC
/begin CHARACTERISTIC EVAM_V_SM_CST_ECT_MIN "small leak cold start condtion ect min" VALUE 0x0002038C __SWORD_S 0 u_deg_C -256 255.9921875 /end CHARACTERISTIC
/begin CHARACTERISTIC EVAM_V_SM_CST_ECT_MAX "small leak cold start condtion ect max" VALUE 0x0002038C __SWORD_S 0 u_deg_C -256 255.9921875 /end CHARACTERISTIC
/begin CHARACTERISTIC EVAM_V_SM_CST_IAT_MIN "small leak cold start condtion iat min" VALUE 0x0002038C __SWORD_S 0 u_deg_C -256 255.9921875 /end CHARACTERISTIC
/begin CHARACTERISTIC EVAM_V_SM_CST_IAT_MAX "small leak cold start condtion iat max" VALUE 0x0002038C __SWORD_S 0 u_deg_C -256 255.9921875 /end CHARACTERISTIC
/begin CHARACTERISTIC EVAM_V_SM_CST_IAT_ECT_DLT "small leak cold start condtion iat to ect delta max" VALUE 0x0002038C __SWORD_S 0 u_deg_C -256 255.9921875 /end CHARACTERISTIC
/begin CHARACTERISTIC EVAM_V_SM_CST_ECT_IAT_DLT "small leak cold start condtion ect to iat delta max" VALUE 0x0002038C __SWORD_S 0 u_deg_C -256 255.9921875 /end CHARACTERISTIC
/begin CHARACTERISTIC EVAM_V_EN_RUN_MIN "diag enable run time min" VALUE 0x0002038C __UWORD_S 0 u_1s_tmr 0 65535 /end CHARACTERISTIC
/begin CHARACTERISTIC EVAM_V_VSM_FLV_MIN "very small leak fuel level min" VALUE 0x379E4 __UWORD_S 0 u_pct_1 0 99.9984741210937 FORMAT "%5.3" /end CHARACTERISTIC
/begin CHARACTERISTIC EVAM_V_VSM_FLV_MAX "very small leak fuel level max" VALUE 0x379E4 __UWORD_S 0 u_pct_1 0 99.9984741210937 FORMAT "%5.3" /end CHARACTERISTIC
/begin CHARACTERISTIC EVAM_V_VSM_FLV_OUT_DLY "very small leak fuel level out confirm delay" VALUE 0x0002038C __UWORD_S 0 u_16x_tmr 0 8191.875 /end CHARACTERISTIC
/begin CHARACTERISTIC EVAM_V_SM_FLV_MIN "small leak fuel level min" VALUE 0x379E4 __UWORD_S 0 u_pct_1 0 99.9984741210937 FORMAT "%5.3" /end CHARACTERISTIC
/begin CHARACTERISTIC EVAM_V_SM_FLV_MAX "small leak fuel level max" VALUE 0x379E4 __UWORD_S 0 u_pct_1 0 99.9984741210937 FORMAT "%5.3" /end CHARACTERISTIC
/begin CHARACTERISTIC EVAM_V_SM_FLV_OUT_DLY "small leak fuel level out confirm delay" VALUE 0x0002038C __UWORD_S 0 u_16x_tmr 0 8191.875 /end CHARACTERISTIC
/begin CHARACTERISTIC EVAM_V_AMB_STBL_VSPD_MIN "amb temp stable vehicle speed min" VALUE 0x39FE6 __UWORD_S 0 u_vspd 0 511.9921875 /end CHARACTERISTIC
/begin CHARACTERISTIC EVAM_V_AMB_T_DEC_THR "amb temp decrease thr" VALUE 0x0002038C __SWORD_S 0 u_deg_C -256 255.9921875 /end CHARACTERISTIC
/begin CHARACTERISTIC EVAM_V_AMB_T_INC_THR "amb temp increase thr" VALUE 0x0002038C __SWORD_S 0 u_deg_C -256 255.9921875 /end CHARACTERISTIC
/begin CHARACTERISTIC EVAM_V_AMB_T_UNSTBL_THR "amb temp unstable thr" VALUE 0x0002038C __UWORD_S 0 u_cnts 0 65535 FORMAT "%5.0" /end CHARACTERISTIC
/begin CHARACTERISTIC EVAM_V_AMB_T_STBL_DUR_KP "amb temp stable duration keep" VALUE 0x0002038C __UBYTE_S 0 b_true 0 1 FORMAT "%1.0" /end CHARACTERISTIC
/begin CHARACTERISTIC EVAM_V_AMB_T_STBL_DUR_MIN "amb temp stable duration min" VALUE 0x0002038C __UWORD_S 0 u_16x_tmr 0 8191.875 /end CHARACTERISTIC
/begin CHARACTERISTIC EVAM_V_IAT_DEC_DLT "IAT decrease from keyon IAT delta" VALUE 0x0002038C __SWORD_S 0 u_deg_C -256 255.9921875 /end CHARACTERISTIC
/begin CHARACTERISTIC EVAM_V_IAT_DEC_DUR "IAT decrease duration" VALUE 0x0002038C __UWORD_S 0 u_16x_tmr 0 8191.875 /end CHARACTERISTIC
/begin CHARACTERISTIC EVAM_V_EN_VLT_MIN "diag enable voltage min" VALUE 0x0002038C __UWORD_S 0 u_volt_32 0 31.99951171875 FORMAT "%4.2" /end CHARACTERISTIC
/begin CHARACTERISTIC EVAM_V_EN_VLT_MAX "diag enable voltage max" VALUE 0x0002038C __UWORD_S 0 u_volt_32 0 31.99951171875 FORMAT "%4.2" /end CHARACTERISTIC
/begin CHARACTERISTIC EVAM_V_VLT_OUT_DUR "voltage out duration" VALUE 0x0002038C __UWORD_S 0 u_16x_tmr 0 8191.875 /end CHARACTERISTIC
/begin CHARACTERISTIC EVAM_V_PG_CTRL_OUT_DUR "purge control out duration" VALUE 0x0002038C __UWORD_S 0 u_16x_tmr 0 8191.875 /end CHARACTERISTIC
/begin CHARACTERISTIC EVAM_V_CAP_OPN_FLV_MAX "diag enable fuel level max" VALUE 0x379E4 __UWORD_S 0 u_pct_1 0 99.9984741210937 FORMAT "%5.3" /end CHARACTERISTIC
/begin CHARACTERISTIC EVAM_V_EN_AMP_MIN "diag enable amp min" VALUE 0x0002038C __UWORD_S 0 u_kPa_0_256 0 255.99609375 FORMAT "%4.1" /end CHARACTERISTIC
/begin CHARACTERISTIC EVAM_V_IDL_TPS_LO "idle condition tps low" VALUE 0x0002038C __UWORD_S 0 u_pct 0 199.996948 FORMAT "%4.1" /end CHARACTERISTIC
/begin CHARACTERISTIC EVAM_V_IDL_TPS_HI "idle condition tps high" VALUE 0x0002038C __UWORD_S 0 u_pct 0 199.996948 FORMAT "%4.1" /end CHARACTERISTIC
/begin CHARACTERISTIC EVAM_V_IDL_VSPD_HI "idle vehicle speed high" VALUE 0x0002038C __UWORD_S 0 u_vspd 0 511.9921875 FORMAT "%4.1" /end CHARACTERISTIC
/begin CHARACTERISTIC EVAM_V_IDL_ESPD_LO "idle engine speed low" VALUE 0x0002038C __UWORD_S 0 u_espd 0 8191.875 FORMAT "%5.1" /end CHARACTERISTIC
/begin CHARACTERISTIC EVAM_V_IDL_ESPD_HI "idle engine speed high" VALUE 0x0002038C __UWORD_S 0 u_espd 0 8191.875 FORMAT "%5.1" /end CHARACTERISTIC
/begin CHARACTERISTIC EVAM_V_CLD_LK_DLY "cold leak test delay" VALUE 0x0002038C __UWORD_S 0 u_16x_tmr 0 8191.875 /end CHARACTERISTIC
/begin CHARACTERISTIC EVAM_V_SLSH_FLV_DLT "fuel slosh detect fuel level delta" VALUE 0x379E4 __UWORD_S 0 u_pct_1 0 99.9984741210937 FORMAT "%5.3" /end CHARACTERISTIC
/begin CHARACTERISTIC EVAM_V_SLSH_MOV_VSPD "vehicle move speed for slosh detect" VALUE 0x0002038C __UWORD_S 0 u_vspd 0 511.9921875 /end CHARACTERISTIC
/begin CHARACTERISTIC EVAM_V_SLSH_DLY "slosh check delay" VALUE 0x0002038C __UWORD_S 0 u_16x_tmr 0 8191.875 /end CHARACTERISTIC
/begin CHARACTERISTIC EVAM_V_SLSH_MOV_PCT "vehicle move duration percent" VALUE 0x379E4 __UWORD_S 0 u_pct_1 0 99.9984741210937 FORMAT "%5.3" /end CHARACTERISTIC
/begin CHARACTERISTIC EVAM_V_SLSH_FUEL_VSPD "slosh fuel condition vehicle speed" VALUE 0x0002038C __UWORD_S 0 u_vspd 0 511.9921875 /end CHARACTERISTIC
/begin CHARACTERISTIC EVAM_V_SLSH_FUEL_TPS "slosh fuel condition tps thr" VALUE 0x0002038C __UWORD_S 0 u_pct 0 199.996948 FORMAT "%4.1" /end CHARACTERISTIC
/begin CHARACTERISTIC EVAM_V_SLSH_FUEL_MAP_DLT "slosh fuel condition map delta" VALUE 0x0002038C __UWORD_S 0 u_kPa_0_256 0 255.99609375 FORMAT "%4.1" /end CHARACTERISTIC
/begin CHARACTERISTIC EVAM_V_SLSH_FUEL_ESPD_DLT "slosh fuel condition engine speed delta" VALUE 0x374C0 __UWORD_S 0 u_espd 0.0 8191.875 FORMAT "%6.2" /end CHARACTERISTIC
/begin CHARACTERISTIC EVAM_C_SLSH_FUEL_FLV_DLT "slosh fuel condition fuel level delta" CURVE 0x000200B0 __UWORD_S 0 u_pct_1 0 99.9984741210937 FORMAT "%5.3" SYMBOL_LINK "EVAM_C_SLSH_FUEL_FLV_DLT" 2
 /begin AXIS_DESCR FIX_AXIS sys_flv_pct_raw u_pct_1 17 0 99.9984741210937
  /begin FIX_AXIS_PAR_LIST 0 4096 8192 12288 16384 20480 24576 28672 32768 36864 40960 45056 49152 53248 57344 61440 65535 /end FIX_AXIS_PAR_LIST
 /end AXIS_DESCR
/end CHARACTERISTIC
/begin CHARACTERISTIC EVAM_V_PV_LK_DUR_MAX "purge valve leak diag duration max" VALUE 0x0002038C __UWORD_S 0 u_16x_tmr 0 8191.875 /end CHARACTERISTIC
/begin CHARACTERISTIC EVAM_V_PV_LK_EOL_DLY "purge valve leak diag end of line delay" VALUE 0x0002038C __UWORD_S 0 u_16x_tmr 0 8191.875 /end CHARACTERISTIC
/begin CHARACTERISTIC EVAM_V_PV_LK_DLY "purge valve leak diag delay" VALUE 0x0002038C __UWORD_S 0 u_16x_tmr 0 8191.875 /end CHARACTERISTIC
/begin CHARACTERISTIC EVAM_V_PV_LK_EOL_DLY_VAC "purge valve leak diag tank vacuum thr" VALUE 0x0002038C __SWORD_S 0 u_kPa_8n_8p -8 7.999755859375 FORMAT "%4.3" /end CHARACTERISTIC
/begin CHARACTERISTIC EVAM_V_PV_LK_DLY_VAC "purge valve leak diag tank vacuum thr" VALUE 0x0002038C __SWORD_S 0 u_kPa_8n_8p -8 7.999755859375 FORMAT "%4.3" /end CHARACTERISTIC
/begin CHARACTERISTIC EVAM_V_PV_LK_OFFT_MAX "purge valve leak slosh check off time max" VALUE 0x0002038C __UWORD_S 0 u_min 0 65535 /end CHARACTERISTIC
/begin CHARACTERISTIC EVAM_V_PV_LK_IAT_DEC "IAT decrease from keyon IAT delta" VALUE 0x0002038C __SWORD_S 0 u_deg_C -256 255.9921875 /end CHARACTERISTIC
/begin CHARACTERISTIC EVAM_V_PV_LK_MOV_VSPD "vehicle move speed for purge leak slosh detect" VALUE 0x0002038C __UWORD_S 0 u_vspd 0 511.9921875 /end CHARACTERISTIC
/begin CHARACTERISTIC EVAM_V_PV_LK_MOV_MIN "purge valve leak vehcle move duration min" VALUE 0x0002038C __UWORD_S 0 u_16x_tmr 0 8191.875 /end CHARACTERISTIC
/begin CHARACTERISTIC EVAM_V_PV_LK_FL_VAC "purge valve leak diag fail tank vacuum thr" VALUE 0x0002038C __SWORD_S 0 u_kPa_8n_8p -8 7.999755859375 FORMAT "%4.3" /end CHARACTERISTIC
/begin CHARACTERISTIC EVAM_V_PV_LK_FL_DLY "purge valve leak diag fail delay" VALUE 0x0002038C __UWORD_S 0 u_16x_tmr 0 8191.875 /end CHARACTERISTIC
/begin CHARACTERISTIC EVAM_V_PV_LK_EOL_FL_DLY "purge valve leak diag fail delay" VALUE 0x0002038C __UWORD_S 0 u_16x_tmr 0 8191.875 /end CHARACTERISTIC
/begin CHARACTERISTIC EVAM_C_PV_LK_STL_SLP "purge valve leak vac slope when engine stall" CURVE 0x000200B0 __SWORD_S 0 u_kPaSec_c -8 7.999755859375 FORMAT "%3.2" SYMBOL_LINK "EVAM_C_PV_LK_STL_SLP" 2
 /begin AXIS_DESCR FIX_AXIS evam_flv_mmv u_pct_1 17 0 99.9984741210937
  /begin FIX_AXIS_PAR_LIST 0 4096 8192 12288 16384 20480 24576 28672 32768 36864 40960 45056 49152 53248 57344 61440 65535 /end FIX_AXIS_PAR_LIST
 /end AXIS_DESCR
/end CHARACTERISTIC
/begin CHARACTERISTIC EVAM_V_PV_LK_SLP_RAT_MAX "purge valve leak mov slope ratio max" VALUE 0x0002038C __UWORD_S 0 u_fac_128 0 127.998046875 /end CHARACTERISTIC
/begin CHARACTERISTIC EVAM_C_SM_VAC_SLP_MAX "vac slope max to abort small leak test during purge valve leak test" CURVE 0x000200B0 __SWORD_S 0 u_kPaSec_c -8 7.999755859375 FORMAT "%3.2" SYMBOL_LINK "EVAM_C_SM_VAC_SLP_MAX" 2
 /begin AXIS_DESCR FIX_AXIS evam_flv_mmv u_pct_1 9 0 99.9984741210937 /begin FIX_AXIS_PAR_LIST 0 8192 16384 24576 32768 40960 49152 57344 65535 /end FIX_AXIS_PAR_LIST /end AXIS_DESCR
/end CHARACTERISTIC
/begin CHARACTERISTIC EVAM_C_EOL_SM_VAC_SLP_MAX "vac slope max to abort small leak test during purge valve leak test" CURVE 0x000200B0 __SWORD_S 0 u_kPaSec_c -8 7.999755859375 FORMAT "%3.2" SYMBOL_LINK "EVAM_C_EOL_SM_VAC_SLP_MAX" 2
 /begin AXIS_DESCR FIX_AXIS evam_flv_mmv u_pct_1 9 0 99.9984741210937 /begin FIX_AXIS_PAR_LIST 0 8192 16384 24576 32768 40960 49152 57344 65535 /end FIX_AXIS_PAR_LIST /end AXIS_DESCR
/end CHARACTERISTIC
/begin CHARACTERISTIC EVAM_C_VSM_VAC_SLP_MAX "vac slope max to abort very small leak test during purge valve leak test" CURVE 0x000200B0 __SWORD_S 0 u_kPaSec_c -8 7.999755859375 FORMAT "%3.2" SYMBOL_LINK "EVAM_C_VSM_VAC_SLP_MAX" 2
 /begin AXIS_DESCR FIX_AXIS evam_flv_mmv u_pct_1 9 0 99.9984741210937 /begin FIX_AXIS_PAR_LIST 0 8192 16384 24576 32768 40960 49152 57344 65535 /end FIX_AXIS_PAR_LIST /end AXIS_DESCR
/end CHARACTERISTIC
/begin CHARACTERISTIC EVAM_C_EOL_VSM_VAC_SLP_MAX "vac slope max to abort very small leak test during purge valve leak test" CURVE 0x000200B0 __SWORD_S 0 u_kPaSec_c -8 7.999755859375 FORMAT "%3.2" SYMBOL_LINK "EVAM_C_EOL_VSM_VAC_SLP_MAX" 2
 /begin AXIS_DESCR FIX_AXIS evam_flv_mmv u_pct_1 9 0 99.9984741210937 /begin FIX_AXIS_PAR_LIST 0 8192 16384 24576 32768 40960 49152 57344 65535 /end FIX_AXIS_PAR_LIST /end AXIS_DESCR
/end CHARACTERISTIC
/begin CHARACTERISTIC EVAM_V_PV_LK_AMB_TST_DUR "purge valve leak diag ambient test duration" VALUE 0x0002038C __UWORD_S 0 u_16x_tmr 0 8191.875 /end CHARACTERISTIC
/begin CHARACTERISTIC EVAM_V_PV_LK_AMB_STB_VSPD "purge valve leak test ambient stable vehicle speed" VALUE 0x0002038C __UWORD_S 0 u_vspd 0 511.992188 FORMAT "%4.1" /end CHARACTERISTIC
/begin CHARACTERISTIC EVAM_V_PV_LK_AMB_STB_DUR "purge valve leak diag ambient stable duration" VALUE 0x0002038C __UWORD_S 0 u_16x_tmr 0 8191.875 /end CHARACTERISTIC
/begin CHARACTERISTIC EVAM_C_CLD_PURG_EN_RUN_MAX "cold leak test purge enable runtime max" CURVE 0x000200B0 __UWORD_S 0 u_16x_tmr 0 8191.875 SYMBOL_LINK "EVAM_C_CLD_PURG_EN_RUN_MAX" 2
 /begin AXIS_DESCR FIX_AXIS sys_keyon_ect u_deg_C 17 -40 152
  /begin FIX_AXIS_PAR_LIST -5120 -3584 -2048 -512 1024 2560 4096 5632 7168 8704 10240 11776 13312 14848 16384 17920 19456 /end FIX_AXIS_PAR_LIST
 /end AXIS_DESCR
/end CHARACTERISTIC
/begin CHARACTERISTIC EVAM_C_CLD_LK_TST_DUR_MAX "cold leak test duration max" VALUE 0x0002038C __UWORD_S 0 u_16x_tmr 0 8191.875 /end CHARACTERISTIC
/begin CHARACTERISTIC EVAM_V_CLD_LK_CONC_HI "cold leak concentration high thr" VALUE 0x0002038C __UWORD_S 0 u_pct 0 199.99694824219 SYMBOL_LINK "EVAM_V_CLD_LK_CONC_HI" 8 /end CHARACTERISTIC
/begin CHARACTERISTIC EVAM_V_VSM_CLD_DUR_MAX "very small cold leak test duration max" VALUE 0x0002038C __UWORD_S 0 u_16x_tmr 0 8191.875 /end CHARACTERISTIC
/begin CHARACTERISTIC EVAM_V_PRESET_DUR_MIN "preset duration min" VALUE 0x0002038C __UWORD_S 0 u_16x_tmr 0 8191.875 /end CHARACTERISTIC
/begin CHARACTERISTIC EVAM_V_PRESET_VAC_MAX "preset tank vacuum max" VALUE 0x0002038C __SWORD_S 0 u_kPa_8n_8p -8 7.999755859375 FORMAT "%4.3" /end CHARACTERISTIC
/begin CHARACTERISTIC EVAM_V_PRESET_VAC_SP "preset tank vacuum setpoint" VALUE 0x0002038C __SWORD_S 0 u_kPa_8n_8p -8 7.999755859375 FORMAT "%4.3" /end CHARACTERISTIC
/begin CHARACTERISTIC EVAM_V_LRG_LK_FL_VAC "large leak fail vac thr" VALUE 0x0002038C __SWORD_S 0 u_kPa_8n_8p -8 7.999755859375 FORMAT "%4.3" /end CHARACTERISTIC
/begin CHARACTERISTIC EVAM_V_LRG_LK_EOL_FL_VAC "large leak fail vac thr" VALUE 0x0002038C __SWORD_S 0 u_kPa_8n_8p -8 7.999755859375 FORMAT "%4.3" /end CHARACTERISTIC
/begin CHARACTERISTIC EVAM_V_VSM_STRT_TM_MAX "very small start time max" VALUE 0x0002038C __UWORD_S 0 u_16x_tmr 0 8191.875 /end CHARACTERISTIC
/begin CHARACTERISTIC EVAM_V_VSM_TST_KP "keep very small test" VALUE 0x0002038C __UBYTE_S 0 b_true 0 1 FORMAT "%1.0" /end CHARACTERISTIC
/begin CHARACTERISTIC EVAM_V_CLD_LRG_LK_DLY "cold large leak delay max" VALUE 0x0002038C __UWORD_S 0 u_16x_tmr 0 8191.875 /end CHARACTERISTIC
/begin CHARACTERISTIC EVAM_C_CLD_LRG_LK_FL_INT "cold large leak fail vac increase int thr" CURVE 0x000200B0 __UWORD_S 0 u_cnts 0 65535 FORMAT "%5.0" SYMBOL_LINK "EVAM_C_CLD_LRG_LK_FL_INT" 2
 /begin AXIS_DESCR FIX_AXIS evam_flv_mmv u_pct_1 9 0 99.9984741210937 /begin FIX_AXIS_PAR_LIST 0 8192 16384 24576 32768 40960 49152 57344 65535 /end FIX_AXIS_PAR_LIST /end AXIS_DESCR
/end CHARACTERISTIC
/begin CHARACTERISTIC EVAM_V_CLD_LRG_LK_EOL_FL_INT "cold large leak fail vac increase int thr" VALUE 0x0002038C __UWORD_S 0 u_cnts 0 65535 FORMAT "%5.0" /end CHARACTERISTIC
/begin CHARACTERISTIC EVAM_V_EOL_DTY_INC_STP "eol purge duty increase step" VALUE 0x0002038C __UWORD_S 0 u_pct 0 199.99694824219 SYMBOL_LINK "EVAM_V_EOL_DTY_INC_STP" 8 /end CHARACTERISTIC
/begin CHARACTERISTIC EVAM_C_EOL_DTY_MAX "eol purge duty max" CURVE 0x000200B0 __UWORD_S 0 u_pct 0 199.99694824219 SYMBOL_LINK "EVAM_C_EOL_DTY_MAX" 2
 /begin AXIS_DESCR FIX_AXIS evam_tank_vac_err u_kPa_8n_8p 9 0 7.999755859375 /begin FIX_AXIS_PAR_LIST 0 640 1280 1920 2560 3200 3840 4480 5120 /end FIX_AXIS_PAR_LIST /end AXIS_DESCR
/end CHARACTERISTIC
/begin CHARACTERISTIC EVAM_V_SM_LK_PSS_VAC "small leak pass vac thr" VALUE 0x0002038C __SWORD_S 0 u_kPa_8n_8p -8 7.999755859375 FORMAT "%4.3" /end CHARACTERISTIC
/begin CHARACTERISTIC EVAM_V_SM_LK_EOL_PSS_VAC "eol small leak pass vac thr" VALUE 0x0002038C __SWORD_S 0 u_kPa_8n_8p -8 7.999755859375 FORMAT "%4.3" /end CHARACTERISTIC
/begin CHARACTERISTIC EVAM_V_SM_LK_DCY_VAC "small leak decay start vac thr" VALUE 0x0002038C __SWORD_S 0 u_kPa_8n_8p -8 7.999755859375 FORMAT "%4.3" /end CHARACTERISTIC
/begin CHARACTERISTIC EVAM_V_SM_LK_EOL_DCY_VAC "eol small leak decay start vac thr" VALUE 0x0002038C __SWORD_S 0 u_kPa_8n_8p -8 7.999755859375 FORMAT "%4.3" /end CHARACTERISTIC
/begin CHARACTERISTIC EVAM_V_SM_LK_DCY_DLY "small leak decay delay" VALUE 0x0002038C __UWORD_S 0 u_16x_tmr 0 8191.875 /end CHARACTERISTIC
/begin CHARACTERISTIC EVAM_V_SM_LK_EOL_DCY_DLY "eol small leak decay delay" VALUE 0x0002038C __UWORD_S 0 u_16x_tmr 0 8191.875 /end CHARACTERISTIC
/begin CHARACTERISTIC EVAM_V_SM_LK_DCY_DUR "small leak decay duration" VALUE 0x0002038C __UWORD_S 0 u_16x_tmr 0 8191.875 /end CHARACTERISTIC
/begin CHARACTERISTIC EVAM_V_SM_LK_EOL_DCY_DUR "eol small leak decay duration" VALUE 0x0002038C __UWORD_S 0 u_16x_tmr 0 8191.875 /end CHARACTERISTIC
/begin CHARACTERISTIC EVAM_V_SM_LK_SLP_CAL_NUM "small leak slope calculate num" VALUE 0x0002038C __UBYTE_S 0 u_cnts 0 8 FORMAT "%1.0" /end CHARACTERISTIC
/begin CHARACTERISTIC EVAM_C_SM_LK_SLP_FAC0 "small leak slope factor 0" CURVE 0x000200B0 __UWORD_S 0 u_fac_2 0 1.999969482421875 FORMAT "%4.3" SYMBOL_LINK "EVAM_M_SM_LK_SLP_FAC" 2
 /begin AXIS_DESCR FIX_AXIS evam_flv_mmv u_pct_1 9 0 99.9984741210937 /begin FIX_AXIS_PAR_LIST 0 8192 16384 24576 32768 40960 49152 57344 65535 /end FIX_AXIS_PAR_LIST /end AXIS_DESCR
/end CHARACTERISTIC
/begin CHARACTERISTIC EVAM_C_SM_LK_SLP_FAC1 "small leak slope factor 1" CURVE 0x000200B0 __UWORD_S 0 u_fac_2 0 1.999969482421875 FORMAT "%4.3" SYMBOL_LINK "EVAM_M_SM_LK_SLP_FAC" 22
 /begin AXIS_DESCR FIX_AXIS evam_flv_mmv u_pct_1 9 0 99.9984741210937 /begin FIX_AXIS_PAR_LIST 0 8192 16384 24576 32768 40960 49152 57344 65535 /end FIX_AXIS_PAR_LIST /end AXIS_DESCR
/end CHARACTERISTIC
/begin CHARACTERISTIC EVAM_C_SM_LK_SLP_FAC2 "small leak slope factor 2" CURVE 0x000200B0 __UWORD_S 0 u_fac_2 0 1.999969482421875 FORMAT "%4.3" SYMBOL_LINK "EVAM_M_SM_LK_SLP_FAC" 42
 /begin AXIS_DESCR FIX_AXIS evam_flv_mmv u_pct_1 9 0 99.9984741210937 /begin FIX_AXIS_PAR_LIST 0 8192 16384 24576 32768 40960 49152 57344 65535 /end FIX_AXIS_PAR_LIST /end AXIS_DESCR
/end CHARACTERISTIC
/begin CHARACTERISTIC EVAM_C_SM_LK_SLP_FAC3 "small leak slope factor 3" CURVE 0x000200B0 __UWORD_S 0 u_fac_2 0 1.999969482421875 FORMAT "%4.3" SYMBOL_LINK "EVAM_M_SM_LK_SLP_FAC" 62
 /begin AXIS_DESCR FIX_AXIS evam_flv_mmv u_pct_1 9 0 99.9984741210937 /begin FIX_AXIS_PAR_LIST 0 8192 16384 24576 32768 40960 49152 57344 65535 /end FIX_AXIS_PAR_LIST /end AXIS_DESCR
/end CHARACTERISTIC
/begin CHARACTERISTIC EVAM_C_SM_LK_SLP_FAC4 "small leak slope factor 4" CURVE 0x000200B0 __UWORD_S 0 u_fac_2 0 1.999969482421875 FORMAT "%4.3" SYMBOL_LINK "EVAM_M_SM_LK_SLP_FAC" 82
 /begin AXIS_DESCR FIX_AXIS evam_flv_mmv u_pct_1 9 0 99.9984741210937 /begin FIX_AXIS_PAR_LIST 0 8192 16384 24576 32768 40960 49152 57344 65535 /end FIX_AXIS_PAR_LIST /end AXIS_DESCR
/end CHARACTERISTIC
/begin CHARACTERISTIC EVAM_C_SM_LK_SLP_FAC5 "small leak slope factor 5" CURVE 0x000200B0 __UWORD_S 0 u_fac_2 0 1.999969482421875 FORMAT "%4.3" SYMBOL_LINK "EVAM_M_SM_LK_SLP_FAC" 102
 /begin AXIS_DESCR FIX_AXIS evam_flv_mmv u_pct_1 9 0 99.9984741210937 /begin FIX_AXIS_PAR_LIST 0 8192 16384 24576 32768 40960 49152 57344 65535 /end FIX_AXIS_PAR_LIST /end AXIS_DESCR
/end CHARACTERISTIC
/begin CHARACTERISTIC EVAM_C_SM_LK_SLP_FAC6 "small leak slope factor 6" CURVE 0x000200B0 __UWORD_S 0 u_fac_2 0 1.999969482421875 FORMAT "%4.3" SYMBOL_LINK "EVAM_M_SM_LK_SLP_FAC" 122
 /begin AXIS_DESCR FIX_AXIS evam_flv_mmv u_pct_1 9 0 99.9984741210937 /begin FIX_AXIS_PAR_LIST 0 8192 16384 24576 32768 40960 49152 57344 65535 /end FIX_AXIS_PAR_LIST /end AXIS_DESCR
/end CHARACTERISTIC
/begin CHARACTERISTIC EVAM_C_SM_LK_SLP_FAC7 "small leak slope factor 7" CURVE 0x000200B0 __UWORD_S 0 u_fac_2 0 1.999969482421875 FORMAT "%4.3" SYMBOL_LINK "EVAM_M_SM_LK_SLP_FAC" 142
 /begin AXIS_DESCR FIX_AXIS evam_flv_mmv u_pct_1 9 0 99.9984741210937 /begin FIX_AXIS_PAR_LIST 0 8192 16384 24576 32768 40960 49152 57344 65535 /end FIX_AXIS_PAR_LIST /end AXIS_DESCR
/end CHARACTERISTIC
/begin CHARACTERISTIC EVAM_C_SM_LK_SLP_FAC8 "small leak slope factor 8" CURVE 0x000200B0 __UWORD_S 0 u_fac_2 0 1.999969482421875 FORMAT "%4.3" SYMBOL_LINK "EVAM_M_SM_LK_SLP_FAC" 162
 /begin AXIS_DESCR FIX_AXIS evam_flv_mmv u_pct_1 9 0 99.9984741210937 /begin FIX_AXIS_PAR_LIST 0 8192 16384 24576 32768 40960 49152 57344 65535 /end FIX_AXIS_PAR_LIST /end AXIS_DESCR
/end CHARACTERISTIC
/begin CHARACTERISTIC EVAM_V_SM_LK_SLP_INC_THR "small leak vac slope increase high thr" VALUE 0x0002038C __SWORD_S 0 u_kPaSec_c -8 7.999755859375 FORMAT "%4.3" /end CHARACTERISTIC
/begin CHARACTERISTIC EVAM_V_VSM_LK_SLP_CAL_NUM "very small leak slope calculate num" VALUE 0x0002038C __UBYTE_S 0 u_cnts 0 8 FORMAT "%1.0" /end CHARACTERISTIC
/begin CHARACTERISTIC EVAM_V_VSM_LK_DCY_DUR "very small leak decay duration" VALUE 0x0002038C __UWORD_S 0 u_16x_tmr 0 8191.875 /end CHARACTERISTIC
/begin CHARACTERISTIC EVAM_V_VSM_LK_EOL_DCY_DUR "eol very small leak decay duration" VALUE 0x0002038C __UWORD_S 0 u_16x_tmr 0 8191.875 /end CHARACTERISTIC
/begin CHARACTERISTIC EVAM_V_VSM_LK_SLP_INC_THR "very small leak vac slope increase high thr" VALUE 0x0002038C __SWORD_S 0 u_kPaSec_c -8 7.999755859375 FORMAT "%4.3" /end CHARACTERISTIC
/begin CHARACTERISTIC EVAM_V_VAP_EN_VAC_MAX "vapor generation test enable vac max" VALUE 0x0002038C __SWORD_S 0 u_kPa_8n_8p -8 7.999755859375 FORMAT "%4.3" /end CHARACTERISTIC
/begin CHARACTERISTIC EVAM_V_VAP_GEN_DLY "vapor generation delay" VALUE 0x0002038C __UWORD_S 0 u_16x_tmr 0 8191.875 /end CHARACTERISTIC
/begin CHARACTERISTIC EVAM_C_VAC_LOW_DLY "vac low condition met delay" CURVE 0x000200B0 __UWORD_S 0 u_16x_tmr 0 8191.875 SYMBOL_LINK "EVAM_C_VAC_LOW_DLY" 2
 /begin AXIS_DESCR FIX_AXIS evam_vap_est_temp u_deg_C 17 0 48
  /begin FIX_AXIS_PAR_LIST 0 384 768 1152 1536 1920 2304 2688 3072 3456 3840 4224 4608 4992 5376 5760 6144 /end FIX_AXIS_PAR_LIST
 /end AXIS_DESCR
/end CHARACTERISTIC
/begin CHARACTERISTIC EVAM_V_VAP_LOG_DUR "vapor data log duration" VALUE 0x0002038C __UWORD_S 0 u_16x_tmr 0 8191.875 /end CHARACTERISTIC
/begin CHARACTERISTIC EVAM_V_VAP_LOG_EN_VAC "vapor generation test log enable vac" VALUE 0x0002038C __SWORD_S 0 u_kPa_8n_8p -8 7.999755859375 FORMAT "%4.3" /end CHARACTERISTIC
/begin CHARACTERISTIC EVAM_V_VAP_EXT_VAC "vapor exit vac" VALUE 0x0002038C __SWORD_S 0 u_kPa_8n_8p -8 7.999755859375 FORMAT "%4.3" /end CHARACTERISTIC
/begin CHARACTERISTIC EVAM_V_SM_VAP_SLP_DLY "vapor generation slope cal delay" VALUE 0x0002038C __UWORD_S 0 u_16x_tmr 0 8191.875 /end CHARACTERISTIC
/begin CHARACTERISTIC EVAM_V_VSM_VAP_SLP_DLY "vapor generation slope cal delay" VALUE 0x0002038C __UWORD_S 0 u_16x_tmr 0 8191.875 /end CHARACTERISTIC
/begin CHARACTERISTIC EVAM_C_SM_VAP_SLP_MAX "small leak vap slope max" CURVE 0x000200B0 __SWORD_S 0 u_kPaSec_c -8 7.999755859375 FORMAT "%3.2" SYMBOL_LINK "EVAM_C_SM_VAP_SLP_MAX" 2
 /begin AXIS_DESCR FIX_AXIS evam_flv_mmv u_pct_1 9 0 99.9984741210937 /begin FIX_AXIS_PAR_LIST 0 8192 16384 24576 32768 40960 49152 57344 65535 /end FIX_AXIS_PAR_LIST /end AXIS_DESCR
/end CHARACTERISTIC
/begin CHARACTERISTIC EVAM_V_SM_VAP_SLP_FAC "small leak vap slope factor" VALUE 0x0002038C __UWORD_S 0 u_fac_1 0 0.999984741210937 /end CHARACTERISTIC
/begin CHARACTERISTIC EVAM_V_SM_PV_SLP_FAC "small leak vap slope factor" VALUE 0x0002038C __UWORD_S 0 u_fac_1 0 0.999984741210937 /end CHARACTERISTIC
/begin CHARACTERISTIC EVAM_C_VSM_VAP_SLP_MAX "very small leak vap slope max" CURVE 0x000200B0 __SWORD_S 0 u_kPaSec_c -8 7.999755859375 FORMAT "%3.2" SYMBOL_LINK "EVAM_C_SM_VAP_SLP_MAX" 2
 /begin AXIS_DESCR FIX_AXIS evam_flv_mmv u_pct_1 9 0 99.9984741210937 /begin FIX_AXIS_PAR_LIST 0 8192 16384 24576 32768 40960 49152 57344 65535 /end FIX_AXIS_PAR_LIST /end AXIS_DESCR
/end CHARACTERISTIC
/begin CHARACTERISTIC EVAM_V_VSM_VAP_SLP_FAC "very small leak vap slope factor" VALUE 0x0002038C __UWORD_S 0 u_fac_1 0 0.999984741210937 /end CHARACTERISTIC
/begin CHARACTERISTIC EVAM_V_VSM_PV_SLP_FAC "small leak vap slope factor" VALUE 0x0002038C __UWORD_S 0 u_fac_1 0 0.999984741210937 /end CHARACTERISTIC
/begin CHARACTERISTIC EVAM_V_CAP_OPN_RST_FLW "cap open rest flow" VALUE 0x0002038C __UWORD_S 0 u_g_per_sec_16 0.0 15.999756 /end CHARACTERISTIC
/begin CHARACTERISTIC EVAM_V_CAP_OPN_RST_CONC "cap open rest concentration" VALUE 0x0002038C __UWORD_S 0 u_pct 0 199.99694824219 /end CHARACTERISTIC
/begin CHARACTERISTIC EVAM_V_LRG_LK_PSS_VAC "larg leak pass vac" VALUE 0x0002038C __SWORD_S 0 u_kPa_8n_8p -8 7.999755859375 FORMAT "%4.3" /end CHARACTERISTIC
/begin CHARACTERISTIC EVAM_V_LRG_LK_PSS_DLY "large leak pass delay" VALUE 0x0002038C __UWORD_S 0 u_16x_tmr 0 8191.875 /end CHARACTERISTIC
/begin CHARACTERISTIC EVAM_V_WRM_LRG_RST_CNTS "warm large leak rest counts" VALUE 0x0002038C __UWORD_S 0 u_cnts 0 65535 FORMAT "%5.0" /end CHARACTERISTIC
/begin CHARACTERISTIC EVAM_V_VNT_BLK_EOL_PSS_VAC "vent block pass eol vac" VALUE 0x0002038C __SWORD_S 0 u_kPa_8n_8p -8 7.999755859375 FORMAT "%4.3" /end CHARACTERISTIC
/begin CHARACTERISTIC EVAM_V_VNT_BLK_INIT_VAC "vent block init vac" VALUE 0x0002038C __SWORD_S 0 u_kPa_8n_8p -8 7.999755859375 FORMAT "%4.3" /end CHARACTERISTIC
/begin CHARACTERISTIC EVAM_V_VNT_BLK_DLY "vent block delay" VALUE 0x0002038C __UWORD_S 0 u_16x_tmr 0 8191.875 /end CHARACTERISTIC
/begin CHARACTERISTIC EVAM_V_VNT_BLK_DUR_MAX "vent block test duration max" VALUE 0x0002038C __UWORD_S 0 u_16x_tmr 0 8191.875 /end CHARACTERISTIC
/begin CHARACTERISTIC EVAM_V_VNT_BLK_VAC_MAX "vent block fail vac max" VALUE 0x0002038C __SWORD_S 0 u_kPa_8n_8p -8 7.999755859375 FORMAT "%4.3" /end CHARACTERISTIC
/begin CHARACTERISTIC EVAM_V_VNT_BLK_FL_DLY "vent block fail delay" VALUE 0x0002038C __UWORD_S 0 u_16x_tmr 0 8191.875 /end CHARACTERISTIC
/begin CHARACTERISTIC EVAM_V_VNT_BLK_PSS_INT "vent block pass int counts" VALUE 0x0002038C __UWORD_S 0 u_cnts 0 65535 FORMAT "%5.0" /end CHARACTERISTIC
/begin CHARACTERISTIC EVAM_C_VAC_INT_MNFD_FAC "vac int manifold vac factor" CURVE 0x000200B0 __UWORD_S 0 u_fac_1 0 0.9999847412109375 SYMBOL_LINK "EVAM_C_VAC_INT_MNFD_FAC" 2
 /begin AXIS_DESCR FIX_AXIS sys_im_vac u_kPa_128n_128p 17 -128 127.99609375
  /begin FIX_AXIS_PAR_LIST 0 1280 2560 3840 5120 6400 7680 8960 10240 11520 12800 14080 15360 16640 17920 19200 20480 /end FIX_AXIS_PAR_LIST
 /end AXIS_DESCR
/end CHARACTERISTIC
/begin CHARACTERISTIC EVAM_V_VAC_INT_PV_DC_FAC "purge valve leak test vac int duty cycle factor" VALUE 0x0002038C __UWORD_S 0 u_fac_1 0 0.9999847412109375 /end CHARACTERISTIC
/begin CHARACTERISTIC EVAM_C_VAC_INT_DC_FAC "vac int duty cycle factor" CURVE 0x000200B0 __UWORD_S 0 u_fac_1 0 0.9999847412109375 SYMBOL_LINK "EVAM_C_VAC_INT_DC_FAC" 2
 /begin AXIS_DESCR FIX_AXIS evac_dc u_pct 17 0.0 100
  /begin FIX_AXIS_PAR_LIST 0 2048 4096 6144 8192 10240 12288 14336 16384 18432 20480 22528 24576 26624 28672 30720 32768 /end FIX_AXIS_PAR_LIST
 /end AXIS_DESCR
/end CHARACTERISTIC
/begin CHARACTERISTIC EVAM_V_MNFD_VAC_LO_THR "manifold vac low thr" VALUE 0x0002038C __SWORD_S 0 u_kPa_128n_128p -128 127.99609375 /end CHARACTERISTIC
/begin CHARACTERISTIC EVAM_V_PG_DC_LO_THR "purge valve duty cycle low thr" VALUE 0x0002038C __UWORD_S 0 u_pct 0 199.996948242187 /end CHARACTERISTIC
/begin CHARACTERISTIC EVAM_C_VAC_INT_IAT_FAC "vac int iat factor" CURVE 0x000200B0 __UWORD_S 0 u_fac_1 0 0.9999847412109375 SYMBOL_LINK "EVAM_C_VAC_INT_IAT_FAC" 2
 /begin AXIS_DESCR FIX_AXIS sys_keyon_iat u_deg_C 17 0 48
  /begin FIX_AXIS_PAR_LIST 0 384 768 1152 1536 1920 2304 2688 3072 3456 3840 4224 4608 4992 5376 5760 6144 /end FIX_AXIS_PAR_LIST
 /end AXIS_DESCR
/end CHARACTERISTIC
/begin CHARACTERISTIC EVAM_C_SM_LK_DCY_SLP "small leak decay slope" CURVE 0x000200B0 __SWORD_S 0 u_kPaSec_c -8 7.999755859375 FORMAT "%3.2" SYMBOL_LINK "EVAM_C_SM_LK_DCY_SLP" 2
 /begin AXIS_DESCR FIX_AXIS evam_flv_mmv u_pct_1 17 0 99.9984741210937
  /begin FIX_AXIS_PAR_LIST 0 4096 8192 12288 16384 20480 24576 28672 32768 36864 40960 45056 49152 53248 57344 61440 65535 /end FIX_AXIS_PAR_LIST
 /end AXIS_DESCR
/end CHARACTERISTIC
/begin CHARACTERISTIC EVAM_C_SM_LK_SLP_TEMP_FAC "small leak decay slope" CURVE 0x000200B0 __SWORD_S 0 u_fac_n256_p256 0 255 SYMBOL_LINK "EVAM_C_SM_LK_SLP_TEMP_FAC" 2
 /begin AXIS_DESCR FIX_AXIS evam_vap_est_temp u_deg_C 11 -256 255.9921875 /begin FIX_AXIS_PAR_LIST 0 512 1024 1536 2048 2560 3072 3584 4096 4608 5120 /end FIX_AXIS_PAR_LIST /end AXIS_DESCR
/end CHARACTERISTIC
/begin CHARACTERISTIC EVAM_C_SM_LK_EOL_DCY_SLP "small leak eol decay slope" CURVE 0x000200B0 __SWORD_S 0 u_kPaSec_c -8 7.999755859375 FORMAT "%3.2" SYMBOL_LINK "EVAM_C_SM_LK_EOL_DCY_SLP" 2
 /begin AXIS_DESCR FIX_AXIS evam_flv_mmv u_pct_1 17 0 99.9984741210937
  /begin FIX_AXIS_PAR_LIST 0 4096 8192 12288 16384 20480 24576 28672 32768 36864 40960 45056 49152 53248 57344 61440 65535 /end FIX_AXIS_PAR_LIST
 /end AXIS_DESCR
/end CHARACTERISTIC
/begin CHARACTERISTIC EVAM_C_VSM_LK_DCY_SLP "very small leak decay slope" CURVE 0x000200B0 __SWORD_S 0 u_kPaSec_c -8 7.999755859375 FORMAT "%3.2" SYMBOL_LINK "EVAM_C_VSM_LK_DCY_SLP" 2
 /begin AXIS_DESCR FIX_AXIS evam_flv_mmv u_pct_1 17 0 99.9984741210937
  /begin FIX_AXIS_PAR_LIST 0 4096 8192 12288 16384 20480 24576 28672 32768 36864 40960 45056 49152 53248 57344 61440 65535 /end FIX_AXIS_PAR_LIST
 /end AXIS_DESCR
/end CHARACTERISTIC
/begin CHARACTERISTIC EVAM_C_VSM_LK_SLP_TEMP_FAC "very small leak decay slope" CURVE 0x000200B0 __SWORD_S 0 u_fac_n256_p256 0 255 SYMBOL_LINK "EVAM_C_VSM_LK_SLP_TEMP_FAC" 2
 /begin AXIS_DESCR FIX_AXIS evam_vap_est_temp u_deg_C 11 -256 255.9921875 /begin FIX_AXIS_PAR_LIST 0 512 1024 1536 2048 2560 3072 3584 4096 4608 5120 /end FIX_AXIS_PAR_LIST /end AXIS_DESCR
/end CHARACTERISTIC
/begin CHARACTERISTIC EVAM_C_VSM_LK_EOL_DCY_SLP "very small leak eol decay slope" CURVE 0x000200B0 __SWORD_S 0 u_kPaSec_c -8 7.999755859375 FORMAT "%3.2" SYMBOL_LINK "EVAM_C_VSM_LK_EOL_DCY_SLP" 2
 /begin AXIS_DESCR FIX_AXIS evam_flv_mmv u_pct_1 17 0 99.9984741210937
  /begin FIX_AXIS_PAR_LIST 0 4096 8192 12288 16384 20480 24576 28672 32768 36864 40960 45056 49152 53248 57344 61440 65535 /end FIX_AXIS_PAR_LIST
 /end AXIS_DESCR
/end CHARACTERISTIC
/begin CHARACTERISTIC EVAM_C_VAP_TEMP_BIAS "vap est temp bias" CURVE 0x000200B0 __SWORD_S 0 u_deg_C -256 255.9921875 SYMBOL_LINK "EVAM_C_VAP_TEMP_BIAS" 2
 /begin AXIS_DESCR FIX_AXIS sys_eng_rtm_nv u_1s_tmr 11 0 400 /begin FIX_AXIS_PAR_LIST 0 40 80 120 160 200 240 280 320 360 400 /end FIX_AXIS_PAR_LIST /end AXIS_DESCR
/end CHARACTERISTIC
/begin CHARACTERISTIC EVAM_V_CAP_OPN_TMS_MAX "cap open times max" VALUE 0x0002038C __UBYTE_S 0 u_cnts 0 255 /end CHARACTERISTIC
/begin CHARACTERISTIC EVAM_V_PV_LK_HYB_DIS_TMS "purge valve leak hybrid stop disable test times" VALUE 0x0002038C __UBYTE_S 0 u_cnts 0 8 FORMAT "%1.0" /end CHARACTERISTIC
/begin CHARACTERISTIC EVAM_V_PV_LK_HYB_DIS_EN "purge valve leak hybrid stop disable enable" VALUE 0x0002038C __UBYTE_S 0 b_true 0 1 FORMAT "%1.0" /end CHARACTERISTIC
/begin CHARACTERISTIC EVAM_V_VAC_SP "tank vacuum setpoint" VALUE 0x0002038C __SWORD_S 0 u_kPa_8n_8p -8 7.999755859375 FORMAT "%4.3" /end CHARACTERISTIC
/begin CHARACTERISTIC EVAM_V_EOL_VAC_SP "eol tank vacuum setpoint" VALUE 0x0002038C __SWORD_S 0 u_kPa_8n_8p -8 7.999755859375 FORMAT "%4.3" /end CHARACTERISTIC
/begin CHARACTERISTIC EVAM_V_PG_FLW_SP "purge flow setpoint" VALUE 0x0002038C __UWORD_S 0 u_g_per_sec_16 0 15.999756 /end CHARACTERISTIC
/begin CHARACTERISTIC EVAM_V_VNT_CLS_DUR "vent valve close duration" VALUE 0x0002038C __UWORD_S 0 u_16x_tmr 0 8191.875 /end CHARACTERISTIC
/begin CHARACTERISTIC EVAM_V_VNT_CTRL_DUR "vent valve open duration" VALUE 0x0002038C __UWORD_S 0 u_16x_tmr 0 8191.875 /end CHARACTERISTIC
/begin CHARACTERISTIC EVAM_V_VNT_TGGL_TMS "vent valve toggle times" VALUE 0x0002038C __UBYTE_S 0 u_cnts 0 255 /end CHARACTERISTIC
/begin CHARACTERISTIC EVAM_V_AMB_T_HI_IAT "ambient temp high IAT" VALUE 0x0002038C __SWORD_S 0 u_deg_C -256 255.9921875 /end CHARACTERISTIC
/begin CHARACTERISTIC EVAM_V_AMB_T_HI_DLT "ambient temp high temp delta" VALUE 0x0002038C __SWORD_S 0 u_deg_C -256 255.9921875 /end CHARACTERISTIC
/begin CHARACTERISTIC EVAM_V_CAP_OPN_RPT_MAX "cap open report times max" VALUE 0x0002038C __UBYTE_S 0 u_cnts 0 255 /end CHARACTERISTIC
/begin CHARACTERISTIC EVAM_V_SRV_VSM_ECT "service very small leak test enable keyon ect" VALUE 0x0002038C __SWORD_S 0 u_deg_C -256 255.9921875 /end CHARACTERISTIC
/begin CHARACTERISTIC EVAM_V_SRV_SM_ECT "service small leak test enable keyon ect" VALUE 0x0002038C __SWORD_S 0 u_deg_C -256 255.9921875 /end CHARACTERISTIC
/begin CHARACTERISTIC EVAM_V_SRV_SM_FLV_HI "service small leak test enable fuel level high" VALUE 0x379E4 __UWORD_S 0 u_pct_1 0 99.9984741210937 FORMAT "%5.3" /end CHARACTERISTIC
/begin CHARACTERISTIC EVAM_V_SRV_SM_FLV_LO "service small leak test enable fuel level low" VALUE 0x379E4 __UWORD_S 0 u_pct_1 0 99.9984741210937 FORMAT "%5.3" /end CHARACTERISTIC
/begin CHARACTERISTIC EVAM_V_SRV_VSM_FLV_HI "service very small leak test enable fuel level high" VALUE 0x379E4 __UWORD_S 0 u_pct_1 0 99.9984741210937 FORMAT "%5.3" /end CHARACTERISTIC
/begin CHARACTERISTIC EVAM_V_SRV_VSM_FLV_LO "service very small leak test enable fuel level low" VALUE 0x379E4 __UWORD_S 0 u_pct_1 0 99.9984741210937 FORMAT "%5.3" /end CHARACTERISTIC
/begin CHARACTERISTIC EVAM_V_TNK_PROT_VAC "tank protect vac" VALUE 0x0002038C __SWORD_S 0 u_kPa_8n_8p -8 7.999755859375 FORMAT "%4.3" /end CHARACTERISTIC
/begin CHARACTERISTIC EVAM_V_TNK_PROT_DLY "tank protect delay" VALUE 0x0002038C __UBYTE_S 0 u_16x_tmr 0 31.875 FORMAT "%4.2" /end CHARACTERISTIC
/begin CHARACTERISTIC EVAM_V_TNK_PROT_FLT_DLY "tank protect delay use filtered tank press" VALUE 0x0002038C __UBYTE_S 0 u_16x_tmr 0 31.875 FORMAT "%4.2" /end CHARACTERISTIC
/begin CHARACTERISTIC EVAM_V_TNK_PROT_FLV_MAX "tank protect fuel level max" VALUE 0x379E4 __UWORD_S 0 u_pct_1 0 99.9984741210937 FORMAT "%5.3" /end CHARACTERISTIC
/begin CHARACTERISTIC EVAM_V_TNK_PROT_PSS_FLW "tank protect pass flow" VALUE 0x0002038C __UWORD_S 0 u_g_per_sec_64 0 63.9990234375 FORMAT "%4.3" /end CHARACTERISTIC
/begin CHARACTERISTIC EVAM_V_TNK_PROT_PSS_DLY "tank protect pass delay" VALUE 0x0002038C __UBYTE_S 0 u_16x_tmr 0 31.875 FORMAT "%4.2" /end CHARACTERISTIC
/begin CHARACTERISTIC EVAM_V_TNK_PROT_PRES_MAX "tank protect vac max" VALUE 0x0002038C __SWORD_S 0 u_kPa_8n_8p -8 7.999755859375 FORMAT "%4.3" /end CHARACTERISTIC
/begin CHARACTERISTIC EVAM_V_TNK_VAC_LRN_DLY "vac learn delay" VALUE 0x0002038C __UWORD_S 0 u_16x_tmr 0 8191.875 /end CHARACTERISTIC
/begin CHARACTERISTIC EVAM_V_TNK_VAC_BIAS "tank vac learn bias" VALUE 0x0002038C __SWORD_S 0 u_kPa_8n_8p -8 7.999755859375 FORMAT "%4.3" /end CHARACTERISTIC
/begin CHARACTERISTIC EVAM_V_VAC_LRN_LO "tank vac learn low" VALUE 0x0002038C __SWORD_S 0 u_kPa_8n_8p -8 7.999755859375 FORMAT "%4.3" /end CHARACTERISTIC
/begin CHARACTERISTIC EVAM_V_VAC_LRN_HI "tank vac learn high" VALUE 0x0002038C __SWORD_S 0 u_kPa_8n_8p -8 7.999755859375 FORMAT "%4.3" /end CHARACTERISTIC
/begin CHARACTERISTIC EVAM_V_TNK_VAC_FIL "tank vac filter" VALUE 0x0002038C __UWORD_S 0 u_filter 0 0.9999847412109375 FORMAT "%10.9" /end CHARACTERISTIC
/begin CHARACTERISTIC EVAM_V_SRV_PRESET_DUR_MIN "preset duration min" VALUE 0x0002038C __UWORD_S 0 u_16x_tmr 0 8191.875 /end CHARACTERISTIC
/begin CHARACTERISTIC EVAM_V_PV_LK_VAC_EOL_INT "purge valve leak vac int eol thr" VALUE 0x0002038C __ULONG_S 0 u_cnts 0 4294967295 FORMAT "%10.0" /end CHARACTERISTIC
/begin CHARACTERISTIC EVAM_C_PV_LK_VAC_INT "purge valve leak vac int thr" CURVE 0x000200B0 __UWORD_S 0 u_cnts 0 65535 FORMAT "%5.0" SYMBOL_LINK "EVAM_C_PV_LK_VAC_INT" 2
 /begin AXIS_DESCR FIX_AXIS evam_flv_mmv u_pct_1 17 0 99.9984741210937
  /begin FIX_AXIS_PAR_LIST 0 4096 8192 12288 16384 20480 24576 28672 32768 36864 40960 45056 49152 53248 57344 61440 65535 /end FIX_AXIS_PAR_LIST
 /end AXIS_DESCR
/end CHARACTERISTIC
/begin CHARACTERISTIC EVAM_C_PV_LK_INT_IAT_FAC "vac int iat factor" CURVE 0x000200B0 __UWORD_S 0 u_fac_2 0 1.999969482421875 FORMAT "%4.3" SYMBOL_LINK "EVAM_C_PV_LK_INT_IAT_FAC" 2
 /begin AXIS_DESCR FIX_AXIS sys_keyon_iat u_deg_C 17 0 48
  /begin FIX_AXIS_PAR_LIST 0 384 768 1152 1536 1920 2304 2688 3072 3456 3840 4224 4608 4992 5376 5760 6144 /end FIX_AXIS_PAR_LIST
 /end AXIS_DESCR
/end CHARACTERISTIC
/begin CHARACTERISTIC EVAM_C_VSM_LK_SRV_DCY_SLP "very small leak service decay slope" CURVE 0x000200B0 __SWORD_S 0 u_kPaSec_c -8 7.999755859375 FORMAT "%3.2" SYMBOL_LINK "EVAM_C_VSM_LK_SRV_DCY_SLP" 2
 /begin AXIS_DESCR FIX_AXIS evam_flv_mmv u_pct_1 17 0 99.9984741210937
  /begin FIX_AXIS_PAR_LIST 0 4096 8192 12288 16384 20480 24576 28672 32768 36864 40960 45056 49152 53248 57344 61440 65535 /end FIX_AXIS_PAR_LIST
 /end AXIS_DESCR
/end CHARACTERISTIC
/begin CHARACTERISTIC EVAM_C_VSM_LK_SLP_FAC0 "very small leak slope factor 0" CURVE 0x000200B0 __UWORD_S 0 u_fac_2 0 1.999969482421875 FORMAT "%4.3" SYMBOL_LINK "EVAM_M_VSM_LK_SLP_FAC" 2
 /begin AXIS_DESCR FIX_AXIS evam_flv_mmv u_pct_1 9 0 99.9984741210937 /begin FIX_AXIS_PAR_LIST 0 8192 16384 24576 32768 40960 49152 57344 65535 /end FIX_AXIS_PAR_LIST /end AXIS_DESCR
/end CHARACTERISTIC
/begin CHARACTERISTIC EVAM_C_VSM_LK_SLP_FAC1 "very small leak slope factor 1" CURVE 0x000200B0 __UWORD_S 0 u_fac_2 0 1.999969482421875 FORMAT "%4.3" SYMBOL_LINK "EVAM_M_VSM_LK_SLP_FAC" 22
 /begin AXIS_DESCR FIX_AXIS evam_flv_mmv u_pct_1 9 0 99.9984741210937 /begin FIX_AXIS_PAR_LIST 0 8192 16384 24576 32768 40960 49152 57344 65535 /end FIX_AXIS_PAR_LIST /end AXIS_DESCR
/end CHARACTERISTIC
/begin CHARACTERISTIC EVAM_C_VSM_LK_SLP_FAC2 "very small leak slope factor 2" CURVE 0x000200B0 __UWORD_S 0 u_fac_2 0 1.999969482421875 FORMAT "%4.3" SYMBOL_LINK "EVAM_M_VSM_LK_SLP_FAC" 42
 /begin AXIS_DESCR FIX_AXIS evam_flv_mmv u_pct_1 9 0 99.9984741210937 /begin FIX_AXIS_PAR_LIST 0 8192 16384 24576 32768 40960 49152 57344 65535 /end FIX_AXIS_PAR_LIST /end AXIS_DESCR
/end CHARACTERISTIC
/begin CHARACTERISTIC EVAM_C_VSM_LK_SLP_FAC3 "very small leak slope factor 3" CURVE 0x000200B0 __UWORD_S 0 u_fac_2 0 1.999969482421875 FORMAT "%4.3" SYMBOL_LINK "EVAM_M_VSM_LK_SLP_FAC" 62
 /begin AXIS_DESCR FIX_AXIS evam_flv_mmv u_pct_1 9 0 99.9984741210937 /begin FIX_AXIS_PAR_LIST 0 8192 16384 24576 32768 40960 49152 57344 65535 /end FIX_AXIS_PAR_LIST /end AXIS_DESCR
/end CHARACTERISTIC
/begin CHARACTERISTIC EVAM_C_VSM_LK_SLP_FAC4 "very small leak slope factor 4" CURVE 0x000200B0 __UWORD_S 0 u_fac_2 0 1.999969482421875 FORMAT "%4.3" SYMBOL_LINK "EVAM_M_VSM_LK_SLP_FAC" 82
 /begin AXIS_DESCR FIX_AXIS evam_flv_mmv u_pct_1 9 0 99.9984741210937 /begin FIX_AXIS_PAR_LIST 0 8192 16384 24576 32768 40960 49152 57344 65535 /end FIX_AXIS_PAR_LIST /end AXIS_DESCR
/end CHARACTERISTIC
/begin CHARACTERISTIC EVAM_C_VSM_LK_SLP_FAC5 "very small leak slope factor 5" CURVE 0x000200B0 __UWORD_S 0 u_fac_2 0 1.999969482421875 FORMAT "%4.3" SYMBOL_LINK "EVAM_M_VSM_LK_SLP_FAC" 102
 /begin AXIS_DESCR FIX_AXIS evam_flv_mmv u_pct_1 9 0 99.9984741210937 /begin FIX_AXIS_PAR_LIST 0 8192 16384 24576 32768 40960 49152 57344 65535 /end FIX_AXIS_PAR_LIST /end AXIS_DESCR
/end CHARACTERISTIC
/begin CHARACTERISTIC EVAM_C_VSM_LK_SLP_FAC6 "very small leak slope factor 6" CURVE 0x000200B0 __UWORD_S 0 u_fac_2 0 1.999969482421875 FORMAT "%4.3" SYMBOL_LINK "EVAM_M_VSM_LK_SLP_FAC" 122
 /begin AXIS_DESCR FIX_AXIS evam_flv_mmv u_pct_1 9 0 99.9984741210937 /begin FIX_AXIS_PAR_LIST 0 8192 16384 24576 32768 40960 49152 57344 65535 /end FIX_AXIS_PAR_LIST /end AXIS_DESCR
/end CHARACTERISTIC
/begin CHARACTERISTIC EVAM_C_VSM_LK_SLP_FAC7 "very small leak slope factor 7" CURVE 0x000200B0 __UWORD_S 0 u_fac_2 0 1.999969482421875 FORMAT "%4.3" SYMBOL_LINK "EVAM_M_VSM_LK_SLP_FAC" 142
 /begin AXIS_DESCR FIX_AXIS evam_flv_mmv u_pct_1 9 0 99.9984741210937 /begin FIX_AXIS_PAR_LIST 0 8192 16384 24576 32768 40960 49152 57344 65535 /end FIX_AXIS_PAR_LIST /end AXIS_DESCR
/end CHARACTERISTIC
/begin CHARACTERISTIC EVAM_C_VSM_LK_SLP_FAC8 "very small leak slope factor 8" CURVE 0x000200B0 __UWORD_S 0 u_fac_2 0 1.999969482421875 FORMAT "%4.3" SYMBOL_LINK "EVAM_M_VSM_LK_SLP_FAC" 162
 /begin AXIS_DESCR FIX_AXIS evam_flv_mmv u_pct_1 9 0 99.9984741210937 /begin FIX_AXIS_PAR_LIST 0 8192 16384 24576 32768 40960 49152 57344 65535 /end FIX_AXIS_PAR_LIST /end AXIS_DESCR
/end CHARACTERISTIC
/begin CHARACTERISTIC EVAM_V_VNT_BLK_VAC_HI "vent block test tank vac high" VALUE 0x0002038C __SWORD_S 0 u_kPa_8n_8p -8 7.999755859375 FORMAT "%4.3" /end CHARACTERISTIC
/begin CHARACTERISTIC EVAM_V_VNT_BLK_VAC_LO "vent block test tank vac high low" VALUE 0x0002038C __SWORD_S 0 u_kPa_8n_8p -8 7.999755859375 FORMAT "%4.3" /end CHARACTERISTIC
/begin CHARACTERISTIC EVAM_V_CAP_OPN_RSTRT_VSPD "cap open restart vehicle speed threshold" VALUE 0x0002038C __UWORD_S 0 u_vspd 0 511.992188 FORMAT "%4.1" /end CHARACTERISTIC
/begin CHARACTERISTIC EVAM_V_CAP_OPN_RSTRT_DLY "cap open restart delay" VALUE 0x0002038C __UBYTE_S 0 u_16x_tmr 0 31.875 FORMAT "%4.2" /end CHARACTERISTIC
/begin CHARACTERISTIC EVAM_V_CAP_OPN_INIT_TST_DIS "cap open initial test disable" VALUE 0x0002038C __UBYTE_S 0 b_true 0 1 FORMAT "%5.2" /end CHARACTERISTIC
/begin CHARACTERISTIC EVAM_V_CAP_OPN_TST_VSPD "cap open test vehicle speed threshold" VALUE 0x0002038C __UWORD_S 0 u_vspd 0 511.992188 FORMAT "%4.1" /end CHARACTERISTIC
/begin CHARACTERISTIC EVAM_V_CAP_OPN_TST_RUN "cap open test run min" VALUE 0x0002038C __UWORD_S 0 u_1s_tmr 0 65535 /end CHARACTERISTIC
/begin CHARACTERISTIC EVAM_V_CAP_OPN_PG_DLY "cap open purge enable delay" VALUE 0x0002038C __UBYTE_S 0 u_16x_tmr 0 31.875 FORMAT "%4.2" /end CHARACTERISTIC
/begin CHARACTERISTIC EVAM_V_CAP_OPN_TST_CON "cap open test concentration" VALUE 0x0002038C __UWORD_S 0 u_pct 0 199.996948 FORMAT "%4.1" /end CHARACTERISTIC
/begin CHARACTERISTIC EVAM_V_CAP_OPN_RST_VSPD "cap open test reset vehicle speed threshold" VALUE 0x0002038C __UWORD_S 0 u_vspd 0 511.992188 FORMAT "%4.1" /end CHARACTERISTIC
/begin CHARACTERISTIC EVAM_V_CAP_OPN_RST_DEC_VSPD "cap open test reset deceleration vehicle speed threshold" VALUE 0x0002038C __UWORD_S 0 u_vspd 0 511.992188 FORMAT "%4.1" /end CHARACTERISTIC
/begin CHARACTERISTIC EVAM_V_CAP_OPN_RST_DEC "cap open test reset deceleration threshold" VALUE 0x0002038C __SWORD_S 0 u_vspd_per_sec -64 63.998046875 FORMAT "%4.2" /end CHARACTERISTIC
/begin CHARACTERISTIC EVAM_V_CAP_OPN_RST_MAP_HI "cap open test reset amp map high" VALUE 0x0002038C __UWORD_S 0 u_kPa_0_256 0 255.99609375 FORMAT "%4.1" /end CHARACTERISTIC
/begin CHARACTERISTIC EVAM_V_CAP_OPN_RST_MAP_LO "cap open test reset amp map low" VALUE 0x0002038C __UWORD_S 0 u_kPa_0_256 0 255.99609375 FORMAT "%4.1" /end CHARACTERISTIC
/begin CHARACTERISTIC EVAM_V_CAP_OPN_RST_FLV "cap open reset fuel level" VALUE 0x379E4 __UWORD_S 0 u_pct_1 0 99.9984741210937 FORMAT "%5.3" /end CHARACTERISTIC
/begin CHARACTERISTIC EVAM_V_EN_EOL_RUN_MIN "diag enable run time min" VALUE 0x0002038C __UWORD_S 0 u_1s_tmr 0 65535 /end CHARACTERISTIC
/begin CHARACTERISTIC EVAM_V_CON_LRN_DIS_VAC "con learn disable tank vac" VALUE 0x0002038C __SWORD_S 0 u_kPa_8n_8p -8 7.999755859375 FORMAT "%4.3" /end CHARACTERISTIC
/begin CHARACTERISTIC COM_V_TRNS_DFLT_VSPD_LMT "Vehicle speed limit when transmission requests default mode." VALUE 0x0002038C __UWORD_S 0 u_vspd 0 511.9921875 FORMAT "%4.1" /end CHARACTERISTIC
/begin CHARACTERISTIC COM_V_TRNS_DFLT_ESPD_LMT "Engine speed limit when transmission requests default mode." VALUE 0x0002038C __UWORD_S 0 u_espd 0 8191.875000 FORMAT "%5.1" /end CHARACTERISTIC
/begin CHARACTERISTIC COM_V_TORQ_SP_PPS_THRSH "Pedal position above this value,then torque update is allowed." VALUE 0x0002038C __UWORD_S 0 u_pct_r 0 127.998046875 /end CHARACTERISTIC
/begin CHARACTERISTIC COM_V_TORQ_SP_DLY "Delay time for driver torque setpoint update." VALUE 0x0002038C __UWORD_S 0 u_1x_tmr 0 511.9921875 FORMAT "%5.2" /end CHARACTERISTIC
/begin CHARACTERISTIC COM_C_TORQ_SP_INIT "Initial driver torque setpoint value." CURVE 0x000200B0 __SWORD_S 0 u_tq -2048 2047.9375
 /begin AXIS_DESCR COM_AXIS NO_INPUT_QUANTITY u_espd_hi 21 0 12799.8046875 AXIS_PTS_REF COM_X_ESPD /end AXIS_DESCR
/end CHARACTERISTIC
/begin AXIS_PTS COM_X_ESPD "" 0x0002006C NO_INPUT_QUANTITY SSV__UWORD_S 0 u_espd_hi 21 0 12799.8046875 FORMAT "%6.1" DEPOSIT ABSOLUTE /end AXIS_PTS
/begin CHARACTERISTIC COM_C_FAN_DC "Fan duty cycle for different discrete state." CURVE 0x000200B0 __UWORD_S 0 u_fac_2 0 1.999969482421875 FORMAT "%4.3"
 /begin AXIS_DESCR FIX_AXIS NO_INPUT_QUANTITY u_fan_ctrl_typ 4 0 3 /begin FIX_AXIS_PAR_LIST 0 1 2 3 /end FIX_AXIS_PAR_LIST /end AXIS_DESCR
/end CHARACTERISTIC
/begin AXIS_PTS COM_X_LH_ESPD "engine speed axis " 0x0002006C sys_eng_spd SSV__UWORD_S 0 u_espd 8 0 8191.875 FORMAT "%6.2" DEPOSIT ABSOLUTE SYMBOL_LINK "COM_X_LH_ESPD" 2 /end AXIS_PTS
/begin AXIS_PTS COM_X_LH_VSPD "vehicle speed axis " 0x0002006C sys_veh_spd SSV__UWORD_S 0 u_vspd 8 0 511.9921875 DEPOSIT ABSOLUTE SYMBOL_LINK "COM_X_LH_VSPD" 2 /end AXIS_PTS
/begin CHARACTERISTIC COM_M_TMS_LH_MX_TORQ "Engine limit torque when TCM CAN communication fails." MAP 0x2091C __SWORD_S 0 u_tq -2048 2047.9375 SYMBOL_LINK "COM_M_TMS_LH_MX_TORQ" 4
 /begin AXIS_DESCR COM_AXIS sys_veh_spd u_vspd 8 0 511.9921875 AXIS_PTS_REF COM_X_LH_VSPD /end AXIS_DESCR
 /begin AXIS_DESCR COM_AXIS sys_eng_spd u_espd 8 0 8191.875 AXIS_PTS_REF COM_X_LH_ESPD /end AXIS_DESCR
/end CHARACTERISTIC
/begin CHARACTERISTIC COM_V_FRIC_LRN_ECT "Coolant temp needs to be higher than this value to enable friction torque learn." VALUE 0x0002038C __SWORD_S 0 u_deg_C -256 255.9921875 FORMAT "%4.2" /end CHARACTERISTIC
/begin CHARACTERISTIC COM_V_FRIC_LRN_ESPD_DB "If the delta between current RPM and 125ms old RPM is less than this calibration for a time, then steady condition to enable friction torque learn is met." VALUE 0x0002038C __UWORD_S 0 u_espd 0.0 8191.875 FORMAT "%6.2" /end CHARACTERISTIC
/begin CHARACTERISTIC COM_V_FRIC_LRN_TM_THRSH "When friction torque learn condition met and keep this time,then the learning is enable." VALUE 0x0002038C __UBYTE_S 0 u_16x_tmr 0 31.875 FORMAT "%4.2" /end CHARACTERISTIC
/begin CHARACTERISTIC COM_V_FRIC_LRN_FILT "Coefficient used to filter friction torque learn value." VALUE 0x0002038C __UWORD_S 0 u_filter 0 0.9999847412109375 FORMAT "%10.9" /end CHARACTERISTIC
/begin CHARACTERISTIC COM_V_FRIC_LRN_FAC "FrictionTorque calculation correction factor." VALUE 0x0002038C __UWORD_S 0 u_fac_2 0 1.999969482421875 FORMAT "%4.3" /end CHARACTERISTIC
/begin CHARACTERISTIC COM_V_FRIC_LRN_MX "Max value to limit friction torque learn value." VALUE 0x0002038C __SWORD_S 0 u_tq -2048 2047.9375 FORMAT "%5.2" /end CHARACTERISTIC
/begin CHARACTERISTIC COM_V_FRIC_LRN_MN "Min value to limit friction torque learn value." VALUE 0x0002038C __SWORD_S 0 u_tq -2048 2047.9375 FORMAT "%5.2" /end CHARACTERISTIC
/begin CHARACTERISTIC COM_V_AIRBAG_DPLY_THRSH "Threshold exceed which air bag signal deployed flag is set when air bag is activated." VALUE 0x0002038C __UBYTE_S 0 u_cnts 0 255 /end CHARACTERISTIC
/begin CHARACTERISTIC COM_V_AIRBAG_BYPS_VSPD "True:Bypass VSS fault when shutoff fuel. False: need check VSS fault when shutoff fuel." VALUE 0x0002038C __UBYTE_S 0 b_true 0 1 FORMAT "%1.0" /end CHARACTERISTIC
/begin CHARACTERISTIC COM_V_AIRBAG_VSPD "When airbag is deployed and vehicle speed has been less than this cal for some time, fuel will shut down." VALUE 0x0002038C __UWORD_S 0 u_vspd 0.0 511.9921875 /end CHARACTERISTIC
/begin CHARACTERISTIC COM_V_AIRBAG_FC_TM "When the airbag is deployed and VSS has been low for this cal time, fuel pump is disabled." VALUE 0x0002038C __UWORD_S 0 u_4x_tmr 0 2047.96875 /end CHARACTERISTIC
/begin CHARACTERISTIC COM_V_AIRBAG_VSPD_HI_TM "When the airbag is deployed and VSS has been above a cal for this amount of time(for any reason),no fuel is commanded." VALUE 0x0002038C __UWORD_S 0 u_4x_tmr 0 2047.96875 /end CHARACTERISTIC
/begin CHARACTERISTIC COM_V_AIRBAG_DSBL_INJ_DLY "When the airbag is deployed and fuel pump is disabled, wait for this cal time then command disabling injectors." VALUE 0x0002038C __UWORD_S 0 u_4x_tmr 0 2047.96875 /end CHARACTERISTIC
/begin CHARACTERISTIC COM_V_AIRBAG_INIT_TM "The initialization time of airbag signal.Typical value around 8s." VALUE 0x0002038C __UWORD_S 0 u_2x_tmr 0 1023.984375 /end CHARACTERISTIC
/begin CHARACTERISTIC COM_V_AIRBAG_ENBL "Calibration to enable airbag control fuel cut off algorithm." VALUE 0x0002038C __UBYTE_S 0 b_true 0 1 FORMAT "%1.0" /end CHARACTERISTIC
/begin CHARACTERISTIC COM_V_ACCM_FUEL_MX "The max value for reset the CAN Signal EMS_AccFuelConsum." VALUE 0x0002038C __ULONG_S 0 u_ml 0 67108863 FORMAT "%10.2" /end CHARACTERISTIC
/begin CHARACTERISTIC COM_M_CLCH_TQ_SP "Clutch torque setpoint to learn." MAP 0x2091C __SWORD_S 0 u_tq -2048 2047.9375 SYMBOL_LINK "COM_M_CLCH_TQ_SP" 4
 /begin AXIS_DESCR COM_AXIS sys_eng_spd u_espd 17 0 8191.875 AXIS_PTS_REF COM_X_CLCH_TQ_ESPD /end AXIS_DESCR
 /begin AXIS_DESCR FIX_AXIS sys_trs_oil_t u_deg_C 15 -256 255
  /begin FIX_AXIS_PAR_LIST -5120 -3584 -2048 -512 1024 2560 4096 5632 7168 8704 10240 11776 13312 14848 16384 /end FIX_AXIS_PAR_LIST
 /end AXIS_DESCR
/end CHARACTERISTIC
/begin AXIS_PTS COM_X_CLCH_TQ_ESPD "engine speed breakpoint" 0x0002006C sys_eng_spd SSV__UWORD_S 0 u_espd 17 0.000000 8191.875000 FORMAT "%5.1" DEPOSIT ABSOLUTE SYMBOL_LINK "COM_X_CLCH_TQ_ESPD" 2 /end AXIS_PTS
/begin CHARACTERISTIC COM_V_ESPD_SYNC_TM_CAN "True indicates that engine speed synchronization time comes from CAN." VALUE 0x0002038C __UBYTE_S 0 b_true 0 1 FORMAT "%1.0" /end CHARACTERISTIC
/begin CHARACTERISTIC COM_V_IND_TYP_TQ_CAN "True:Transmit max min torque in indicate type on CAN.False:Transmit max min torque in flywheel type on CAN." VALUE 0x0002038C __UBYTE_S 0 b_true 0 1 FORMAT "%1.0" /end CHARACTERISTIC
/begin CHARACTERISTIC COM_V_CAN_EDITION "CAN edition" VALUE 0x0002038C __UBYTE_S 0 u_cnts 0 255 FORMAT "%1.0" /end CHARACTERISTIC
/begin CHARACTERISTIC COM_V_NUM1 "CAN common number 1." VALUE 0x0002038C __UBYTE_S 0 u_cnts 0 255 FORMAT "%1.0" /end CHARACTERISTIC
/begin CHARACTERISTIC COM_V_NUM2 "CAN common number 2." VALUE 0x0002038C __UBYTE_S 0 u_cnts 0 255 FORMAT "%1.0" /end CHARACTERISTIC
/begin CHARACTERISTIC COM_V_NUM3 "CAN common number 3." VALUE 0x0002038C __UBYTE_S 0 u_cnts 0 255 FORMAT "%1.0" /end CHARACTERISTIC
/begin CHARACTERISTIC COM_V_NUM4 "CAN common number 4." VALUE 0x0002038C __UBYTE_S 0 u_cnts 0 255 FORMAT "%1.0" /end CHARACTERISTIC
/begin CHARACTERISTIC COM_V_NUM5 "CAN common number 5." VALUE 0x0002038C __UBYTE_S 0 u_cnts 0 255 FORMAT "%1.0" /end CHARACTERISTIC
/begin CHARACTERISTIC COM_V_NUM6 "CAN common number 6." VALUE 0x0002038C __UBYTE_S 0 u_cnts 0 255 FORMAT "%1.0" /end CHARACTERISTIC
/begin CHARACTERISTIC COM_V_NUM7 "CAN common number 7." VALUE 0x0002038C __UBYTE_S 0 u_cnts 0 255 FORMAT "%1.0" /end CHARACTERISTIC
/begin CHARACTERISTIC COM_V_NUM8 "CAN common number 8." VALUE 0x0002038C __UBYTE_S 0 u_cnts 0 255 FORMAT "%1.0" /end CHARACTERISTIC
/begin CHARACTERISTIC COM_V_MIN_PPS_OVR_CRU "Min pedal position to enable override cruise." VALUE 0x0002038C __UWORD_S 0 u_pct 0 199.996948 FORMAT "%4.1" /end CHARACTERISTIC
/begin CHARACTERISTIC COM_V_CRU_VSPD_STP "The ramp step when the difference between target cruise speed and vehicle speed is large." VALUE 0x0002038C __UWORD_S 0 u_vspd 0 511.992188 FORMAT "%4.1" /end CHARACTERISTIC
/begin CHARACTERISTIC COM_V_CAN_TQ_CHNG_DLY_INC_END "Delay time used to delay setting TQINOTCU as TF_I_E when exiting tcu torque increase mode." VALUE 0x0002038C __UWORD_S 0 u_1x_tmr 0 511.9921875 FORMAT "%5.2" /end CHARACTERISTIC
/begin CHARACTERISTIC COM_V_TIRE_RAD "The radius of the tire to calculate the mileage." VALUE 0x2004E __UWORD_S 0 u_meter_2 0.0 1.999969482421875 /end CHARACTERISTIC
/begin COMPU_METHOD u_volt_32 "voltage" RAT_FUNC "%6.4" "V" COEFFS 0.0 1.0 0.000000 0.0 0.0 0.00048828125 /end COMPU_METHOD
/begin COMPU_METHOD u_kPa_0_256 "press" RAT_FUNC "%5.2" "kPa" COEFFS 0.0 1.0 0.000000 0.0 0.0 0.00390625 /end COMPU_METHOD
/begin COMPU_METHOD u_kPa_8n_8p "press" RAT_FUNC "%6.5" "kPa" COEFFS 0.0 1.0 0.000000 0.0 0.0 0.000244140625 /end COMPU_METHOD
/begin COMPU_METHOD u_kPa_128n_128p "press" RAT_FUNC "%5.2" "kPa" COEFFS 0.0 1.0 0.000000 0.0 0.0 0.00390625 /end COMPU_METHOD
/begin COMPU_METHOD u_kPaSec_c "press" RAT_FUNC "%5.2" "kPa/s" COEFFS 0.0 1.0 0.000000 0.0 0.0 0.000244140625 /end COMPU_METHOD
/begin COMPU_METHOD u_fac_128 "factor" RAT_FUNC "%5.2" "fac" COEFFS 0.0 1.0 0.000000 0.0 0.0 0.001953125 /end COMPU_METHOD
/begin COMPU_METHOD u_fac_4 "factor" RAT_FUNC "%5.4" "fac" COEFFS 0.0 1.0 0.000000 0.0 0.0 0.00006103515625 /end COMPU_METHOD
/begin COMPU_METHOD u_fac_2 "factor" RAT_FUNC "%3.2" "fac" COEFFS 0.0 1.0 0.000000 0.0 0.0 0.000030517578125 /end COMPU_METHOD
/begin COMPU_METHOD u_fac_1 "factor" RAT_FUNC "%4.3" "fac" COEFFS 0.0 1.0 0.000000 0.0 0.0 0.0000152587890625 /end COMPU_METHOD
/begin COMPU_METHOD u_ml "mililiter" RAT_FUNC "%7.3" "ml" COEFFS 0.0 1.0 0.000000 0.0 0.0 0.015625 /end COMPU_METHOD
/begin COMPU_METHOD u_ul "microliter" RAT_FUNC "%7.3" "ul" COEFFS 0.0 1.0 0.000000 0.0 0.0 0.03125 /end COMPU_METHOD
/begin COMPU_METHOD u_deg_C "degC" RAT_FUNC "%5.2" "¡æ" COEFFS 0.0 1.0 0.0 0.0 0.0 0.0078125 /end COMPU_METHOD
/begin COMPU_METHOD u_filter "filter" RAT_FUNC "%11.10" "coef" COEFFS 0.0 1.0 0.0 0.0 0.0 0.0000152587890625 /end COMPU_METHOD
/begin COMPU_METHOD u_cnts "counts" RAT_FUNC "%3.0" "cnts" COEFFS 0.0 1.0 0.0 0.0 0.0 1.0 /end COMPU_METHOD
/begin COMPU_METHOD u_min "min timer" RAT_FUNC "%5.0" "min" COEFFS 0.0 1.0 0.0 0.0 0.0 1.00 /end COMPU_METHOD
/begin COMPU_METHOD u_1x_tmr "7.81 timer" RAT_FUNC "%4.3" "s" COEFFS 0.0 1.0 0.0 0.0 0.0 0.0078125 /end COMPU_METHOD
/begin COMPU_METHOD u_2x_tmr "15.6 timer" RAT_FUNC "%6.2" "s" COEFFS 0.0 1.0 0.0 0.0 0.0 0.015625 /end COMPU_METHOD
/begin COMPU_METHOD u_4x_tmr "31.2 timer" RAT_FUNC "%6.2" "s" COEFFS 0.0 1.0 0.0 0.0 0.0 0.03125 /end COMPU_METHOD
/begin COMPU_METHOD u_16x_tmr "125 timer" RAT_FUNC "%5.1" "s" COEFFS 0.0 1.0 0.0 0.0 0.0 0.125 /end COMPU_METHOD
/begin COMPU_METHOD u_1s_tmr "1 sec timer" RAT_FUNC "%5.0" "s" COEFFS 0.0 1.0 0.0 0.0 0.0 1.0 /end COMPU_METHOD
/begin COMPU_METHOD b_true "" TAB_VERB "%6.3" "" COMPU_TAB_REF b_true /end COMPU_METHOD
/begin COMPU_VTAB b_true "" TAB_VERB 2 0 "FALSE" 1 "TRUE" /end COMPU_VTAB
/begin COMPU_METHOD b_enable "" TAB_VERB "%6.3" "" COMPU_TAB_REF b_enable /end COMPU_METHOD
/begin COMPU_VTAB b_enable "" TAB_VERB 2 0 "DISABLE" 1 "ENABLE" /end COMPU_VTAB
/begin COMPU_METHOD u_fan_ctrl_typ "" TAB_VERB "%4.0" "" COMPU_TAB_REF u_fan_ctrl_typ /end COMPU_METHOD
/begin COMPU_VTAB u_fan_ctrl_typ "" TAB_VERB 4 0 "OFF" 1 "LOW" 2 "MED" 3 "HIGH" /end COMPU_VTAB
/begin COMPU_METHOD u_espd "engine speed" RAT_FUNC "%5.2" "rpm" COEFFS 0.0 1.0 0.000000 0.0 0.0 0.125 /end COMPU_METHOD
/begin COMPU_METHOD u_vspd "vehicle speed" RAT_FUNC "%5.2" "kph" COEFFS 0.0 1.0 0.000000 0.0 0.0 0.0078125 /end COMPU_METHOD
/begin COMPU_METHOD u_vspd_per_sec "vehicle speed acc" RAT_FUNC "%5.3" "kph/s" COEFFS 0.0 1.0 0.000000 0.0 0.0 0.001953125 /end COMPU_METHOD
/begin COMPU_METHOD u_pct "percentage" RAT_FUNC "%5.2" "%" COEFFS 0.0 1.0 0.000000 0.0 0.0 0.0030517578125 /end COMPU_METHOD
/begin COMPU_METHOD u_pct_1 "percentage" RAT_FUNC "%5.2" "%" COEFFS 0.0 1.0 0.000000 0.0 0.0 0.00152587890625 /end COMPU_METHOD
/begin COMPU_METHOD u_pct_s "percentage" RAT_FUNC "%5.2" "%" COEFFS 0.0 1.0 0.000000 0.0 0.0 0.006103515625 /end COMPU_METHOD
/begin COMPU_METHOD u_pct_r "real pct" RAT_FUNC "%5.2" "%" COEFFS 0.0 1.0 0.000000 0.0 0.0 0.001953125 /end COMPU_METHOD
/begin COMPU_METHOD u_g_per_sec_64 "g per second" RAT_FUNC "%5.2" "g/s" COEFFS 0.0 1.0 0.000000 0.0 0.0 0.0009765625 /end COMPU_METHOD
/begin COMPU_METHOD u_afr "airfuel" RAT_FUNC "%3.1" "Ratio" COEFFS 0.0 1.0 0.000000 0.0 0.0 0.00048828125 /end COMPU_METHOD
/begin COMPU_METHOD u_kPa_0_4096 "IMEP" RAT_FUNC "%6.2" "kPa" COEFFS 0.0 1.0 0.000000 0.0 0.0 0.0625 /end COMPU_METHOD
/begin COMPU_METHOD u_tq "torque" RAT_FUNC "%5.1" "Nm" COEFFS 0.0 1.0 0.000000 0.0 0.0 0.0625 /end COMPU_METHOD
/begin COMPU_METHOD u_evam_dis_rsn "" TAB_VERB "%5.0" "" COMPU_TAB_REF u_evam_dis_rsn /end COMPU_METHOD
/begin COMPU_VTAB u_evam_dis_rsn "" TAB_VERB 13 0 "NO_REASON" 1 "FAULT_ACTV" 2 "BAT_VOLT" 3 "IAT_DECREASING" 4 "PURGE_OR_VENT_SRV_CTRL" 6 "PURGE_OR_VENT_CAL_CTRL" 7 "KEYON_ECT_HI" 8 "FUEL_LEVEL_OUT" 9 "COLD_TEST_NOT_MET" 10 "OFVC_DIAG_CLEAR" 11 "AMP_OUT" 12 "PURGE_CTRL_LOSS" 13 "REFUEL" /end COMPU_VTAB
/begin COMPU_METHOD u_evam_cld_tmp_chk "" TAB_VERB "%5.0" "" COMPU_TAB_REF u_evam_cld_tmp_chk /end COMPU_METHOD
/begin COMPU_VTAB u_evam_cld_tmp_chk "" TAB_VERB 3 0 "UNKOWN" 1 "OUT" 2 "MET" /end COMPU_VTAB
/begin COMPU_METHOD u_evam_stat "" TAB_VERB "%1.0" "" COMPU_TAB_REF u_evam_stat /end COMPU_METHOD
/begin COMPU_VTAB u_evam_stat "" TAB_VERB 7 0 "DISABLE" 1 "ABORT" 2 "PURGE_VLV_LEAK" 3 "COLD_LEAK_TESTS" 4 "WARM_LARGE_LEAK_TEST" 5 "VENT_BLOCK" 6 "TEST_FINISH" /end COMPU_VTAB
/begin COMPU_METHOD u_diag_typ "" TAB_VERB "%5.0" "" COMPU_TAB_REF u_diag_typ /end COMPU_METHOD
/begin COMPU_VTAB u_diag_typ "" TAB_VERB 5 0 "BYPASS" 1 "LIGHT_SVS" 2 "LIGHT_3RD_TRIP" 4 "LIGHT_2ND_TRIP" 8 "LIGHT_1ST_TRIP" /end COMPU_VTAB
/begin COMPU_METHOD u_den_grp "" TAB_VERB "%5.0" "" COMPU_TAB_REF u_den_grp /end COMPU_METHOD
/begin COMPU_VTAB u_den_grp "" TAB_VERB 34 0 "INTERNAL_USE" 1 "GENERIC" 2 "B1_CFD" 3 "B2_CFD" 4 "EGR_FLW" 5 "B1_EXH_CAM_ST" 6 "B1_EXH_VVT_STUK" 7 "B1_EXH_VVT_POS" 8 "B1_EXH_VVT_RESP" 9 "B2_EXH_CAM_ST" 10 "B2_EXH_VVT_STUK" 11 "B2_EXH_VVT_POS" 12 "B2_EXH_VVT_RESP" 13 "B1_INTK_CAM_ST" 14 "B1_INTK_VVT_STUK" 15 "B1_INTK_VVT_POS" 16 "B1_INTK_VVT_RESP" 17 "B2_INTK_CAM_ST" 18 "B2_INTK_VVT_STUK" 19 "B2_INTK_VVT_POS" 20 "B2_INTK_VVT_RESP" 21 "EVAM_PURGE_FLOW" 22 "EVAM_SMALL_LEAK" 23 "B1S1_RSP_SW_TMS" 24 "B1S1_RSP_RCH_LEAN" 25 "B1S1_RSP_LEAN_RCH" 26 "B1S1_RSP_RATIO" 27 "" 28 "" 29 "" 30 "B1S2_PUC_RESP" 31 "B1S2_POW_RESP" 32 "B1_SECOND_AIR" 33 "B2_SECOND_AIR" /end COMPU_VTAB
/begin COMPU_METHOD u_iupr_idx "" TAB_VERB "%6.3" "" COMPU_TAB_REF u_iupr_idx /end COMPU_METHOD
/begin COMPU_VTAB u_iupr_idx "" TAB_VERB 10 0 "B1_CAT" 1 "B2_CAT" 2 "B1_UO2" 3 "B1_DO2" 4 "B2_UO2" 5 "B2_DO2" 6 "EVAM_VERY_SMALL" 7 "EGR_VVT" 8 "SECONDARY_AIR" 9 "Number of Denom" /end COMPU_VTAB
/begin COMPU_METHOD u_can_period "" TAB_VERB "%6.3" "" COMPU_TAB_REF u_can_period /end COMPU_METHOD
/begin COMPU_VTAB u_can_period "" TAB_VERB 8 0 "OFF" 3 "10ms" 5 "20ms" 7 "50ms" 9 "100ms" 10 "200ms" 12 "500ms" 13 "1s" /end COMPU_VTAB
/begin COMPU_METHOD u_can_chn "" TAB_VERB "%6.3" "" COMPU_TAB_REF u_can_chn /end COMPU_METHOD
/begin COMPU_VTAB u_can_chn "" TAB_VERB 3 0 "CAN0" 1 "CAN1" 2 "CAN2" /end COMPU_VTAB
/begin COMPU_METHOD u_can_txmsg_num "" TAB_VERB "%6.3" "" COMPU_TAB_REF u_can_txmsg_num /end COMPU_METHOD
/begin COMPU_VTAB u_can_txmsg_num "" TAB_VERB 17 0 "MSG0" 1 "MSG1" 2 "MSG2" 3 "MSG3" 4 "MSG4" 5 "MSG5" 6 "MSG6" 7 "MSG7" 8 "MSG8" 9 "MSG9" 10 "MSG10" 11 "MSG11" 12 "MSG12" 13 "MSG13" 14 "MSG14" 15 "MSG15" 255 "OFF" /end COMPU_VTAB
/begin COMPU_METHOD u_can_byte_num "" TAB_VERB "%6.3" "" COMPU_TAB_REF u_can_byte_num /end COMPU_METHOD
/begin COMPU_VTAB u_can_byte_num "" TAB_VERB 8 0 "BYTE0" 1 "BYTE1" 2 "BYTE2" 3 "BYTE3" 4 "BYTE4" 5 "BYTE5" 6 "BYTE6" 7 "BYTE7" /end COMPU_VTAB
/begin COMPU_METHOD u_can_bit_loc "" TAB_VERB "%6.3" "" COMPU_TAB_REF u_can_bit_loc /end COMPU_METHOD
/begin COMPU_VTAB u_can_bit_loc "" TAB_VERB 8 0 "BIT0" 1 "BIT1" 2 "BIT2" 3 "BIT3" 4 "BIT4" 5 "BIT5" 6 "BIT6" 7 "BIT7" /end COMPU_VTAB
/begin COMPU_METHOD u_can_cruz_st "" TAB_VERB "%6.3" "" COMPU_TAB_REF u_can_cruz_st /end COMPU_METHOD
/begin COMPU_VTAB u_can_cruz_st "" TAB_VERB 15 0 "DISABLE" 1 "STANDBY_DISABLE" 2 "STANDBY_ENABLE" 3 "ENGAGED" 4 "COAST" 5 "TAP_DOWN" 6 "TAP_Up" 7 "RES" 8 "ACC_SBE" 9 "ACC_ENG" 10 "STEP_DOWN" 11 "STEP_UP" 12 "OVERRIDE" 13 "FAULT" 14 "CANCELLED" /end COMPU_VTAB
/begin COMPU_METHOD u_can_eng_st "" TAB_VERB "%6.3" "" COMPU_TAB_REF u_can_eng_st /end COMPU_METHOD
/begin COMPU_VTAB u_can_eng_st "" TAB_VERB 5 0 "STOP" 1 "RUN" 2 "IDLE" 3 "FUEL_CUT" 4 "CRANK" /end COMPU_VTAB
/begin COMPU_METHOD u_mot_dir "" TAB_VERB "%6.3" "" COMPU_TAB_REF u_mot_dir /end COMPU_METHOD
/begin COMPU_VTAB u_mot_dir "" TAB_VERB 2 0 "OPEN" 1 "CLOSE" /end COMPU_VTAB
/begin COMPU_METHOD u_g_per_sec_16 "g per second" RAT_FUNC "%5.2" "g/s" COEFFS 0.0 1.0 0.000000 0.0 0.0 0.000244140625 /end COMPU_METHOD
/begin COMPU_METHOD u_purge_diag_ctrl_mod "" TAB_VERB "%4.0" "" COMPU_TAB_REF u_purge_diag_ctrl_mod /end COMPU_METHOD
/begin COMPU_VTAB u_purge_diag_ctrl_mod "" TAB_VERB 4 0 "Inactive" 1 "RampOff" 2 "TankVacuum" 3 "MassFlow" /end COMPU_VTAB
/begin COMPU_METHOD u_ul_long "microliter" RAT_FUNC "%7.3" "uL" COEFFS 0.0 1.0 0.000000 0.0 0.0 0.125 /end COMPU_METHOD
/begin COMPU_METHOD u_amb_stb_st "" TAB_VERB "%6.3" "" COMPU_TAB_REF u_amb_stb_st /end COMPU_METHOD
/begin COMPU_VTAB u_amb_stb_st "" TAB_VERB 4 0 "UNKNOWN" 1 "DEC" 3 "INC" 4 "STABLE" /end COMPU_VTAB
/begin COMPU_METHOD u_fac_n256_p256 "factor" RAT_FUNC "%5.2" "fac" COEFFS 0.0 1.0 0.000000 0.0 0.0 0.0078125 /end COMPU_METHOD
/begin COMPU_METHOD u_vnt_ctrl_st "" TAB_VERB "%6.3" "" COMPU_TAB_REF u_vnt_ctrl_st /end COMPU_METHOD
/begin COMPU_VTAB u_vnt_ctrl_st "" TAB_VERB 3 0 "INACTIVE" 1 "CLOSE" 2 "OPEN" /end COMPU_VTAB
/begin COMPU_METHOD u_espd_hi "high espd" RAT_FUNC "%5.2" "rpm" COEFFS 0.0 1.0 0.000000 0.0 0.0 0.1953125 /end COMPU_METHOD
/begin COMPU_METHOD u_meter_2 "length unit:m" RAT_FUNC "%6.5" "meter" COEFFS 0.0 1.0 0.000000 0.0 0.0 0.000030517578125 /end COMPU_METHOD
/begin COMPU_METHOD p_t_GPF_SI_N512_512_LONG "Ax + B" RAT_FUNC "%10.6" "kPa" COEFFS 0.0 1.0 0.000000 0.0 0.0 0.000000238418 /end COMPU_METHOD
/begin FUNCTION errm ""
 /begin DEF_CHARACTERISTIC ERRM_V_IUPR_DSPLY_IDX ERRM_V_PD_CLR_MF_EN ERRM_V_PD_STR_MF_EN ERRM_V_FF_PRITY_EN ERRM_V_IUPR_ENG_STRT_ESPD ERRM_REF_VOLT3_TYP ERRM_REF_VOLT3_MIL_ON ERRM_REF_VOLT3_DEN_GRP ERRM_REF_VOLT3_DTC ERRM_CAN_GW_TYP ERRM_CAN_GW_MIL_ON ERRM_CAN_GW_DEN_GRP ERRM_CAN_GW_DTC ERRM_BRK_PRESS_LO_TYP ERRM_BRK_PRESS_LO_MIL_ON ERRM_BRK_PRESS_LO_DEN_GRP ERRM_BRK_PRESS_LO_DTC ERRM_BRK_PRESS_HI_TYP ERRM_BRK_PRESS_HI_MIL_ON ERRM_BRK_PRESS_HI_DEN_GRP ERRM_BRK_PRESS_HI_DTC ERRM_ECT_STUK_TYP ERRM_ECT_STUK_MIL_ON ERRM_ECT_STUK_DEN_GRP ERRM_ECT_STUK_DTC ERRM_TNK_P_RAT_LO_TYP ERRM_TNK_P_RAT_LO_MIL_ON ERRM_TNK_P_RAT_LO_DEN_GRP ERRM_TNK_P_RAT_LO_DTC ERRM_TNK_P_RAT_HI_TYP ERRM_TNK_P_RAT_HI_MIL_ON ERRM_TNK_P_RAT_HI_DEN_GRP ERRM_TNK_P_RAT_HI_DTC ERRM_BRKP_LLEAK_TYP ERRM_BRKP_LLEAK_MIL_ON ERRM_BRKP_LLEAK_DEN_GRP ERRM_BRKP_LLEAK_DTC ERRM_BRKP_SLEAK_TYP ERRM_BRKP_SLEAK_MIL_ON ERRM_BRKP_SLEAK_DEN_GRP ERRM_BRKP_SLEAK_DTC ERRM_BRKP_RLY_HI_TYP ERRM_BRKP_RLY_HI_MIL_ON ERRM_BRKP_RLY_HI_DEN_GRP ERRM_BRKP_RLY_HI_DTC ERRM_BRKP_RLY_LO_TYP ERRM_BRKP_RLY_LO_MIL_ON ERRM_BRKP_RLY_LO_DEN_GRP ERRM_BRKP_RLY_LO_DTC /end DEF_CHARACTERISTIC
/end FUNCTION
/begin FUNCTION evam ""
 /begin DEF_CHARACTERISTIC EVAM_V_FLV_MMV_DLY EVAM_V_FLV_FIL EVAM_V_IDL_VSPD_LO EVAM_V_REFUEL_VAC EVAM_V_REFUEL_DLT EVAM_V_CAP_OPN_FC_THR EVAM_V_VSM_CST_ECT_MIN EVAM_V_VSM_CST_ECT_MAX EVAM_V_VSM_CST_IAT_MIN EVAM_V_VSM_CST_IAT_MAX EVAM_V_VSM_CST_IAT_HI_DLT EVAM_V_VSM_CST_ECT_HI_DLT EVAM_V_CST_OFFT_MIN EVAM_V_SM_CST_ECT_MIN EVAM_V_SM_CST_ECT_MAX EVAM_V_SM_CST_IAT_MIN EVAM_V_SM_CST_IAT_MAX EVAM_V_SM_CST_IAT_ECT_DLT EVAM_V_SM_CST_ECT_IAT_DLT EVAM_V_EN_RUN_MIN EVAM_V_VSM_FLV_MIN EVAM_V_VSM_FLV_MAX EVAM_V_VSM_FLV_OUT_DLY EVAM_V_SM_FLV_MIN EVAM_V_SM_FLV_MAX EVAM_V_SM_FLV_OUT_DLY EVAM_V_AMB_STBL_VSPD_MIN EVAM_V_AMB_T_DEC_THR EVAM_V_AMB_T_INC_THR EVAM_V_AMB_T_UNSTBL_THR EVAM_V_AMB_T_STBL_DUR_KP EVAM_V_AMB_T_STBL_DUR_MIN EVAM_V_IAT_DEC_DLT EVAM_V_IAT_DEC_DUR EVAM_V_EN_VLT_MIN EVAM_V_EN_VLT_MAX EVAM_V_VLT_OUT_DUR EVAM_V_PG_CTRL_OUT_DUR EVAM_V_CAP_OPN_FLV_MAX EVAM_V_EN_AMP_MIN EVAM_V_IDL_TPS_LO EVAM_V_IDL_TPS_HI EVAM_V_IDL_VSPD_HI EVAM_V_IDL_ESPD_LO EVAM_V_IDL_ESPD_HI EVAM_V_CLD_LK_DLY EVAM_V_SLSH_FLV_DLT EVAM_V_SLSH_MOV_VSPD EVAM_V_SLSH_DLY EVAM_V_SLSH_MOV_PCT EVAM_V_SLSH_FUEL_VSPD EVAM_V_SLSH_FUEL_TPS EVAM_V_SLSH_FUEL_MAP_DLT EVAM_V_SLSH_FUEL_ESPD_DLT EVAM_C_SLSH_FUEL_FLV_DLT EVAM_V_PV_LK_DUR_MAX EVAM_V_PV_LK_EOL_DLY EVAM_V_PV_LK_DLY EVAM_V_PV_LK_EOL_DLY_VAC EVAM_V_PV_LK_DLY_VAC EVAM_V_PV_LK_OFFT_MAX EVAM_V_PV_LK_IAT_DEC EVAM_V_PV_LK_MOV_VSPD EVAM_V_PV_LK_MOV_MIN EVAM_V_PV_LK_FL_VAC EVAM_V_PV_LK_FL_DLY EVAM_V_PV_LK_EOL_FL_DLY EVAM_C_PV_LK_STL_SLP EVAM_V_PV_LK_SLP_RAT_MAX EVAM_C_SM_VAC_SLP_MAX EVAM_C_EOL_SM_VAC_SLP_MAX EVAM_C_VSM_VAC_SLP_MAX EVAM_C_EOL_VSM_VAC_SLP_MAX EVAM_V_PV_LK_AMB_TST_DUR EVAM_V_PV_LK_AMB_STB_VSPD EVAM_V_PV_LK_AMB_STB_DUR EVAM_C_CLD_PURG_EN_RUN_MAX EVAM_C_CLD_LK_TST_DUR_MAX EVAM_V_CLD_LK_CONC_HI EVAM_V_VSM_CLD_DUR_MAX EVAM_V_PRESET_DUR_MIN EVAM_V_PRESET_VAC_MAX EVAM_V_PRESET_VAC_SP EVAM_V_LRG_LK_FL_VAC EVAM_V_LRG_LK_EOL_FL_VAC EVAM_V_VSM_STRT_TM_MAX EVAM_V_VSM_TST_KP EVAM_V_CLD_LRG_LK_DLY EVAM_C_CLD_LRG_LK_FL_INT EVAM_V_CLD_LRG_LK_EOL_FL_INT EVAM_V_EOL_DTY_INC_STP EVAM_C_EOL_DTY_MAX EVAM_V_SM_LK_PSS_VAC EVAM_V_SM_LK_EOL_PSS_VAC EVAM_V_SM_LK_DCY_VAC EVAM_V_SM_LK_EOL_DCY_VAC EVAM_V_SM_LK_DCY_DLY EVAM_V_SM_LK_EOL_DCY_DLY EVAM_V_SM_LK_DCY_DUR EVAM_V_SM_LK_EOL_DCY_DUR EVAM_V_SM_LK_SLP_CAL_NUM EVAM_C_SM_LK_SLP_FAC0 EVAM_C_SM_LK_SLP_FAC1 EVAM_C_SM_LK_SLP_FAC2 EVAM_C_SM_LK_SLP_FAC3 EVAM_C_SM_LK_SLP_FAC4 EVAM_C_SM_LK_SLP_FAC5 EVAM_C_SM_LK_SLP_FAC6 EVAM_C_SM_LK_SLP_FAC7 EVAM_C_SM_LK_SLP_FAC8 EVAM_V_SM_LK_SLP_INC_THR EVAM_V_VSM_LK_SLP_CAL_NUM EVAM_V_VSM_LK_DCY_DUR EVAM_V_VSM_LK_EOL_DCY_DUR EVAM_V_VSM_LK_SLP_INC_THR EVAM_V_VAP_EN_VAC_MAX EVAM_V_VAP_GEN_DLY EVAM_C_VAC_LOW_DLY EVAM_V_VAP_LOG_DUR EVAM_V_VAP_LOG_EN_VAC EVAM_V_VAP_EXT_VAC EVAM_V_SM_VAP_SLP_DLY EVAM_V_VSM_VAP_SLP_DLY EVAM_C_SM_VAP_SLP_MAX EVAM_V_SM_VAP_SLP_FAC EVAM_V_SM_PV_SLP_FAC EVAM_C_VSM_VAP_SLP_MAX EVAM_V_VSM_VAP_SLP_FAC EVAM_V_VSM_PV_SLP_FAC EVAM_V_CAP_OPN_RST_FLW EVAM_V_CAP_OPN_RST_CONC EVAM_V_LRG_LK_PSS_VAC EVAM_V_LRG_LK_PSS_DLY EVAM_V_WRM_LRG_RST_CNTS EVAM_V_VNT_BLK_EOL_PSS_VAC EVAM_V_VNT_BLK_INIT_VAC EVAM_V_VNT_BLK_DLY EVAM_V_VNT_BLK_DUR_MAX EVAM_V_VNT_BLK_VAC_MAX EVAM_V_VNT_BLK_FL_DLY EVAM_V_VNT_BLK_PSS_INT EVAM_C_VAC_INT_MNFD_FAC EVAM_V_VAC_INT_PV_DC_FAC EVAM_C_VAC_INT_DC_FAC EVAM_V_MNFD_VAC_LO_THR EVAM_V_PG_DC_LO_THR EVAM_C_VAC_INT_IAT_FAC EVAM_C_SM_LK_DCY_SLP EVAM_C_SM_LK_SLP_TEMP_FAC EVAM_C_SM_LK_EOL_DCY_SLP EVAM_C_VSM_LK_DCY_SLP EVAM_C_VSM_LK_SLP_TEMP_FAC EVAM_C_VSM_LK_EOL_DCY_SLP EVAM_C_VAP_TEMP_BIAS EVAM_V_CAP_OPN_TMS_MAX EVAM_V_PV_LK_HYB_DIS_TMS EVAM_V_PV_LK_HYB_DIS_EN EVAM_V_VAC_SP EVAM_V_EOL_VAC_SP EVAM_V_PG_FLW_SP EVAM_V_VNT_CLS_DUR EVAM_V_VNT_CTRL_DUR EVAM_V_VNT_TGGL_TMS EVAM_V_AMB_T_HI_IAT EVAM_V_AMB_T_HI_DLT EVAM_V_CAP_OPN_RPT_MAX EVAM_V_SRV_VSM_ECT EVAM_V_SRV_SM_ECT EVAM_V_SRV_SM_FLV_HI EVAM_V_SRV_SM_FLV_LO EVAM_V_SRV_VSM_FLV_HI EVAM_V_SRV_VSM_FLV_LO EVAM_V_TNK_PROT_VAC EVAM_V_TNK_PROT_DLY EVAM_V_TNK_PROT_FLT_DLY EVAM_V_TNK_PROT_FLV_MAX EVAM_V_TNK_PROT_PSS_FLW EVAM_V_TNK_PROT_PSS_DLY EVAM_V_TNK_PROT_PRES_MAX EVAM_V_TNK_VAC_LRN_DLY EVAM_V_TNK_VAC_BIAS EVAM_V_VAC_LRN_LO EVAM_V_VAC_LRN_HI EVAM_V_TNK_VAC_FIL EVAM_V_SRV_PRESET_DUR_MIN EVAM_V_PV_LK_VAC_EOL_INT EVAM_C_PV_LK_VAC_INT EVAM_C_PV_LK_INT_IAT_FAC EVAM_C_VSM_LK_SRV_DCY_SLP EVAM_C_VSM_LK_SLP_FAC0 EVAM_C_VSM_LK_SLP_FAC1 EVAM_C_VSM_LK_SLP_FAC2 EVAM_C_VSM_LK_SLP_FAC3 EVAM_C_VSM_LK_SLP_FAC4 EVAM_C_VSM_LK_SLP_FAC5 EVAM_C_VSM_LK_SLP_FAC6 EVAM_C_VSM_LK_SLP_FAC7 EVAM_C_VSM_LK_SLP_FAC8 EVAM_V_VNT_BLK_VAC_HI EVAM_V_VNT_BLK_VAC_LO EVAM_V_CAP_OPN_RSTRT_VSPD EVAM_V_CAP_OPN_RSTRT_DLY EVAM_V_CAP_OPN_INIT_TST_DIS EVAM_V_CAP_OPN_TST_VSPD EVAM_V_CAP_OPN_TST_RUN EVAM_V_CAP_OPN_PG_DLY EVAM_V_CAP_OPN_TST_CON EVAM_V_CAP_OPN_RST_VSPD EVAM_V_CAP_OPN_RST_DEC_VSPD EVAM_V_CAP_OPN_RST_DEC EVAM_V_CAP_OPN_RST_MAP_HI EVAM_V_CAP_OPN_RST_MAP_LO EVAM_V_CAP_OPN_RST_FLV EVAM_V_EN_EOL_RUN_MIN EVAM_V_CON_LRN_DIS_VAC /end DEF_CHARACTERISTIC
 /begin OUT_MEASUREMENT evam_diag_dis_rsn evam_dis_flt_actv evam_trip_dis_flt_actv evam_eol_diag_req evam_diag_fn evam_bat_vlt_dis evam_flv_mmv evam_cst_temp_st evam_sml_flv_en evam_refuel_actv evam_cld_tst_met evam_cld_lk_en evam_lk_idl_en evam_lk_dly_actv evam_lk_en evam_cld_lk_fn evam_slosh_flv_max evam_slosh_flv_min evam_slosh_flv evam_slosh_mov evam_slosh_fuel evam_cld_en evam_pv_lk_fn evam_vnt_vlv_tggl_fn evam_vnt_vlv_tggl_req evam_pv_lk_init evam_pv_lk_init_fn evam_pv_lk_excd evam_pv_lk_dly_fn evam_tank_vac_mmv evam_pv_lk_int_req evam_pv_lk_slp_tm evam_pv_lk_strt_vac evam_pv_lk_vac_idx_thr evam_pv_lk_fl evam_pf_vac_fnl evam_pf_hivac_dur evam_vac_inc_int_cor evam_pv_lk_vac_slp evam_pv_tst_sm_abrt evam_pv_tst_vsm_abrt evam_cld_lk_abrt evam_cld_lk_dur evam_cld_lk_dur_excd evam_vsml_lk_dur_excd evam_cld_lrg_lk_dur_excd evam_prst_vacdrw_actv evam_prst_mintm_fn evam_prst_init_fn evam_sml_lk_vacdrw_fn evam_cld_lrg_lk_pass evam_prst_init evam_prst_int_req evam_sml_lk_dcy_req evam_vsml_lk_dcy_req evam_sm_lk_vap_req evam_vsml_lk_vap_req evam_vsml_lk_slp_inc_hi evam_vsml_lk_hivap evam_vsml_lk_vap_abrt evam_sml_lk_dcy_fn evam_vsml_lk_dsbl evam_sml_lk_tst_req evam_cld_lrg_lk_req evam_cld_lrg_lk_init_fn evam_cld_lrg_lk_int_req evam_cld_lrg_lk_init evam_cld_llk_vac_idx_thrsh evam_cld_llk_fl evam_cld_llk_fn evam_sml_lk_vap_fn evam_vsml_lk_vap_fn evam_vsml_lk_dcy_fn evam_vsml_lk_dcy_pass evam_vsml_lk_pass evam_sml_lk_pass evam_sml_lk_dcy_dly_tm evam_sml_lk_dcy_tm evam_sml_lk_idx_pss evam_sml_lk_slp_inc_hi evam_sml_lk_dcy_slp evam_vsml_lk_dcy_tm evam_vsml_lk_idx_pss evam_vsml_lk_dcy_slp evam_sml_lk_fl evam_sml_lk_fn evam_vsml_lk_fl evam_vsml_lk_fn evam_stat evam_tank_prot evam_pg_vlv_off_req evam_diag_ctrl_mod evam_cp_msflw_sp evam_tank_vac_err evam_tank_vac_rt evam_prst_sp_rch evam_flv_mmv_dly evam_refuel_dly evam_vsm_flv_out_dly evam_sm_flv_out_dly evam_amb_t_stbl_dur evam_flv_dlt evam_refuel_flv_bs evam_trip_refuel_tms evam_fuel_cap_opn evam_cap_opn_fc evam_trip_cap_opn_fc evam_vsm_cst_temp_out evam_wrm_tst_req evam_cap_opn_tst_req evam_vsm_flv_out evam_sm_flv_met evam_cap_opn_tms_met evam_cap_opn_tms evam_amb_t_stb_st evam_amb_t_unstb_cnt evam_iat_dec_met evam_bat_vlt_out evam_pg_ctrl_out_dur evam_lk_dly_tmr evam_slosh_chk_req evam_slosh_chk_ext_dly evam_slosh_mov_tmr evam_slosh_mov_pct evam_slosh_mov_excd evam_slosh_ext_dly evam_pg_vlv_lk_tmr evam_pv_lk_cool_met evam_pv_lk_veh_mov evam_pv_lk_mov_vac evam_pv_lk_mov_tmr evam_pv_lk_mov_strt_vac evam_pv_lk_mov_slp evam_pv_lk_mov_slp_max evam_pv_lk_mov_slp_rat evam_pv_lk_mov_no_rpt evam_pv_lk_amb_tst_tmr evam_pv_lk_amb_stb_tmr evam_pv_lk_amb_stb evam_cld_lk_tst_fn evam_cld_lk_conc_hi evam_vac_drw_tmr evam_pre_vac_met evam_lrg_lk_pre_pass evam_cld_lrg_lk_strt_tm evam_srv_vsm_flv_out evam_eol_tst_actv evam_eol_tst_pg_dty evam_sm_lk_vac_init evam_sm_lk_vac_lst evam_sm_lk_vac_idx evam_sml_lk_idx_slp evam_sm_lk_vac_intrv evam_sm_lk_slp_thr evam_vsm_lk_vac_init evam_vsm_lk_vac_lst evam_vsm_lk_vac_intrv evam_vsml_lk_idx_slp evam_vsm_lk_slp_thr evam_vap_tst_en evam_vac_low evam_vap_gen_dly evam_vac_low_dly evam_vap_est_temp evam_vap_stbl_dly evam_vap_slp_tm evam_vap_tst_abrt evam_sm_vap_slp_req evam_sm_vap_vac_init evam_sm_vap_vac_end evam_sm_vap_vac_slp evam_vsm_vap_slp_req evam_vsm_vap_vac_init evam_vsm_vap_vac_end evam_sm_vap_hi evam_sm_vap_tst_pss evam_sm_dcy_slp_cor evam_sm_vap_tst_ext evam_vsm_vap_hi evam_vsm_vap_tst_pss evam_vsm_dcy_slp_cor evam_vsm_vap_tst_ext evam_cld_lrg_strt_excd evam_lrg_lk_tst_fn evam_lrg_lk_init_fn evam_lrg_lk_vnt_tggl_req evam_wrm_lrg_lk_rst_cnt evam_lrg_lk_pss_dly evam_lrg_lk_tst_dur evam_vnt_blk_tst_fn evam_vnt_blk_tst_excd evam_vnt_blk_tst_tmr evam_vnt_blk_tst_fl evam_vnt_blk_dly_fn evam_vnt_blk_init evam_vnt_blk_vac_dly evam_vnt_blk_int_req evam_vac_inc_int evam_vac_inc_cor_int_dlt evam_vac_inc_int_dlt evam_stat_lst evam_pv_lk_tst_tms evam_hyb_dis evam_tank_vac_sp evam_vnt_vlv_tggl_tmr evam_vnt_ctrl_st evam_vnt_tggl_tms evam_vnt_tggl_st evam_vnt_blk_rprt evam_vsm_lk_rprt evam_amb_t_hi evam_vsm_lk_rprt_hld evam_vsm_lk_rprt_dis evam_sm_lk_rprt evam_lrg_lk_rprt evam_cap_opn_fl_tms evam_cap_opn_fl_trp evam_cap_cld_fl_tms evam_cld_lrg_lk_rprt evam_trip_llk_pass evam_pv_lk_rprt evam_srv_vsm_ect_dis evam_srv_tst_en evam_vac_nois_lrn_fn evam_tnk_prot_tmr evam_tnk_prot_en evam_vac_hi_vnt_opn evam_tnk_prot_flt_tmr evam_tnk_prot_pss_tmr evam_prot_vnt_opn_req evam_vnt_vlv_st evam_tnk_vac_lrn_tmr evam_keyon_tnk_vac evam_tnk_vac_adp evam_cap_opn_tst_rstrt evam_cap_opn_rstrt_dly evam_cap_opn_vspd_met evam_pg_en_tmr evam_cap_opn_tst_rst evam_con_lrn_actv evam_tnk_vac_lrn_fn /end OUT_MEASUREMENT
/end FUNCTION
/begin FUNCTION egr ""
 /begin DEF_CHARACTERISTIC EGR_V_POS_MIN EGR_C_DC_PROP_FAC EGR_X_POS_ERR EGR_X_POS_ERR_A EGR_C_DC_INT_FAC EGR_C_DC_INT_BAS EGR_V_EN_IAT_MAX_LO EGR_V_EN_IAT_MAX_HI EGR_V_EN_IAT_MIN_HI EGR_V_EN_IAT_MIN_LO EGR_X_IMEP EGR_M_EGR_RAT_SP EGR_V_CTRL_EN EGR_V_EN_BAT_MAX_LO EGR_V_EN_BAT_MAX_HI EGR_V_EN_BAT_MIN_HI EGR_V_EN_BAT_MIN_LO EGR_V_EN_KEYON_ECT EGR_V_EN_ECT_MIN_HI EGR_V_EN_ECT_MIN_LO EGR_V_EN_AF_MAX EGR_V_EN_AF_MIN EGR_V_EN_IMEP_MIN_HI EGR_V_EN_IMEP_MIN_LO EGR_V_EN_TPS_MAX_LO EGR_V_EN_TPS_MAX_HI EGR_V_EN_TPS_MIN_HI EGR_V_EN_TPS_MIN_LO EGR_V_EN_ESPD_MAX EGR_V_EN_ESPD_MIN EGR_V_EN_VSPD_MAX EGR_V_EN_VSPD_MIN EGR_V_EN_VAC_MIN_HI EGR_V_EN_VAC_MIN_LO EGR_V_SP_FIL EGR_V_EN_IAT_BYPS_DUR EGR_C_RAT_SP_ECT_FAC EGR_M_RAT_SP_AMP_FAC EGR_V_CLN_EN_ECT EGR_V_CLN_EN_VSPD EGR_V_CLN_EN_PUC_INTVL EGR_V_CLN_STG1_DUR EGR_V_CLN_STG2_DUR EGR_V_CLN_STG3_DUR /end DEF_CHARACTERISTIC
 /begin OUT_MEASUREMENT egr_pos_sp egr_conds_met egr_pos_err egr_ratio_sp egr_dc_i egr_dc_p_i egr_pwm_dc egr_hw_rdy_st egr_iat_met /end OUT_MEASUREMENT
/end FUNCTION
/begin FUNCTION com ""
 /begin DEF_CHARACTERISTIC COM_V_TRNS_DFLT_VSPD_LMT COM_V_TRNS_DFLT_ESPD_LMT COM_V_TORQ_SP_PPS_THRSH COM_V_TORQ_SP_DLY COM_C_TORQ_SP_INIT COM_X_ESPD COM_C_FAN_DC COM_X_LH_ESPD COM_X_LH_VSPD COM_M_TMS_LH_MX_TORQ COM_V_FRIC_LRN_ECT COM_V_FRIC_LRN_ESPD_DB COM_V_FRIC_LRN_TM_THRSH COM_V_FRIC_LRN_FILT COM_V_FRIC_LRN_FAC COM_V_FRIC_LRN_MX COM_V_FRIC_LRN_MN COM_V_AIRBAG_DPLY_THRSH COM_V_AIRBAG_BYPS_VSPD COM_V_AIRBAG_VSPD COM_V_AIRBAG_FC_TM COM_V_AIRBAG_VSPD_HI_TM COM_V_AIRBAG_DSBL_INJ_DLY COM_V_AIRBAG_INIT_TM COM_V_AIRBAG_ENBL COM_V_ACCM_FUEL_MX COM_M_CLCH_TQ_SP COM_X_CLCH_TQ_ESPD COM_V_ESPD_SYNC_TM_CAN COM_V_IND_TYP_TQ_CAN COM_V_CAN_EDITION COM_V_NUM1 COM_V_NUM2 COM_V_NUM3 COM_V_NUM4 COM_V_NUM5 COM_V_NUM6 COM_V_NUM7 COM_V_NUM8 COM_V_MIN_PPS_OVR_CRU COM_V_CRU_VSPD_STP COM_V_CAN_TQ_CHNG_DLY_INC_END COM_V_TIRE_RAD /end DEF_CHARACTERISTIC
 /begin OUT_MEASUREMENT com_ac_t com_ac_t_vld com_vspd_invld com_fan_ctrl_req_st com_tcu_tcc_actv /end OUT_MEASUREMENT
/end FUNCTION
/begin FUNCTION can_tx "tx"
 /begin DEF_CHARACTERISTIC CAN_V_TX_00_ID CAN_V_TX_00_DLC CAN_V_TX_00_PERIOD CAN_V_TX_00_CHN CAN_V_TX_01_ID CAN_V_TX_01_DLC CAN_V_TX_01_PERIOD CAN_V_TX_01_CHN CAN_V_TX_02_ID CAN_V_TX_02_DLC CAN_V_TX_02_PERIOD CAN_V_TX_02_CHN CAN_V_TX_03_ID CAN_V_TX_03_DLC CAN_V_TX_03_PERIOD CAN_V_TX_03_CHN CAN_V_TX_04_ID CAN_V_TX_04_DLC CAN_V_TX_04_PERIOD CAN_V_TX_04_CHN CAN_V_TX_05_ID CAN_V_TX_05_DLC CAN_V_TX_05_PERIOD CAN_V_TX_05_CHN CAN_V_TX_06_ID CAN_V_TX_06_DLC CAN_V_TX_06_PERIOD CAN_V_TX_06_CHN CAN_V_TX_07_ID CAN_V_TX_07_DLC CAN_V_TX_07_PERIOD CAN_V_TX_07_CHN CAN_V_TX_08_ID CAN_V_TX_08_DLC CAN_V_TX_08_PERIOD CAN_V_TX_08_CHN CAN_V_TX_09_ID CAN_V_TX_09_DLC CAN_V_TX_09_PERIOD CAN_V_TX_09_CHN CAN_V_TX_10_ID CAN_V_TX_10_DLC CAN_V_TX_10_PERIOD CAN_V_TX_10_CHN CAN_V_TX_11_ID CAN_V_TX_11_DLC CAN_V_TX_11_PERIOD CAN_V_TX_11_CHN CAN_V_TX_12_ID CAN_V_TX_12_DLC CAN_V_TX_12_PERIOD CAN_V_TX_12_CHN CAN_V_TX_13_ID CAN_V_TX_13_DLC CAN_V_TX_13_PERIOD CAN_V_TX_13_CHN CAN_V_TX_14_ID CAN_V_TX_14_DLC CAN_V_TX_14_PERIOD CAN_V_TX_14_CHN CAN_V_TX_15_ID CAN_V_TX_15_DLC CAN_V_TX_15_PERIOD CAN_V_TX_15_CHN CAN_TX_CRUZ_EN_LAMP_ID CAN_TX_CRUZ_EN_LAMP_BYTE_LOC CAN_TX_CRUZ_EN_LAMP_BIT_LOC CAN_TX_CRUZ_EN_LAMP_BIT_LEN CAN_TX_CRUZ_EN_LAMP_TABLE CAN_TX_CRUZ_SW_ID CAN_TX_CRUZ_SW_BYTE_LOC CAN_TX_CRUZ_SW_BIT_LOC CAN_TX_CRUZ_SW_BIT_LEN CAN_TX_CRUZ_SW_TABLE CAN_TX_CRUZ_ACTV_ID CAN_TX_CRUZ_ACTV_BYTE_LOC CAN_TX_CRUZ_ACTV_BIT_LOC CAN_TX_CRUZ_ACTV_BIT_LEN CAN_TX_CRUZ_ACTV_TABLE CAN_TX_ENG_PROT_ACTV_ID CAN_TX_ENG_PROT_ACTV_BYTE_LOC CAN_TX_ENG_PROT_ACTV_BIT_LOC CAN_TX_ENG_PROT_ACTV_BIT_LEN CAN_TX_ENG_PROT_ACTV_TABLE CAN_TX_SVS_LAMP_ID CAN_TX_SVS_LAMP_BYTE_LOC CAN_TX_SVS_LAMP_BIT_LOC CAN_TX_SVS_LAMP_BIT_LEN CAN_TX_SVS_LAMP_TABLE CAN_TX_MIL_LAMP_ID CAN_TX_MIL_LAMP_BYTE_LOC CAN_TX_MIL_LAMP_BIT_LOC CAN_TX_MIL_LAMP_BIT_LEN CAN_TX_MIL_LAMP_TABLE CAN_TX_LIMP_ACTV_ID CAN_TX_LIMP_ACTV_BYTE_LOC CAN_TX_LIMP_ACTV_BIT_LOC CAN_TX_LIMP_ACTV_BIT_LEN CAN_TX_LIMP_ACTV_TABLE CAN_TX_AC_RLY_ID CAN_TX_AC_RLY_BYTE_LOC CAN_TX_AC_RLY_BIT_LOC CAN_TX_AC_RLY_BIT_LEN CAN_TX_AC_RLY_TABLE CAN_TX_ECT_FL_ACTV_ID CAN_TX_ECT_FL_ACTV_BYTE_LOC CAN_TX_ECT_FL_ACTV_BIT_LOC CAN_TX_ECT_FL_ACTV_BIT_LEN CAN_TX_ECT_FL_ACTV_TABLE CAN_TX_IAT_FL_ACTV_ID CAN_TX_IAT_FL_ACTV_BYTE_LOC CAN_TX_IAT_FL_ACTV_BIT_LOC CAN_TX_IAT_FL_ACTV_BIT_LEN CAN_TX_IAT_FL_ACTV_TABLE CAN_TX_MAP_FL_ACTV_ID CAN_TX_MAP_FL_ACTV_BYTE_LOC CAN_TX_MAP_FL_ACTV_BIT_LOC CAN_TX_MAP_FL_ACTV_BIT_LEN CAN_TX_MAP_FL_ACTV_TABLE CAN_TX_TQ_EST_FL_ID CAN_TX_TQ_EST_FL_BYTE_LOC CAN_TX_TQ_EST_FL_BIT_LOC CAN_TX_TQ_EST_FL_BIT_LEN CAN_TX_TQ_EST_FL_TABLE CAN_TX_TCU_TQ_REQ_AVLB_ID CAN_TX_TCU_TQ_REQ_AVLB_BYTE_LOC CAN_TX_TCU_TQ_REQ_AVLB_BIT_LOC CAN_TX_TCU_TQ_REQ_AVLB_BIT_LEN CAN_TX_TCU_TQ_REQ_AVLB_TABLE CAN_TX_ESP_TQ_REQ_AVLB_ID CAN_TX_ESP_TQ_REQ_AVLB_BYTE_LOC CAN_TX_ESP_TQ_REQ_AVLB_BIT_LOC CAN_TX_ESP_TQ_REQ_AVLB_BIT_LEN CAN_TX_ESP_TQ_REQ_AVLB_TABLE CAN_TX_ENG_TQ_RDC_EN_ID CAN_TX_ENG_TQ_RDC_EN_BYTE_LOC CAN_TX_ENG_TQ_RDC_EN_BIT_LOC CAN_TX_ENG_TQ_RDC_EN_BIT_LEN CAN_TX_ENG_TQ_RDC_EN_TABLE CAN_TX_TRIP_ENG_RUN_ID CAN_TX_TRIP_ENG_RUN_BYTE_LOC CAN_TX_TRIP_ENG_RUN_BIT_LOC CAN_TX_TRIP_ENG_RUN_BIT_LEN CAN_TX_TRIP_ENG_RUN_TABLE CAN_TX_ENG_WARM_UP_ID CAN_TX_ENG_WARM_UP_BYTE_LOC CAN_TX_ENG_WARM_UP_BIT_LOC CAN_TX_ENG_WARM_UP_BIT_LEN CAN_TX_ENG_WARM_UP_TABLE CAN_TX_BAT_VLT_FL_ACTV_ID CAN_TX_BAT_VLT_FL_ACTV_BYTE_LOC CAN_TX_BAT_VLT_FL_ACTV_BIT_LOC CAN_TX_BAT_VLT_FL_ACTV_BIT_LEN CAN_TX_BAT_VLT_FL_ACTV_TABLE CAN_TX_TPS_FL_ACTV_ID CAN_TX_TPS_FL_ACTV_BYTE_LOC CAN_TX_TPS_FL_ACTV_BIT_LOC CAN_TX_TPS_FL_ACTV_BIT_LEN CAN_TX_TPS_FL_ACTV_TABLE CAN_TX_PPS_FL_ACTV_ID CAN_TX_PPS_FL_ACTV_BYTE_LOC CAN_TX_PPS_FL_ACTV_BIT_LOC CAN_TX_PPS_FL_ACTV_BIT_LEN CAN_TX_PPS_FL_ACTV_TABLE CAN_TX_BRK_PEDL_ACTV_ID CAN_TX_BRK_PEDL_ACTV_BYTE_LOC CAN_TX_BRK_PEDL_ACTV_BIT_LOC CAN_TX_BRK_PEDL_ACTV_BIT_LEN CAN_TX_BRK_PEDL_ACTV_TABLE CAN_TX_BRK_LAMP_ACTV_ID CAN_TX_BRK_LAMP_ACTV_BYTE_LOC CAN_TX_BRK_LAMP_ACTV_BIT_LOC CAN_TX_BRK_LAMP_ACTV_BIT_LEN CAN_TX_BRK_LAMP_ACTV_TABLE CAN_TX_CRK_FL_ACTV_ID CAN_TX_CRK_FL_ACTV_BYTE_LOC CAN_TX_CRK_FL_ACTV_BIT_LOC CAN_TX_CRK_FL_ACTV_BIT_LEN CAN_TX_CRK_FL_ACTV_TABLE CAN_TX_VSS_FL_ACTV_ID CAN_TX_VSS_FL_ACTV_BYTE_LOC CAN_TX_VSS_FL_ACTV_BIT_LOC CAN_TX_VSS_FL_ACTV_BIT_LEN CAN_TX_VSS_FL_ACTV_TABLE CAN_TX_ENG_STRT_EN_ID CAN_TX_ENG_STRT_EN_BYTE_LOC CAN_TX_ENG_STRT_EN_BIT_LOC CAN_TX_ENG_STRT_EN_BIT_LEN CAN_TX_ENG_STRT_EN_TABLE CAN_TX_ENG_STRT_FL_ID CAN_TX_ENG_STRT_FL_BYTE_LOC CAN_TX_ENG_STRT_FL_BIT_LOC CAN_TX_ENG_STRT_FL_BIT_LEN CAN_TX_ENG_STRT_FL_TABLE CAN_TX_IMMO_STRT_EN_ID CAN_TX_IMMO_STRT_EN_BYTE_LOC CAN_TX_IMMO_STRT_EN_BIT_LOC CAN_TX_IMMO_STRT_EN_BIT_LEN CAN_TX_IMMO_STRT_EN_TABLE CAN_TX_IDL_EN_ID CAN_TX_IDL_EN_BYTE_LOC CAN_TX_IDL_EN_BIT_LOC CAN_TX_IDL_EN_BIT_LEN CAN_TX_IDL_EN_TABLE CAN_TX_ENG_FCO_ID CAN_TX_ENG_FCO_BYTE_LOC CAN_TX_ENG_FCO_BIT_LOC CAN_TX_ENG_FCO_BIT_LEN CAN_TX_ENG_FCO_TABLE CAN_TX_KEY_ON_ID CAN_TX_KEY_ON_BYTE_LOC CAN_TX_KEY_ON_BIT_LOC CAN_TX_KEY_ON_BIT_LEN CAN_TX_KEY_ON_TABLE CAN_TX_CAT_HT_ACTV_ID CAN_TX_CAT_HT_ACTV_BYTE_LOC CAN_TX_CAT_HT_ACTV_BIT_LOC CAN_TX_CAT_HT_ACTV_BIT_LEN CAN_TX_CAT_HT_ACTV_TABLE CAN_TX_IMMO_INSTL_ID CAN_TX_IMMO_INSTL_BYTE_LOC CAN_TX_IMMO_INSTL_BIT_LOC CAN_TX_IMMO_INSTL_BIT_LEN CAN_TX_IMMO_INSTL_TABLE CAN_TX_FULL_PEDAL_ID CAN_TX_FULL_PEDAL_BYTE_LOC CAN_TX_FULL_PEDAL_BIT_LOC CAN_TX_FULL_PEDAL_BIT_LEN CAN_TX_FULL_PEDAL_TABLE CAN_TX_HYB_STP_ACTV_ID CAN_TX_HYB_STP_ACTV_BYTE_LOC CAN_TX_HYB_STP_ACTV_BIT_LOC CAN_TX_HYB_STP_ACTV_BIT_LEN CAN_TX_HYB_STP_ACTV_TABLE CAN_TX_SS_LAMP_ACTV_ID CAN_TX_SS_LAMP_ACTV_BYTE_LOC CAN_TX_SS_LAMP_ACTV_BIT_LOC CAN_TX_SS_LAMP_ACTV_BIT_LEN CAN_TX_SS_LAMP_ACTV_TABLE CAN_TX_CRUZ_ST_ID CAN_TX_CRUZ_ST_BYTE_LOC CAN_TX_CRUZ_ST_BIT_LOC CAN_TX_CRUZ_ST_BIT_LEN CAN_TX_CRUZ_ST_TABLE CAN_TX_ENG_ST_ID CAN_TX_ENG_ST_BYTE_LOC CAN_TX_ENG_ST_BIT_LOC CAN_TX_ENG_ST_BIT_LEN CAN_TX_ENG_ST_TABLE /end DEF_CHARACTERISTIC
 /begin OUT_MEASUREMENT /end OUT_MEASUREMENT
/end FUNCTION
/begin RECORD_LAYOUT __UBYTE_S FNC_VALUES 1 UBYTE COLUMN_DIR DIRECT /end RECORD_LAYOUT
/begin RECORD_LAYOUT __UWORD_S FNC_VALUES 1 UWORD COLUMN_DIR DIRECT /end RECORD_LAYOUT
/begin RECORD_LAYOUT __ULONG_S FNC_VALUES 1 ULONG COLUMN_DIR DIRECT /end RECORD_LAYOUT
/begin RECORD_LAYOUT __SWORD_S FNC_VALUES 1 SWORD COLUMN_DIR DIRECT /end RECORD_LAYOUT
/begin RECORD_LAYOUT SSV__UWORD_S AXIS_PTS_X 1 UWORD INDEX_INCR DIRECT /end RECORD_LAYOUT
/end MODULE
/end PROJECT
